ENTRY &ARG0

GLOBAL &HLOS_TYPE
GLOBAL &TZ_BUILDID
GLOBAL &T32_VER_PATH_QIPL
GLOBAL &T32_VER
GLOBAL &CHIPID
GLOBAL &MODEM_BUILDID
GLOBAL &T32_VER_PATH_TEX
GLOBAL &T32_VER_PATH_SD
GLOBAL &BDWLAN07_BINARY
GLOBAL &MPSS_ELF
GLOBAL &BDWLANB0B_BINARY
GLOBAL &CPE_ELF
GLOBAL &BDWLANB30_BINARY
GLOBAL &KEYMASTER_BINARY
GLOBAL &BDWLAN34_BINARY
GLOBAL &IPA_FWS_ELF
GLOBAL &BDWLAN32_BINARY
GLOBAL &MODEM_WLAN_PD_ELFLOADER
GLOBAL &BDWLANB105_BINARY
GLOBAL &BOOT_CONFIG
GLOBAL &BDWLAN33_BINARY
GLOBAL &STORSEC_BINARY
GLOBAL &APPS_ELF
GLOBAL &BDWLANB107_BINARY
GLOBAL &MBA_BINARY
GLOBAL &MPSS_BINARY
GLOBAL &CMNLIB_BINARY
GLOBAL &BDWLAN36_BINARY
GLOBAL &APPSBOOT_BINARY
GLOBAL &MBA_ELF
GLOBAL &BDWLAN10C_BINARY
GLOBAL &GFX_ELF
GLOBAL &BDWLANB0A_BINARY
GLOBAL &CMNLIB64_BINARY
GLOBAL &BDWLANB3A_BINARY
GLOBAL &BDWLAN37_BINARY
GLOBAL &QSEE_ELF
GLOBAL &BDWLANB108_BINARY
GLOBAL &AOP_ELF
GLOBAL &HYP_BINARY
GLOBAL &MODEM_WLAN_PD_SHAREDOBJ
GLOBAL &MPSS_QDB_BINARY
GLOBAL &APPS_BINARY
GLOBAL &VENUS_ELF
GLOBAL &BDWLANB109_BINARY
GLOBAL &BDWLAN_BINARY
GLOBAL &QUP_BINARY
GLOBAL &BDWLAN38_BINARY
GLOBAL &BDWLAN09_BINARY
GLOBAL &MON_ELF
GLOBAL &BDWLAN31_BINARY
GLOBAL &BDWLAN30_BINARY
GLOBAL &BDWLANB0E_BINARY
GLOBAL &CDSP_BINARY
GLOBAL &BDWLAN14_BINARY
GLOBAL &TZ_BINARY
GLOBAL &BDWLANB106_BINARY
GLOBAL &BDWLAN04_BINARY
GLOBAL &BOOT_ELF
GLOBAL &TZDEVCFG_BINARY
GLOBAL &BDWLANB0F_BINARY
GLOBAL &WLAN_BINARY
GLOBAL &AOP_BINARY
GLOBAL &BDWLAN15_BINARY
GLOBAL &BDWLAN35_BINARY
GLOBAL &fingerprint64_BINARY
GLOBAL &BDWLANB3F_BINARY
GLOBAL &CPE_BINARY
GLOBAL &ADSP_PD2_ELF
GLOBAL &VENUS_BINARY
GLOBAL &BDWLANB104_BINARY
GLOBAL &BDWLANB0D_BINARY
GLOBAL &ADSP_BINARY
GLOBAL &BDWLANB102_BINARY
GLOBAL &HYP_ELF
GLOBAL &ADSP_ELF
GLOBAL &CDSP_ELF
GLOBAL &BOOT_BINARY

IF ("&ARG0"=="asic")
(
	&PRODUCT_FLAVOR="asic"
	&HLOS_TYPE="LA"
	&TZ_BUILDID="XAWAANAA"
	&T32_VER_PATH_QIPL="//qctdfsrt/prj/vlsi/vlsi_verify/vi_tools/Tools/Trace32/LT170406"
	&T32_VER="LT170406"
	&CHIPID="qcs605"
	&MODEM_BUILDID="sdm710.gps.prod"
	&T32_VER_PATH_TEX="//western/qdsp6_sw_release/TRACE32/Run/LT170406"
	&T32_VER_PATH_SD="//batman/qdsp6_sw_release/TRACE32/Run/LT170406"
	&BDWLAN07_BINARY="wlan_proc/wlan/halphy_tools/host/bdfUtil/qca61x0/bdf/bdwlan.b07"
	&MPSS_ELF="modem_proc/build/ms/M670sdm710.gps.prodQ00025_WLAN_ELF_LOADER.elf"
	&MPSS_ELF="modem_proc/build/ms/M670sdm710.gps.prodQ00025_ELF_LOADER_reloc.elf"
	&MPSS_ELF="modem_proc/build/ms/M670sdm710.gps.prodQ00025.elf"
	&MPSS_ELF="modem_proc/build/ms/M670sdm710.gps.prodQ00025_ELF_LOADER.elf"
	&MPSS_ELF="modem_proc/build/ms/M670sdm710.gps.prodQ00025_reloc.elf"
	&BDWLANB0B_BINARY="wlan_proc/wlan/halphy_tools/host/bdfUtil/qca61x0/bdf/bdwlan.b0b"
	&CPE_ELF="wdsp_proc/build/bsp/cpe_link/build/AAAAAAAA/CPE_PROC_IMG_AAAAAAAAQ.elf"
	&CPE_ELF="cpe_proc/build/bsp/cpe_link/build/AAAAAAAA/CPE_PROC_IMG_AAAAAAAAQ.elf"
	&BDWLANB30_BINARY="wlan_proc/wlan/halphy_tools/host/bdfUtil/qca61x0/bdf/bdwlan.b30"
	&KEYMASTER_BINARY="trustzone_images/build/ms/bin/XAWAANAA/keymaster64.mbn"
	&BDWLAN34_BINARY="wlan_proc/wlan/halphy_tools/host/bdfUtil/qca61x0/bdf/bdwlan.b34"
	&BDWLAN32_BINARY="wlan_proc/wlan/halphy_tools/host/bdfUtil/qca61x0/bdf/bdwlan.b32"
	&MODEM_WLAN_PD_ELFLOADER="modem_proc/core/bsp/elf_loader_wlan/build/sdm710.gps.prod/ELF_LOADER_IMG_sdm710.gps.prodQ.elf"
	&BDWLANB105_BINARY="wlan_proc/wlan/halphy_tools/host/bdfUtil/qca61x0/bdf/bdwlan.105"
	&BOOT_CONFIG="boot_images/QcomPkg/SDM670Pkg/Bin/670/LA/RELEASE/xbl_config.elf"
	&BDWLAN33_BINARY="wlan_proc/wlan/halphy_tools/host/bdfUtil/qca61x0/bdf/bdwlan.b33"
	&STORSEC_BINARY="trustzone_images/build/ms/bin/XAWAANAA/storsec.mbn"
	&APPS_ELF="out/target/product/qcs605/obj/KERNEL_OBJ/vmlinux"
	&BDWLANB107_BINARY="wlan_proc/wlan/halphy_tools/host/bdfUtil/qca61x0/bdf/bdwlan.107"
	&MBA_BINARY="modem_proc/build/ms/bin/sdm710.gps.prod/mba.mbn"
	&MPSS_BINARY="modem_proc/build/ms/bin/sdm710.gps.prod/qdsp6sw.mbn"
	&CMNLIB_BINARY="trustzone_images/build/ms/bin/XAWAANAA/cmnlib.mbn"
	&BDWLAN36_BINARY="wlan_proc/wlan/halphy_tools/host/bdfUtil/qca61x0/bdf/bdwlan.b36"
	&APPSBOOT_BINARY="out/target/product/qcs605/abl.elf"
	&MBA_ELF="modem_proc/core/bsp/mba_img/build/sdm710.gps.prod/MBA_CORE_IMG_sdm710.gps.prodQ.elf"
	&BDWLAN10C_BINARY="wlan_proc/wlan/halphy_tools/host/bdfUtil/qca61x0/bdf/bdwlan.10c"
	&GFX_ELF="out/target/product/qcs605/vendor/firmware/a615_zap.elf"
	&BDWLANB0A_BINARY="wlan_proc/wlan/halphy_tools/host/bdfUtil/qca61x0/bdf/bdwlan.b0a"
	&CMNLIB64_BINARY="trustzone_images/build/ms/bin/XAWAANAA/cmnlib64.mbn"
	&BDWLANB3A_BINARY="wlan_proc/wlan/halphy_tools/host/bdfUtil/qca61x0/bdf/bdwlan.b3a"
	&BDWLAN37_BINARY="wlan_proc/wlan/halphy_tools/host/bdfUtil/qca61x0/bdf/bdwlan.b37"
	&QSEE_ELF="trustzone_images/ssg/bsp/qsee/build/XAWAANAA/qsee.elf"
	&BDWLANB108_BINARY="wlan_proc/wlan/halphy_tools/host/bdfUtil/qca61x0/bdf/bdwlan.108"
	&AOP_ELF="aop_proc/core/bsp/aop/build/670pm670/AOP_AAAAANAZO.elf"
	&HYP_BINARY="trustzone_images/build/ms/bin/XAWAANAA/hyp.mbn"
	&MODEM_WLAN_PD_SHAREDOBJ="modem_proc/core/bsp/core_user_pic/build/sdm710.gps.prod/CORE_USER.so"
	&MPSS_QDB_BINARY="modem_proc/build/ms/bin/sdm710.gps.prod/qdsp6m.qdb"
	&APPS_BINARY="out/target/product/qcs605/boot.img"
	&VENUS_ELF="venus_proc/build/bsp/asic/build/PROD/venus.elf"
	&BDWLANB109_BINARY="wlan_proc/wlan/halphy_tools/host/bdfUtil/qca61x0/bdf/bdwlan.109"
	&BDWLAN_BINARY="wlan_proc/wlan/halphy_tools/host/bdfUtil/qca61x0/bdf/bdwlan.bin"
	&QUP_BINARY="common/core_qupv3fw/sdm710/qupv3fw.elf"
	&BDWLAN38_BINARY="wlan_proc/wlan/halphy_tools/host/bdfUtil/qca61x0/bdf/bdwlan.b38"
	&BDWLAN09_BINARY="wlan_proc/wlan/halphy_tools/host/bdfUtil/qca61x0/bdf/bdwlan.b09"
	&MON_ELF="trustzone_images/ssg/bsp/monitor/build/XAWAANAA/mon.elf"
	&BDWLAN31_BINARY="wlan_proc/wlan/halphy_tools/host/bdfUtil/qca61x0/bdf/bdwlan.b31"
	&BDWLAN30_BINARY="wlan_proc/wlan/halphy_tools/host/bdfUtil/qca61x0/bdf/bdwlan.b30"
	&BDWLANB0E_BINARY="wlan_proc/wlan/halphy_tools/host/bdfUtil/qca61x0/bdf/bdwlan.b0e"
	&CDSP_BINARY="cdsp_proc/obj/qdsp6v5_ReleaseG/670.cdsp.prod/cdsp.mbn"
	&BDWLAN14_BINARY="wlan_proc/wlan/halphy_tools/host/bdfUtil/qca61x0/bdf/bdwlan.b14"
	&TZ_BINARY="trustzone_images/build/ms/bin/XAWAANAA/tz.mbn"
	&BDWLANB106_BINARY="wlan_proc/wlan/halphy_tools/host/bdfUtil/qca61x0/bdf/bdwlan.106"
	&BDWLAN04_BINARY="wlan_proc/wlan/halphy_tools/host/bdfUtil/qca61x0/bdf/bdwlan.b04"
	&TZDEVCFG_BINARY="trustzone_images/build/ms/bin/XAWAANAA/devcfg_qcs605.mbn"
	&BDWLANB0F_BINARY="wlan_proc/wlan/halphy_tools/host/bdfUtil/qca61x0/bdf/bdwlan.b0f"
	&WLAN_BINARY="wlan_proc/build/ms/bin/QCAHLAWPDL/signed/wlanmdsp.mbn"
	&AOP_BINARY="aop_proc/build/ms/bin/AAAAANAZO/670/pm670/aop.mbn"
	&BDWLAN15_BINARY="wlan_proc/wlan/halphy_tools/host/bdfUtil/qca61x0/bdf/bdwlan.b15"
	&BDWLAN35_BINARY="wlan_proc/wlan/halphy_tools/host/bdfUtil/qca61x0/bdf/bdwlan.b35"
	&fingerprint64_BINARY="trustzone_images/build/ms/bin/XAWAANAA/fingerpr.mbn"
	&BDWLANB3F_BINARY="wlan_proc/wlan/halphy_tools/host/bdfUtil/qca61x0/bdf/bdwlan.b3f"
	&CPE_BINARY="cpe_proc/build/ms/bin/AAAAAAAAQ/cpe_9335.mbn"
	&ADSP_PD2_ELF="adsp_proc/build/ms/AUDIO_670.adsp.prodQ.elf"
	&VENUS_BINARY="venus_proc/build/bsp/asic/build/PROD/mbn/reloc/socCheck/signed/venus.mbn"
	&BDWLANB104_BINARY="wlan_proc/wlan/halphy_tools/host/bdfUtil/qca61x0/bdf/bdwlan.104"
	&BDWLANB0D_BINARY="wlan_proc/wlan/halphy_tools/host/bdfUtil/qca61x0/bdf/bdwlan.b0d"
	&ADSP_BINARY="adsp_proc/obj/qdsp6v5_ReleaseG/670.adsp.prod/adsp.mbn"
	&BDWLANB102_BINARY="wlan_proc/wlan/halphy_tools/host/bdfUtil/qca61x0/bdf/bdwlan.102"
	&HYP_ELF="trustzone_images/core/bsp/hypervisor/build/XAWAANAA/hyp.elf"
	&ADSP_ELF="adsp_proc/build/ms/ROOT_670.adsp.prodQ.elf"
	&CDSP_ELF="cdsp_proc/build/ms/ROOT_670.cdsp.prodQ.elf"
	&BOOT_BINARY="boot_images/QcomPkg/SDM670Pkg/Bin/670/LA/RELEASE/xbl.elf"
)
ENDDO
//============================================================================
//  Name:                                                                     
//    std_sessioncfg_apps.cmm 
//
//  Description:                                                              
//    Script to setup sub-system level features
//                                                                            
// Copyright (c) 2012 - 2016 by Qualcomm Technologies, Incorporated.  All Rights Reserved.        
//
//
//
//
//                      EDIT HISTORY FOR FILE
//  This section contains comments describing changes made to the module.
//  Notice that changes are listed in reverse chronological order.
//
// when       who             what, where, why
// --------   ---             ---------------------------------------------------------
// 12/01/2017 JBILLING        Particulars added for sdx24
// 07/26/2017 JBILLING        Particulars added for sdx50
// 11/18/2016 JBILLING        Updated for sdx20
// 05/02/2016 JBILLING        Internal/external menu scripts
// 04/15/2016 JBILLING        Transition to one menu file
// 03/16/2016 JBILLING        Modified for bringuptool
// 07/10/2012 AJCheriyan      Created for B-family 
//

//**************************************************
//                  Declarations 
//**************************************************
LOCAL &ArgumentLine
LOCAL &UTILITY &Remainder
LOCAL &targetprocessor


GLOBAL &HLOS

IF "&HLOS"==""
(
    IF (STRING.SCAN(STR.UPR("&CHIPSET"),"MDM",0)!=-1)||(STRING.SCAN(STR.UPR("&CHIPSET"),"SDX",0)!=-1)
    (
        &HLOS="MN"
    )
    ELSE
    (
        &HLOS="LA"
    )
)
//**************************************************
//                  Arguments Passed 
//**************************************************
ENTRY %LINE &ArgumentLine


//**************************************************
//                  Local Variables
//**************************************************
LOCAL &local_image &local_IMAGE &local_HWBLOCKNAME
&local_image="apps"
&local_IMAGE="APPS"
&local_HWBLOCKNAME="&APPS_HW_BLOCK_NAME"
//Note that &APPS_HW_BLOCK_NAME is defined in DAP_APPS.cmm
//**************************************************
//                  Basic Options Check
//**************************************************



    &SUBROUTINE="MAIN"
    LOCAL &rvalue
    // This should be created by some top level script. The setupenv for each proc would
    // set this up
     AREA.SELECT
    // Call the required utility
    GOSUB &SUBROUTINE &ArgumentLine
    ENTRY %LINE &rvalue

    GOSUB EXIT &rvalue





//**************************************************
//
// @Function: MAIN
// @Description : Main logic of the script
//
//**************************************************
MAIN:

    LOCAL &Option &Target &Image &buildroot &Processor_Root_Name &buildid
    ENTRY &Option &Target &Image &buildroot &Processor_Root_Name &buildid

    LOCAL &FILE

    // Clear the windows
    //WINCLEAR
    //Clear out the current menu
    MENU.RESET
    
    do std_versionchecker

    IF "&Target"==""
    &Target="&CHIPSET"
    IF "&Target"==""
    (
        do std_fatalexit SYSTEM "Error! std_sessioncfg_&local_image - CHISPET not defined"
    )
    
    IF "&Option"=="INIT"
    (
        do std_setupenv.cmm
    )
    
    GOSUB GENERAL_HW_SPECIFIC_MENU_SETUP &Target
    
    
    GOSUB IMAGE_SPECIFIC_MENU_SETUP &Target &Image
    
    
    
    ////////////////////////////////////////////////////////////////////////////////////////////
    //      If we were called from a specific image, then load up context from that image
    GOSUB LOADBUILDCONTEXT &Image &buildroot &Processor_Root_Name &buildid
    
    
    ///////////////////////////////////////////////
    //      Finally, the general stuff that we want to show up after all other menu items
    //setup core apps options
    IF ("&T32PROP"!="sim")
    (
        LOCAL &commandscript
        &commandscript="std_commands_"+"&local_image"+"_"+"&CHIPSET"+".men"
        DO std_utils EXECUTESCRIPT EXIT &METASCRIPTSDIR/&local_image/&CHIPSET/&commandscript
    ) 
    
    //Clear out all the stuff on screen
    
    IF "&Option"=="INIT"
    (
        WINCLEAR
        //Display help menus
        LOCAL &menuscript1 &menuscript2
        &menuscript1="std_rootcmm_menu_"+"&local_HWBLOCKNAME"+"-"+"&HLOS"+"_internal"+".cmm"
        &menuscript2="std_rootcmm_menu_"+"&local_HWBLOCKNAME"+"-"+"&HLOS"+"_external"+".cmm"
        IF FILE.EXIST("&METATOOLSDIR/&Target/&menuscript1")
        (
            do std_utils EXECUTESCRIPT EXIT &METATOOLSDIR/&Target/&menuscript1 HELP
        )
        ELSE
        (
            do std_utils EXECUTESCRIPT EXIT &METATOOLSDIR/&Target/&menuscript2 HELP
        )
        
        do std_versionchecker
    )
    
    
    RETURN SUCCESS
    
    

///////////////////////////////////////////////
//      General setup 
//      This is image/sw independent
//      Scripts that are focused on hardware should be here
///////////////////////////////////////////////////
GENERAL_HW_SPECIFIC_MENU_SETUP:
    // Do common environment setup
    

    //FIXME - move this to cmmbuilder
    IF ("&Target"=="MSM8996")
    (
        //Setup apps register options
        &FILE="&METASCRIPTSDIR"+"/apps/&CHIPSET/hydra/hydra.men"
        if FILE.EXIST("&FILE")
        (
            &PATH="&METASCRIPTSDIR"+"/apps/&CHIPSET/hydra"
            PATH + "&PATH"
            do std_utils EXECUTESCRIPT EXIT &FILE
        )
    )

    LOCAL &menuscript1 &menuscript2
    &menuscript1="std_rootcmm_menu_"+"&local_HWBLOCKNAME"+"-"+"&HLOS"+"_internal"+".cmm"
    &menuscript2="std_rootcmm_menu_"+"&local_HWBLOCKNAME"+"-"+"&HLOS"+"_external"+".cmm"
    //Set up the hardware specific menu
    IF FILE.EXIST("&METATOOLSDIR/&Target/&menuscript1")
    (
        
        do std_utils EXECUTESCRIPT EXIT &METATOOLSDIR/&Target/&menuscript1 CREATEMENU

        do std_utils EXECUTESCRIPT EXIT &METATOOLSDIR/&Target/&menuscript1 ADDMENUBUTTONS
    )
    ELSE IF FILE.EXIST("&METATOOLSDIR/&Target/&menuscript2")
    (
        do std_utils EXECUTESCRIPT EXIT &METATOOLSDIR/&Target/&menuscript2 CREATEMENU

        do std_utils EXECUTESCRIPT EXIT &METATOOLSDIR/&Target/&menuscript2 ADDMENUBUTTONS
    )
    ELSE
    (
        //WINPOS 0. 0. 80. 3.
        //AREA
        //PRINT " "
        //PRINT "Warning - could not find menu script for &local_HWBLOCKNAME"
        //PRINT " "
    )
    
    RETURN
    
    
    
///////////////////////////////////////////////
//      Image specific setup 
//      This is image/sw DEPENDENT
//      Scripts that are focused on software should be here
///////////////////////////////////////////////////
IMAGE_SPECIFIC_MENU_SETUP:
    LOCAL &Target &Image
    ENTRY &Target &Image

    IF "&Image"!=""
    (

        IF ("&HLOS"=="LA")
        (
            // Load the LINUX menu file
             &FILE=OS.PSD()+"/demo/arm/kernel/linux/linux-3.x/linux.men"
            do std_utils EXECUTESCRIPT EXIT &FILE
        )
    
    )
    //Load context menu for HLOS by default
    ELSE IF ("&HLOS"!="")||("&HLOS_TYPE"!="")
    (
        IF ("&HLOS_TYPE"!="")
        (
            &HLOS="&HLOS_TYPE"
        )
        

        IF FILE.EXIST(~~\demo\arm64\kernel\linux\linux-3.x\linux3.t32)&&(("&HLOS"=="LA")||("&HLOS"=="LE"))
        (
            // Load the LINUX menu file
            do std_utils EXECUTESCRIPT EXIT ~~\demo\arm64\kernel\linux\linux-3.x\linux3.t32
            do std_utils EXECUTESCRIPT EXIT ~~\demo\arm64\kernel\linux\linux-3.x\linux.men
        )
    
        
    )
    
    RETURN
    
///////////////////////////////////////////////
//
//      LOADBUILDCONTEXT
//          Loads context information from specific image build
//
//
///////////////////////////////////////////////
LOADBUILDCONTEXT:
    LOCAL &image &buildroot &Processor_Root_Name &buildid
    ENTRY &image &buildroot &Processor_Root_Name &buildid
    //If this is being called from a loadsyms directory
    IF (OS.DIR("&buildroot"))&&("&Processor_Root_Name"!="")&&("&buildid"!="")
    (
    

        LOCAL &scriptpath
        IF OS.DIR("&buildroot/&Processor_Root_Name/core/products/scripts/&buildid")&&("&buildid"!="")
        (
            &scriptpath="&buildroot/&Processor_Root_Name/core/products/scripts/&buildid"
        )
        ELSE
        (
            do std_utils GET_SCRIPT_PATH EXIT &buildroot/&Processor_Root_Name/core/products/scripts std_extensions.cmm
            ENTRY &scriptpath
        )
        
        //Reasons to skip out before resetting the menu
        //IF scripts weren't found or IF (it's a TN build and OSAM isn't present), return
        IF (!OS.DIR("&scriptpath"))||("&scriptpath"=="")||(("&HLOS"=="MN"||"&HLOS"=="TN")&&(!FILE.EXIST(&buildroot\&Processor_Root_Name\build\ms\l4.men)))
        (
            //PRINT "Warning! Could not find context menu scripts for this image! (std_extensions, std_toolsconfig etc.)"
            RETURN SUCCESS //break if build doesn't have scripts populated.
        )
        ELSE
        (
            IF (("&HLOS"=="MN"||"&HLOS"=="TN")) //&&("&T32PROP"=="sim")) //File check was done above
            (
                //Workaround until std_toolsconfig has needed scripts
                IF !((STRING.SCAN("&CHIPSET","sdx50",0)!=-1)||STRING.SCAN("&CHIPSET","sdx24",0)!=-1)
                (
                    do std_utils EXECUTESCRIPT EXIT &buildroot\&Processor_Root_Name\build\ms\l4.men
                    do std_utils EXECUTESCRIPT EXIT &buildroot\&Processor_Root_Name\build\ms\l4.t32
                )
                //do std_utils EXECUTESCRIPT EXIT &buildroot/&Processor_Root_Name/core/products/std_buildconfig.cmm
            )
            // Load the extensions for the system
            do std_utils EXECUTESCRIPT EXIT &scriptpath/std_extensions.cmm                
            // Load the relative path info for the build
            do std_utils EXECUTESCRIPT EXIT &scriptpath/std_toolsconfig.cmm
            // Program the menus for general debugging
            do std_utils EXECUTESCRIPT EXIT  &scriptpath/std_scripts.men
        )

    )    
    
    RETURN SUCCESS

EXIT:
    LOCAL &rvalue
    ENTRY %LINE &rvalue
    ENDDO &rvalue
    


FATALEXIT:
    LOCAL &rvalue
    ENTRY %LINE &rvalue
    IF STRING.SCAN("&FAILUREKEYWORD","FAILUREKEYWORD",0)==-1
    (
        do std_fatalexit SYSTEM "&FAILUREKEYWORD - &rvalue"
    )
    ELSE
    (
        do std_fatalexit SYSTEM "&rvalue"
    )

    
//Should never get here
    END
    


   


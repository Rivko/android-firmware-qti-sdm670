//============================================================================
//  Name:                                                                     
//    apps_deattach_actions.cmm
//
//  Description:                                                              
//    When APPS deattaches, execute the following.
//    To be  used with 'GLOBALON SYSDOWN DO aop_deattach_actions.cmm' command within T32.
//                                                                            
// Copyright (c) 2012 - 2017 by Qualcomm Technologies, Incorporated.  All Rights Reserved.  
// Confidential and proprietary      
//
//
//
//
//                      EDIT HISTORY FOR FILE
//  This section contains comments describing changes made to the module.
//  Notice that changes are listed in reverse chronological order.
//
// when       who             what, where, why
// --------   ---             ---------------------------------------------------------
// 04/13/2017 JBILLING        Created

//////////////////////
///
/// @brief Main functionality. Currently does nothing for deattach case.
///
//////////////////////
MAIN:
    
    LOCAL &accessmode
    &accessmode="EZAXI"
    
    //Variable  shared between attach script and detach script.
    //Check so  that repeated sys.d does not rerun the detach script.
    GLOBAL &ATTACH_ASSERTED
    IF ("&ATTACH_ASSERTED"!="1.")
    (
        ENDDO
    )
    &ATTACH_ASSERTED=0.
    
    //print "Goodbye!" ///<For debug
    
    ON ERROR GOSUB
    (
        IF ("&ReEnableWdogOnSYSDWN"=="TRUE")
        (
            PRINT "Warning - error ocurred when attempting to configure JTAG<->Power options on deattach"
        )
        ENDDO
    )
    
//  No actions taken for deattach
    ENDDO

//============================================================================
//  Name:                                                                     
//    std_apps_msm8998.cmm
//
//  Description:                                                              
//    Script for CTI configurations specific to target
//
//  Usage
//  do std_cti_msm8992 <Subroutine>
//
//  where <Subroutine> is one of the following:
//      GETAPPSCORELIST - returns a string of all apps cores to be used in std_cti
//      SETCTIGPIOS - Configures TLMM to map GPIO's to CTI's for this target
//      HELP/help - prints help window
//     
//
// Copyright (c) 2012 - 2014 by Qualcomm Technologies, Incorporated.  All Rights Reserved.        
//
//
//
//                      EDIT HISTORY FOR FILE
//  This section contains comments describing changes made to the module.
//  Notice that changes are listed in reverse chronological order.
//
// when         who         what, where, why
// --------     ---        --------------------------------------------------------
// 08/11/2014   JBILLING    Added TESTCLOCK API, commented for FC
// 05/21/2014   JBilling    Added subroutines appropriately
// 10/29/2013   JBILLING    Created

//###################Arguments passed #####################

LOCAL &UTILITY &OPTION &IARG0 &IARG1 &IARG2 &IARG3 &IARG4 &IARG5 &IARG6 &IARG7 &IARG8 &IARG9 &IARG10 &IARG11
LOCAL &ArgumentLine
LOCAL &SUBROUTINE

ENTRY %LINE &ArgumentLine
ENTRY &UTILITY &OPTION &IARG0 &IARG1 &IARG2 &IARG3 &IARG4 &IARG5 &IARG6 &IARG7 &IARG8 &IARG9 &IARG10 &IARG11

//#####################Select Subroutine###################


// Input Argument 0 is the name of the utility
&SUBROUTINE="&UTILITY"
IF !(("&SUBROUTINE"=="APPSLIST")||("&SUBROUTINE"=="GETCORETYPE")||("&SUBROUTINE"=="SETCTIGPIOS")||("&SUBROUTINE"=="GETALLCORELIST")||("&SUBROUTINE"=="HELP")||("&SUBROUTINE"=="help"))
(
    &SUBROUTINE="HELP"
    PRINT %ERROR "std_cti_msm8992: Subroutine not found! Printing Help Window"
)

    // This should be created by some top level script. The setupenv for each proc would
    // set this up
    AREA.SELECT
    // Call the required utility
    GOSUB &SUBROUTINE &OPTION &IARG0 &IARG1 &IARG2 &IARG3 &IARG4 &IARG5 &IARG6 &IARG7 &IARG8 &IARG9 &IARG10 &IARG11
    ENTRY &PASS &RVAL0 &RVAL1 &RVAL2

    GOTO EXIT
    
APPSLIST:

    ENDDO "APPS0,APPS1,APPS2,APPS3,APPSC0"

        
        
GETALLCORELIST:

        ENDDO "APPS0,APPS1,APPS2,APPS3,APPSC0,MPSS,ADSP,RPM,SP"

    
    
RETURN

GETCORETYPE:
    LOCAL &IARG0
    ENTRY &IARG0
    IF (STRING.SCAN(STR.LWR("&IARG0"),"apps",0)!=-1)
    (
     
        //default to A53
        IF ((STRING.SCAN(STR.LWR("&IARG0"),"4",0)!=-1)||(STRING.SCAN(STR.LWR("&IARG0"),"5",0)!=-1)||(STRING.SCAN(STR.LWR("&IARG0"),"6",0)!=-1)||(STRING.SCAN(STR.LWR("&IARG0"),"7",0)!=-1))
        (
            ENDDO A57
        )
        ELSE
        (
            ENDDO A53
        )
        
        
    )
    ENDDO "NULL"
    
    
    
RETURN


////////////////////////////////////////
//
//            MAKE_SURE_BOOT_PROCESSOR_ATTACHED
//            
//            Makes sure boot processor is attached
//          Otherwise attaching on subsystem processor not possible
//
///////////////////////////////////////// 
MAKE_SURE_BOOT_PROCESSOR_ATTACHED:
    LOCAL &image &targetprocessor &targetprocessorport &bootprocessor &bootprocessorport &peripheral_processor &processortimeoutvalue &debugscript &symbolloadscript &imagebuildroot &entry_bkpt &error_bkpts &lpm_option &sleep_disable_command &cti_enable &multi_elf_option &alternateelf &extraoption
        &image="rpm"
    do std_debug_&CHIPSET GETDEBUGDEFAULTS NONE &image &lpm_option &cti_enable &alternateelf &extraoption
        ENTRY &image &targetprocessor &targetprocessorport &bootprocessor &bootprocessorport &peripheral_processor &processortimeoutvalue &debugscript &symbolloadscript &imagebuildroot &entry_bkpt &error_bkpts &lpm_option &sleep_disable_command &cti_enable &multi_elf_option &alternateelf &extraoption


    LOCAL &Rvalue
    do std_intercom_init CHECKSESSION 1 &bootprocessor
        ENTRY &Rvalue
    IF (&Rvalue!=1.)&&("&bootprocessor"=="APPS0")
    (
        do std_intercom_init CHECKSESSION 1 APPSC0
        ENTRY &Rvalue
    )
    IF (&Rvalue!=1.)
    (
        PRINT %ERROR "&bootprocessor T32 window not open. Please open and try again"
        GOTO FATALEXIT
    )
    
    
    //Run HWIO if needed
    LOCAL &hwio_ran
    INTERCOM.EVALUATE &bootprocessorport Y.EXIST(HWIO_LPASS_QDSP6SS_CGC_OVERRIDE_ADDR)
        &hwio_ran=EVAL()
    IF (&hwio_ran==0x0)
    (

            do std_intercom_do &bootprocessorport hwio
        
    )
    
    //if boot processor t32 not attached, attach.
    INTERCOM.EVALUATE &bootprocessorport SYSTEM.MODE()
        &BOOT_PROCESSOR_STATE=EVAL()
    IF ("&BOOT_PROCESSOR_STATE"!="0x0B")
    (
        INTERCOM.EXECUTE &bootprocessorport sys.m.a
    )
    INTERCOM.EVALUATE &bootprocessorport SYSTEM.MODE()
        &BOOT_PROCESSOR_STATE=EVAL()
    IF ("&BOOT_PROCESSOR_STATE"!="0x0B")
    (
            winclear
            WINPOS 0. 0. 60. 15. 0. 0. 
            area.reset
            area
            PRINT %ERROR " std_cti_&image - &bootprocessor not able to attach"
            PRINT %ERROR " Please ensure the following:"    
            PRINT %ERROR "     JTAG is physically attached"
            PRINT %ERROR "     T32 installation is up to date."
            PRINT %ERROR "     Device is booted."
            PRINT %ERROR " "
            
            ENDDO &FAILURE
    )
    
    RETURN   
    
    
help:
HELP:
    AREA.RESET
    AREA.CREATE std_cti_target_help 125. 23.
    AREA.SELECT std_cti_target_help
    WINPOS 5. 39. 125. 23.
    AREA.VIEW std_cti_target_help

    PRINT " Description:                                       "                       
    PRINT "   Script for CTI configurations specific to target"
    PRINT " "
    PRINT " Usage"
    PRINT " do std_cti_msm8992 <Subroutine>"
    PRINT " "
    PRINT " where <Subroutine> is one of the following:"
    PRINT "     GETAPPSCORELIST - returns a string of all apps cores to be used in std_cti"
    PRINT "     SETCTIGPIOS - Configures TLMM to map GPIO's to CTI's for this target"
    PRINT "     HELP/help - prints help window"

enddo

    
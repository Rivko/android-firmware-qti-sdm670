//============================================================================
//  Name:                                                                     
//    std_reset_wa.cmm 
//
//  Description:                                                              
//		Reset script for Windows on ARM HLOS
//                                                                            
// Copyright (c) 2012 - 2014 by Qualcomm Technologies, Incorporated.  All Rights Reserved.        
//
//
//
//
//                      EDIT HISTORY FOR FILE
//  This section contains comments describing changes made to the module.
//  Notice that changes are listed in reverse chronological order.
//
// when       who     		what, where, why
// --------   ---     		---------------------------------------------------------
// 01/10/2013 AJCheriyan	Added support for other spins
// 10/10/2012 AJCheriyan	Modified to included JTAG based reset
// 08/19/2012 AJCheriyan	Ported from LA reset 
// 07/19/2012 AJCheriyan    Created for B-family (8974)


MAIN:


	GOTO EXIT


EXIT:
	ENDDO

	

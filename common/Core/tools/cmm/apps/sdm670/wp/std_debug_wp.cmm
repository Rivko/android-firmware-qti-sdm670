//  Name:                                                                     
//    std_debug_wp.cmm 
//
//  Description:                                                              
//    WP specific debug script. Called after top level debug setup is done
//                                                                            
// Copyright (c) 2012 - 2014 by Qualcomm Technologies, Incorporated.  All Rights Reserved.        
//
//
//
//
//                      EDIT HISTORY FOR FILE
//  This section contains comments describing changes made to the module.
//  Notice that changes are listed in reverse chronological order.
//
// when       who             what, where, why
// --------   ---             ---------------------------------------------------------
// 07/20/2017 JBILLING      Updates for SDM845
// 05/04/2015 JBILLING      Added new buildroot support for boot_images/qcompkg
// 10/19/2012 AJCheriyan    Created for B-family

// Following arguments are supported. 
// ARG0 - Image to debug. 
// ARGn - n > 1 - Script specific arguments 
//####################Declarations#######################

LOCAL &ArgumentLine
LOCAL &UTILITY &OPTION &IARG0 &IARG1 &IARG2 &IARG3 &IARG4 &IARG5 &IARG6 &IARG7 &IARG8 &IARG9 &IARG10 &IARG11
LOCAL &targetprocessor &string_length

//###################Arguments passed #####################
ENTRY %LINE &ArgumentLine
LOCAL &SubRoutine &Port
ENTRY &SubRoutine %LINE &remainder
LOCAL &TargetProcessor &TargetProcessorPort  &BootProc &BootProcPort &UsesCTI &ProcessorTimeoutValue &DebugScript &SymbolLoadScript &BuildPath &EntryBkpt &ErrBkpts &LpmOpt &SleepDisableCmd &extraoption &Unused1 &Unused2 &Unused3

//* Check if we need to call for help or do some work *//
IF ("&ArgumentLine"=="")
(
    &SubRoutine="HELP"
)
ELSE IF ("&SubRoutine"=="GETAPPSENTRYBREAKPOINT")
(
    &SubRoutine="GETAPPSENTRYBREAKPOINT"
)
ELSE
(
    &SubRoutine="MAIN"
)

GOSUB &SubRoutine
    LOCAL &Rvalue
    ENTRY %LINE &Rvalue

    GOSUB EXIT &Rvalue



////////////////////////////////////////
//
//          MAIN
//          Main std_debug_la logic
//
/////////////////////////////////////////
MAIN:
    //note that optextract has a limit of 10 entries
    do optextract Img,Lpm,Bkpts,CTI_Enable,alternateelf,extraoption &ArgumentLine
    LOCAL &image &lpm_option &user_defined_bkpts &cti_enable &alternateelf &extraoption
    ENTRY &image &lpm_option &user_defined_bkpts &cti_enable &alternateelf &extraoption //expect 6 returns from optextract

    // Get the target processor for this port
    //do std_debug_&CHIPSET GETDEBUGDEFAULTS NONE &image
    //ENTRY &Unused1 &TargetProcessor &TargetProcessorPort &BootProc &BootProcPort &UsesCTI &Peripheral_Processor &ProcessorTimeoutValue &DebugScript &SymbolLoadScript &BuildPath &EntryBkpt &ErrBkpts &LpmOpt &SleepDisableCmd  &extraoption &Unused2 &Unused3

    //Work is already done in std_debug_&CHIPSET
    do std_debug_&CHIPSET APPSBOOT_BKPT WP


GETAPPSENTRYBREAKPOINT:

RETURN 0x9FC00000

HELP:
    AREA
    PRINT "This is helpful"
    RETURN SUCCESS
    
EXIT:
    LOCAL &rvalue
    ENTRY %LINE &rvalue
    ENDDO &rvalue



FATALEXIT:
    END


    




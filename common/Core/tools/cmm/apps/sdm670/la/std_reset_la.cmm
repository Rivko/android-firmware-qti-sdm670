//============================================================================
//  Name:                                                                     
//    std_reset_la.cmm 
//
//  Description:                                                              
//        Reset script for Linux Android HLOS
//                                                                            
// Copyright (c) 2012 - 2014 by Qualcomm Technologies, Incorporated.  All Rights Reserved.        
//
//
//
//
//                      EDIT HISTORY FOR FILE
//  This section contains comments describing changes made to the module.
//  Notice that changes are listed in reverse chronological order.
//
// when       who           what, where, why
// --------   ---           ---------------------------------------------------------
// 09/14/2015 JBILLING      Updated handling added
// 02/10/2013 AJCheriyan    Removed Reset Logic to top level script
// 01/10/2013 AJCheriyan    Added support for other spins
// 10/10/2012 AJCheriyan    Modified to included JTAG based reset
// 07/19/2012 AJCheriyan    Created for B-family (8974)

MAIN:


    GOSUB EXIT SUCCESS


EXIT:
    LOCAL &result
    ENTRY %LINE &result
    ENDDO &result

    

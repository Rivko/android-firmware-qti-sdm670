//============================================================================
//  Name:                                                                     
//    argparser.cmm 
//
//  Description:                                                              
//    Script to parse a string of whitespace separate key-value pairs
//                                                                            
// Copyright (c) 2014 - 2016 by QUALCOMM Technologies, Incorporated.  All Rights Reserved.        
//
//
//
//
//                      EDIT HISTORY FOR FILE
//  This section contains comments describing changes made to the module.
//  Notice that changes are listed in reverse chronological order.
//
// when       who     		what, where, why
// --------   ---     		---------------------------------------------------------
// 02/28/2014 AJCheriyan    Created for SCRIPTS.2.1 warehouse


// ARG0 - String to be parsed in the format key1=value1 key2=value2 key3=value3
// Usage -
//  do argparser key1=value1 key2=value2 key3=value3 will return key1 value1 key2 value2 key3 value3

MAIN:
	ENTRY %LINE &STRINGARGS
	
	// Return values
	LOCAL &RPARAM0 &RVALUE0 &RPARAM1 &RVALUE1 &RPARAM2 &RVALUE2 &RPARAM3 &RVALUE3 &RPARAM4 &RVALUE4  
	LOCAL &RPARAM5 &RVALUE5 &RPARAM6 &RVALUE6 &RPARAM7 &RVALUE7 &RPARAM8 &RVALUE8 &RPARAM9 &RVALUE9
	LOCAL &RPARAM10 &RVALUE10 &RPARAM11 &RVALUE11 &RPARAM12 &RVALUE12 &RPARAM13 &RVALUE13 &RPARAM14 &RVALUE14  

	// Other variables used
	LOCAL &STARTSTRING &LENGTH &KEYVALUEPAIR &KEYVALUEPAIRSEP &COUNT
	
	// Initialize our search string, length and counter to keep track of the key,value pairs
	&STRINGARGS=STRING.TRIM("&STRINGARGS")
	&STARTSTRING="&STRINGARGS "
	&LENGTH=STRING.LEN("&STARTSTRING")
	&COUNT=0
	
	// Initialize all the return values to avoid a stack underflow
	&RPARAM0=""
	&RVALUE0=""
	&RPARAM1=""
	&RVALUE1=""
	&RPARAM2=""
	&RVALUE2=""
	&RPARAM3=""
	&RVALUE3=""
	&RPARAM4=""
	&RVALUE4=""
	&RPARAM5=""
	&RVALUE5=""
	&RPARAM6=""
	&RVALUE6=""
	&RPARAM7=""
	&RVALUE7=""
	&RPARAM8=""
	&RVALUE8=""
	&RPARAM9=""
	&RVALUE9=""
	&RPARAM10=""
	&RVALUE10=""
	&RPARAM11=""
	&RVALUE11=""
	&RPARAM12=""
	&RVALUE12=""
	&RPARAM13=""
	&RVALUE13=""
	&RPARAM14=""
	&RVALUE14=""
	
	WHILE (&LENGTH>0)
	(
		// First the first '=' in the string
		&FIRSTKEY=STring.Scan("&STRINGARGS","=",0);
		// Check if we have a string without any '=' strings. 
		IF (&FIRSTKEY==-1)
		(
			// This means there was no key value pair. Set &LENGTH to 0 to exit
			&LENGTH=0
		)
		ELSE
		(
			// We have at least one key-value pair. Extract the entire thing
			&KEYVALUEPAIRSEP=STring.Scan("&STARTSTRING"," ",0);
			IF (&KEYVALUEPAIRSEP==-1)
			(
				// It means there was just one key value pair)
				&KEYVALUEPAIR="&STARTSTRING"
			)
			ELSE
			(
				&KEYVALUEPAIR=STRing.MID("&STARTSTRING",0,&KEYVALUEPAIRSEP)
			)
			
			// We have the key=value entry from the string. Separate it out
			GOSUB XTRACTKEYVAL &KEYVALUEPAIR
			ENTRY &RKEY &RVAL

			// Assign the return values. Crude method of returning a variable number of return values
			IF (&COUNT==0)
			(
				&RPARAM0="&RKEY"
				&RVALUE0="&RVAL"
			)
			IF (&COUNT==1)
			(
				&RPARAM1="&RKEY"
				&RVALUE1="&RVAL"
			)
			IF (&COUNT==2)
			(
				&RPARAM2="&RKEY"
				&RVALUE2="&RVAL"
			)
			IF (&COUNT==3)
			(
				&RPARAM3="&RKEY"
				&RVALUE3="&RVAL"
			)
			IF (&COUNT==4)
			(
				&RPARAM4="&RKEY"
				&RVALUE4="&RVAL"
			)
			IF (&COUNT==5)
			(
				&RPARAM5="&RKEY"
				&RVALUE5="&RVAL"
			)	
			IF (&COUNT==6)
			(
				&RPARAM6="&RKEY"
				&RVALUE6="&RVAL"
			)
			IF (&COUNT==7)
			(
				&RPARAM7="&RKEY"
				&RVALUE7="&RVAL"
			)
			IF (&COUNT==8)
			(
				&RPARAM8="&RKEY"
				&RVALUE8="&RVAL"
			)
			IF (&COUNT==9)
			(
				&RPARAM9="&RKEY"
				&RVALUE9="&RVAL"
			)
			IF (&COUNT==10)
			(
				&RPARAM10="&RKEY"
				&RVALUE10="&RVAL"
			)
			IF (&COUNT==11)
			(
				&RPARAM11="&RKEY"
				&RVALUE11="&RVAL"
			)
			IF (&COUNT==12)
			(
				&RPARAM12="&RKEY"
				&RVALUE12="&RVAL"
			)
			IF (&COUNT==13)
			(
				&RPARAM13="&RKEY"
				&RVALUE13="&RVAL"
			)
			IF (&COUNT==14)
			(
				&RPARAM14="&RKEY"
				&RVALUE14="&RVAL"
			)			
			// Set the new string
			&STARTSTRING=STRing.MID("&STARTSTRING", STRING.LEN("&KEYVALUEPAIR")+1, STRING.LEN("&STARTSTRING")-STRING.LEN("&KEYVALUEPAIR"));
			// Set the new length
			&LENGTH=STRING.LEN("&STARTSTRING");
			// Now bump up the count 
			&COUNT=&COUNT+1	
		)
	)
	
EXIT:
	// Now return all these values to the top level
	ENDDO &RPARAM0 &RVALUE0 &RPARAM1 &RVALUE1 &RPARAM2 &RVALUE2 &RPARAM3 &RVALUE3 &RPARAM4 &RVALUE4 &RPARAM5 &RVALUE5 &RPARAM6 &RVALUE6 &RPARAM7 &RVALUE7 &RPARAM8 &RVALUE8 
	//&RPARAM9 &RVALUE9 &RPARAM10 &RVALUE10 &RPARAM11 &RVALUE11 &RPARAM12 &RVALUE12 &RPARAM13 &RVALUE3 &RPARAM14 &RVALUE14


// Function which parsers a string in the form of key=value entries and returns them
// in two separate variables	
XTRACTKEYVAL:
		LOCAL &KEY &VAL &SEP
		
		ENTRY &STRINGTOPARSE
		// Extract the key
		&SEP=STRING.SCAN("&STRINGTOPARSE", "=", 0);
		&KEY=STRING.MID("&STRINGTOPARSE", 0, &SEP);
		&VAL=STRING.MID("&STRINGTOPARSE", &SEP+1, STRING.LENGTH("&STRINGTOPARSE")-&SEP);
		RETURN &KEY &VAL
		
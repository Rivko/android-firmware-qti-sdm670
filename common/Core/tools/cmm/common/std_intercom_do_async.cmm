//============================================================================
//  Name:                                                                     
//    std_intercom_do.cmm
//
//  Description:                                                              
//    It executes a cmm script on a remote T32 session and waits for it to complete
//                                                                            
// Copyright (c) 2012 - 2014 by Qualcomm Technologies, Incorporated.  All Rights Reserved.        
//
//
//
//	Edits: Edits
// amcheriy     : Ported to Async Intercom script   : 02/19/2014
//  amcheriy    : Added ability to check return val : 02/14/2014
//  amcheriy 	: Added change to return to base dir: 07/21/2012
//  rvennam	    : Modified script for 8960          : 06/06/2011
//  amcheriy	: Local intercom call detection		: 03/15/2011
//	amcheriy	: Removed semaphore usage for sync	: 03/15/2011
//	amcheriy	: Print commands print to area win	: 02/15/2011
//	amcheriy	: Created for MSM8660				: 12/15/2010
// ------------------------------------------------------------------------------------------

ENTRY &INTERCOM_HANDLE &SCRIPT_NAME &SCRIPT_ARG1 &SCRIPT_ARG2 &SCRIPT_ARG3 &SCRIPT_ARG4 &SCRIPT_ARG5 &SCRIPT_ARG6 &SCRIPT_ARG7 &SCRIPT_ARG8

LOCAL &SCRIPT_DIR
LOCAL &SEMAPHORE
LOCAL &ELAPSED_TIME
LOCAL &REMOTE_DIR

&SCRIPT_DIR=OS.PPD()

IF ("&LOCALHOST"!="&INTERCOM_HANDLE")
(
	IF INTERCOM.PING(&INTERCOM_HANDLE)
	(
	    INTERCOM.EXECUTENOWAIT &INTERCOM_HANDLE DO &SCRIPT_NAME &SCRIPT_ARG1 &SCRIPT_ARG2 &SCRIPT_ARG3 &SCRIPT_ARG4 &SCRIPT_ARG5 &SCRIPT_ARG6 &SCRIPT_ARG7 &SCRIPT_ARG8
	)
	ELSE
	(
		PRINT "REMOTE T32 SESSION FAILED TO RESPOND: &INTERCOM_HANDLE"
	)
)
ELSE
(
    // THIS MEANS THE CALLING SESSION IS THE INTENDED SESSION TO RUN THE SCRIPT
	DO &SCRIPT_NAME &SCRIPT_ARG1 &SCRIPT_ARG2 &SCRIPT_ARG3 &SCRIPT_ARG4 &SCRIPT_ARG5 &SCRIPT_ARG6 &SCRIPT_ARG7 &SCRIPT_ARG8

)	 

CD &SCRIPT_DIR
ENDDO

//============================================================================
//  Name:                                                                     
//    std_mapbuilds.cmm 
//
//  Description:                                                              
//    Used to map changed build locations to only the relevant debug sessions
//                                                                            
// Copyright (c) 2012 - 2014 by Qualcomm Technologies, Incorporated.  All Rights Reserved.        
//
//
//
//
//                      EDIT HISTORY FOR FILE
//  This section contains comments describing changes made to the module.
//  Notice that changes are listed in reverse chronological order.
//
// when       who             what, where, why
// --------   ---             ---------------------------------------------------------
// 09/14/2015 JBILLING      Changes made for automation
// 07/19/2012 AJCheriyan    Created for B-family 
//
// ARG0 - Session whose builds have to be sync'd
// ARG1 - New build location
ENTRY &ARG0 &ARG1

LOCAL &BUILD
MAIN:
    IF ("&ARG0"=="RPM")
    (
        &RPM_BUILDROOT="&ARG1"
    )
    IF ("&ARG0"=="APPS")
    (
        &APPS_BUILDROOT="&ARG1"
    )
    IF ("&ARG0"=="MPSS")
    (
        &MPSS_BUILDROOT="&ARG1"
    )
    IF ("&ARG0"=="ADSP")
    (
        &ADSP_BUILDROOT="&ARG1"
    )
    IF ("&ARG0"=="WCNSS")
    (
        &WCNSS_BUILDROOT="&ARG1"
    )
    IF ("&ARG0"=="WLAN")
    (
        &WLAN_BUILDROOT="&ARG1"
    )
    IF ("&ARG0"=="BOOT")
    (
        &BOOT_BUILDROOT="&ARG1"
    )
    IF ("&ARG0"=="BOOTUEFI")
    (
        &BOOT_UEFI_BUILDROOT="&ARG1"
    )
    IF ("&ARG0"=="TZ")
    (
        &TZ_BUILDROOT="&ARG1"
    )
    IF ("&ARG0"=="SDI")
    (
        &SDI_BUILDROOT="&ARG1"
    )


    GOSUB EXIT SUCCESS
    //No return from here
    
EXIT:
    LOCAL &rvalue
    ENTRY %LINE &rvalue
    ENDDO &rvalue
    
FATALEXIT:
    LOCAL &rvalue
    ENTRY %LINE &rvalue
    IF STRING.SCAN("&FAILUREKEYWORD","FAILUREKEYWORD",0)==-1
    (
        GOSUB EXIT &FAILUREKEYWORD - &rvalue
    )
    ELSE
    (
        GOSUB EXIT &rvalue
    )
    
//Should never get here
    END




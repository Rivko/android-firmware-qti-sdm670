//============================================================================
//  Name:                                                                     
//    std_hwio.cmm 
//
//  Description:                                                              
//    HWIO Symbols Script
//                                                                            
// Copyright (c) 2012 - 2014 by Qualcomm Technologies, Incorporated.  All Rights Reserved.        
//
//
//
//
//                      EDIT HISTORY FOR FILE
//  This section contains comments describing changes made to the module.
//  Notice that changes are listed in reverse chronological order.
//
// when       who             what, where, why
// --------   ---             -----------------------------------------
// 04/08/2016 JBILLING        Stubbed for only v1
// 03/10/2016 JBILLING        Updated for 8998



LOCAL &DefaultChipVersion &ChipVersion
&DefaultChipVersion="V1"


    //IF (STRING.SCAN("&CHIPSET_REVISION","CHIP",0)!=-1)
    //(
    //    IF (!(0==SYSTEM.MODE()||2==SYSTEM.MODE()))
    //    (
    //        do std_platinfo
    //    )
    //
    //)  

    //If we didn't find v1, v2, v3 in revision, then use default chipsetversion
    //IF (STRING.SCAN("&CHIPSET_REVISION","V1",0)!=-1)
    //    &ChipVersion="V1"
    //ELSE IF (STRING.SCAN("&CHIPSET_REVISION","V2",0)!=-1)
    //    &ChipVersion="V2"
    //ELSE IF (STRING.SCAN("&CHIPSET_REVISION","V3",0)!=-1)
    //    &ChipVersion="V3"
    //ELSE IF (STRING.SCAN("&CHIPSET_REVISION","V4",0)!=-1)
    //    &ChipVersion="V4"
    //ELSE
    //    &ChipVersion="&DefaultChipVersion"
    
    &ChipVersion="&DefaultChipVersion"

    IF !Y.EXIST(HWIO_WARLOCK_V1)
    (
        PRINT "Loading HWIO Symbols"
        LOCAL &script
        &script="hwio_"+"&CHIPSET"+"_"+"&ChipVersion"
        do &script
    )
    
    
    
    
    
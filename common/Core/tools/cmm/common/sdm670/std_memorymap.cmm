//============================================================================
//   Title: std_memorymap
//
//   License: License
//   Copyright 2012-2017 Qualcomm Technologies Inc
//
//   Description: This script setup the memory map for the target
//
//   Input: None
//
//   Output: None
//
//   Usage: do std_memorymap
//
//   Team: CoreBSP Products SDM845
//
//   Target: SDM845
//
//
//   Location: Perforce Revision
//
// when       who           what, where, why
// --------   ---           ---------------------------------------------------------
// 06/20/2017 JBILLING      Ported in KASLR updates from 8998
// 02/23/2017 JBILLING      Fixed DDR binary name to fix std_loadsim
// 03/10/2016 JBILLING      Created for 8998
// 03/02/2016 JBILLING      General cleanup, fixes for RPM loadsim
// 06/15/2015 JBILLING      Fixes for RPM debug             
// 04/14/2015 JBILLING      Updates for IPA                 
// 03/17/2015 JBILLING      MOre updates for Istari, SLPI   
// 12/29/2014 JBILLING      Updated for Istari              
// 07/02/2014 JBILLING      Updated for memorymap changes   
// 05/04/2014 AMCHERIY      Updated for Elessar             
// 02/20/2013 AMCHERIY      Relocatable image support        
// 04/02/2013 AMCHERIY      Updated DDR addresses            
// 01/10/2013 AMCHERIY      Correct RPM addresses            
// 10/19/2012 AMCHERIY      Added more debug cookies        
// 10/10/2012 AMCHERIY      Added debug cookies to map        
// 08/03/2012 AMCHERIY      Corrected addresses                
// 05/03/2012 AMCHERIY      First version for MSM8974        
// 05/03/2012 AMCHERIY      Re-written for B-family            



///////////////////////////////////////
//////////// Q6 General ///////////////
///////////////////////////////////////
GLOBAL &TCM_Q6SW_DUMP_START_ADDR
&TCM_Q6SW_DUMP_START_ADDR=0x17400000

GLOBAL &TCM_Q6SW_FULL_DUMP_SIZE
&TCM_Q6SW_FULL_DUMP_SIZE=0x400000

GLOBAL &TCM_Q6SW_512K_DUMP_SIZE
&TCM_Q6SW_512K_DUMP_SIZE=0x7FFFF

GLOBAL &TCM_Q6SW_1024K_DUMP_SIZE
&TCM_Q6SW_512K_DUMP_SIZE=0xFFFFF

GLOBAL &TCM_L2CACHE_START_ADDR
&TCM_L2CACHE_START_ADDR=0x04480000


/////////////////////////////////////////
////////ADSP Memory Map variables////////
/////////////////////////////////////////
//FIXME - update for 8998
GLOBAL &ADSP_EFS_start
GLOBAL &ADSP_EFS_end
GLOBAL &ADSP_EFS_size
GLOBAL &ADSP_EFS_log
&ADSP_EFS_start=0X85F80000
&ADSP_EFS_size=0X20000
&ADSP_EFS_end=&ADSP_EFS_start+&ADSP_EFS_size
&ADSP_EFS_log="ADSP_EFS_log.bin"

// ADSP SW Image - 30 MB

GLOBAL &ADSP_SW_start
GLOBAL &ADSP_SW_end
GLOBAL &ADSP_SW_size
GLOBAL &ADSP_SW_log
&ADSP_SW_start=0x93D00000
&ADSP_SW_size=0x1E00000
&ADSP_SW_end=&ADSP_SW_start+&ADSP_SW_size
&ADSP_SW_log="ADSP_SW_log.bin"

//FIXME - update for 8998
GLOBAL &ADSP_TCM_start
GLOBAL &ADSP_VIRT_START_ISLAND
GLOBAL &ADSP_ISLAND_SIZE
&ADSP_TCM_start=0x17400000
&ADSP_VIRT_START_ISLAND=0x400000
&ADSP_ISLAND_SIZE=0x80000

/////////////////////////////////////////
////////SLPI Memory Map variables////////
/////////////////////////////////////////
// SLPI SW Image - 25 MB
GLOBAL &SLPI_SW_start
GLOBAL &SLPI_SW_end
GLOBAL &SLPI_SW_size
GLOBAL &SLPI_SW_log
&SLPI_SW_start=0x93800000
&SLPI_SW_size=0xC00000
&SLPI_SW_end=&SLPI_SW_start+&SLPI_SW_size

&SLPI_SW_log="SLPI_SW_log.bin"

//FIXME - update for 8998
GLOBAL &SLPI_TCM_start
GLOBAL &SLPI_VIRT_START_ISLAND
GLOBAL &SLPI_ISLAND_SIZE
&SLPI_TCM_start=0X01800000
&SLPI_VIRT_START_ISLAND=0xB0000000
&SLPI_ISLAND_SIZE=0x7D000



/////////////////////////////////////////
////////MPSS Memory Map variables////////
/////////////////////////////////////////

GLOBAL &MPSS_EFS_start
GLOBAL &MPSS_EFS_end
GLOBAL &MPSS_EFS_size
GLOBAL &MPSS_EFS_log
&MPSS_EFS_start=0X85E00000
&MPSS_EFS_size=0X200000
&MPSS_EFS_end=&MPSS_EFS_start+&MPSS_EFS_size
&MPSS_EFS_log="MPSS_EFS_log.bin"


// MPSS Image - 126 MB
GLOBAL &MPSS_SW_start
GLOBAL &MPSS_SW_end
GLOBAL &MPSS_SW_size
GLOBAL &MPSS_SW_log
//This may be changed by std_memorymap_&HLOS
&MPSS_SW_start=0x8B000000
&MPSS_SW_size=0x7E00000
&MPSS_SW_end=&MPSS_SW_start+&MPSS_SW_size
&MPSS_SW_log="MPSS_SW_log.bin"

//fixme - update for 8998
GLOBAL &MPSS_TCM_start
&MPSS_TCM_start=0x02400000


/////////////////////////////////////////
////////MPSS WLAN Memory Map variables////////
/////////////////////////////////////////
// SLPI SW Image - 25 MB
GLOBAL &MPSS_WLAN_SW_start
GLOBAL &MPSS_WLAN_SW_end
GLOBAL &MPSS_WLAN_SW_size
GLOBAL &MPSS_WLAN_SW_log
&MPSS_WLAN_SW_start=&MPSS_SW_start
&MPSS_WLAN_SW_size=&MPSS_SW_size
&MPSS_WLAN_SW_end=&MPSS_WLAN_SW_start+&MPSS_WLAN_SW_size

&MPSS_WLAN_SW_log="&MPSS_WLAN_SW_log"

//MPSS_WLAN TCM is same as MPSS TCM

/////////////////////////////////////////
////////VSS  Memory Map variables////////
/////////////////////////////////////////
// VSS Image - 5 MB
GLOBAL &VSS_SW_start
GLOBAL &VSS_SW_end
GLOBAL &VSS_SW_size
GLOBAL &VSS_SW_log
&VSS_SW_start=0x92E00000
&VSS_SW_size=0X500000
&VSS_SW_end=&VSS_SW_start+&VSS_SW_size

&VSS_SW_log="Venus_SW_log.bin"


/////////////////////////////////////////
////////AOP  Memory Map variables////////
/////////////////////////////////////////
// AOP Code RAM - 160 KB
//FIXME - update for 8998
GLOBAL &CODERAM_start
GLOBAL &CODERAM_AOP_start
GLOBAL &CODERAM_end
GLOBAL &CODERAM_size
GLOBAL &CODERAM_log
GLOBAL &CODERAM_USB_log
&CODERAM_start=0X200000
//Address from AOP core perspective (has no MMU)
&CODERAM_AOP_start=0x00000000
&CODERAM_size=0X7D000
&CODERAM_end=&CODERAM_start+&CODERAM_size
&CODERAM_log="CODERAM_log.bin"
&CODERAM_USB_log="CODERAM.bin"
//FIXME - update for 8998
// AOP Data RAM - 80 kB 
GLOBAL &DATARAM_start
GLOBAL &DATARAM_AOP_start
GLOBAL &DATARAM_end
GLOBAL &DATARAM_size
GLOBAL &DATARAM_log
GLOBAL &DATARAM_USB_log
&DATARAM_start=0X290000
//Address from AOP core perspective (has no MMU)
&DATARAM_AOP_start=0x00090000 
&DATARAM_size=0X14000
&DATARAM_end=&DATARAM_start+&DATARAM_size
&DATARAM_log="DATARAM_log.bin"
&DATARAM_USB_log="DATARAM.bin"
//FIXME - update for 8998
// AOP Message RAM - 16KB
GLOBAL &MSGRAM_start
GLOBAL &MSGRAM_end
GLOBAL &MSGRAM_size
GLOBAL &MSGRAM_log
GLOBAL &MSGRAM_USB_log
GLOBAL &MSGRAM_AOP_start
&MSGRAM_start=0x60000
//Address from AOP core perspective (has no MMU)
&MSGRAM_AOP_start=0x60068000    
&MSGRAM_size=0x6000
&MSGRAM_end=&MSGRAM_start+&MSGRAM_size
&MSGRAM_log="MSGRAM_log.bin"
&MSGRAM_USB_log="MSGRAM.bin"


/////////////////////////////////////////
////////PBL  Memory Map variables////////
/////////////////////////////////////////
GLOBAL &PBL_emmc_init_done
&PBL_emmc_init_done=0x10D220

/////////////////////////////////////////
////////HLOS Memory Map variables////////
/////////////////////////////////////////
GLOBAL &HLOS_1_start
GLOBAL &HLOS_1_end
GLOBAL &HLOS_1_size
GLOBAL &HLOS_1_log
&HLOS_1_start=0x80000000
&HLOS_1_size=0X80000000
&HLOS_2_end=&HLOS_1_start+&HLOS_1_size
&HLOS_1_log="HLOS_1_log.bin"


GLOBAL &HLOS_2_start
GLOBAL &HLOS_2_end
GLOBAL &HLOS_2_size
GLOBAL &HLOS_2_log
&HLOS_2_start=0x100000000
&HLOS_2_size=0X80000000
&HLOS_2_end=&HLOS_2_start+&HLOS_2_size
&HLOS_2_log="HLOS_2_log.bin"


GLOBAL &HLOS_3_start
GLOBAL &HLOS_3_end
GLOBAL &HLOS_3_size
GLOBAL &HLOS_3_log
&HLOS_3_start=0x200000000
&HLOS_3_size=0X80000000
&HLOS_3_end=&HLOS_3_start+&HLOS_2_size
&HLOS_3_log="HLOS_3_log.bin"


//fixme - update for 8998
GLOBAL &SHARED_RAM_DUMP_START_ADDR
GLOBAL &SHARED_RAM_DUMP_SIZE 
&SHARED_RAM_DUMP_START_ADDR=0x87E80000
&SHARED_RAM_DUMP_SIZE=0xBFFFF


/////////////////////////////////////////
////////MBA  Memory Map variables////////
/////////////////////////////////////////
//fixme - update for 8998
GLOBAL &MBA_Meta_start
GLOBAL &MBA_Meta_end
GLOBAL &MBA_Meta_size
GLOBAL &MBA_Meta_log
&MBA_Meta_start=0XD1FC000
&MBA_Meta_end=0XD1FFFFF
&MBA_Meta_size=0X4000
&MBA_Meta_log="MBA_Meta_log.bin"

//fixme - update for 8998
GLOBAL &MBA_SW_start
GLOBAL &MBA_SW_end
GLOBAL &MBA_SW_size
GLOBAL &MBA_SW_log
&MBA_SW_start=0XD100000
&MBA_SW_size=0XFC000
&MBA_SW_end=&MBA_SW_start+&MBA_SW_size

&MBA_SW_log="MBA_SW_log.bin"



///////////Remote EFS/////////////

GLOBAL &EFS1_DUMP_START_ADDR
&EFS1_DUMP_START_ADDR=&MPSS_EFS_start

GLOBAL &EFS1_DUMP_SIZE
&EFS1_DUMP_SIZE=&MPSS_EFS_size

//GLOBAL &EFS2_DUMP_START_ADDR
//&EFS2_DUMP_START_ADDR=0x80C00000
//
//GLOBAL &EFS2_DUMP_SIZE
//&EFS2_DUMP_SIZE=0xfffff
//
//GLOBAL &EFS3_DUMP_START_ADDR
//&EFS3_DUMP_START_ADDR=0x80D00000
//
//GLOBAL &EFS3_DUMP_SIZE
//&EFS3_DUMP_SIZE=0xfffff





/////////////////////////////////////////
////////QDSS Memory Map variables////////
/////////////////////////////////////////
// QDSS Image - 16 MB
GLOBAL &QDSS_SW_start
GLOBAL &QDSS_SW_end
GLOBAL &QDSS_SW_size
GLOBAL &QDSS_SW_log
&QDSS_SW_start=0X10000000
&QDSS_SW_end=0X10FFFFFF
&QDSS_SW_size=0x1000000
&QDSS_SW_log="QDSS_SW_log.bin"


/////////////////////////////////////////
////////TZ   Memory Map variables////////
/////////////////////////////////////////
GLOBAL &TZ_SW_start
GLOBAL &TZ_SW_end
GLOBAL &TZ_SW_size
GLOBAL &TZ_SW_log
&TZ_SW_start=0X86200000
&TZ_SW_size=0X100000
&TZ_SW_end=&TZ_SW_start+&TZ_SW_size
&TZ_SW_log="TZ_SW_log.bin"


GLOBAL &PIMEM_start
GLOBAL &PIMEM_end
GLOBAL &PIMEM_size
GLOBAL &PIMEM_log
GLOBAL &PIMEM_USB_log
&PIMEM_start=0X86300000
&PIMEM_size=0X4800000
&PIMEM_end=&PIMEM_start+&PIMEM_size
&PIMEM_log="PIMEM_log.bin"
&PIMEM_USB_log="PIMEM.bin"


GLOBAL &TZ_DUMP_START_ADDR
&TZ_DUMP_START_ADDR=&TZ_SW_start

GLOBAL &TZ_DUMP_SIZE
&TZ_DUMP_SIZE=&TZ_SW_size


/////////////////////////////////////////
////////IPA  Memory Map variables////////
/////////////////////////////////////////
//FIXME - update for 8998
//0x7950000++0x4000          - IPA_IRAM.bin   --> Load script should load this region at address 0x0 into the CM3 simulator
//0x7954000--0x7957eff      - IPA_DRAM.bin  --> Load script should load this region at address 0x4000 into the CM3 simulator
//0x7945000--0x7946FFF     - IPA_SRAM.bin   (IPA SRAM: SW-Area)
//0x7949000--0x794BEFF     - IPA_HRAM.bin  (IPA SRAM: HW-Area)
//0x794F000-0x794FFFF      - IPA_DICT.bin (Decompression Dictionary)
//0x7962000--0x79620FF    - IPA_MBOX.bin
//0x7904000++0x26fff        - IPA_REG1.bin
//0x7940000++0x4fff          - IPA_REG2.bin
//0x7960000++0x1fff          - IPA_REG3.bin

////////IPA_IRAM.bin///////
GLOBAL &IPA_IRAM_log
GLOBAL &IPA_IRAM_IPA_start
GLOBAL &IPA_IRAM_start
GLOBAL &IPA_IRAM_end
GLOBAL &IPA_IRAM_size
&IPA_IRAM_log="IPA_IRAM.bin"
&IPA_IRAM_IPA_start=0x0
&IPA_IRAM_start=0x7950000
&IPA_IRAM_size=0x4000
&IPA_IRAM_end=&IPA_IRAM_start+&IPA_IRAM_size //0x7953FFF

////////IPA_DRAM.bin///////
GLOBAL &IPA_DRAM_log
GLOBAL &IPA_DRAM_IPA_start
GLOBAL &IPA_DRAM_start
GLOBAL &IPA_DRAM_end
GLOBAL &IPA_DRAM_size
&IPA_DRAM_log="IPA_DRAM.bin"
&IPA_DRAM_IPA_start=0x4000
&IPA_DRAM_start=0x7954000
&IPA_DRAM_size=0x3F00
&IPA_DRAM_end=&IPA_DRAM_start+&IPA_DRAM_size //0x7957eff

////////IPA_SRAM.bin///////
GLOBAL &IPA_SRAM_log 
GLOBAL &IPA_SRAM_start
GLOBAL &IPA_SRAM_end
GLOBAL &IPA_SRAM_size
&IPA_SRAM_log="IPA_SRAM.bin" 
&IPA_SRAM_start=0x7945000
&IPA_SRAM_size=0x1FFF
&IPA_SRAM_end=&IPA_SRAM_start+&IPA_SRAM_size  //0x7946FFF

////////IPA_HRAM.bin///////
GLOBAL &IPA_HRAM_log 
GLOBAL &IPA_HRAM_start
GLOBAL &IPA_HRAM_end
GLOBAL &IPA_HRAM_size
&IPA_HRAM_log="IPA_HRAM.bin" 
&IPA_HRAM_start=0x7949000
&IPA_HRAM_size=0x2EFF
&IPA_HRAM_end=&IPA_HRAM_start+&IPA_HRAM_size  //0x794BEFF

////////IPA_DICT.bin///////
GLOBAL &IPA_DICT_log 
GLOBAL &IPA_DICT_start
GLOBAL &IPA_DICT_end
GLOBAL &IPA_DICT_size
&IPA_DICT_log="IPA_DICT.bin" 
&IPA_DICT_start=0x794F000
&IPA_DICT_size=0xFFF
&IPA_DICT_end=&IPA_DICT_start+&IPA_DICT_size  //0x794FFFF

////////IPA_MBOX.bin///////
GLOBAL &IPA_MBOX_log 
GLOBAL &IPA_MBOX_start
GLOBAL &IPA_MBOX_end
GLOBAL &IPA_MBOX_size
&IPA_MBOX_log="IPA_MBOX.bin" 
&IPA_MBOX_start=0x7962000
&IPA_MBOX_size=0xFF
&IPA_MBOX_end=&IPA_MBOX_start+&IPA_MBOX_size  //0x79620FF

////////IPA_REG1.bin///////
GLOBAL &IPA_REG1_log
GLOBAL &IPA_REG1_start
GLOBAL &IPA_REG1_end
GLOBAL &IPA_REG1_size
&IPA_REG1_log="IPA_REG1.bin"
&IPA_REG1_start=0x7904000
&IPA_REG1_size=0x26fff
&IPA_REG1_end=&IPA_REG1_start+&IPA_REG1_size  //0x792AFFF

////////IPA_REG2.bin///////
GLOBAL &IPA_REG2_log
GLOBAL &IPA_REG2_start
GLOBAL &IPA_REG2_end
GLOBAL &IPA_REG2_size
&IPA_REG2_log="IPA_REG2.bin"
&IPA_REG2_start=0x7940000
&IPA_REG2_size=0x4fff
&IPA_REG1_end=&IPA_REG1_start+&IPA_REG1_size  //0x7944FFF

////////IPA_REG3.bin///////
GLOBAL &IPA_REG3_log
GLOBAL &IPA_REG3_start
GLOBAL &IPA_REG3_end
GLOBAL &IPA_REG3_size
&IPA_REG3_log="IPA_REG3.bin"
&IPA_REG3_start=0x7960000
&IPA_REG3_size=0x1fff
&IPA_REG1_end=&IPA_REG1_start+&IPA_REG1_size  //0x7961fff

GLOBAL &IPA_regs
GLOBAL &IPA_mmu
&IPA_regs="IPA_regs.cmm"
&AOP_mmu="IPA_regs.cmm"


/////////////////////////////////////////
////////DDR  Memory Map variables////////
/////////////////////////////////////////
// DDR memory: combined space used by all images
GLOBAL &DDR_1_start
GLOBAL &DDR_1_end
GLOBAL &DDR_1_size
GLOBAL &DDR_1_log
GLOBAL &DDR_1_USB_log
&DDR_1_start=0x80000000
&DDR_1_size=0x1FFFFFFF
&DDR_1_end=&DDR_1_start+&DDR_1_size
&DDR_1_log="DDR0CS0.BIN"
&DDR_1_USB_log="DDRCS0_0.BIN"

GLOBAL &DDR_2_start
GLOBAL &DDR_2_end
GLOBAL &DDR_2_size
GLOBAL &DDR_2_log
GLOBAL &DDR_2_USB_log
&DDR_2_start=0xA0000000
&DDR_2_size=0x1FFFFFFF
&DDR_2_end=&DDR_2_start+&DDR_2_size
&DDR_2_log="DDR1CS0.BIN"
&DDR_2_USB_log="DDRCS0_1.BIN"


// DDR memory sub-section - combined space used by all peripherals
// Saving this region will give all peripherals in one go
GLOBAL &DDR_Periph_start
GLOBAL &DDR_Periph_end
GLOBAL &DDR_Periph_size
GLOBAL &DDR_Periph_log
&DDR_Periph_start=0x8ab00000
&DDR_Periph_size=0x9900000
&DDR_Periph_end=&DDR_Periph_start+&DDR_Periph_size
&DDR_Periph_log="DDRPeriph.bin"


/////////////////////////////////////////
////////SMEM Memory Map variables////////
/////////////////////////////////////////
GLOBAL &SMEM_start
GLOBAL &SMEM_end
GLOBAL &SMEM_size
GLOBAL &SMEM_log
&SMEM_start=0x86000000
&SMEM_size=0X200000
&SMEM_end=&SMEM_start+&SMEM_size
&SMEM_log="SMEM_log.bin"


/////////////////////////////////////////////
//////// OCIMEM Memory Region ///////////////
/////////////////////////////////////////////
GLOBAL &OCIMEM_start
GLOBAL &OCIMEM_end
GLOBAL &OCIMEM_size
GLOBAL &OCIMEM_log
GLOBAL &OCIMEM_USB_log
&OCIMEM_start=0x14680000
&OCIMEM_size=0x80000
&OCIMEM_end=&OCIMEM_start+&OCIMEM_size
&OCIMEM_log="OCIMEM.bin"
&OCIMEM_USB_log="OCIMEM.bin"


/////////////////////////////////////////
/////SharedIMEM Memory Map variables/////
/////////////////////////////////////////
GLOBAL &SHARED_IMEM_start
GLOBAL &SHARED_IMEM_end
GLOBAL &SHARED_IMEM_size
GLOBAL &SHARED_IMEM_log
GLOBAL &SHARED_IMEM_USB_log
&SHARED_IMEM_start=&OCIMEM_start+0x3F000
//&SHARED_IMEM_start=0x146BF000
&SHARED_IMEM_size=0x40000
&SHARED_IMEM_end=&SHARED_IMEM_start+&SHARED_IMEM_size

//Shared IMEM is part of OCIMEM
&SHARED_IMEM_log="OCIMEM.bin"


/////////////////////////////////////////////
//////// Relocatable Image support///////////
/////////////////////////////////////////////
GLOBAL &RELOCATION_DATA_start
GLOBAL &RELOCATION_DATA_end
GLOBAL &RELOCATION_DATA_size
&RELOCATION_DATA_start=&SHARED_IMEM_start+0x94C
&RELOCATION_DATA_size=0xC8
&RELOCATION_DATA_end=&RELOCATION_DATA_start+&RELOCATION_DATA_size-0x1

// Each entry in the table is in the following format
// 8 bytes - image name
// 8 bytes - image start address
// 4 bytes - image size


//////////////////////////////////////////////////////
// This region is in the Shared IMEM block          //
// These are the cookies used to debug any image    //
// Allocation varies from target to target          //
//////////////////////////////////////////////////////
GLOBAL &DEBUG_REGION_START
GLOBAL &DEBUG_REGION_END
GLOBAL &DEBUG_REGION_SIZE
GLOBAL &DEBUG_COOKIE_VALUE
GLOBAL &XBL_DEBUG_COOKIE
GLOBAL &MBA_DEBUG_COOKIE
GLOBAL &MPSS_DEBUG_COOKIE
GLOBAL &ADSP_DEBUG_COOKIE
GLOBAL &CDSP_DEBUG_COOKIE
GLOBAL &SLPI_DEBUG_COOKIE
GLOBAL &WCNSS_DEBUG_COOKIE
GLOBAL &APPSBOOT_DEBUG_COOKIE
GLOBAL &MDM_DEBUG_COOKIE
GLOBAL &AOP_DEBUG_COOKIE
GLOBAL &RPM_DEBUG_COOKIE
&DEBUG_COOKIE_VALUE=0x53444247
//&DEBUG_REGION_START=0x66BF934
&DEBUG_REGION_START=&SHARED_IMEM_start+0x934
//&DEBUG_REGION_END=0x66BF94C
&DEBUG_REGION_SIZE=0x18
&DEBUG_REGION_END=&DEBUG_REGION_START+&DEBUG_REGION_SIZE

&XBL_DEBUG_COOKIE=&DEBUG_REGION_START+0x10      //0x66BF944
&MBA_DEBUG_COOKIE=&DEBUG_REGION_START+0x4       //0x66BF938
&MPSS_DEBUG_COOKIE=&DEBUG_REGION_START+0x0      //0x66BF934
&ADSP_DEBUG_COOKIE=&DEBUG_REGION_START+0x8      //0x66BF93C
&CDSP_DEBUG_COOKIE=&DEBUG_REGION_START+0x8      //0x66BF93C
&SLPI_DEBUG_COOKIE=&DEBUG_REGION_START+0x8      //0x66BF93C
&WCNSS_DEBUG_COOKIE=&DEBUG_REGION_START+0xC     //0x66BF940
&APPSBOOT_DEBUG_COOKIE=&DEBUG_REGION_START+0x14 //0x66BF948
&RPM_DEBUG_COOKIE=&DEBUG_REGION_START+1E4 		
&MDM_DEBUG_COOKIE="&MPSS_DEBUG_COOKIE"
&AOP_DEBUG_COOKIE=&SHARED_IMEM_start+0xB18 //0x66bfb18
&RPM_DEBUG_COOKIE=&AOP_DEBUG_COOKIE

/////////////////////////////////////////////
//////// KASLR Feature for APPS /////////////
/////////////////////////////////////////////

GLOBAL &KASLR_LOCATION &KASLR_ENABLED_CODE
&KASLR_LOCATION=&SHARED_IMEM_start+0x6D0
//&KASLR_LOCATION=0x146bf6d0
&KASLR_ENABLED_CODE=0xDEAD4EAD
GLOBAL &KASLR_OFFSET_ADDR &KASLR_ENABLED
&KASLR_ENABLED="FALSE"

/////////////////////////////////////////////
//////// Various Registers///////////////////
/////////////////////////////////////////////
GLOBAL &WCNSS_regs
GLOBAL &WCNSS_mmu
&WCNSS_regs="WCNSS_regs.cmm"
&WCNSS_mmu="WCNSS_mmu.cmm"

GLOBAL &AOP_regs
GLOBAL &AOP_mmu
&AOP_regs="AOP_regs.cmm"
&AOP_mmu="AOP_regs.cmm"

GLOBAL &MPSS_Thread0_regs
&MPSS_Thread0_regs="MPSS_Thread0_regs.cmm"
GLOBAL &MPSS_Thread1_regs
&MPSS_Thread1_regs="MPSS_Thread1_regs.cmm"
GLOBAL &MPSS_Thread2_regs
&MPSS_Thread2_regs="MPSS_Thread2_regs.cmm"
GLOBAL &MPSS_Thread3_regs
&MPSS_Thread3_regs="MPSS_Thread3_regs.cmm"

GLOBAL &ADSP_Thread0_regs
&ADSP_Thread0_regs="ADSP_Thread0_regs.cmm"
GLOBAL &ADSP_Thread1_regs
&ADSP_Thread1_regs="ADSP_Thread1_regs.cmm"
GLOBAL &ADSP_Thread2_regs
&ADSP_Thread2_regs="ADSP_Thread2_regs.cmm"
GLOBAL &ADSP_Thread3_regs
&ADSP_Thread3_regs="ADSP_Thread3_regs.cmm"

GLOBAL &SLPI_Thread0_regs
&SLPI_Thread0_regs="SLPI_Thread0_regs.cmm"
GLOBAL &SLPI_Thread1_regs
&SLPI_Thread1_regs="SLPI_Thread1_regs.cmm"
GLOBAL &SLPI_Thread2_regs
&SLPI_Thread2_regs="SLPI_Thread2_regs.cmm"
GLOBAL &SLPI_Thread3_regs
&SLPI_Thread3_regs="SLPI_Thread3_regs.cmm"


GLOBAL &KPSS_Core0_regs
GLOBAL &KPSS_Core0_mmu
&KPSS_Core0_regs="KPSS_Core0_regs.cmm"
&KPSS_Core0_mmu="KPSS_Core0_mmu.cmm"

GLOBAL &KPSS_Core1_regs
GLOBAL &KPSS_Core1_mmu
&KPSS_Core1_regs="KPSS_Core1_regs.cmm"
&KPSS_Core1_mmu="KPSS_Core1_mmu.cmm"

GLOBAL &KPSS_Core2_regs
GLOBAL &KPSS_Core2_mmu
&KPSS_Core2_regs="KPSS_Core2_regs.cmm"
&KPSS_Core2_mmu="KPSS_Core2_mmu.cmm"

GLOBAL &KPSS_Core3_regs
GLOBAL &KPSS_Core3_mmu
&KPSS_Core3_regs="KPSS_Core3_regs.cmm"
&KPSS_Core3_mmu="KPSS_Core3_mmu.cmm"


/////////////////////////////////////////////
/////////////////////////////////////////////
/////////END Global Constants Section////////
/////////////////////////////////////////////
/////////////////////////////////////////////

//###################Arguments passed #####################
LOCAL &ArgumentLine
ENTRY %LINE &ArgumentLine
LOCAL &SUBROUTINE &argline
ENTRY &SUBROUTINE %LINE &argline
//#####################Select Subroutine###################

// Input Argument 0 is the name of the utility
&SUBROUTINE=STR.UPR("&SUBROUTINE")

IF !(("&SUBROUTINE"=="MAIN")||("&SUBROUTINE"=="KASLR_SIMEM_PARSE_LOCATION"))
(
    &SUBROUTINE="MAIN"
    &argline="&ArgumentLine"
)

// Call the required utility
GOSUB &SUBROUTINE &argline
LOCAL &rvalue
ENTRY %LINE &rvalue
GOSUB EXIT &rvalue

/////////////////////////////////////
///
/// @brief Main routine for std_memorymap.
/// Searches relocatable image info depending on if 
/// simulator or live target.
///
//////////////////////////////////////
MAIN:
    ENTRY &LoadOption
   LOCAL &result
    // Check if any attributes obtained at run time are needed
    If ("&LoadOption"=="DYNAMIC")
    (
            // Change any defaults
            IF (!SIMULATOR())
            (
                // Get relocated image info again
                GOSUB PARSE_IMAGE_RELOCATION
				 ENTRY %LINE &result
                IF STRING.SCAN("&result","FAILURE",0)!=-1
                (
                    GOSUB EXIT &result
                )
                ENTRY %LINE &result
            )
            ELSE
            (
                // Do both together on simulator
                GOSUB RELOC_SIMEM_N_PARSE_IMAGE_RELOC
                GOSUB KASLR_SIMEM_PARSE_LOCATION
                ENTRY %LINE &result
            )
    )

    GOSUB EXIT &result

EXIT:
    LOCAL &rvalue
    ENTRY %LINE &rvalue
    ENDDO &rvalue
/////////////////////////////////////
///
/// @brief Offset calculation for KASLR feature
///
//////////////////////////////////////
KASLR_SIMEM_PARSE_LOCATION:
    LOCAL &KASLRCode
    &KASLRCode=DATA.LONG(EA:&KASLR_LOCATION)
    
    LOCAL &KASLR_offset1 &KASLR_offset2
    IF &KASLRCode==&KASLR_ENABLED_CODE //KASLR enabled. get offset
    (
        
        &KASLR_offset1=DATA.LONG(EZAXI:&KASLR_LOCATION+4)
        &KASLR_offset2=DATA.LONG(EZAXI:&KASLR_LOCATION+8)
        &KASLR_OFFSET_ADDR=&KASLR_offset2<<32.+&KASLR_offset1
        &KASLR_ENABLED="TRUE"
    )
    ELSE
    (
        &KASLR_OFFSET_ADDR=0x0
        &KASLR_ENABLED="FALSE"
    )
    RETURN SUCCESS

// Function to parse relocated image data that is 
// saved in internal memory
// This function will be run once only unless a new 
// session has started
PARSE_IMAGE_RELOCATION:
    LOCAL &HEAD &TAIL &IMG_NAME &IMG_START &IMG_SIZE

    &HEAD=&RELOCATION_DATA_start
    &TAIL=&RELOCATION_DATA_end

    ON ERROR GOSUB
    (
        PRINT %ERROR "Error ocurred while reading relocation data from device"
        RETURN "Error ocurred while reading relocation data from device"
    )
    WHILE (&HEAD<=&TAIL)
    (
        // Null terminate the string
        DATA.SET EA:&HEAD+0x4 %LONG DATA.LONG(EA:&HEAD+0x4)&0xFFFFFF
         &IMG_NAME=DATA.STRING(EA:&HEAD)
        &IMG_START=DATA.LONG(EA:&HEAD+0xC)<<32.|DATA.LONG(EA:&HEAD+0x8)
        &IMG_SIZE=DATA.LONG(EA:&HEAD+0x10)

        // We have 5 images supported. No error if an image is not present
        IF ("&IMG_NAME"=="slpi")
        (
            &SLPI_SW_start=&IMG_START
            &SLPI_SW_size=&IMG_SIZE
            &SLPI_SW_end=&IMG_START+&IMG_SIZE-1
        )
        
        // We have 5 images supported. No error if an image is not present
        IF ("&IMG_NAME"=="adsp")
        (
            &ADSP_SW_start=&IMG_START
            &ADSP_SW_size=&IMG_SIZE
            &ADSP_SW_end=&IMG_START+&IMG_SIZE-1
        )

        IF ("&IMG_NAME"=="modem")
        (
            &MPSS_SW_start=&IMG_START
            &MPSS_SW_size=&IMG_SIZE
            &MPSS_SW_end=&IMG_START+&IMG_SIZE-1
        )

        IF ("&IMG_NAME"=="wcnss")
        (
            &WCNSS_SW_start=&IMG_START
            &WCNSS_SW_size=&IMG_SIZE
            &WCNSS_SW_end=&IMG_START+&IMG_SIZE-1
        )

        // Move to the next entry
        &HEAD=&HEAD+0x14
    )

    RETURN SUCCESS


// Function to parse relocated image data that is 
// saved in internal memory and identify shared IMEM location
// This function will be run once only unless a new debug
// session has started    
RELOC_SIMEM_N_PARSE_IMAGE_RELOC:
    LOCAL &HEAD &TAIL &IMG_NAME &IMG_START &IMG_SIZE 
    LOCAL &RELOCATED &COUNT

    // Init locals
    &RELOCATED=0
    &COUNT=0

    // Start with default location for shared IMEM
    WHILE ((&RELOCATED==0)&&(&COUNT<1))
    (
        &HEAD=&RELOCATION_DATA_start
        &TAIL=&RELOCATION_DATA_end
        WHILE (&HEAD<=&TAIL)
        (
            // Null terminate the string
            DATA.SET EA:&HEAD+0x4 %LONG DATA.LONG(EA:&HEAD+0x4)&0xFFFFFF
             &IMG_NAME=DATA.STRING(EA:&HEAD)
            &IMG_START=DATA.LONG(EA:&HEAD+0xC)<<32.|DATA.LONG(EA:&HEAD+0x8)
            &IMG_SIZE=DATA.LONG(EA:&HEAD+0x10)

            // We have 5 images supported. No error if an image is not present
            IF (STR.LWR("&IMG_NAME")=="slpi")
            (
                &SLPI_SW_start=&IMG_START
                &SLPI_SW_size=&IMG_SIZE
                &SLPI_SW_end=&IMG_START+&IMG_SIZE-1
                &RELOCATED=1
            )
            
            IF (STR.LWR("&IMG_NAME")=="adsp")
            (
                &ADSP_SW_start=&IMG_START
                &ADSP_SW_size=&IMG_SIZE
                &ADSP_SW_end=&IMG_START+&IMG_SIZE-1
                &RELOCATED=1
            )

            IF (STR.LWR("&IMG_NAME")=="modem")
            (
                &MPSS_SW_start=&IMG_START
                &MPSS_SW_size=&IMG_SIZE
                &MPSS_SW_end=&IMG_START+&IMG_SIZE-1
                &RELOCATED=1
            )

            IF (STR.LWR("&IMG_NAME")=="wcnss")
            (
                &WCNSS_SW_start=&IMG_START
                &WCNSS_SW_size=&IMG_SIZE
                &WCNSS_SW_end=&IMG_START+&IMG_SIZE-1
                &RELOCATED=1
            )

            // Move to the next entry
            &HEAD=&HEAD+0x14
        )

        // Increment count
        &COUNT=&COUNT+1

    )

    // If we reach this point without finding relocated data, it means 911 time !
    IF (&RELOCATED==0)
    (
        PRINT "Relocated data not found at : &RELOCATION_DATA_start"
        RETURN "FAILURE - Relocated data not found at : &RELOCATION_DATA_start"
    )
    ELSE
    (
        PRINT "Relocated data found at : &RELOCATION_DATA_start"
        RETURN SUCCESS
    )
    //Should never get here
    RETURN


    


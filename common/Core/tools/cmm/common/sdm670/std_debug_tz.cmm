//============================================================================
//  Name:                                                                     
//    std_debug_tz.cmm 
//
//  Description:                                                              
//    Trustzone debug script
//                                                                            
// Copyright (c) 2012 - 2014 by Qualcomm Technologies, Incorporated.  All Rights Reserved.        
//
//
//
//
//                      EDIT HISTORY FOR FILE
//  This section contains comments describing changes made to the module.
//  Notice that changes are listed in reverse chronological order.
//
// when       who             what, where, why
// --------   ---             ---------------------------------------------------------
// 02/02/2016 JBILLING        Changes made for symbol reuse
// 09/14/2015 JBILLING        More changes made for automation
// 08/27/2015 JBILLING        Updates for automation testing harnesses
// 04/21/2015 JBILLING        Fixed command line / silent functionality
// 04/01/2015 JBILLING      Ported for 8996
// 05/12/2014 AJCheriyan    Moved to the new design
// 10/10/2012 AJCheriyan    Moved to actual reset based debug mechanism
// 08/14/2012 AJCheriyan    Fixed typo.
// 07/19/2012 AJCheriyan    Created for B-family.



//####################Declarations#######################

LOCAL &ArgumentLine
LOCAL &UTILITY &OPTION &IARG0 &IARG1 &IARG2 &IARG3 &IARG4 &IARG5 &IARG6 &IARG7 &IARG8 &IARG9 &IARG10 &IARG11
LOCAL &string_length
LOCAL &SubRoutine &Port
LOCAL &Unused1 &targetprocessor &targetprocessorport &bootprocessor &bootprocessorport &peripheral_processor &processortimeoutvalue &debugscript &symbolloadscript &imagebuildroot &entry_bkpt &error_bkpts &lpm_option &sleep_disable_command &extraoption &Unused2 &Unused3
LOCAL &BootProcessor &DefBkpts

//###################Arguments passed #####################
ENTRY %LINE &ArgumentLine
ENTRY &UTILITY &OPTION &IARG0 &IARG1 &IARG2 &IARG3 &IARG4 &IARG5 &IARG6 &IARG7 &IARG8 &IARG9 &IARG10 &IARG11



//##################Defaults##########################
&targetprocessor="apps0"

//#####################Select Subroutine###################
// Name of the utility we are calling
LOCAL &SUBROUTINE
// Any subroutine specific options
// Default exists for each subroutine
LOCAL &OPTION

//* Check if we need to call for help or do some work *//
IF ("&ArgumentLine"=="")
(
    &SUBROUTINE="HELP"
)
ELSE
(
    &SUBROUTINE="MAIN"
)

    GOSUB &SUBROUTINE
    LOCAL &Rvalue
    ENTRY %LINE &Rvalue

    GOSUB EXIT &Rvalue


////////////////////////////////////////
//
//          MAIN
//          Main std_debug_tz logic
//
/////////////////////////////////////////
MAIN:

    LOCAL &image &targetprocessor &targetprocessorport &bootprocessor &bootprocessorport &peripheral_processor &processortimeoutvalue &debugscript &symbolloadscript &imagebuildroot &entry_bkpt &error_bkpts &lpm_option &sleep_disable_command &cti_enable &multi_elf_option &alternateelf &extraoption
    //note that optextract has a limit of 10 entries
    do optextract Img,Lpm,Bkpts,CTI_Enable,alternateelf,extraoption &ArgumentLine
        ENTRY &image &lpm_option &user_defined_bkpts &cti_enable &alternateelf &extraoption //expect 6 returns from optextract

    // Get the target processor for this port
    do std_debug_&CHIPSET GETDEBUGDEFAULTS NONE &image &lpm_option &cti_enable &alternateelf &extraoption
    ENTRY &image &targetprocessor &targetprocessorport &bootprocessor &bootprocessorport &peripheral_processor &processortimeoutvalue &debugscript &symbolloadscript &imagebuildroot &entry_bkpt &error_bkpts &lpm_option &sleep_disable_command &cti_enable &multi_elf_option &alternateelf &extraoption
    

    // We have work to do if it is SBL
    IF ("&image"=="tz")
    (

        // Load the symbols on the remote session
        //do std_intercom_do &targetprocessorport std_loadsyms_tz tz &imagebuildroot
        
        // Attach to Apps Core 0 and break
        //do std_intercom_do &targetprocessorport std_utils BREAKPROC

        // Clear the debug cookie
        //do std_debug_&CHIPSET SETDEBUGCOOKIE clear &image

        // Set the breakpoints specified by the user
        IF ("&user_defined_bkpts"!="NULL")
        (
            
            do std_intercom_do &targetprocessorport std_utils SETBREAKPOINTS ONCHIP &user_defined_bkpts 
        )
        WINCLEAR
        
        //always set breakpoint for entry_bkpt 
        IF ("&USEEXISTINGSYMS_TARGET"=="FALSE")||("&ENTRYHEXADDR_TARGET"=="NULL")
        (
            INTERCOM.EVALUATE &targetprocessorport ADDRESS.OFFSET(D:(&entry_bkpt))
            &ENTRYHEXADDR_TARGET=EVAL()
            do std_intercom_cmds &targetprocessorport WAIT BREAK.DELETE &entry_bkpt
            do std_intercom_do &targetprocessorport std_utils SETBREAKPOINTS Onchip &entry_bkpt
            
            
        )
        ELSE IF ("&USEEXISTINGSYMS_TARGET"=="TRUE")&&("&ENTRYHEXADDR_TARGET"!="NULL")
        (
            do std_intercom_cmds &targetprocessorport WAIT BREAK.DELETE &ENTRYHEXADDR_TARGET
            do std_intercom_do &targetprocessorport std_utils SETBREAKPOINTS Onchip &ENTRYHEXADDR_TARGET
        )
        
        // Now set the exit breakpoints, and let it go
        do std_intercom_cmds &targetprocessorport NOWAIT Break.Set &error_bkpts /onchip, GO
        

        
        //Check that we stop in a reasonable amount of time
        LOCAL &T32_runstate
        &count=0
        INTERCOM.EVALUATE &targetprocessorport STATE.RUN()
        &T32_runstate=EVAL()
        
        LOCAL &counter
        &counter=0x0
        WHILE (STATE.RUN())&&(&counter<&processortimeoutvalue)
        (
            &counter=&counter+1.
            wait.100ms
        
        )

        IF &counter==50.
        (
            WINPOS 0. 0. 50. 10.
            area.reset
            area
            PRINT %ERROR "   Apps Processor did not stop at entry. "
            PRINT " "
            PRINT %ERROR "   Please Check if:"
            PRINT %ERROR "       - Symbols mismatch,"
            PRINT %ERROR "       - TZ image loaded "
            PRINT " "
            PRINT " "
            PRINT " "
            //Don't use same symbols on next run
            &USEEXISTINGSYMS_TARGET="FALSE"
            &ENTRYHEXADDR_TARGET="NULL"
            do std_fatalexit USER "std_debug_&targetprocessor - symbol mismatch; processor didn't halt at &entry_bkpt"
        )
        
        /////////////////////////////////////////////////////////////////////////////////////////////////////
        ////////////////////////////////Debug Logic - after first bp hit ////////////////////////////////////
        /////////////////////////////////////////////////////////////////////////////////////////////////////
        ////////////////////////////////This section sets all the options (LPM, CTI, breakpoints etc.)///////
        /////////////////////////////////////////////////////////////////////////////////////////////////////
        
        

        //now remove the entry breakpoint
        IF ("&USEEXISTINGSYMS_TARGET"=="FALSE")||("&ENTRYHEXADDR_TARGET"=="NULL")
        (
            INTERCOM.EXECUTE &targetprocessorport break.delete &entry_bkpt  
        )
        ELSE IF ("&USEEXISTINGSYMS_TARGET"=="TRUE")&&("&ENTRYHEXADDR_TARGET"!="NULL")
        (
            INTERCOM.EXECUTE &targetprocessorport break.delete &ENTRYHEXADDR_TARGET
        )
        
        IF ("&multi_elf_option"=="true")
        (
            //This will load secondary elfs to all open apps windows
            //Keep it silent, so append 'silent' option to whatever was given in extraoption
            do std_loadsyms_tz_secondary_elfs NULL remotely notliveattach NULL NULL &extraoption,silent
            
            //set breakpoints again in case some exist in other pd
            do std_intercom_do &targetprocessorport std_utils SETBREAKPOINTS Onchip &user_defined_bkpts
        
        )
        
        
        //We stop at this point per configuration
        
        
        WINPOS 0. 0. 
        DATA.LIST
        WINPOS 0. 50%
        REGISTER /SL
    )

    RETURN SUCCESS
    
HELP:
    AREA
    PRINT "This is helpful"
    RETURN SUCCESS
    
EXIT:
    LOCAL &rvalue
    ENTRY %LINE &rvalue
    ENDDO &rvalue
    

//Should never get here. 
FATALEXIT:
    LOCAL &rvalue
    ENTRY %LINE &rvalue
    IF STRING.SCAN("&FAILUREKEYWORD","FAILUREKEYWORD",0)==-1
    (
        GOSUB EXIT &FAILUREKEYWORD - &rvalue
    )
    ELSE
    (
        GOSUB EXIT &rvalue
    )
    
//Should never get here
    END


        

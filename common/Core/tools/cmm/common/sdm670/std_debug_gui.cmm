//============================================================================
//  Name:                                                                     
//    std_debug_gui.cmm 
//
//  Description:                                                              
//    Target specific script to display subsystems to debug
//                                                                            
// Copyright (c) 2012 - 2014 by Qualcomm Technologies, Incorporated.  All Rights Reserved.        
//
//
//
//
//                      EDIT HISTORY FOR FILE
//  This section contains comments describing changes made to the module.
//  Notice that changes are listed in reverse chronological order.
//
// when       who         what, where, why
// --------   ---         ---------------------------------------------------------
// 07/27/2016 JBILLING    Add testpd
// 12/09/2015 JBILLING    Add fusion platform menu
// 02/06/2015 RSSRIDHA    Fix Flashless/PCIE debug options
// 09/08/2014 rssridha    Created for 9x45 
//

MAIN:

LOCAL &debugconfig

    IF "&FUSION_PLATFORM"=="TRUE"
    (
            WINPOS 10. 5. 50. 15.
            DIALOG
            (
                HEADER "STD_Debug Options"
                //POS width, height, length
                POS 1. 0. 25
                 TEXT "8998/9x55 Fusion Configuration"
                POS 8. 1. 25
                 TEXT "8998 Options"
                 

                //POS 1. 2. 10.
                //MODEMDEBUG: DEFBUTTON "9x55-Modem/Apps" "GOSUB CALL_IMAGE_DEBUG_GUI mpss"
                
                //POS 1. 4. 10.
                //SLPIDEBUG: DEFBUTTON "SLPI" "GOSUB CALL_IMAGE_DEBUG_GUI slpi"   
                
                POS 1. 5. 10.
                ADSPDEBUG: DEFBUTTON "ADSP" "GOSUB CALL_IMAGE_DEBUG_GUI adsp"        
                
                POS 15. 3. 10.
                TZDEBUG: DEFBUTTON "TZ" "GOSUB EXECUTE_DEBUG tz"
                
                POS 15. 4. 10.
                APPSBOOTDEBUG: DEFBUTTON "appsboot" "GOSUB CALL_IMAGE_DEBUG_GUI appsboot"

                POS 15. 5. 10.
                BOOTDEBUG: DEFBUTTON "XBL" "GOSUB EXECUTE_DEBUG xbl"
                
                POS 15. 6. 10.
                AOPDEBUG: DEFBUTTON "AOP" "GOSUB CALL_IMAGE_DEBUG_GUI aop"

                
                
                //POS 1. 8. 10.
                //WCNDEBUG: DEFBUTTON "WCNSS" "GOSUB STD_DEBUG_CALL_GUI wcnss"
                
                
                //POS 15. 8. 10.
                //APPSPBLDEBUG: DEFBUTTON "APPSPBL" "GOSUB STD_DEBUG_EXECUTE_DEBUG appspbl"
                

                
                POS 32. 1. 10.
                TEXT "Fusion options"
                POS 30. 4. 14.
                FUSMODEMDEBUG: DEFBUTTON "9x55-Modem/Apps" "GOSUB CALL_IMAGE_DEBUG_GUI mpss-fus"
                
                POS 30. 5. 14.
                FUSMBADEBUG: DEFBUTTON "9x55-MBA" "GOSUB CALL_IMAGE_DEBUG_GUI mba"

                POS 30. 6. 14.
                FUSAOPDEBUG: DEFBUTTON "9x55-AOP" "GOSUB CALL_IMAGE_DEBUG_GUI aop-fus"

                
            )
            
            DIALOG.DISABLE FUSMBADEBUG
            DIALOG.DISABLE FUSAOPDEBUG
    )
    ELSE
    (
            WINPOS 10. 5. 40. 15.
            DIALOG
            (
                HEADER "STD_Debug Options"
                //POS width, height, length
                POS 1. 0. 25
                 TEXT "Select the system to debug"

                POS 1. 2. 10.
                MODEMDEBUG: DEFBUTTON "Modem" "GOSUB CALL_IMAGE_DEBUG_GUI mpss"
                
                //POS 1. 3. 10.
                //SLPIDEBUG: DEFBUTTON "SLPI" "GOSUB CALL_IMAGE_DEBUG_GUI slpi"   
                
                POS 1. 4. 10.
                ADSPDEBUG: DEFBUTTON "ADSP" "GOSUB CALL_IMAGE_DEBUG_GUI adsp"        
                
                POS 1. 5. 10.
                ADSPDEBUG: DEFBUTTON "CDSP" "GOSUB CALL_IMAGE_DEBUG_GUI cdsp"        
                
                POS 1. 6. 10.
                WLANDEBUG: DEFBUTTON "WLAN" "GOSUB CALL_IMAGE_DEBUG_GUI wlan"        
                
                POS 1. 7. 10.
                TESTPDDEBUG: DEFBUTTON "TESTPD" "GOSUB CALL_IMAGE_DEBUG_GUI testpd"        
                
                POS 15. 2. 10.
                TZDEBUG: DEFBUTTON "TZ" "GOSUB EXECUTE_DEBUG tz"
                
                POS 15. 3. 10.
                APPSBOOTDEBUG: DEFBUTTON "appsboot" "GOSUB CALL_IMAGE_DEBUG_GUI appsboot"

                POS 15. 4. 10.
                BOOTDEBUG: DEFBUTTON "XBL" "GOSUB EXECUTE_DEBUG xbl"
                
                POS 15. 5. 10.
                AOPDEBUG: DEFBUTTON "AOP" "GOSUB CALL_IMAGE_DEBUG_GUI aop"

                
                
                //POS 1. 8. 10.
                //WCNDEBUG: DEFBUTTON "WCNSS" "GOSUB STD_DEBUG_CALL_GUI wcnss"
                
                
                //POS 15. 8. 10.
                //APPSPBLDEBUG: DEFBUTTON "APPSPBL" "GOSUB STD_DEBUG_EXECUTE_DEBUG appspbl"
                
                POS 15. 9. 10.
                MBADEBUG: DEFBUTTON "MBA" "GOSUB CALL_IMAGE_DEBUG_GUI mba"

                
            )
        
    )
//    DIALOG.DISABLE APPSPBLDEBUG
    
    STOP
    
    
    DIALOG.END
    GOSUB EXIT

    
    
CALL_IMAGE_DEBUG_GUI:
    LOCAL &result
    ENTRY &result
    DIALOG.END
    do std_debug STD_DEBUG_CALL_GUI &result

    GOSUB EXIT


EXECUTE_DEBUG:
        LOCAL &result
        ENTRY &result
        DIALOG.END
        do std_debug Img=&result

    
EXIT:
    LOCAL &rvalue
    ENTRY %LINE &rvalue
    return &rvalue




// Title: std_intercom_dodecrypt

// License: License
// Copyright 2015 Qualcomm Technologies Inc

//	Description: General Description
//	This script allows an encrypted script to be executed in a remote T32 session synchronously
//
//	It can be executed from any T32 session.

//	Inputs: Inputs
//	Intercom handle, Script to be executed, Arguments to be passed to script

//	Output: Outputs
//	None

//	Usage: Usage
//  do std_intercom_dodecrypt <intercom_handle> <script name> <arguments to script>
//
//	do std_intercom_dodecrypt &RPM_T32 std_setupenv MSM8660

//  Team: Functional Area
//  CoreBSP Products 8660

//	Target: Target
//	MSM8660

//	Location: Perforce Revision

//	Edits: Edits
//	amcheriy	: Local intercom call detection		: 03/15/2011
//
//	amcheriy	: Removed semaphore usage for sync	: 03/15/2011
//	amcheriy	: Print commands print to area win	: 02/15/2011
//	amcheriy	: Created for MSM8660				: 12/15/2010
// ------------------------------------------------------------------------------------------

ENTRY &INTERCOM_HANDLE &SCRIPT_NAME &SCRIPT_ARG1 &SCRIPT_ARG2 &SCRIPT_ARG3 &SCRIPT_ARG4 &SCRIPT_ARG5 &SCRIPT_ARG6

LOCAL &SCRIPT_DIR
LOCAL &KEY

&SCRIPT_DIR=OS.PPD()
&KEY=OS.FILE.NAME(&SCRIPT_NAME)

IF ("&LOCALHOST_HANDLE"!="&INTERCOM_HANDLE")
(
	IF INTERCOM.PING(&INTERCOM_HANDLE)
	(
		INTERCOM &INTERCOM_HANDLE CD.DODECRYPT "&KEY" &SCRIPT_NAME.emm &SCRIPT_ARG1 &SCRIPT_ARG2 &SCRIPT_ARG3 &SCRIPT_ARG4 &SCRIPT_ARG5 &SCRIPT_ARG6 &SCRIPT_ARG7 &SCRIPT_ARG8
		INTERCOM.WAIT &INTERCOM_HANDLE
	)
	ELSE
	(
		PRINT "REMOTE T32 SESSION FAILED TO RESPOND: &INTERCOM_HANDLE"
	)
)
ELSE
(
	// THIS MEANS THE CALLING SESSION IS THE INTENDED SESSION TO RUN THE SCRIPT
	CD.DODECRYPT "&KEY" &SCRIPT_NAME.emm &SCRIPT_ARG1 &SCRIPT_ARG2 &SCRIPT_ARG3 &SCRIPT_ARG4 &SCRIPT_ARG5 &SCRIPT_ARG6
)	 

CD &SCRIPT_DIR
AREA.SELECT LOG
ENDDO

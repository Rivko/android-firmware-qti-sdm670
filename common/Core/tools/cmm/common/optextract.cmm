//============================================================================
//  Name:                                                                     
//    optextract.cmm 
//
//  Description:                                                              
//    Script to extract the values associated with keys in a string of key-value pairs
//                                                                            
// Copyright (c) 2014 - 2016 by QUALCOMM Technologies, Incorporated.  All Rights Reserved.        
//
//
//
//
//                      EDIT HISTORY FOR FILE
//  This section contains comments describing changes made to the module.
//  Notice that changes are listed in reverse chronological order.
//
// when       who           what, where, why
// --------   ---           ---------------------------------------------------------
// 03/10/2016 JBILLING      updated separator from '/' to '~'
// 04/28/2014 AJCheriyan    Fixed hardcoded path reference
// 02/28/2014 AJCheriyan    Created for SCRIPTS.2.0 warehouse


// ARG0 - String to be parsed in the format key1=value1 key2=value2 key3=value3
// Usage -
//  do optextract key1,key2 key1=value1 key2=value2 key3=value3 will return value1 value2
// OR
// Syntax to be deprecated: do optextract key1, key2 value1 value2 value3 will return value1 value2
 

MAIN:
    ENTRY &PARAMLIST %LINE &ARGUMENTS
    &ARGUMENTS=STRING.TRIM("&ARGUMENTS")

    LOCAL &ARGUMENTS1 &ARGUMENTS2
    LOCAL &PARAMETER0 &PARAMETER1 &PARAMETER2 &PARAMETER3 &PARAMETER4  
    LOCAL &PARAMETER5 &PARAMETER6 &PARAMETER7 &PARAMETER8 &PARAMETER9
    LOCAL &PARAMETER10 &PARAMETER11 &PARAMETER12 &PARAMETER13 &PARAMETER14  
    LOCAL &PARAMVAL0 &PARAMVAL1 &PARAMVAL2 &PARAMVAL3 &PARAMVAL4 
    LOCAL &PARAMVAL5 &PARAMVAL6 &PARAMVAL7 &PARAMVAL8 &PARAMVAL9
    LOCAL &PARAMVAL10 &PARAMVAL11 &PARAMVAL12 &PARAMVAL13 &PARAMVAL14

    // Other random locals
    LOCAL &TEMPARGUMENTS

    &PARAMVAL0=""
    &PARAMVAL1=""
    &PARAMVAL2=""
    &PARAMVAL3=""
    &PARAMVAL4=""
    &PARAMVAL5=""
    &PARAMVAL6=""
    &PARAMVAL7=""
    &PARAMVAL8=""
    &PARAMVAL9=""

    // Parse the list of parameters first to get all the parameters
    GOSUB SPLITUSINGSEP , &PARAMLIST
    ENTRY &PARAMETER0 &PARAMETER1 &PARAMETER2 &PARAMETER3 &PARAMETER4 &PARAMETER5 &PARAMETER6 &PARAMETER7 &PARAMETER8 &PARAMETER9

    // Now arrange the input arguments in the order they want it to be parsed.
    &COUNT=0
    WHILE (&COUNT<20)
    (

        IF ((STRING.SCAN("&ARGUMENTS", "&PARAMETER0", 0)>STRING.SCAN("&ARGUMENTS", "&PARAMETER1", 0))&&(STRING.SCAN("&ARGUMENTS", "&PARAMETER1", 0)>-1))
        (
            // swap them now
            &STRING1="&PARAMETER0"+STRING.SCANANDEXTRACT("&ARGUMENTS","&PARAMETER0","")
            &STRING2="&PARAMETER1"+STRING.SCANANDEXTRACT("&ARGUMENTS","&PARAMETER1","")
            
            &ARGUMENTS=STRING.REPLACE("&ARGUMENTS","&STRING1","&STRING2",1)
            &ARGUMENTS=STRING.REPLACE("&ARGUMENTS","&STRING2","&STRING1",1)
        )
        ELSE IF ((STRING.SCAN("&ARGUMENTS", "&PARAMETER0", 0)<0)&&("&PARAMETER0"!=""))
        (
            &ARGUMENTS= "&ARGUMENTS "+"&PARAMETER0"+"=NULL"
        )
        
        IF ((STRING.SCAN("&ARGUMENTS", "&PARAMETER1", 0)>STRING.SCAN("&ARGUMENTS", "&PARAMETER2", 0))&&(STRING.SCAN("&ARGUMENTS", "&PARAMETER2", 0)>-1))
        (
            // swap them now
            &STRING1="&PARAMETER1"+STRING.SCANANDEXTRACT("&ARGUMENTS","&PARAMETER1","")
            &STRING2="&PARAMETER2"+STRING.SCANANDEXTRACT("&ARGUMENTS","&PARAMETER2","")
            
            &ARGUMENTS=STRING.REPLACE("&ARGUMENTS","&STRING1","&STRING2",1)
            &ARGUMENTS=STRING.REPLACE("&ARGUMENTS","&STRING2","&STRING1",1)
        )
        ELSE IF ((STRING.SCAN("&ARGUMENTS", "&PARAMETER1", 0)<0)&&("&PARAMETER1"!=""))
        (
            &ARGUMENTS= "&ARGUMENTS "+"&PARAMETER1"+"=NULL"
        )
        IF ((STRING.SCAN("&ARGUMENTS", "&PARAMETER2", 0)>STRING.SCAN("&ARGUMENTS", "&PARAMETER3", 0))&&(STRING.SCAN("&ARGUMENTS", "&PARAMETER3", 0)>-1))
        (
            // swap them now
            &STRING1="&PARAMETER2"+STRING.SCANANDEXTRACT("&ARGUMENTS","&PARAMETER2","")
            &STRING2="&PARAMETER3"+STRING.SCANANDEXTRACT("&ARGUMENTS","&PARAMETER3","")
            
            &ARGUMENTS=STRING.REPLACE("&ARGUMENTS","&STRING1","&STRING2",1)
            &ARGUMENTS=STRING.REPLACE("&ARGUMENTS","&STRING2","&STRING1",1)
        )
        ELSE IF ((STRING.SCAN("&ARGUMENTS", "&PARAMETER2", 0)<0)&&("&PARAMETER2"!=""))
        (
            &ARGUMENTS= "&ARGUMENTS "+"&PARAMETER2"+"=NULL"
        )
        IF ((STRING.SCAN("&ARGUMENTS", "&PARAMETER3", 0)>STRING.SCAN("&ARGUMENTS", "&PARAMETER4", 0))&&(STRING.SCAN("&ARGUMENTS", "&PARAMETER4", 0)>-1))
        (
            // swap them now
            &STRING1="&PARAMETER3"+STRING.SCANANDEXTRACT("&ARGUMENTS","&PARAMETER3","")
            &STRING2="&PARAMETER4"+STRING.SCANANDEXTRACT("&ARGUMENTS","&PARAMETER4","")
            
            &ARGUMENTS=STRING.REPLACE("&ARGUMENTS","&STRING1","&STRING2",1)
            &ARGUMENTS=STRING.REPLACE("&ARGUMENTS","&STRING2","&STRING1",1)
        )
        ELSE IF ((STRING.SCAN("&ARGUMENTS", "&PARAMETER3", 0)<0)&&("&PARAMETER3"!=""))
        (
            &ARGUMENTS= "&ARGUMENTS "+"&PARAMETER3"+"=NULL"
        )
        IF ((STRING.SCAN("&ARGUMENTS", "&PARAMETER4", 0)>STRING.SCAN("&ARGUMENTS", "&PARAMETER5", 0))&&(STRING.SCAN("&ARGUMENTS", "&PARAMETER5", 0)>-1))
        (
            // swap them now
            &STRING1="&PARAMETER4"+STRING.SCANANDEXTRACT("&ARGUMENTS","&PARAMETER4","")
            &STRING2="&PARAMETER5"+STRING.SCANANDEXTRACT("&ARGUMENTS","&PARAMETER5","")
            
            &ARGUMENTS=STRING.REPLACE("&ARGUMENTS","&STRING1","&STRING2",1)
            &ARGUMENTS=STRING.REPLACE("&ARGUMENTS","&STRING2","&STRING1",1)
        )
        ELSE IF ((STRING.SCAN("&ARGUMENTS", "&PARAMETER4", 0)<0)&&("&PARAMETER4"!=""))
        (
            &ARGUMENTS= "&ARGUMENTS "+"&PARAMETER4"+"=NULL"

        )
        IF ((STRING.SCAN("&ARGUMENTS", "&PARAMETER5", 0)>STRING.SCAN("&ARGUMENTS", "&PARAMETER6", 0))&&(STRING.SCAN("&ARGUMENTS", "&PARAMETER6", 0)>-1))
        (
            // swap them now
            &STRING1="&PARAMETER5"+STRING.SCANANDEXTRACT("&ARGUMENTS","&PARAMETER5","")
            &STRING2="&PARAMETER0"+STRING.SCANANDEXTRACT("&ARGUMENTS","&PARAMETER6","")
            
            &ARGUMENTS=STRING.REPLACE("&ARGUMENTS","&STRING1","&STRING2",1)
            &ARGUMENTS=STRING.REPLACE("&ARGUMENTS","&STRING2","&STRING1",1)
        )
        ELSE IF ((STRING.SCAN("&ARGUMENTS", "&PARAMETER5", 0)<0)&&("&PARAMETER5"!=""))
        (
            &ARGUMENTS="&ARGUMENTS "+"&PARAMETER5"+"=NULL"
        )
        IF ((STRING.SCAN("&ARGUMENTS", "&PARAMETER6", 0)>STRING.SCAN("&ARGUMENTS", "&PARAMETER7", 0))&&(STRING.SCAN("&ARGUMENTS", "&PARAMETER7", 0)>-1))
        (
            // swap them now
            &STRING1="&PARAMETER5"+STRING.SCANANDEXTRACT("&ARGUMENTS","&PARAMETER6","")
            &STRING2="&PARAMETER0"+STRING.SCANANDEXTRACT("&ARGUMENTS","&PARAMETER7","")
            
            &ARGUMENTS=STRING.REPLACE("&ARGUMENTS","&STRING1","&STRING2",1)
            &ARGUMENTS=STRING.REPLACE("&ARGUMENTS","&STRING2","&STRING1",1)
        )
        ELSE IF ((STRING.SCAN("&ARGUMENTS", "&PARAMETER6", 0)<0)&&("&PARAMETER6"!=""))
        (
            &ARGUMENTS="&ARGUMENTS "+"&PARAMETER6"+"=NULL"
        )
        IF ((STRING.SCAN("&ARGUMENTS", "&PARAMETER7", 0)>STRING.SCAN("&ARGUMENTS", "&PARAMETER8", 0))&&(STRING.SCAN("&ARGUMENTS", "&PARAMETER8", 0)>-1))
        (
            // swap them now
            &STRING1="&PARAMETER5"+STRING.SCANANDEXTRACT("&ARGUMENTS","&PARAMETER7","")
            &STRING2="&PARAMETER0"+STRING.SCANANDEXTRACT("&ARGUMENTS","&PARAMETER8","")
            
            &ARGUMENTS=STRING.REPLACE("&ARGUMENTS","&STRING1","&STRING2",1)
            &ARGUMENTS=STRING.REPLACE("&ARGUMENTS","&STRING2","&STRING1",1)
        )
        ELSE IF ((STRING.SCAN("&ARGUMENTS", "&PARAMETER7", 0)<0)&&("&PARAMETER7"!=""))
        (
            &ARGUMENTS="&ARGUMENTS "+"&PARAMETER7"+"=NULL"
        )
        IF ((STRING.SCAN("&ARGUMENTS", "&PARAMETER8", 0)>STRING.SCAN("&ARGUMENTS", "&PARAMETER8", 0))&&(STRING.SCAN("&ARGUMENTS", "&PARAMETER9", 0)>-1))
        (
            // swap them now
            &STRING1="&PARAMETER5"+STRING.SCANANDEXTRACT("&ARGUMENTS","&PARAMETER8","")
            &STRING2="&PARAMETER0"+STRING.SCANANDEXTRACT("&ARGUMENTS","&PARAMETER9","")
            
            &ARGUMENTS=STRING.REPLACE("&ARGUMENTS","&STRING1","&STRING2",1)
            &ARGUMENTS=STRING.REPLACE("&ARGUMENTS","&STRING2","&STRING1",1)
        )
        ELSE IF ((STRING.SCAN("&ARGUMENTS", "&PARAMETER8", 0)<0)&&("&PARAMETER8"!=""))
        (
            &ARGUMENTS="&ARGUMENTS "+"&PARAMETER8"+"=NULL"
        )
        IF ((STRING.SCAN("&ARGUMENTS", "&PARAMETER9", 0)>STRING.SCAN("&ARGUMENTS", "&PARAMETER0", 0))&&(STRING.SCAN("&ARGUMENTS", "&PARAMETER0", 0)>-1))
        (
            // swap them now
            &STRING1="&PARAMETER5"+STRING.SCANANDEXTRACT("&ARGUMENTS","&PARAMETER9","")
            &STRING2="&PARAMETER0"+STRING.SCANANDEXTRACT("&ARGUMENTS","&PARAMETER0","")
            
            &ARGUMENTS=STRING.REPLACE("&ARGUMENTS","&STRING1","&STRING2",1)
            &ARGUMENTS=STRING.REPLACE("&ARGUMENTS","&STRING2","&STRING1",1)
        )
        ELSE IF ((STRING.SCAN("&ARGUMENTS", "&PARAMETER9", 0)<0)&&("&PARAMETER9"!=""))
        (
            &ARGUMENTS="&ARGUMENTS "+"&PARAMETER7"+"=NULL"
        )

        &COUNT=&COUNT+1
    )
   

    // Check if we need to split the string into smaller ones to accommodate length limitations
    LOCAL &separator
    &separator="~"
    &TEMPARGUMENTS=STRING.REPLACE("&ARGUMENTS"," ","&separator",0)
    //GOSUB SPLITUSINGSEP / &TEMPARGUMENTS GetCount
    GOSUB SPLITUSINGSEP &separator &TEMPARGUMENTS GetCount

    ENTRY &WORDSCOUNTED
    
    // Lower level parsing script supports 9 key-value pairs. If greater, split
    IF (&WORDSCOUNTED>9)
    (
        GOSUB STRINGSPLITINTWO &TEMPARGUMENTS 9-&WORDSCOUNTED 
        ENTRY &ARGUMENTS1 &ARGUMENTS2
        &ARGUMENTS1=STRING.REPLACE("&ARGUMENTS1","&separator"," ",0)
        &ARGUMENTS2=STRING.REPLACE("&ARGUMENTS2","&separator"," ",0)
    )
    ELSE
    (
        &ARGUMENTS1="&ARGUMENTS"
        &ARGUMENTS2=""
    )
    
    // Now parse the string of key-value pairs
    do argparser.cmm &ARGUMENTS1
    ENTRY &KEY0 &VALUE0 &KEY1 &VALUE1 &KEY2 &VALUE2 &KEY3 &VALUE3 &KEY4 &VALUE4 &KEY5 &VALUE5 &KEY6 &VALUE6 &KEY7 &VALUE7 &KEY8 &VALUE8
    do argparser.cmm &ARGUMENTS2
    ENTRY &KEY9 &VALUE9 &KEY10 &VALUE10 &KEY11 &VALUE11 &KEY12 &VALUE12 &KEY13 &VALUE13 &KEY14 &VALUE14 

    // Check for the parameter we care about
    IF ("&KEY0"!="")&&(("&PARAMETER0"=="&KEY0")||("&PARAMETER1"=="&KEY0")||("&PARAMETER2"=="&KEY0")||("&PARAMETER3"=="&KEY0")||("&PARAMETER4"=="&KEY0")||("&PARAMETER5"=="&KEY0")||("&PARAMETER6"=="&KEY0")||("&PARAMETER7"=="&KEY0")||("&PARAMETER8"=="&KEY0")||("&PARAMETER9"=="&KEY0")||("&PARAMETER10"=="&KEY0")||("&PARAMETER11"=="&KEY0")||("&PARAMETER12"=="&KEY0")||("&PARAMETER13"=="&KEY0")||("&PARAMETER14"=="&KEY0"))
    (
        &PARAMVAL0="&VALUE0"
    )
    IF ("&KEY1"!="")&&(("&PARAMETER0"=="&KEY1")||("&PARAMETER1"=="&KEY1")||("&PARAMETER2"=="&KEY1")||("&PARAMETER3"=="&KEY1")||("&PARAMETER4"=="&KEY1")||("&PARAMETER5"=="&KEY1")||("&PARAMETER6"=="&KEY1")||("&PARAMETER7"=="&KEY1")||("&PARAMETER8"=="&KEY1")||("&PARAMETER9"=="&KEY1")||("&PARAMETER10"=="&KEY1")||("&PARAMETER11"=="&KEY1")||("&PARAMETER12"=="&KEY1")||("&PARAMETER13"=="&KEY1")||("&PARAMETER14"=="&KEY1"))
    (
        &PARAMVAL1="&VALUE1"
    )
    IF ("&KEY2"!="")&&(("&PARAMETER0"=="&KEY2")||("&PARAMETER1"=="&KEY2")||("&PARAMETER2"=="&KEY2")||("&PARAMETER3"=="&KEY2")||("&PARAMETER4"=="&KEY2")||("&PARAMETER5"=="&KEY2")||("&PARAMETER6"=="&KEY2")||("&PARAMETER7"=="&KEY2")||("&PARAMETER8"=="&KEY2")||("&PARAMETER9"=="&KEY2")||("&PARAMETER10"=="&KEY2")||("&PARAMETER11"=="&KEY2")||("&PARAMETER12"=="&KEY2")||("&PARAMETER13"=="&KEY2")||("&PARAMETER14"=="&KEY2"))
    (
        &PARAMVAL2="&VALUE2"
    )
    IF ("&KEY3"!="")&&(("&PARAMETER0"=="&KEY3")||("&PARAMETER1"=="&KEY3")||("&PARAMETER2"=="&KEY3")||("&PARAMETER3"=="&KEY3")||("&PARAMETER4"=="&KEY3")||("&PARAMETER5"=="&KEY3")||("&PARAMETER6"=="&KEY3")||("&PARAMETER7"=="&KEY3")||("&PARAMETER8"=="&KEY3")||("&PARAMETER9"=="&KEY3")||("&PARAMETER10"=="&KEY3")||("&PARAMETER11"=="&KEY3")||("&PARAMETER12"=="&KEY3")||("&PARAMETER13"=="&KEY3")||("&PARAMETER14"=="&KEY3"))
    (
        &PARAMVAL3="&VALUE3"
    )
    IF ("&KEY4"!="")&&(("&PARAMETER0"=="&KEY4")||("&PARAMETER1"=="&KEY4")||("&PARAMETER2"=="&KEY4")||("&PARAMETER3"=="&KEY4")||("&PARAMETER4"=="&KEY4")||("&PARAMETER5"=="&KEY4")||("&PARAMETER6"=="&KEY4")||("&PARAMETER7"=="&KEY4")||("&PARAMETER8"=="&KEY4")||("&PARAMETER9"=="&KEY4")||("&PARAMETER10"=="&KEY4")||("&PARAMETER11"=="&KEY4")||("&PARAMETER12"=="&KEY4")||("&PARAMETER13"=="&KEY4")||("&PARAMETER14"=="&KEY4"))
    (
        &PARAMVAL4="&VALUE4"
    )
    IF ("&KEY5"!="")&&(("&PARAMETER0"=="&KEY5")||("&PARAMETER1"=="&KEY5")||("&PARAMETER2"=="&KEY5")||("&PARAMETER3"=="&KEY5")||("&PARAMETER4"=="&KEY5")||("&PARAMETER5"=="&KEY5")||("&PARAMETER6"=="&KEY5")||("&PARAMETER7"=="&KEY5")||("&PARAMETER8"=="&KEY5")||("&PARAMETER9"=="&KEY5")||("&PARAMETER10"=="&KEY5")||("&PARAMETER11"=="&KEY5")||("&PARAMETER12"=="&KEY5")||("&PARAMETER13"=="&KEY5")||("&PARAMETER14"=="&KEY5"))
    (
        &PARAMVAL5="&VALUE5"
    )
    IF ("&KEY6"!="")&&(("&PARAMETER0"=="&KEY6")||("&PARAMETER1"=="&KEY6")||("&PARAMETER2"=="&KEY6")||("&PARAMETER3"=="&KEY6")||("&PARAMETER4"=="&KEY6")||("&PARAMETER5"=="&KEY6")||("&PARAMETER6"=="&KEY6")||("&PARAMETER7"=="&KEY6")||("&PARAMETER8"=="&KEY6")||("&PARAMETER9"=="&KEY6")||("&PARAMETER10"=="&KEY6")||("&PARAMETER11"=="&KEY6")||("&PARAMETER12"=="&KEY6")||("&PARAMETER13"=="&KEY6")||("&PARAMETER14"=="&KEY6"))
    (
        &PARAMVAL6="&VALUE6"
    )
    IF ("&KEY7"!="")&&(("&PARAMETER0"=="&KEY7")||("&PARAMETER1"=="&KEY7")||("&PARAMETER2"=="&KEY7")||("&PARAMETER3"=="&KEY7")||("&PARAMETER4"=="&KEY7")||("&PARAMETER5"=="&KEY7")||("&PARAMETER6"=="&KEY7")||("&PARAMETER7"=="&KEY7")||("&PARAMETER8"=="&KEY7")||("&PARAMETER9"=="&KEY7")||("&PARAMETER10"=="&KEY7")||("&PARAMETER11"=="&KEY7")||("&PARAMETER12"=="&KEY7")||("&PARAMETER13"=="&KEY7")||("&PARAMETER14"=="&KEY7"))
    (
        &PARAMVAL7="&VALUE7"
    )
    IF ("&KEY8"!="")&&(("&PARAMETER0"=="&KEY8")||("&PARAMETER1"=="&KEY8")||("&PARAMETER2"=="&KEY8")||("&PARAMETER3"=="&KEY8")||("&PARAMETER4"=="&KEY8")||("&PARAMETER5"=="&KEY8")||("&PARAMETER6"=="&KEY8")||("&PARAMETER7"=="&KEY8")||("&PARAMETER8"=="&KEY8")||("&PARAMETER9"=="&KEY8")||("&PARAMETER10"=="&KEY8")||("&PARAMETER11"=="&KEY8")||("&PARAMETER12"=="&KEY8")||("&PARAMETER13"=="&KEY8")||("&PARAMETER14"=="&KEY8"))
    (
        &PARAMVAL8="&VALUE8"
    )
    IF ("&KEY9"!="")&&(("&PARAMETER0"=="&KEY9")||("&PARAMETER1"=="&KEY9")||("&PARAMETER2"=="&KEY9")||("&PARAMETER3"=="&KEY9")||("&PARAMETER4"=="&KEY9")||("&PARAMETER5"=="&KEY9")||("&PARAMETER6"=="&KEY9")||("&PARAMETER7"=="&KEY9")||("&PARAMETER8"=="&KEY9")||("&PARAMETER9"=="&KEY9")||("&PARAMETER10"=="&KEY9")||("&PARAMETER11"=="&KEY9")||("&PARAMETER12"=="&KEY9")||("&PARAMETER13"=="&KEY9")||("&PARAMETER14"=="&KEY9"))
    (
        &PARAMVAL9="&VALUE9"
    )
    IF ("&KEY10"!="")&&(("&PARAMETER0"=="&KEY10")||("&PARAMETER1"=="&KEY10")||("&PARAMETER2"=="&KEY10")||("&PARAMETER3"=="&KEY10")||("&PARAMETER4"=="&KEY10")||("&PARAMETER5"=="&KEY10")||("&PARAMETER6"=="&KEY10")||("&PARAMETER7"=="&KEY10")||("&PARAMETER8"=="&KEY10")||("&PARAMETER9"=="&KEY10")||("&PARAMETER10"=="&KEY10")||("&PARAMETER11"=="&KEY10")||("&PARAMETER12"=="&KEY10")||("&PARAMETER13"=="&KEY10")||("&PARAMETER14"=="&KEY10"))
    (
        &PARAMVAL10="&VALUE10"
    )
    IF ("&KEY11"!="")&&(("&PARAMETER0"=="&KEY11")||("&PARAMETER1"=="&KEY11")||("&PARAMETER2"=="&KEY11")||("&PARAMETER3"=="&KEY11")||("&PARAMETER4"=="&KEY11")||("&PARAMETER5"=="&KEY11")||("&PARAMETER6"=="&KEY11")||("&PARAMETER7"=="&KEY11")||("&PARAMETER8"=="&KEY11")||("&PARAMETER9"=="&KEY11")||("&PARAMETER10"=="&KEY11")||("&PARAMETER11"=="&KEY11")||("&PARAMETER12"=="&KEY11")||("&PARAMETER13"=="&KEY11")||("&PARAMETER14"=="&KEY11"))
    (
        &PARAMVAL11="&VALUE11"
    )
    IF ("&KEY12"!="")&&(("&PARAMETER0"=="&KEY12")||("&PARAMETER1"=="&KEY12")||("&PARAMETER2"=="&KEY12")||("&PARAMETER3"=="&KEY12")||("&PARAMETER4"=="&KEY12")||("&PARAMETER5"=="&KEY12")||("&PARAMETER6"=="&KEY12")||("&PARAMETER7"=="&KEY12")||("&PARAMETER8"=="&KEY12")||("&PARAMETER9"=="&KEY12")||("&PARAMETER10"=="&KEY12")||("&PARAMETER11"=="&KEY12")||("&PARAMETER12"=="&KEY12")||("&PARAMETER13"=="&KEY12")||("&PARAMETER14"=="&KEY12"))
    (
        &PARAMVAL12="&VALUE12"
    )
    IF ("&KEY13"!="")&&(("&PARAMETER0"=="&KEY13")||("&PARAMETER1"=="&KEY13")||("&PARAMETER2"=="&KEY13")||("&PARAMETER3"=="&KEY13")||("&PARAMETER4"=="&KEY13")||("&PARAMETER5"=="&KEY13")||("&PARAMETER6"=="&KEY13")||("&PARAMETER7"=="&KEY13")||("&PARAMETER8"=="&KEY13")||("&PARAMETER9"=="&KEY13")||("&PARAMETER10"=="&KEY13")||("&PARAMETER11"=="&KEY13")||("&PARAMETER12"=="&KEY13")||("&PARAMETER13"=="&KEY13")||("&PARAMETER14"=="&KEY13"))
    (
        &PARAMVAL13="&VALUE13"
    )
    IF ("&KEY14"!="")&&(("&PARAMETER0"=="&KEY14")||("&PARAMETER1"=="&KEY14")||("&PARAMETER2"=="&KEY14")||("&PARAMETER3"=="&KEY14")||("&PARAMETER4"=="&KEY14")||("&PARAMETER5"=="&KEY14")||("&PARAMETER6"=="&KEY14")||("&PARAMETER7"=="&KEY14")||("&PARAMETER8"=="&KEY14")||("&PARAMETER9"=="&KEY14")||("&PARAMETER10"=="&KEY14")||("&PARAMETER11"=="&KEY14")||("&PARAMETER12"=="&KEY14")||("&PARAMETER13"=="&KEY14")||("&PARAMETER14"=="&KEY14"))
    (
        &PARAMVAL14="&VALUE14"
    )   

    // We could have cases where all return values are not populated. Shift to the left. Assume we have at least one return value and that should be populated correctly.
    &COUNT=0
    WHILE (&COUNT<15)
    (
        IF ("&PARAMVAL0"=="")
        (
            &PARAMVAL0="&PARAMVAL1"
            &PARAMVAL1="&PARAMVAL2"
            &PARAMVAL2="&PARAMVAL3"
            &PARAMVAL3="&PARAMVAL4"
            &PARAMVAL4="&PARAMVAL5"
            &PARAMVAL5="&PARAMVAL6"
            &PARAMVAL6="&PARAMVAL7"
            &PARAMVAL7="&PARAMVAL8"
            &PARAMVAL8="&PARAMVAL9"
            &PARAMVAL9="&PARAMVAL10"
            &PARAMVAL10="&PARAMVAL11"
            &PARAMVAL11="&PARAMVAL12"
            &PARAMVAL12="&PARAMVAL13"
            &PARAMVAL13="&PARAMVAL14"           
        )
        IF ("&PARAMVAL1"=="")
        (
            &PARAMVAL1="&PARAMVAL2"
            &PARAMVAL2="&PARAMVAL3"
            &PARAMVAL3="&PARAMVAL4"
            &PARAMVAL4="&PARAMVAL5"
            &PARAMVAL5="&PARAMVAL6"
            &PARAMVAL6="&PARAMVAL7"
            &PARAMVAL7="&PARAMVAL8"
            &PARAMVAL8="&PARAMVAL9"
            &PARAMVAL9="&PARAMVAL10"
            &PARAMVAL10="&PARAMVAL11"
            &PARAMVAL11="&PARAMVAL12"
            &PARAMVAL12="&PARAMVAL13"
            &PARAMVAL13="&PARAMVAL14"           
        )
        ELSE IF ("&PARAMVAL2"=="")
        (
            &PARAMVAL2="&PARAMVAL3"
            &PARAMVAL3="&PARAMVAL4"
            &PARAMVAL4="&PARAMVAL5"
            &PARAMVAL5="&PARAMVAL6"
            &PARAMVAL6="&PARAMVAL7"
            &PARAMVAL7="&PARAMVAL8"
            &PARAMVAL8="&PARAMVAL9"
            &PARAMVAL9="&PARAMVAL10"
            &PARAMVAL10="&PARAMVAL11"
            &PARAMVAL11="&PARAMVAL12"
            &PARAMVAL12="&PARAMVAL13"
            &PARAMVAL13="&PARAMVAL14"
        )
        ELSE IF ("&PARAMVAL3"=="")
        (
            &PARAMVAL3="&PARAMVAL4"
            &PARAMVAL4="&PARAMVAL5"
            &PARAMVAL5="&PARAMVAL6"
            &PARAMVAL6="&PARAMVAL7"
            &PARAMVAL7="&PARAMVAL8"
            &PARAMVAL8="&PARAMVAL9"
            &PARAMVAL9="&PARAMVAL10"
            &PARAMVAL10="&PARAMVAL11"
            &PARAMVAL11="&PARAMVAL12"
            &PARAMVAL12="&PARAMVAL13"
            &PARAMVAL13="&PARAMVAL14"
        )
        ELSE IF ("&PARAMVAL4"=="")
        (
            &PARAMVAL4="&PARAMVAL5"
            &PARAMVAL5="&PARAMVAL6"
            &PARAMVAL6="&PARAMVAL7"
            &PARAMVAL7="&PARAMVAL8"
            &PARAMVAL8="&PARAMVAL9"
            &PARAMVAL9="&PARAMVAL10"
            &PARAMVAL10="&PARAMVAL11"
            &PARAMVAL11="&PARAMVAL12"
            &PARAMVAL12="&PARAMVAL13"
            &PARAMVAL13="&PARAMVAL14"
        )
        ELSE IF ("&PARAMVAL5"=="")
        (
            &PARAMVAL5="&PARAMVAL6"
            &PARAMVAL6="&PARAMVAL7"
            &PARAMVAL7="&PARAMVAL8"
            &PARAMVAL8="&PARAMVAL9"
            &PARAMVAL9="&PARAMVAL10"
            &PARAMVAL10="&PARAMVAL11"
            &PARAMVAL11="&PARAMVAL12"
            &PARAMVAL12="&PARAMVAL13"
            &PARAMVAL13="&PARAMVAL14"
        )
        ELSE IF ("&PARAMVAL6"=="")
        (
            &PARAMVAL6="&PARAMVAL7"
            &PARAMVAL7="&PARAMVAL8"
            &PARAMVAL8="&PARAMVAL9"
            &PARAMVAL9="&PARAMVAL10"
            &PARAMVAL10="&PARAMVAL11"
            &PARAMVAL11="&PARAMVAL12"
            &PARAMVAL12="&PARAMVAL13"
            &PARAMVAL13="&PARAMVAL14"
        )
        ELSE IF ("&PARAMVAL7"=="")
        (
            &PARAMVAL7="&PARAMVAL8"
            &PARAMVAL8="&PARAMVAL9"
            &PARAMVAL9="&PARAMVAL10"
            &PARAMVAL10="&PARAMVAL11"
            &PARAMVAL11="&PARAMVAL12"
            &PARAMVAL12="&PARAMVAL13"
            &PARAMVAL13="&PARAMVAL14"
        )
        ELSE IF ("&PARAMVAL8"=="")
        (
            &PARAMVAL8="&PARAMVAL9"
            &PARAMVAL9="&PARAMVAL10"
            &PARAMVAL10="&PARAMVAL11"
            &PARAMVAL11="&PARAMVAL12"
            &PARAMVAL12="&PARAMVAL13"
            &PARAMVAL13="&PARAMVAL14"
        )
        ELSE IF ("&PARAMVAL9"=="")
        (
            &PARAMVAL9="&PARAMVAL10"
            &PARAMVAL10="&PARAMVAL11"
            &PARAMVAL11="&PARAMVAL12"
            &PARAMVAL12="&PARAMVAL13"
            &PARAMVAL13="&PARAMVAL14"
        )
        ELSE IF ("&PARAMVAL10"=="")
        (
            &PARAMVAL10="&PARAMVAL11"
            &PARAMVAL11="&PARAMVAL12"
            &PARAMVAL12="&PARAMVAL13"
            &PARAMVAL13="&PARAMVAL14"
        )
        ELSE IF ("&PARAMVAL11"=="")
        (
            &PARAMVAL11="&PARAMVAL12"
            &PARAMVAL12="&PARAMVAL13"
            &PARAMVAL13="&PARAMVAL14"
        )
        ELSE IF ("&PARAMVAL12"=="")
        (
            &PARAMVAL12="&PARAMVAL13"
            &PARAMVAL13="&PARAMVAL14"
        )       
        ELSE IF ("&PARAMVAL13"=="")
        (
            &PARAMVAL13="&PARAMVAL14"
        )
        &COUNT=&COUNT+1
    )
    
//Now exit with the return values in the order they were requested
EXIT:
    do std_utils SANITIZEQUOTATIONS NULL &PARAMVAL0 &PARAMVAL1 &PARAMVAL2 &PARAMVAL3 &PARAMVAL4 &PARAMVAL5 &PARAMVAL6 &PARAMVAL7 &PARAMVAL8 &PARAMVAL9 &PARAMVAL10  &PARAMVAL11 &PARAMVAL12 &PARAMVAL13 &PARAMVAL14
    ENTRY &PARAMVAL0 &PARAMVAL1 &PARAMVAL2 &PARAMVAL3 &PARAMVAL4 &PARAMVAL5 &PARAMVAL6 &PARAMVAL7 &PARAMVAL8 &PARAMVAL9 &PARAMVAL10  &PARAMVAL11 &PARAMVAL12 &PARAMVAL13 &PARAMVAL14
    ENDDO &PARAMVAL0 &PARAMVAL1 &PARAMVAL2 &PARAMVAL3 &PARAMVAL4 &PARAMVAL5 &PARAMVAL6 &PARAMVAL7 &PARAMVAL8 &PARAMVAL9 &PARAMVAL10  &PARAMVAL11 &PARAMVAL12 &PARAMVAL13 &PARAMVAL14


// Function to concatenate strings
CONCAT:
    ENTRY &STR0 &STR1 &STR2 &STR3 &STR4 &STR5
    
    LOCAL &RSTR
    &RSTR=""
    IF ("&STR0"!="")
    (
        &RSTR="&RSTR"+"&STR0,"
    )
    IF ("&STR1"!="")
    (
        &RSTR="&RSTR"+"&STR1,"
    )
    IF ("&STR2"!="")
    (
        &RSTR="&RSTR"+"&STR2,"
    )
    IF ("&STR3"!="")
    (
        &RSTR="&RSTR"+"&STR3,"
    )
    IF ("&STR4"!="")
    (
        &RSTR="&RSTR"+"&STR4,"
    )
    IF ("&STR5"!="")
    (
        &RSTR="&RSTR"+"&STR5,"
    )

    &RSTR=STRING.REPLACE("&RSTR",",","",-1)
    RETURN &RSTR


// Function to split a single strip into a 2
// Input arguments include the string to split and the position of the word
// where we need to split
STRINGSPLITINTWO:
    ENTRY &STRINGTOSPLIT &SPLITLOCATION1
    LOCAL &RTRSTRING1 &RTRSTRING2 &RTRSTRING1START &RTRSTRING2START
    LOCAL &TEMPSTRING

    &TEMPSTRING=STRING.REPLACE("&STRINGTOSPLIT ",",","SPLIT", &SPLITLOCATION1)
    &RTRSTRING1START=STRING.SCAN("&TEMPSTRING","SPLIT",0)
    &RTRSTRING1=STRING.MID("&TEMPSTRING",0,&RTRSTRING1START)
    
    
    &RTRSTRING2=STRING.MID("&TEMPSTRING",&RTRSTRING1START+5,STRING.LEN("&TEMPSTRING"))
    RETURN &RTRSTRING1 &RTRSTRING2

// Function to split a string based on a separator. Space is not supported because of 
// Practice limitations
SPLITUSINGSEP:
    // The separator to look for
    ENTRY &SEPSEARCH &STRINGTOPARSE &RCOUNT
    LOCAL &ENTRY0 &ENTRY1 &ENTRY2 &ENTRY3 &ENTRY4 &ENTRY5 &ENTRY6 &ENTRY7 &ENTRY8 &ENTRY9
    LOCAL &COUNTER
    // Parse the list of parameters first to get all the parameters
    &LENGTH=STRING.LEN("&STRINGTOPARSE")
    &CPYPARAMLIST="&STRINGTOPARSE"
    &COUNTER=0

    WHILE (&LENGTH>0)
    (
        &ARGEND=STRING.SCAN("&CPYPARAMLIST","&SEPSEARCH",0)
        // Check if this is the last entry in the list
        IF (&ARGEND==-1)
        (
            &ARGEND=&LENGTH
        )
        
        // Extract the parameters one at a time
        IF (&COUNTER==0)
        (
            &ENTRY0=STRING.MID("&CPYPARAMLIST",0,&ARGEND)
        )
        IF (&COUNTER==1)
        (
            &ENTRY1=STRING.MID("&CPYPARAMLIST",0,&ARGEND)
        )
        IF (&COUNTER==2)
        (
            &ENTRY2=STRING.MID("&CPYPARAMLIST",0,&ARGEND)
        )
        IF (&COUNTER==3)
        (
            &ENTRY3=STRING.MID("&CPYPARAMLIST",0,&ARGEND)
        )
        IF (&COUNTER==4)
        (
            &ENTRY4=STRING.MID("&CPYPARAMLIST",0,&ARGEND)
        )
        IF (&COUNTER==5)
        (
            &ENTRY5=STRING.MID("&CPYPARAMLIST",0,&ARGEND)
        )
        // Extract the parameters one at a time
        IF (&COUNTER==6)
        (
            &ENTRY6=STRING.MID("&CPYPARAMLIST",0,&ARGEND)
        )
        IF (&COUNTER==7)
        (
            &ENTRY7=STRING.MID("&CPYPARAMLIST",0,&ARGEND)
        )
        IF (&COUNTER==8)
        (
            &ENTRY8=STRING.MID("&CPYPARAMLIST",0,&ARGEND)
        )
        IF (&COUNTER==9)
        (
            &ENTRY9=STRING.MID("&CPYPARAMLIST",0,&ARGEND)
        )
    
        IF (&ARGEND==-1)
        (
            &CPYPARAMLIST=""
        )
        ELSE
        (
            &CPYPARAMLIST=STRING.MID("&CPYPARAMLIST",&ARGEND+1,&LENGTH)
        )
        &LENGTH=STRING.LEN("&CPYPARAMLIST")
        &COUNTER=&COUNTER+1
    )
    
    // Either return count or strings
    IF ("&RCOUNT"=="GetCount")
    (
        RETURN &COUNTER
    )
    ELSE
    (
        RETURN &ENTRY0 &ENTRY1 &ENTRY2 &ENTRY3 &ENTRY4 &ENTRY5 &ENTRY6 &ENTRY7 &ENTRY8 &ENTRY9
    )
    
    

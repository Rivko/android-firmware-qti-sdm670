//============================================================================
//  Name:                                                                     
//    std_loadsyms_tz_secondary_elfs.cmm 
//
//  Description:                                                              
//    Script to load TrustZone image symbols
//                                                                            
// Copyright (c) 2012 - 2014 by Qualcomm Technologies, Incorporated.  All Rights Reserved.        
//
//
//
//
//                      EDIT HISTORY FOR FILE
//  This section contains comments describing changes made to the module.
//  Notice that changes are listed in reverse chronological order.
//
// when       who           what, where, why
// --------   ---           ---------------------------------------------------------
// 03/28/2016 JBILLING      Moved sessioncfg logic to std_sessioncfg..
// 03/10/2016 JBILLING      Updated temp path for host OS
// 02/16/2016 JBILLING      BUILDID and context menu search
// 09/14/2015 JBILLING      Changes made for automation
// 08/05/2015 JBILLING      Added automation supprot and updated for elf chosen apart from given build usecase
// 06/18/2015 JBILLING      Add plusvm option
// 02/05/2015 JBILLING      Added functionality for std_apps
// 02/02/2015 JBILLING      Minor bug/parsing fixes
// 01/13/2015 JBILLING      Created

//




//###################Arguments passed #####################
LOCAL &ArgumentLine
ENTRY %LINE &ArgumentLine
LOCAL &UTILITY &OPTION &IARG0 &IARG1 &IARG2 &IARG3 &IARG4 &IARG5 &IARG6 &IARG7 &IARG8 &IARG9 &IARG10 &IARG11
ENTRY &UTILITY &OPTION &IARG0 &IARG1 &IARG2 &IARG3 &IARG4 &IARG5 &IARG6 &IARG7 &IARG8 &IARG9 &IARG10 &IARG11

//###################Variables #####################
LOCAL &ELFFILE  &LOCAL_BUILDROOT
LOCAL &LocalCopyHyp &LocalCopyMon

LOCAL &Processor_Root_Name &Elf_Directory
LOCAL &targetprocessorport

&Processor_Root_Name="trustzone_images"

&ELFFILE="NULL" 
&LOCAL_BUILDROOT="NULL"

&Elf_Directory="&Processor_Root_Name"
LOCAL &file &filename &what_to_cut &location &filepath &elf_filename &elf_filepath &elf_fullpath
LOCAL &RootElfSuffix &SuffixSearchValue_NonReloc &SuffixSearchValue_Reloc &Suffix_NonReloc &Suffix_Reloc

&RootElfSuffix=".elf"
&SuffixSearchValue_NonReloc=".elf"
&SuffixSearchValue_Reloc=".elf"
&Suffix_NonReloc=".elf"
&Suffix_Reloc=".elf"




//#####################Select Subroutine###################
// Name of the utility we are calling
LOCAL &SUBROUTINE
// Any subroutine specific options
// Default exists for each subroutine


// Input Argument 0 is the name of the utility
&SUBROUTINE="&UTILITY"
&SUBROUTINE=STR.UPR("&SUBROUTINE")
IF !(("&SUBROUTINE"=="HELP"))
(
    GOSUB MAIN &UTILITY &OPTION &IARG0 &IARG1 &IARG2 &IARG3 &IARG4 &IARG5 &IARG6 &IARG7 &IARG8 &IARG9 &IARG10 &IARG11
    LOCAL &rvalue
    ENTRY %LINE &rvalue
    GOSUB EXIT &rvalue

)

    // This should be created by some top level script. The setupenv for each proc would
    // set this up
    AREA.SELECT
    // Call the required utility
    GOSUB &SUBROUTINE &OPTION &IARG0 &IARG1 &IARG2 &IARG3 &IARG4 &IARG5 &IARG6 &IARG7 &IARG8 &IARG9 &IARG10 &IARG11
    LOCAL &rvalue
    ENTRY %LINE &rvalue
    GOSUB EXIT &rvalue



MAIN:
    LOCAL &APPSBUILD &RemoteOption &LiveAttach &loadsecondelf &alternateelf &extraoption
    ENTRY &APPSBUILD &RemoteOption &LiveAttach &loadsecondelf &alternateelf &extraoption


    
    LOCAL &buildroot &second_elffile &third_elffile &alternateelf
    LOCAL &given_buildroot &stored_buildroot &default_buildroot &default_elf
    &given_buildroot="&APPSBUILD"
    &second_alternateelf="&HypervisorElf"
    &third_alternateelf="&MonitorElf"
    &stored_buildroot="&TZ_STORED_BUILDROOT"
    &default_buildroot="&TZ_BUILDROOT"
    //&default_elf="&TZ_ELF"
    &default_second_elf="&HYP_ELF"
    &default_third_elf="&MON_ELF"
            

    IF ("&APPSBUILD"!="")
    (
        &given_buildroot="&APPSBUILD"
    )
    ELSE
    (
        &given_buildroot="NULL"
    )
    
    //if alternateelf is comma deliminated and silent mode is desired, load elfs directly.
    IF ((STRING.SCAN("&alternateelf",",",0)!=-1)&&(STRING.SCAN("&extraoption","silent",0)!=-1))
    (
        &ParamList=STR.REPLACE("&alternateelf",","," ",0)
        do optextract HypervisorElf,MonitorElf &ParamList
        ENTRY &HypervisorElf &MonitorElf &Unused1 &Unused2 &Unused3
        
        &second_alternateelf="&HypervisorElf"
        &third_alternateelf="&MonitorElf"
    )
    ELSE IF FILE.EXIST("&HypervisorElf")&&(FILE.EXIST("&MonitorElf"))
    (
        &second_alternateelf="&HypervisorElf"
        &third_alternateelf="&MonitorElf"
    )
    ELSE
    (
        &second_alternateelf="NULL"
        &third_alternateelf="NULL"
    )
    
    IF ("&TZ_STORED_BUILDROOT"!="")
    (
        &stored_buildroot="&TZ_STORED_BUILDROOT"
    )
    ELSE
    (
        &stored_buildroot="NULL"
    )
    
    IF ("&TZ_BUILDROOT"!="")
    (
        &default_buildroot="&TZ_BUILDROOT"
    )
    ELSE
    (
        &default_buildroot="NULL"
    )
    
    IF ("&HYP_ELF"!="")
    (
        &default_second_elf="&HYP_ELF"
    )
    ELSE
    (
        &default_second_elf="NULL"
    )
    
    IF ("&MON_ELF"!="")
    (
        &default_third_elf="&MON_ELF"
    )
    ELSE
    (
        &default_third_elf="NULL"
    )
            
            
    
    
    

        
    GOSUB SELECT_ELF_FILE &given_buildroot &stored_buildroot &default_buildroot &second_alternateelf &default_second_elf
    ENTRY &buildroot &second_elffile
    
    GOSUB SELECT_ELF_FILE &given_buildroot &stored_buildroot &default_buildroot &third_alternateelf &default_third_elf
    ENTRY &buildroot &third_elffile



    LOCAL &rvalue
    IF ("&RemoteOption"=="remotely")
    (
        &targetprocessorport=&APPS0_PORT
        GOSUB LOAD_SYMBOLS_ON_ALL_APPS_T32 &buildroot &second_elffile &third_elffile
        ENTRY &rvalue
    )
    ELSE 
    (
        GOSUB LOAD_SYMBOLS_ON_THIS_T32 &buildroot &second_elffile &third_elffile
        ENTRY &rvalue
    )
    
    IF ("&LiveAttach"=="liveattach")
    (

    )

    GOSUB EXIT &rvalue

    
    
SELECT_ELF_FILE:
        LOCAL &given_buildroot &stored_buildroot &default_buildroot &alternateelf &default_elf
        ENTRY &given_buildroot &stored_buildroot &default_buildroot &alternateelf &default_elf

        LOCAL &rvalue_buildroot &rvalue_elffile 
        
        
            //If no given build directory, use the default one
            //stored_buildroot is buildpath calculated from initial std_loadsyms. 
            //default_buildroot is default buildpath from metabuild.
            IF (!OS.DIR("&given_buildroot"))
            (
                IF OS.DIR("&stored_buildroot")
                (
                    &given_buildroot="&stored_buildroot"
                )
                ELSE
                (
                    //nothing. rely on parsing or gui
                )
            )
            
            
            //If buildroot and elf given, use those
            IF (OS.DIR("&given_buildroot")&&(FILE.EXIST("&alternateelf")))
            (
                &rvalue_elffile="&alternateelf"
                &rvalue_buildroot="&given_buildroot"
                RETURN &rvalue_buildroot &rvalue_elffile
            )
        

            //If just alternate elf is given use that for elf and build root
            //However if we can't parse the path for the buildroot, 
            //Then rely on the GUI to give us a good build root
            IF FILE.EXIST("&alternateelf")
            (
                &rvalue_elffile="&alternateelf"
                GOSUB GET_ELF_BUILDROOT &alternateelf
                ENTRY &rvalue_buildroot
                
                IF OS.DIR("&rvalue_buildroot")
                (
                    PRINT "Using &alternateelf as base buildroot and elf file"
                    RETURN &rvalue_buildroot &rvalue_elffile
                )
                ELSE IF (STRING.SCAN("&extraoption","silent",0)!=-1)&&(OS.DIR("&default_buildroot"))
                (
                    RETURN &default_buildroot &rvalue_elffile
                )
                ELSE IF STRING.SCAN("&extraoption","forcesilent",0)!=-1
                (
                    PRINT %ERROR "std_loadsyms_&Image error! Elf parsing error found and forcesilent specified. Exiting"
                    do std_fatalexit USER "std_loadsyms_&Image error! Elf parsing error found and forcesilent specified. Exiting"
                )
                ELSE
                (
                    //buildroot invalid. Drop to GUI
                )

            )
            //Alternate elf not given. try to get from givens/defaults. else drop to GUI.
            ELSE IF FILE.EXIST("&given_buildroot/&default_elf")
            (

                    &rvalue_elffile=("&given_buildroot/&default_elf")
                    &rvalue_buildroot="&given_buildroot"
                    RETURN &rvalue_buildroot &rvalue_elffile
            
            )
            ELSE IF FILE.EXIST("&default_buildroot/&default_elf")&&(STRING.SCAN("&extraoption","silent",0)!=-1)
            (

                &rvalue_elffile=("&default_buildroot/&default_elf")
                &rvalue_buildroot="&default_buildroot"
                RETURN &rvalue_buildroot &rvalue_elffile
            )
            ELSE
            (
                //Nothing. Drop to GUI
            )
            
            
            //We couldn't find a valid elf path by now. Exit if forcesilent specified.
            ELSE IF STRING.SCAN("&extraoption","forcesilent",0)!=-1
            (
                PRINT %ERROR "std_loadsyms_&Image error! Elf parsing error found and forcesilent specified. Exiting"
                do std_fatalexit USER "std_loadsyms_&Image error! Elf parsing error found and forcesilent specified. Exiting"
            )
            ELSE
            (
                //Nothing. drop to GUI.
            )

            //////////////////////Use GUI//////////////////////
            
            //Use GUI if alternateelf not specified or if buildroot directory is wrong
            
            
            IF FILE.EXIST("&given_buildroot/&default_elf")
            (
                
                &filepath=OS.FILE.PATH("&given_buildroot/&default_elf")
                
                DIALOG.FILE "&filepath/*&RootElfSuffix"
                ENTRY &rvalue_elffile
                

                GOSUB GET_ELF_BUILDROOT &rvalue_elffile
                ENTRY &rvalue_buildroot
                
                
                //If alternateelf specified and buildroot is good, use alternate elf with buildroot
                IF FILE.EXIST("&alternateelf")&&(OS.DIR("&rvalue_buildroot"))
                (
                    &rvalue_elffile="&alternateelf"
                    PRINT "Root build is &rvalue_buildroot, but Alternate Elf specified to be used: &rvalue_elffile"
                )
                //If no alternate elf given but rvalue_buildroot is good, then use that.
                ///////This is the default usecase/////////
                ELSE IF (OS.DIR("&rvalue_buildroot"))
                (
                    PRINT "Using build root &rvalue_buildroot with elf file &rvalue_elffile"
                    //Leave rvalue_buildroot and rvalue_elffile as is.
                )
                //If rvalue_buildroot was bad, then some bad directory given. Default to given_buildroot
                ELSE IF FILE.EXIST("&alternateelf")
                (
                    PRINT "Alternate Elf given, but could not find specified build root directory. Using Alternate Elf with default build root: &given_buildroot"
                    &rvalue_elffile="&alternateelf"
                    &rvalue_buildroot="&given_buildroot"
                )
                //If rvalue_buildroot was bad and no alternate elf given, default to given_buildroot.
                ELSE
                (
                    PRINT "Could not find build root structure from selected elf. Will use selected elf with default build root: &given_buildroot"
                    &rvalue_buildroot="&given_buildroot"
                )
            )
            ELSE IF (OS.DIR("&given_buildroot"))
            (
                LOCAL &filepath
                IF (OS.DIR("&given_buildroot/&Elf_Directory"))
                (
                    &filepath="&given_buildroot/&Elf_Directory"
                )
                ELSE
                (
                    &filepath="&given_buildroot"
                )
                DIALOG.FILE "&filepath/*&RootElfSuffix"
                ENTRY &rvalue_elffile
                
                
                GOSUB GET_ELF_BUILDROOT &rvalue_elffile
                ENTRY &rvalue_buildroot
                //If alternateelf specified, use that path.
                //This case should only hit if alternate elf specified but bad buildrootparsed out from it.
                //If alternateelf specified and buildroot is good, use alternate elf with buildroot
                IF FILE.EXIST("&alternateelf")&&(OS.DIR("&rvalue_buildroot"))
                (
                    &rvalue_elffile="&alternateelf"
                    PRINT "Root build is &rvalue_buildroot, but Alternate Elf specified to be used: &rvalue_elffile"
                )
                //If no alternate elf given but rvalue_buildroot is good, then use that.
                ///////This is the default usecase/////////
                ELSE IF (OS.DIR("&rvalue_buildroot"))
                (
                    PRINT "Using build root &rvalue_buildroot with elf file &rvalue_elffile"
                    //Leave rvalue_buildroot and rvalue_elffile as is.
                )
                //If rvalue_buildroot was bad, then some bad directory given. Default to given_buildroot
                ELSE IF FILE.EXIST("&alternateelf")
                (
                    PRINT "Alternate Elf given, but could not find specified build root directory. Using Alternate Elf with default build root: &given_buildroot"
                    &rvalue_elffile="&alternateelf"
                    &rvalue_buildroot="&given_buildroot"
                )
                //If rvalue_buildroot was bad and no alternate elf given, default to given_buildroot.
                
                ELSE
                (
                    PRINT "Could not find build root structure from selected elf. Will use selected elf with default build root: &given_buildroot"
                    &rvalue_buildroot="&given_buildroot"
                )
            )
            ELSE
            (
                DIALOG.FILE "*&RootElfSuffix"
                ENTRY &rvalue_elffile
                
                IF ("&rvalue_elffile"!="")
                (
                            GOSUB GET_ELF_BUILDROOT &rvalue_elffile
                            ENTRY &rvalue_buildroot
                )
                
            )
            
            
            //Check if an elf was given
            IF ("&rvalue_elffile"=="")
            (
                PRINT "No Elf File selected. Exiting"
                GOSUB EXIT SUCCESS
            )
            
            
            RETURN &rvalue_buildroot &rvalue_elffile
          
            
GET_ELF_BUILDROOT:
            LOCAL &local_elffile &local_buildroot
            ENTRY &local_elffile
            
            LOCAL &location &what_to_cut &filepath
            &location=STRING.SCAN("&local_elffile","&Processor_Root_Name",0)
            &what_to_cut=&location-STRING.LENGTH("&local_elffile")-1
            &filepath=STRING.CUT("&local_elffile",&what_to_cut)

            //If not a legitimate  path, return NULL
            IF (OS.DIR("&filepath")&&("&filepath"!=""))
            (
                &local_buildroot=OS.FILE.PATH(&filepath/&Processor_Root_Name)
            )
            ELSE
            (
                &local_buildroot="NULL"
            )

            
            RETURN &local_buildroot
            

LOAD_SYMBOLS_ON_THIS_T32:

            LOCAL &buildroot &second_elffile &third_elffile
            ENTRY &buildroot &second_elffile &third_elffile
            LOCAL &hypelf &monelf
            
            
            IF !(FILE.EXIST("&HypervisorElf"))
            (
                &hypelf="&second_elffile"
            )
            ELSE
            (
                &hypelf="&HypervisorElf"
            )
            IF !(FILE.EXIST("&MonitorElf"))
            (
                &monelf="&third_elffile"
            )
            ELSE
            (
                &monelf="&MonitorElf"
            )
            
            PRINT "Loading &hypelf and &monelf"
            LOCAL &commandlineoptions        
            &commandlineoptions="/noclear"


            
            IF OS.DIR(&LOCAL_BUILDROOT)
            (
                &commandlineoptions=&commandlineoptions+" /strippart &Processor_Root_Name /sourcepath &LOCAL_BUILDROOT/&Processor_Root_Name"
            )

            IF (STRING.SCAN("&extraoption","pushbinary",0)==-1)
            (   
                &commandlineoptions=" /nocode "+"&commandlineoptions"
            )
            //This for tracing. Loads elf file to T32 pod for faster trace analysis, but takes up space on pod memory
            IF (STRING.SCAN("&extraoption","plusvm",0)!=-1)
            (
                &commandlineoptions=" /plusvm"+"&commandlineoptions"
            )
        
            d.load.elf &hypelf &commandlineoptions
            IF FILE.EXIST("&monelf")
            (
                d.load.elf &monelf &commandlineoptions
            )


            
    RETURN SUCCESS

    
    
LOAD_SYMBOLS_ON_ALL_APPS_T32:
 
            LOCAL &buildroot &second_elffile &third_elffile
            ENTRY &buildroot &second_elffile &third_elffile
            LOCAL &hypelf &monelf
            LOCAL &CMD
            
            
            IF !(FILE.EXIST("&HypervisorElf"))
            (
                &hypelf="&second_elffile"
            )
            ELSE
            (
                &hypelf="&HypervisorElf"
            )
            IF !(FILE.EXIST("&MonitorElf"))
            (
                &monelf="&third_elffile"
            )
            ELSE
            (
                &monelf="&MonitorElf"
            )
            
            
            
            
            IF (STRING.SCAN("&monelf","&TEMPDIR",0)!=-1)&&(STRING.SCAN("&hypelf","&TEMPDIR",0)!=-1)
            (
                //Load to all open apps cores
                &CMD="do std_apps"
                
            )
            ELSE
            (
                PRINT "Warning - Hypervisor / Monitor elfs not found in temp directory. Only loading to apps0 window"
                &CMD="INTERCOM.EXECUTE &targetprocessorport"
            )
            
            &CMD PRINT "Loading &hypelf and &monelf"
            LOCAL &commandlineoptions        
            &commandlineoptions="/noclear"
            IF (STRING.SCAN("&extraoption","pushbinary",0)==-1)
            (   
                &commandlineoptions=" /nocode "+"&commandlineoptions"
            )
            
            //This for tracing. Loads elf file to T32 pod for faster trace analysis, but takes up space on pod memory
            IF (STRING.SCAN("&extraoption","plusvm",0)!=-1)
            (
                 &commandlineoptions=" /plusvm"+"&commandlineoptions"
            )
    
            
            IF OS.DIR(&LOCAL_BUILDROOT)
            (

                &CMD d.load.elf &hypelf &commandlineoptions /strippart "&Processor_Root_Name" /sourcepath "&LOCAL_BUILDROOT/&Processor_Root_Name"
                
                IF FILE.EXIST("&monelf")
                (
                    &CMD d.load.elf &monelf &commandlineoptions /strippart "&Processor_Root_Name" /sourcepath "&LOCAL_BUILDROOT/&Processor_Root_Name"
                )
            )
            ELSE
            (
                &CMD d.load.elf &hypelf &commandlineoptions 
                
                IF FILE.EXIST("&monelf")
                (
                    &CMD d.load.elf &monelf &commandlineoptions 
                )
            
            )
            
            &CMD y.create.l SecondarySymbolsLoadedFlag 1
            &CMD y.create.l SecondarySymbolsLoadedFlag_tz 1
            &CMD y.create.done
           
            
    RETURN SUCCESS



help:
HELP:
    AREA.RESET
    AREA.CREATE std_loadsyms_tz_secondary_elfs 125. 50.
    AREA.SELECT std_loadsyms_tz_secondary_elfs
    WINPOS 0. 0. 125. 50.
    AREA.VIEW std_loadsyms_tz_secondary_elfs

    //HEADER "std_cti help window"
    

    
    PRINT " ////////////////////////////////////////////////////////////////////"
    PRINT " /////////////// std_loadsyms_tz_secondary_elfs Help ////////////////"
    PRINT " ////////////////////////////////////////////////////////////////////"
    PRINT " Usage: "
    PRINT "     do std_loadsyms_tz_secondary_elfs <TZBUILDPATH> <RemoteOption> <LiveAttach> NULL <AlternateElf> <extraoption>"
    PRINT " Where required arguments are (enter 'NULL' if not used): "
    PRINT "     TZBUILDPATH   == path to tz build, or 'NULL' "
    PRINT "     RemoteOption  == 'remotely' or 'NULL' - Load elf on all apps t32 windows. Mon and Hyp elf should be copied locally"
    PRINT "     LiveAttach    == 'liveattach' or 'NULL' - T32 is attached to apps"
    PRINT "     loadsecondelf == Always NULL (this keeps commands for all std_loadsyms scripts same"
    PRINT "     AlternateElf  == Load elf file that is different from buildpath given"
    PRINT "                      this can be given as the monitor and hypervisor elfs, e.g."
    PRINT "                      AlternateElf=HypervisorElf=\\hypervisorpath\hyp.elf,MonitorElf=\\monitorpath\mon.elf"
    PRINT "                      ->Make sure to specify 'silent' if you don't want prompts to show up"
    PRINT "     extraoption == comma,deliminated,options"
    PRINT "                 Which may be:"
    PRINT "                     pushbinary - pushes binary onto target (useful for simulation environments)"
    PRINT "                     silent - no GUI prompt, just load elf files given"
    PRINT "                     forcesilent - doesn't use GUI. If paths don't resolve, FATALEXIT"
    PRINT "                                   forcesilent is for automation where GUI's cannot be used"
    PRINT "                     plusvm    - For ETM Tracing. Loads elf file to t32 pod for faster trace processing"
    PRINT "                                 So that T32 doesn't need to scan memory for trace symbol matching."
    PRINT "                                 However, it takes up space on the pod that could be used for traces"
    PRINT " "
    PRINT "E.G:"
    PRINT " do std_loadsyms_tz_secondary_elfs \\mypath remotely NULL \\hypervisorpath\hyp.elf,MonitorElf=\\monitorpath\mon.elf pushbinary,silent"
    
    
    RETURN SUCCESS

EXIT:
    LOCAL &rvalue
    ENTRY %LINE &rvalue
    ENDDO &rvalue
    
FATALEXIT:
    LOCAL &rvalue
    ENTRY %LINE &rvalue
    IF STRING.SCAN("&FAILUREKEYWORD","FAILUREKEYWORD",0)==-1
    (
        GOSUB EXIT &FAILUREKEYWORD - &rvalue
    )
    ELSE
    (
        GOSUB EXIT &rvalue
    )
    
//Should never get here
    END






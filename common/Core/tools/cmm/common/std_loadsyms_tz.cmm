//============================================================================
//  Name:                                                                     
//    std_loadsyms_tz.cmm 
//
//  Description:                                                              
//    Script to load TrustZone image symbols
//                                                                            
// Copyright (c) 2012 - 2014 by Qualcomm Technologies, Incorporated.  All Rights Reserved.        
//
//
//
//
//                      EDIT HISTORY FOR FILE
//  This section contains comments describing changes made to the module.
//  Notice that changes are listed in reverse chronological order.
//
// when       who           what, where, why
// --------   ---           ---------------------------------------------------------
// 04/13/2016 JBILLING      elf searching more robust for when default paths are bad
// 03/28/2016 JBILLING      Moved sessioncfg logic to std_sessioncfg..
// 03/10/2016 JBILLING      Updated temp path for host OS
// 02/16/2016 JBILLING      BUILDID and context menu search
// 12/14/2015 JBILLING      'nosecondelf' option added, minor typo fix
// 09/14/2015 JBILLING      Changes made for automation
// 08/05/2015 JBILLING      Added automation support and updated for elf chosen apart from given build usecase
// 06/18/2015 JBILLING      Add plusvm option
// 06/04/2015 JBILLING      Bug fix for default buildroot
// 04/27/2015 JBILLING      Overhaul for parsing
// 03/25/2015 JBILLING      Added further text parsing features
// 02/06/2015 JBILLING      Fixed parsing errors, added functionality for std_apps
// 01/13/2015 JBILLING      Changed parameters, updated to only use primary TZ Elf, added HELP menu
// 05/14/2014 AJCheriyan    Created for Badger64 
//




//###################Arguments passed #####################
LOCAL &ArgumentLine
ENTRY %LINE &ArgumentLine
LOCAL &UTILITY &OPTION &IARG0 &IARG1 &IARG2 &IARG3 &IARG4 &IARG5 &IARG6 &IARG7 &IARG8 &IARG9 &IARG10 &IARG11
ENTRY &UTILITY &OPTION &IARG0 &IARG1 &IARG2 &IARG3 &IARG4 &IARG5 &IARG6 &IARG7 &IARG8 &IARG9 &IARG10 &IARG11

//###################Variables #####################
LOCAL &ELFFILE  &LOCAL_BUILDROOT
GLOBAL &QseeElf &MonitorElf &HypervisorElf &TZ_STORED_BUILDROOT

LOCAL &Processor_Root_Name &Image &Elf_Directory
LOCAL &targetprocessorport

&Processor_Root_Name="trustzone_images"
&Image="trustzone"
&ELFFILE="NULL" 
&LOCAL_BUILDROOT="NULL"
&MonitorElf="NULL"
&HypervisorElf="NULL"
LOCAL &chipset_lwr
&chipset_lwr=STR.LWR("&CHIPSET")

LOCAL &QseeComponentDir &MonComponentDir &HypComponentDir


IF "&chipset_lwr"=="sdm845"||(STRING.SCAN("&chipset_lwr","sdx24",0)!=-1)
(
    &QseeComponentDir="ssg"
    &MonComponentDir="ssg"
    &HypComponentDir="core"
)
ELSE
(
    &QseeComponentDir="core"
    &MonComponentDir="core"
    &HypComponentDir="core"
)

&Elf_Directory="&Processor_Root_Name/&QseeComponentDir/bsp/qsee/build"

LOCAL &file &filename &what_to_cut &location &filepath &elf_filename &elf_filepath &elf_fullpath
LOCAL &RootElfSuffix &SuffixSearchValue_NonReloc &SuffixSearchValue_Reloc &Suffix_NonReloc &Suffix_Reloc

&RootElfSuffix=".elf"
&SuffixSearchValue_NonReloc=".elf"
&SuffixSearchValue_Reloc=".elf"
&Suffix_NonReloc=".elf"
&Suffix_Reloc=".elf"

GLOBAL &HYP_ELF &MON_ELF
LOCAL &MON_Backup_ELF &HYP_Backup_ELF
IF ("&TZ_BUILDID"!="")
(

    &MON_Backup_ELF="trustzone_images/&MonComponentDir/bsp/monitor/build/&TZ_BUILDID/mon.elf"
    &HYP_Backup_ELF="trustzone_images/&HypComponentDir/bsp/hypervisor/build/&TZ_BUILDID/hyp.elf"
)
ELSE
(
    &MON_Backup_ELF="trustzone_images/&MonComponentDir/bsp/monitor/build/RAGAANRA/mon.elf"
    &HYP_Backup_ELF="trustzone_images/&HypComponentDir/bsp/hypervisor/build/RAGAANRA/hyp.elf"
)



//#####################Select Subroutine###################
// Name of the utility we are calling
LOCAL &SUBROUTINE
// Any subroutine specific options
// Default exists for each subroutine


// Input Argument 0 is the name of the utility
&SUBROUTINE="&UTILITY"
&SUBROUTINE=STR.UPR("&SUBROUTINE")
IF !(("&SUBROUTINE"=="HELP"))
(
    GOSUB MAIN &UTILITY &OPTION &IARG0 &IARG1 &IARG2 &IARG3 &IARG4 &IARG5 &IARG6 &IARG7 &IARG8 &IARG9 &IARG10 &IARG11
    LOCAL &rvalue
    ENTRY %LINE &rvalue
    GOSUB EXIT &rvalue

)

    // This should be created by some top level script. The setupenv for each proc would
    // set this up
    AREA.SELECT
    // Call the required utility
    GOSUB &SUBROUTINE &OPTION &IARG0 &IARG1 &IARG2 &IARG3 &IARG4 &IARG5 &IARG6 &IARG7 &IARG8 &IARG9 &IARG10 &IARG11
    LOCAL &rvalue
    ENTRY %LINE &rvalue
    GOSUB EXIT &rvalue



MAIN:
    LOCAL &APPSBUILD &RemoteOption &LiveAttach &loadsecondelf &alternateelf &extraoption
    ENTRY &APPSBUILD &RemoteOption &LiveAttach &loadsecondelf &alternateelf &extraoption

    LOCAL &buildroot &elffile
    LOCAL &given_buildroot &default_buildroot &default_elf //&default_secondPD_elf
    LOCAL &default_second_elf &default_third_elf

    IF ("&APPSBUILD"!="")
    (
        &given_buildroot="&APPSBUILD"
    )
    ELSE
    (
        &given_buildroot="NULL"
    )
    
    IF ("&TZ_BUILDROOT"!="")
    (
        &default_buildroot="&TZ_BUILDROOT"
    )
    ELSE
    (
        &default_buildroot="NULL"
    )
    
    IF ("&alternateelf"=="")
    (
        &alternateelf="NULL"
    )
    
    IF (STRING.SCAN(STR.UPR("&CHIPSET"),"MDM",0)!=-1)||(STRING.SCAN(STR.UPR("&CHIPSET"),"SDX",0)!=-1)
    (
        &default_elf="&TZ_ELF"
    )
    ELSE
    (
        IF ("&QSEE_ELF"!="")
        (
            &default_elf="&QSEE_ELF"
        )
        ELSE
        (
            &default_elf="NULL"
        )
    )

    
    IF ("&HYP_ELF"!="")
    (
        &default_second_elf="&HYP_ELF"
    )
    ELSE
    (
        &default_second_elf="&HYP_Backup_ELF"
    )
    
    IF ("&MON_ELF"!="")
    (
        &default_third_elf="&MON_ELF"
    )
    ELSE
    (
        &default_third_elf="&MON_Backup_ELF"
    )
            
            
    
    GOSUB SELECT_ELF_FILE &given_buildroot &default_buildroot &alternateelf &default_elf
    ENTRY &buildroot &elffile
    
    GOSUB GET_TZ_BUILDID &elffile
    GLOBAL &TZ_BUILDID
    ENTRY &TZ_BUILDID
    //Update backup elfs
    &HYP_Backup_ELF="trustzone_images/&HypComponentDir/bsp/hypervisor/build/&TZ_BUILDID/hyp.elf"
    &MON_Backup_ELF="trustzone_images/&MonComponentDir/bsp/monitor/build/&TZ_BUILDID/mon.elf"
    &backup_second_elf="&HYP_Backup_ELF"
    &backup_third_elf="&MON_Backup_ELF"
    //FIXME - MAKE Generic
    
    IF !((STRING.SCAN(STR.UPR("&CHIPSET"),"MDM",0)!=-1)||(STRING.SCAN(STR.UPR("&CHIPSET"),"SDX",0)!=-1))
    (
        //Set global variable for secondpd script to pick up
        &TZ_STORED_BUILDROOT="&buildroot"
        //Pass entry from here directly into global var
        //'nosecondelf' used if user doesn't want script to search for remaining elfs.
        IF (STRING.SCAN("&loadsecondelf","nosecondelf",0)==-1)
        (
            PRINT "Please point to Hypervisor ELF"
            GOSUB SELECT_SECOND_ELF &buildroot hyp.elf &default_second_elf &backup_second_elf
            ENTRY &HypervisorElf
            IF !FILE.EXIST("&HypervisorElf")
            (
                &HypervisorElf="NULL"
            )
            PRINT "Please point to Monitor ELF"
            GOSUB SELECT_SECOND_ELF &buildroot mon.elf &default_third_elf &backup_third_elf
            ENTRY &MonitorElf
            IF !FILE.EXIST("&MonitorElf")
            (
                &MonitorElf="NULL"
            )
        )
    )
    LOCAL &rvalue
    IF ("&RemoteOption"=="remotely")
    (
        &targetprocessorport=&APPS0_PORT
        GOSUB LOAD_SYMBOLS_ON_ALL_APPS_T32 &buildroot &elffile
        ENTRY &rvalue
        IF "&rvalue"=="SUCCESS"
        (
            PRINT "qsee.elf loaded successfully"
        )
    )
    ELSE 
    (
        GOSUB LOAD_SYMBOLS_ON_THIS_T32 &buildroot &elffile
        ENTRY &rvalue
    )
    
    IF ("&loadsecondelf"=="loadsecondelf")&&("&MonitorElf"!="NULL")&&("&HypervisorElf"!="NULL")
    (
        LOCAL &new_extraoption
        &new_extraoption="silent,"+"&extraoption"
        do std_loadsyms_tz_secondary_elfs &buildroot &RemoteOption &LiveAttach NULL MonitorElf=&MonitorElf,HypervisorElf=&HypervisorElf &new_extraoption
        ENTRY %LINE &rvalue
        
        IF "&rvalue"=="SUCCESS"
        (
            PRINT "qsee.elf, hyp.elf, mon.elf loaded successfully"
        )
    )

    GOSUB EXIT &rvalue
    
GET_TZ_BUILDID:
    LOCAL &fullelfpath &temppath &wheretocut
    ENTRY &fullelfpath
    
    &temppath=OS.FILE.PATH("&fullelfpath")
    &local_tz_buildid=OS.FILE.NAME("&temppath")
    
    RETURN &local_tz_buildid
SELECT_ELF_FILE:
        LOCAL &given_buildroot &default_buildroot &alternateelf &default_elf
        ENTRY &given_buildroot &default_buildroot &alternateelf &default_elf

        LOCAL &rvalue_buildroot &rvalue_elffile 
        
            //If buildroot and  elf given, use those
            IF (OS.DIR("&given_buildroot")&&(FILE.EXIST("&alternateelf")))
            (
                &rvalue_elffile="&alternateelf"
                &rvalue_buildroot="&given_buildroot"
                RETURN &rvalue_buildroot &rvalue_elffile
            )
            
            //If no given build directory, use the default one
            IF (!OS.DIR("&given_buildroot"))
            (
                &given_buildroot="&default_buildroot"
            )
            
            //If just alternate elf is given use that for elf and build root
            //However if we can't parse the path for the buildroot, 
            //Then rely on the GUI to give us a good build root
            IF FILE.EXIST("&alternateelf")
            (
                &rvalue_elffile="&alternateelf"
                GOSUB GET_ELF_BUILDROOT &alternateelf
                ENTRY &rvalue_buildroot
                
                IF OS.DIR("&rvalue_buildroot")
                (
                    PRINT "Using &alternateelf as base buildroot and elf file"
                    RETURN &rvalue_buildroot &rvalue_elffile
                )
                //Else drop to GUI
            )
            ELSE IF FILE.EXIST("&given_buildroot/&default_elf")
            (
                IF STRING.SCAN("&extraoption","silent",0)!=-1
                (
                    &rvalue_elffile=("&given_buildroot/&default_elf")
                    &rvalue_buildroot="&given_buildroot"
                    RETURN &rvalue_buildroot &rvalue_elffile
                )
                ELSE
                (
                    //Nothing. Drop to GUI
                )
            
            )
            //We couldn't find a valid elf path by now. Exit if forcesilent specified.
            ELSE IF STRING.SCAN("&extraoption","forcesilent",0)!=-1
            (
                PRINT %ERROR "std_loadsyms_&Image error! Elf parsing error found and forcesilent specified. Exiting"
                do std_fatalexit USER "std_loadsyms_&Image error! Elf parsing error found and forcesilent specified. Exiting"
            )
            ELSE
            (
                //Nothing. drop to GUI.
            )

            //////////////////////Use GUI//////////////////////
            
            //Use GUI if alternateelf not specified or if buildroot directory is wrong
            
            
            IF FILE.EXIST("&given_buildroot/&default_elf")
            (
                
                &filepath=OS.FILE.PATH("&given_buildroot/&default_elf")
                
                DIALOG.FILE "&filepath/*&RootElfSuffix"
                ENTRY &rvalue_elffile
                

                GOSUB GET_ELF_BUILDROOT &rvalue_elffile
                ENTRY &rvalue_buildroot
                
                
                //If alternateelf specified and buildroot is good, use alternate elf with buildroot
                IF FILE.EXIST("&alternateelf")&&(OS.DIR("&rvalue_buildroot"))
                (
                    &rvalue_elffile="&alternateelf"
                    PRINT "Root build is &rvalue_buildroot, but Alternate Elf specified to be used: &rvalue_elffile"
                )
                //If no alternate elf given but rvalue_buildroot is good, then use that.
                ///////This is the default usecase/////////
                ELSE IF (OS.DIR("&rvalue_buildroot"))
                (
                    PRINT "Using build root &rvalue_buildroot with elf file &rvalue_elffile"
                    //Leave rvalue_buildroot and rvalue_elffile as is.
                )
                //If rvalue_buildroot was bad, then some bad directory given. Default to given_buildroot
                ELSE IF FILE.EXIST("&alternateelf")
                (
                    PRINT "Alternate Elf given, but could not find specified build root directory. Using Alternate Elf with default build root: &given_buildroot"
                    &rvalue_elffile="&alternateelf"
                    &rvalue_buildroot="&given_buildroot"
                )
                //If rvalue_buildroot was bad and no alternate elf given, default to given_buildroot.
                ELSE
                (
                    PRINT "Could not find build root structure from selected elf. Will use selected elf with default build root: &given_buildroot"
                    &rvalue_buildroot="&given_buildroot"
                )
            )
            ELSE IF (OS.DIR("&given_buildroot"))
            (
                LOCAL &filepath
                IF (OS.DIR("&given_buildroot/&Elf_Directory"))
                (
                    &filepath="&given_buildroot/&Elf_Directory"
                )
                ELSE
                (
                    &filepath="&given_buildroot"
                )
                DIALOG.FILE "&filepath/*&RootElfSuffix"
                ENTRY &rvalue_elffile
                
                
                GOSUB GET_ELF_BUILDROOT &rvalue_elffile
                ENTRY &rvalue_buildroot
                //If alternateelf specified, use that path.
                //This case should only hit if alternate elf specified but bad buildrootparsed out from it.
                //If alternateelf specified and buildroot is good, use alternate elf with buildroot
                IF FILE.EXIST("&alternateelf")&&(OS.DIR("&rvalue_buildroot"))
                (
                    &rvalue_elffile="&alternateelf"
                    PRINT "Root build is &rvalue_buildroot, but Alternate Elf specified to be used: &rvalue_elffile"
                )
                //If no alternate elf given but rvalue_buildroot is good, then use that.
                ///////This is the default usecase/////////
                ELSE IF (OS.DIR("&rvalue_buildroot"))
                (
                    PRINT "Using build root &rvalue_buildroot with elf file &rvalue_elffile"
                    //Leave rvalue_buildroot and rvalue_elffile as is.
                )
                //If rvalue_buildroot was bad, then some bad directory given. Default to given_buildroot
                ELSE IF FILE.EXIST("&alternateelf")
                (
                    PRINT "Alternate Elf given, but could not find specified build root directory. Using Alternate Elf with default build root: &given_buildroot"
                    &rvalue_elffile="&alternateelf"
                    &rvalue_buildroot="&given_buildroot"
                )
                //If rvalue_buildroot was bad and no alternate elf given, default to given_buildroot.
                
                ELSE
                (
                    PRINT "Could not find build root structure from selected elf. Will use selected elf with default build root: &given_buildroot"
                    &rvalue_buildroot="&given_buildroot"
                )
            )
            ELSE
            (
                DIALOG.FILE "*&RootElfSuffix"
                ENTRY &rvalue_elffile
                
                IF ("&rvalue_elffile"!="")
                (
                            GOSUB GET_ELF_BUILDROOT &rvalue_elffile
                            ENTRY &rvalue_buildroot
                )
                
            )
            
            
            //Check if an elf was given
            IF ("&rvalue_elffile"=="")
            (
                PRINT "No Elf File selected. Exiting"
                GOSUB EXIT SUCCESS
            )
            
            
            RETURN &rvalue_buildroot &rvalue_elffile
          
            
GET_ELF_BUILDROOT:
            LOCAL &local_elffile &local_buildroot
            ENTRY &local_elffile
            
            LOCAL &location &what_to_cut &filepath
            &location=STRING.SCAN("&local_elffile","&Processor_Root_Name",0)
            &what_to_cut=&location-STRING.LENGTH("&local_elffile")-1
            &filepath=STRING.CUT("&local_elffile",&what_to_cut)

            //If not a legitimate  path, return NULL
            IF (OS.DIR("&filepath")&&("&filepath"!=""))
            (
                &local_buildroot=OS.FILE.PATH(&filepath/&Processor_Root_Name)
            )
            ELSE
            (
                &local_buildroot="NULL"
            )

            
            RETURN &local_buildroot
            
            
            
            

            
            
            


SELECT_SECOND_ELF:
        LOCAL &buildroot &elffile &default_secondPD_elf &backup_secondPD_elf
        ENTRY &buildroot &elffile &default_secondPD_elf &backup_secondPD_elf
        
        LOCAL &rvalue_secondPD_elf
        
            ///////////Select Second PD Elf////////////////

            LOCAL &searchvalue &suffix 
            IF (STRING.SCAN("&elffile","reloc",0)!=-1)
            (
                &searchvalue="&SuffixSearchValue_Reloc"
                &suffix="&Suffix_Reloc"
            )
            ELSE
            (
                &searchvalue="&SuffixSearchValue_NonReloc"
                &suffix="&Suffix_NonReloc"
            )
            
            LOCAL &root_elf_path &secondPD_elf_filename &elffilename
            &elffilename=OS.FILE.NAME("&elffile")
            &secondPD_elf_filename=STRING.REPLACE("&elffilename","&searchvalue","&suffix",0)
            &root_elf_path=OS.FILE.PATH("&elffile")
            
            IF FILE.EXIST("&root_elf_path/&secondPD_elf_filename")
            (
                &rvalue_secondPD_elf="&root_elf_path/&secondPD_elf_filename"
            )
            ELSE IF FILE.EXIST("&buildroot/&default_secondPD_elf")
            (
                &rvalue_secondPD_elf="&buildroot/&default_secondPD_elf"
            )
            ELSE IF FILE.EXIST("&buildroot/&backup_secondPD_elf")
            (
                &rvalue_secondPD_elf="&buildroot/&backup_secondPD_elf"
            )
            //Else just land us in core/bsp
            ELSE
            (
                IF STRING.SCAN("&secondPD_elf_filename","hyp",0)!=-1
                (
                    PRINT "Please point to hypervisor elf"
                    
                    &rvalue_secondPD_elf="&buildroot"+"/&Processor_Root_Name/&HypComponentDir/bsp/hypervisor/"+"&secondPD_elf_filename"
                )
                ELSE IF STRING.SCAN("&secondPD_elf_filename","mon",0)!=-1
                (
                    PRINT "Please point to monitor elf"
                    &rvalue_secondPD_elf="&buildroot"+"/&Processor_Root_Name/&MonComponentDir/bsp/monitor/"+"&secondPD_elf_filename"
                
                )
                ELSE 
                (
                    PRINT "Please point to &secondPD_elf_filename"
                    &rvalue_secondPD_elf="&buildroot"+"/&Processor_Root_Name/core/bsp/"+"&secondPD_elf_filename"
                )
            )
            //Revert to GUI as long as forcesilent not specified//
            IF ((STRING.SCAN("&extraoption","forcesilent",0)!=-1)&&!FILE.EXIST("&rvalue_secondPD_elf"))
            (
                PRINT %ERROR "std_loadsyms_&Image error! &Image SecondPD elf not found and forcesilent option specified. Exiting"
                do std_fatalexit USER std_loadsyms_&Image error! &Image SecondPD elf not found and forcesilent option specified. Exiting"
            )
            ELSE IF (!FILE.EXIST("&rvalue_secondPD_elf")||(STRING.SCAN("&rvalue_secondPD_elf","&suffix",0)==-1))
            (
                PRINT "Please point to second PD Elf"
                DIALOG.FILE "&buildroot/&Processor_Root_Name/build/ms/*&suffix" 
                ENTRY &rvalue_secondPD_elf
            )

            //Check if secondPD elf was given
            IF !FILE.EXIST("&rvalue_secondPD_elf")
            (
                PRINT "Warning: Invalid or missing second PD elf file"
                &rvalue_secondPD_elf=""
                RETURN "WARNING: Invalid or missing second PD elf file"
            )
            
            //Try to copy second PD elf to temp directory for faster loading
            ON ERROR CONTINUE
               
                PRINT "Copying &secondPD_elf_filename to &TEMPDIR"
                COPY &rvalue_secondPD_elf "&TEMPDIR\&secondPD_elf_filename"
                IF FILE.EXIST("&TEMPDIR\&secondPD_elf_filename")
                (
                    &rvalue_secondPD_elf="&TEMPDIR\&secondPD_elf_filename"
                )
            ON ERROR
            
            
    RETURN &rvalue_secondPD_elf
        
                    
            LOCAL &qsee_elf_filename &hyp_elf_filename &mon_elf_filename

            /////////////////////////////////////////////////
            //////////////////Find QSEE Elf//////////////////
            /////////////////////////////////////////////////
            IF (FILE.EXIST("&APPSBUILD/&QSEE_ELF"))
            (
                &elf_fullpath="&APPSBUILD/&QSEE_ELF"
                &elf_filename=OS.FILE.NAME("&elf_fullpath")
                &elf_filepath=STRING.REPLACE("&elf_fullpath","&elf_filename","*.elf",0)
                
                IF (STRING.SCAN("&extraoption","silent",0)!=-1) //if silent specified
                (
                    &ELFFILE="&elf_fullpath"
                )
                ELSE
                (
                    IF (STRING.SCAN("&extraoption","forcesilent",0)!=-1)
                    (
                        PRINT %ERROR "std_loadsyms_tz error! forcesilent option specified and elf file not accessible: &elf_fullpath"
                        do std_fatalexit USER "std_loadsyms_tz error! forcesilent option specified and elf file not accessible: &elf_fullpath"
                    )
                    ELSE
                    (
                        DIALOG.FILE "&elf_filepath"
                        ENTRY &ELFFILE
                    )
                )
                
            )
            ELSE IF (FILE.EXIST("&TZ_BUILDROOT/&QSEE_ELF"))
            (
                &elf_fullpath="&TZ_BUILDROOT/&QSEE_ELF"
                &elf_filename=OS.FILE.NAME("&elf_fullpath")
                &elf_filepath=STRING.REPLACE("&elf_fullpath","&elf_filename","*.elf",0)
                
                IF (STRING.SCAN("&extraoption","silent",0)!=-1) //if silent specified
                (
                    &ELFFILE=&elf_fullpath
                )
                ELSE
                (
                    DIALOG.FILE "&elf_filepath"
                    ENTRY &ELFFILE
                )
                
            )
            ELSE IF (OS.DIR("&APPSBUILD"))
            (
                DIALOG.FILE "&APPSBUILD/*.elf"
                ENTRY &ELFFILE
            
                &elf_fullpath="&ELFFILE"
                &elf_filename=OS.FILE.NAME("&elf_fullpath")
            )
            ELSE IF (OS.DIR("&TZ_BUILDROOT"))
            (
                DIALOG.FILE "&TZ_BUILDROOT/*.elf"
                ENTRY &ELFFILE
            
                &elf_fullpath="&ELFFILE"
                &elf_filename=OS.FILE.NAME("&elf_fullpath")
            )
            ELSE //last resort, point to a default directory
            (
                DIALOG.FILE "*.elf" 
                ENTRY &ELFFILE
            )
            
            //Check if an elf was given
            IF ("&ELFFILE"=="")
            (
                PRINT "No Elf File selected. Exiting"
                GOSUB EXIT SUCCESS
            )

            //Fill out appropriate variables
            &location=STRING.SCAN("&ELFFILE","&processor_root_name",0)
            &what_to_cut=&location-STRING.LENGTH("&ELFFILE")
            &filepath=STRING.CUT("&ELFFILE",&what_to_cut)

            &LOCAL_BUILDROOT=OS.FILE.PATH(&filepath)
            &elf_filename=OS.FILE.NAME("&ELFFILE")
            &QseeElf="&ELFFILE"
            &qsee_elf_filename="&elf_filename"
            
            &TZ_BUILDROOT="&LOCAL_BUILDROOT"
            

            ///////////////////////////////////////////////
            //Parse out build flavor from given QSEE path//
            ///////////////////////////////////////////////
            LOCAL &previous_slash &temp_elf_path &current_index &full_string_length &path_to_flavor
            &temp_elf_path=STRING.REPLACE("&QseeElf","\","/",0.)
            &path_to_flavor=STRING.CUT("&temp_elf_path",-(STRING.LENGTH("&qsee_elf_filename"))) //should be a '/' on the end 
            &previous_slash=0.
            &temp_elf_path
            &current_index=0.
            &full_string_length=STRING.LENGTH("&path_to_flavor")
            
            WHILE (&current_index<&full_string_length)
            (
                &previous_slash=&current_index
                &current_index=STRING.SCAN("&path_to_flavor","/",&current_index)
                &current_index=&current_index+1
            )
            
            &BUILDFLAV=STRING.CUT("&path_to_flavor",&previous_slash)
            &BUILDFLAV=STRING.CUT("&BUILDFLAV",-1) //trim off trailing '/'
            
            
            
            /////////////////////////////////////////////////
            ///////////////Find Hypervisor Elf///////////////
            /////////////////////////////////////////////////
            LOCAL &hyp_elf_fullpath &hyp_elf_filename &hyp_elf_filepath            
            &hyp_elf_filename="hyp.elf"

            
            //Try to construct elf path from what was given as QSEE elf path
            &HypervisorElf="&LOCAL_BUILDROOT"+"/&processor_root_name/&HypComponentDir/bsp/hypervisor/build/&BUILDFLAV/"+"&hyp_elf_filename"

            IF (FILE.EXIST("&HypervisorElf"))
            (
                //Do nothing. Use this as HypervisorElf
            )
            //Else look for what was given in generated build
            ELSE IF (FILE.EXIST("&LOCAL_BUILDROOT/&HYP_ELF"))
            (
                &hyp_elf_fullpath="&LOCAL_BUILDROOT/&HYP_ELF"
                &hyp_elf_filename=OS.FILE.NAME("&hyp_elf_fullpath")
                &hyp_elf_filepath=STRING.REPLACE("&hyp_elf_fullpath","&hyp_elf_filename","*.elf",0)
                IF (STRING.SCAN("&extraoption","silent",0)!=-1) //if silent specified
                (
                    &HypervisorElf=&hyp_elf_fullpath
                )
                ELSE
                (
                    DIALOG.FILE "&hyp_elf_filepath"
                    ENTRY &HypervisorElf
                )
            )
            //Else just have user point directly to it
            ELSE IF (!FILE.EXIST("&HypervisorElf")||(STRING.SCAN("&HypervisorElf","hyp",0)==-1))
            (
                PRINT "Please point to hypervisor Elf"
                DIALOG.FILE "&LOCAL_BUILDROOT/*.elf" 
                ENTRY &HypervisorElf
            )

            //Check if hypervisor elf was given
            IF !FILE.EXIST("&HypervisorElf")
            (
                PRINT "Warning: Invalid or missing Hypervisor elf file"
                &HypervisorElf=""
            )
        
        
        
            /////////////////////////////////////////////////
            /////////////////Find Monitor Elf////////////////
            /////////////////////////////////////////////////
            LOCAL &mon_elf_fullpath &mon_elf_filename &mon_elf_filepath            
            &mon_elf_filename="mon.elf"

            &MonitorElf="&LOCAL_BUILDROOT"+"/&processor_root_name/&MonComponentDir/bsp/monitor/build/&BUILDFLAV/"+"&mon_elf_filename"
            //Try to construct elf path from what was given as QSEE elf path
            IF (FILE.EXIST("&MonitorElf"))
            (
                //Do nothing. Use this as MonitorElf
            )
            //Else look for what was given in generated build
            ELSE IF (FILE.EXIST("&LOCAL_BUILDROOT/&MON_ELF"))
            (
                &mon_elf_fullpath="&LOCAL_BUILDROOT/&MON_ELF"
                &mon_elf_filename=OS.FILE.NAME("&mon_elf_fullpath")
                &mon_elf_filepath=STRING.REPLACE("&mon_elf_fullpath","&mon_elf_filename","*.elf",0)
                IF (STRING.SCAN("&extraoption","silent",0)!=-1) //if silent specified
                (
                    &MonitorElf=&mon_elf_fullpath
                )
                ELSE
                (
                    DIALOG.FILE "&mon_elf_filepath"
                    ENTRY &MonitorElf
                )
            )
            //Else just have user point directly to it
            IF (!FILE.EXIST("&MonitorElf")||(STRING.SCAN("&MonitorElf","mon",0)==-1))
            (
                PRINT "Please point to Monitor Elf"
                DIALOG.FILE "&LOCAL_BUILDROOT/*.elf" 
                ENTRY &MonitorElf
            )

            //Check if hypervisor elf was given
            IF !FILE.EXIST("&MonitorElf")
            (
                PRINT "Warning: Invalid or missing Monitor elf file"
                &MonitorElf=""
            )   
            
            

            
            //Try to copy secondary elfs to temp directory for faster loading
            ON ERROR CONTINUE 
                
               
               
                
                COPY &QseeElf "&TEMPDIR\&qsee_elf_filename"
                COPY &HypervisorElf "&TEMPDIR\&hyp_elf_filename"
                COPY &MonitorElf "&TEMPDIR\&mon_elf_filename"
                
                IF FILE.EXIST("&TEMPDIR\&qsee_elf_filename")
                (
                    &QseeElf="&TEMPDIR\&qsee_elf_filename"
                )
                
                IF FILE.EXIST("&TEMPDIR\&hyp_elf_filename")
                (
                    &HypervisorElf="&TEMPDIR\&hyp_elf_filename"
                )
                IF FILE.EXIST("&TEMPDIR\&mon_elf_filename")
                (
                    &MonitorElf="&TEMPDIR\&mon_elf_filename"
                )
                
            ON ERROR
        
        
        RETURN &QseeElf &HypervisorElf &MonitorElf
           

LOAD_SYMBOLS_ON_THIS_T32:
    LOCAL &buildroot &elffile
    ENTRY &buildroot &elffile

            PRINT "Loading Elf &elffile with build root &buildroot"
            
            
            LOCAL &commandlineoptions
            &commandlineoptions=""
            //include "/nocode" unless pushbinary specified.
            IF (STRING.SCAN("&extraoption","pushbinary",0)==-1)
            (
                &commandlineoptions=" /nocode "+"&commandlineoptions"
            )
            //This for tracing. Loads elf file to T32 pod for faster trace analysis, but takes up space on pod memory
            IF (STRING.SCAN("&extraoption","plusvm",0)!=-1)
            (
                &commandlineoptions=" /plusvm"+"&commandlineoptions"
            )
            
            IF (STRING.SCAN("&extraoption","noclear",0)!=-1)
            (
                &commandlineoptions=" /noclear"+"&commandlineoptions"
            )
            d.load.elf &elffile &commandlineoptions /strippart "&Processor_Root_Name" /sourcepath "&buildroot/&Processor_Root_Name"
            
            y.create.l PrimarySymbolsLoadedFlag 1
            y.create.l PrimarySymbolsLoadedFlag_tz 1
            y.create.done        

            //Setup menu context
            do std_sessioncfg_apps SYM &CHIPSET TZ &buildroot &Processor_Root_Name &TZ_BUILDID            
            
    RETURN SUCCESS

    
    
LOAD_SYMBOLS_ON_ALL_APPS_T32:
    LOCAL &buildroot &elffile
    ENTRY &buildroot &elffile
            PRINT "Loading Elf on remote T32 Session. Elf file &elffile with build root &buildroot"
            
            LOCAL &commandlineoptions
            &commandlineoptions=""
            //include "/nocode" unless pushbinary specified.
            IF (STRING.SCAN("&extraoption","pushbinary",0)==-1)
            (
                &commandlineoptions=" /nocode "+"&commandlineoptions"
            )
            //This for tracing. Loads elf file to T32 pod for faster trace analysis, but takes up space on pod memory
            IF (STRING.SCAN("&extraoption","plusvm",0)!=-1)
            (
                &commandlineoptions=" /plusvm"+"&commandlineoptions"
            )
            
            IF (STRING.SCAN("&extraoption","noclear",0)!=-1)
            (
                &commandlineoptions=" /noclear"+"&commandlineoptions"
            )

            do std_apps d.load.elf &elffile &commandlineoptions /strippart "&Processor_Root_Name" /sourcepath "&buildroot/&Processor_Root_Name"
            
            do std_apps y.create.l PrimarySymbolsLoadedFlag 1
            do std_apps y.create.l PrimarySymbolsLoadedFlag_tz 1
            do std_apps y.create.done    
            
            do std_apps do std_sessioncfg_apps SYM &CHIPSET TZ &buildroot &Processor_Root_Name &TZ_BUILDID
            
            
    RETURN SUCCESS



help:
HELP:
    AREA.RESET
    AREA.CREATE std_loadsyms_tz 125. 50.
    AREA.SELECT std_loadsyms_tz
    WINPOS 0. 0. 125. 50.
    AREA.VIEW std_loadsyms_tz

    //HEADER "std_cti help window"
    

    
    PRINT " ////////////////////////////////////////////////////////////////////"
    PRINT " /////////////// std_loadsyms_tz Help ////////////////"
    PRINT " ////////////////////////////////////////////////////////////////////"
    PRINT " Usage: "
    PRINT "     do std_loadsyms_tz <TZBUILDPATH> <RemoteOption> <LiveAttach> NULL <AlternateELF> <extraoption>"
    PRINT " Where required arguments are (enter 'NULL' if not used): "
    PRINT "     TZBUILDPATH   == path to tz build, or 'NULL' "
    PRINT "     RemoteOption  == 'remotely' or 'NULL' - Load elf on all apps t32 windows. Mon and Hyp elf should be copied locally"
    PRINT "     LiveAttach    == 'liveattach' or 'NULL' - T32 is attached to apps"
    PRINT "     loadsecondelf == Always NULL (this keeps commands for all std_loadsyms scripts same"
    PRINT "     AlternateELF  == Load elf file that is different from buildpath given"
    PRINT "                      this can be given as the monitor and hypervisor elfs, e.g."
    PRINT "                      AlternateELF=HypervisorElf=\\hypervisorpath\hyp.elf,MonitorElf=\\monitorpath\mon.elf"
    PRINT "                      ->Make sure to specify 'silent' if you don't want prompts to show up"
    PRINT "     extraoption == comma,deliminated,options"
    PRINT "                 Which may be:"
    PRINT "                     pushbinary - pushes binary onto target (useful for simulation environments)"
    PRINT "                     silent - attempts to not use GUI. If paths don't resolve, use GUI"
    PRINT "                     forcesilent - doesn't use GUI. If paths don't resolve, FATALEXIT"
    PRINT "                                   forcesilent is for automation where GUI's cannot be used"
    PRINT "                     plusvm    - For ETM Tracing. Loads elf file to t32 pod for faster trace processing"
    PRINT "                                 So that T32 doesn't need to scan memory for trace symbol matching."
    PRINT "                                 However, it takes up space on the pod that could be used for traces"
    PRINT " "
    PRINT " Notes of ELF and BUILD ROOT Selection"
    PRINT "     The BUILD ROOT contains code source and additional scripts which are useful and"
    PRINT "     neccessary for debug in various contexts. In one case a user may want to source "
    PRINT "     both ELF and code source from the same build. In another case using an ELF file "
    PRINT "     from a location different from BUILD ROOT is preferred. BUILDPATH and AlternateElf"
    PRINT "     Options are available for this purpose. "
    PRINT "     The following is their behavior:"
    PRINT "     If both BUILDPATH and AlternateElf are specified, use those respectively"
    PRINT "     If no AlternateElf specified but BUILDPATH specified, source both ELF and BUILDPATH "
    PRINT "         from that given build path"
    PRINT "     If AlternateElf specified but no BUILDPATH specified, source the BUILDPATH and ELF"
    PRINT "         from that given AlternateElf"
    PRINT "     If neither BUILDPAPTH nor AlternateElf specified, try to use GLOBAL defaults for"
    PRINT "         BUILDPATH and ELFFILE given from metabuild."
    PRINT " "
    PRINT "     If any of these options fail, a GUI will open. However if forcesilent is specified, "
    PRINT "         The process will crash (forcesilent is for automation purposes where "
    PRINT "         GUI's cannot be used"
    PRINT " "
    PRINT "E.G:"
    PRINT " do std_loadsyms_tz \\mypath remotely NULL \\hypervisorpath\hyp.elf,MonitorElf=\\monitorpath\mon.elf pushbinary,silent"
    
    
    RETURN SUCCESS

EXIT:
    LOCAL &rvalue
    ENTRY %LINE &rvalue
    ENDDO &rvalue
    
FATALEXIT:
    LOCAL &rvalue
    ENTRY %LINE &rvalue
    IF STRING.SCAN("&FAILUREKEYWORD","FAILUREKEYWORD",0)==-1
    (
        GOSUB EXIT &FAILUREKEYWORD - &rvalue
    )
    ELSE
    (
        GOSUB EXIT &rvalue
    )
    
//Should never get here
    END






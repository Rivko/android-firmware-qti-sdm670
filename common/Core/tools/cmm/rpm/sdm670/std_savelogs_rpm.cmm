//============================================================================
//  Name:                                                                     
//    std_savelogs_rpm.cmm 
//
//  Description:                                                              
//    Script to save RPM memory locations
//                                                                            
// Copyright (c) 2012 - 2014 by Qualcomm Technologies, Incorporated.  All Rights Reserved.        
//
//
//
//
//                      EDIT HISTORY FOR FILE
//  This section contains comments describing changes made to the module.
//  Notice that changes are listed in reverse chronological order.
//
// when       who     		what, where, why
// --------   ---     		---------------------------------------------------------
// 07/02/2014 AJCheriyan    Added MSGRAM back in
// 07/10/2012 AJCheriyan    Created for B-family 
//

// We support one argument for this script
// &ARG0 - Output location for the logs
ENTRY &ARG0

LOCAL &LOGLOCATION

MAIN:
	&LOGLOCATION="&ARG0"

	// Load the memory map
	do std_memorymap

	// Save the memories first
	GOSUB SAVEBIN

	// Save registers and anything else
	GOSUB SAVESTATE

	// Done
	GOTO EXIT

// Function that actually saves the binaries
SAVEBIN:
    do std_utils SAVEBIN &LOGLOCATION &CODERAM_log &CODERAM_start &CODERAM_size
	do std_utils SAVEBIN &LOGLOCATION &DATARAM_log &DATARAM_start &DATARAM_size
    do std_utils SAVEBIN &LOGLOCATION &MSGRAM_log  &MSGRAM_start  &MSGRAM_size

	RETURN

// Function that actually saves the state
SAVESTATE:
	do std_utils SAVEREGS &LOGLOCATION &RPM_regs

	RETURN	

FATALEXIT:
	END

EXIT:
	ENDDO


		



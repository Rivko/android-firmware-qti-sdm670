//============================================================================
//  Name:                                                                     
//    DAP_WCNSS.cmm
//
//  Description:                                                              
//    Setup script for the Wireless Connectivity Sub-system
//                                                                            
// Copyright (c) 2012 - 2014 by Qualcomm Technologies, Incorporated.  All Rights Reserved.        
//
//
//
//
//                      EDIT HISTORY FOR FILE
//  This section contains comments describing changes made to the module.
//  Notice that changes are listed in reverse chronological order.
//
// when       who     		what, where, why
// --------   ---     		---------------------------------------------------------
// 04/04/2014 AJCheriyan    SWD support auto-detect
// 04/13/2013 AJCheriyan	Support for QDSS Gen 2
// 04/02/2013 AJCheriyan	Added SWD support
// 02/11/2013 AJCheriyan	Added 8x26 support
// 08/28/2012 AJCheriyan	Bumped JTAG clock up from default
// 07/10/2012 AJCheriyan    Created for B-family
//

// The script accepts two input arguments
// ARG0 - Chipset name
// ARG1 - Core number
// Ideal case, the argument 'ARG0' would not have to be used
// as the parameters for a sub-system should be the same
// across the entire family of chipsets

ENTRY &ARG0 &ARG1 &ARG2

MAIN:

	IF (("&ARG0"=="MSM8974")||("&ARG0"=="msm8974"))
	(
		SYSTEM.CPU ARM926EJ
		SYSTEM.CONFIG SLAVE ON    
		SYSTEM.JTAGCLOCK 15.0MHZ 	
		SYSTEM.CONFIG.DAPIRPOST 16.
		SYSTEM.CONFIG.DAPDRPOST 2.
		SYSTEM.CONFIG.DAPIRPRE 0.
		SYSTEM.CONFIG.DAPDRPRE 0.
		SYSTEM.CONFIG.MEMORYACCESSPORT 0.
		SYSTEM.CONFIG.DEBUGACCESSPORT 1.
		SYSTEM.CONFIG.JTAGACCESSPORT 2.
		SYSTEM.CONFIG COREJTAGPORT 2.
		SYSTEM.OPTION ENRESET OFF
		SYSTEM.OPTION RESBREAK ON

		SYSTEM.MEMACCESS DAP
	)

	IF (("&ARG0"=="MSM8X26")||("&ARG0"=="msm8x26"))
	(
		SYSTEM.CPU ARM926EJ
		SYSTEM.CONFIG SLAVE ON    
		SYSTEM.JTAGCLOCK 15.0MHZ
		SYSTEM.CONFIG.DAPIRPOST 16.
		SYSTEM.CONFIG.DAPDRPOST 2.
		SYSTEM.CONFIG.DAPIRPRE 0.
		SYSTEM.CONFIG.DAPDRPRE 0.	
		SYSTEM.CONFIG.MEMORYACCESSPORT 0.
		SYSTEM.CONFIG.DEBUGACCESSPORT 1.
		SYSTEM.CONFIG.JTAGACCESSPORT 2.
		SYSTEM.CONFIG COREJTAGPORT 2.
		SYSTEM.OPTION ENRESET OFF
		SYSTEM.OPTION RESBREAK ON

		SYSTEM.MEMACCESS DAP
	)

	IF (("&ARG0"=="MSM8X10")||("&ARG0"=="msm8x10")||("&ARG0"=="MSM8962")||("&ARG0"=="msm8962")||("&ARG0"=="APQ8084")||("&ARG0"=="apq8084"))
	(
		SYSTEM.CPU ARM926EJ
		SYSTEM.CONFIG SLAVE ON    
		SYSTEM.JTAGCLOCK 15.0MHZ
		SYSTEM.CONFIG.DAPIRPOST 16.
		SYSTEM.CONFIG.DAPDRPOST 2.
		SYSTEM.CONFIG.DAPIRPRE 0.
		SYSTEM.CONFIG.DAPDRPRE 0.	
		SYSTEM.CONFIG.MEMORYACCESSPORT 0.
		SYSTEM.CONFIG.AXIACCESSPORT 0.
		SYSTEM.CONFIG.DEBUGACCESSPORT 1.
		SYSTEM.CONFIG.JTAGACCESSPORT 2.
		SYSTEM.CONFIG COREJTAGPORT 2.
		SYSTEM.OPTION ENRESET OFF
		SYSTEM.OPTION RESBREAK ON

		SYSTEM.MEMACCESS DAP
	)

	// Common settings for all chipsets
	IF ((("&ARG2"=="SWD")||("&ARG2"=="swd"))&&(CABLE.TWOWIRE()))
	(
		SYSTEM.CONFIG SWDP ON 
		SYSTEM.CONFIG DEBUGPORTTYPE SWD
	)

	// Launch startup scripts
	IF (OS.ENV(STARTUPCMM)!="")
	(
            &STARTUPSCRIPT=OS.ENV(STARTUPCMM)
	    do &STARTUPSCRIPT
	)
	
	GOTO EXIT

EXIT:
	ENDDO

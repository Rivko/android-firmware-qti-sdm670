//============================================================================
//  Name:                                                                     
//    DAP_CDSP.cmm
//
//  Description:                                                              
//    Setup script for the Compute DSP
//                                                                            
// Copyright (c) 2012 - 2017 by Qualcomm Technologies, Incorporated.  All Rights Reserved.        
//
//
//
//
//                      EDIT HISTORY FOR FILE
//  This section contains comments describing changes made to the module.
//  Notice that changes are listed in reverse chronological order.
//
// when       who             what, where, why
// --------   ---             --------------------------------------------------------
// 09/29/2017 JBILLING        Updated for EUD  arguments
// 08/26/2017 Martham         Updated for sdm670
// 02/01/2017 JBILLING        Created for SDM845
//
// The script accepts two input arguments
// ARG0 - Chipset name
// ARG1 - Core number
// ARG2 - JTAG / SWD option
// Ideal case, the argument 'ARG0' would not have to be used
// as the parameters for a sub-system should be the same
// across the entire family of chipsets

ENTRY &ARG0 &ARG1 &ARG2
GLOBAL &CDSP_HW_BLOCK_NAME &CURRENT_HW_BLOCK_NAME
&CDSP_HW_BLOCK_NAME="CDSP-Q6"
MAIN:
    &ARG0=STR.UPR("&ARG0")
    IF (("&ARG0"=="SDM845")||("&ARG0"=="SDM670"))
    (
        SYStem.CPU HexagonV65
        
        
        IF "&RUMI"=="TRUE"
        (
            SYSTEM.JTAGCLOCK 500khz
        )
        ELSE
        (
            SYSTEM.JTAGCLOCK 5Mhz
        )

        SYStem.CONFIG SLAVE ON
        SYStem.CONFIG MEMORYACCESSPORT 0.
        SYStem.CONFIG DEBUGACCESSPORT  1.
        SYStem.CONFIG AXIACCESSPORT    0.
        SYStem.CONFIG MULTITAP NONE
        SYStem.CONFIG DAPIRPOST 0.
        SYStem.CONFIG DAPDRPOST 0.
        SYStem.CONFIG DAPIRPOST 11.
        SYStem.CONFIG DAPDRPOST 1.
        SYStem.CONFIG.ETM.Base           DAP:0x86864000
        SYStem.CONFIG.COREDEBUG.Base     DAP:0x86865000
        
        IF "&RUMI"=="TRUE"
        (
            SYStem.CONFIG DAPIRPOST 0.
            SYStem.CONFIG DAPDRPOST 0.
            System.CONFIG.debugtimescale 4.
        )
    )
    
    &CURRENT_HW_BLOCK_NAME="&CDSP_HW_BLOCK_NAME"
    IF "&EUD"!="TRUE"
    (
        // Common settings for all chipsets
        IF (("&ARG2"=="SWD")||("&ARG2"=="swd"))
        (
            SYSTEM.CONFIG SWDP ON 
            SYSTEM.CONFIG DEBUGPORTTYPE SWD
        )
        ELSE
        (
            SYStem.CONFIG DEBUGPORTTYPE JTAG
        )
    )
    // Launch startup scripts
    IF (OS.ENV(STARTUPCMM)!="")
    (
        &STARTUPSCRIPT=OS.ENV(STARTUPCMM)
        do &STARTUPSCRIPT
    )
    IF "&EUD"!="TRUE"
    (
    AUTOSTORE DAP_CDSP HISTORY
    )
    GOTO EXIT

EXIT:
    ENDDO

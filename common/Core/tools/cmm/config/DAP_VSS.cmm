//============================================================================
//  Name:                                                                     
//    DAP_VSS.cmm
//
//  Description:                                                              
//    Setup script for the Video Sub-system
//                                                                            
// Copyright (c) 2012 - 2014 by Qualcomm Technologies, Incorporated.  All Rights Reserved.        
//
//
//
//
//                      EDIT HISTORY FOR FILE
//  This section contains comments describing changes made to the module.
//  Notice that changes are listed in reverse chronological order.
//
// when       who             what, where, why
// --------   ---             ---------------------------------------------------------
// 08/26/2017 Martham       Updated for sdm670
// 02/01/2017 JBILLING      Updated for sdm845
// 04/04/2014 AJCheriyan    SWD support auto-detect
// 04/13/2013 AJCheriyan    Support for QDSS Gen 2
// 04/02/2013 AJCheriyan    Added SWD support
// 02/11/2013 AJCheriyan    Added 8x26 support
// 09/04/2012 AJCheriyan    Created for B-family
//

// The script accepts two input arguments
// ARG0 - Chipset name
// ARG1 - Core number
// Ideal case, the argument 'ARG0' would not have to be used
// as the parameters for a sub-system should be the same
// across the entire family of chipsets

ENTRY &ARG0 &ARG1 &ARG2

GLOBAL &VSS_HW_BLOCK_NAME &CURRENT_HW_BLOCK_NAME
&VSS_HW_BLOCK_NAME="VSS-CORTEXM3"
MAIN:
    &ARG0=STR.UPR("&ARG0")
    
    IF (("&ARG0"=="SDM845")||("&ARG0"=="SDM670"))
    (
        SYStem.CPU ARM926EJ
        
        IF "&RUMI"=="TRUE"
        (
            SYSTEM.JTAGCLOCK 500khz
        )
        ELSE
        (
            SYSTEM.JTAGCLOCK 5Mhz
        )
        SYStem.OPTION NOIRCHECK ON
        SYStem.OPTION WAITRESET OFF
        SYStem.OPTION ENRESET OFF
        SYStem.OPTION RESBREAK OFF
        SYStem.CONFIG SLAVE ON
        SYStem.CONFIG MEMORYACCESSPORT 0.
        SYStem.CONFIG DEBUGACCESSPORT  1.
        SYStem.CONFIG AXIACCESSPORT    0.
        SYStem.CONFIG JTAGACCESSPORT   2.
        SYStem.CONFIG COREJTAGPORT     3.
        SYStem.CONFIG DAPIRPOST 0.
        SYStem.CONFIG DAPDRPOST 0.
        SYStem.CONFIG DAPIRPOST 11.
        SYStem.CONFIG DAPDRPOST 1.
        SYStem.MEMACCESS DAP
    )
    ELSE IF (("&ARG0"=="MSM8974"))
    (
        SYSTEM.CPU ARM926EJ 
        SYSTEM.CONFIG SLAVE ON    

        SYSTEM.JTAGCLOCK 15.0MHZ

        SYSTEM.CONFIG.DAPIRPOST 16.
        SYSTEM.CONFIG.DAPDRPOST 2.
        SYSTEM.CONFIG.DAPIRPRE 0.
        SYSTEM.CONFIG.DAPDRPRE 0.
        SYSTEM.CONFIG.MEMORYACCESSPORT 0
        SYSTEM.CONFIG.DEBUGACCESSPORT 1
        SYSTEM.CONFIG.JTAGACCESSPORT 2
        SYSTEM.CONFIG.COREJTAGPORT 3
    
    )
    
    IF (("&ARG0"=="MSM8X26"))
    (
        SYSTEM.CPU ARM926EJ 
        SYSTEM.CONFIG SLAVE ON    

        SYSTEM.JTAGCLOCK 15.0MHZ

        SYSTEM.CONFIG.DAPIRPOST 16.
        SYSTEM.CONFIG.DAPDRPOST 2.
        SYSTEM.CONFIG.DAPIRPRE 0.
        SYSTEM.CONFIG.DAPDRPRE 0.
        SYSTEM.CONFIG.MEMORYACCESSPORT 0
        SYSTEM.CONFIG.DEBUGACCESSPORT 1
        SYSTEM.CONFIG.JTAGACCESSPORT 2
        SYSTEM.CONFIG.COREJTAGPORT 3
    )

    IF (("&ARG0"=="MSM8994")||("&ARG0"=="MSM8992")||("&ARG0"=="MSM8996")||("&ARG0"=="MSM8998"))
    (
        SYSTEM.CPU ARM926EJ 
        SYSTEM.CONFIG SLAVE ON    

        SYSTEM.JTAGCLOCK 10.0MHZ

        SYSTEM.CONFIG.DAPIRPOST 16.
        SYSTEM.CONFIG.DAPDRPOST 2.
        SYSTEM.CONFIG.DAPIRPRE 0.
        SYSTEM.CONFIG.DAPDRPRE 0.
        SYSTEM.CONFIG.MEMORYACCESSPORT 0
        SYSTEM.CONFIG.AXIACCESSPORT 0
        SYSTEM.CONFIG.DEBUGACCESSPORT 1
        SYSTEM.CONFIG.JTAGACCESSPORT 2
        SYSTEM.CONFIG.COREJTAGPORT 3
        
    )

    // Common settings for all chipsets
    IF ((("&ARG2"=="SWD")||("&ARG2"=="swd"))&&(CABLE.TWOWIRE()))
    (
        SYSTEM.CONFIG SWDP ON 
        SYSTEM.CONFIG DEBUGPORTTYPE SWD
    )

    // Launch startup scripts
    IF (OS.ENV(STARTUPCMM)!="")
    (
        &STARTUPSCRIPT=OS.ENV(STARTUPCMM)
        do &STARTUPSCRIPT
    )
    &CURRENT_HW_BLOCK_NAME="&VSS_HW_BLOCK_NAME"
    
    GOTO EXIT

EXIT:
    ENDDO

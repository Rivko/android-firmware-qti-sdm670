//============================================================================
//  Name:                                                                     
//    DAP_GPMU.cmm
//
//  Description:                                                              
//    Setup script for the MMSS GPMU subsystem
//                                                                            
// Copyright (c) 2012 - 2017 by Qualcomm Technologies, Incorporated.  All Rights Reserved.        
// This file confidential and proprietary.
//
//
//
//
//                      EDIT HISTORY FOR FILE
//  This section contains comments describing changes made to the module.
//  Notice that changes are listed in reverse chronological order.
//
// when       who             what, where, why
// --------   ---             ---------------------------------------------------------
// 08/26/2017 Martham         Updated for sdm670
// 04/20/2017 JBILLING        Created for sdm845


// The script accepts two input arguments
// ARG0 - Chipset name
// ARG1 - Core number
// Ideal case, the argument 'ARG0' would not have to be used
// as the parameters for a sub-system should be the same
// across the entire family of chipsets

ENTRY &ARG0 &ARG1 &ARG2

GLOBAL &GPMU_HW_BLOCK_NAME &CURRENT_HW_BLOCK_NAME
&GPMU_HW_BLOCK_NAME="GPMU-CORTEXM3"
MAIN:
    &ARG0=STR.UPR("&ARG0")
    
    IF (("&ARG0"=="SDM845")||("&ARG0"=="SDM670"))
    (
        SYStem.CPU CortexM3
        
        IF "&RUMI"=="TRUE"
        (
            SYSTEM.JTAGCLOCK 500khz
        )
        ELSE
        (
            SYSTEM.JTAGCLOCK 5Mhz
        )
        
        SYStem.OPTION WAITRESET OFF
        SYStem.OPTION ENRESET OFF
        SYStem.OPTION RESBREAK OFF
        SYStem.CONFIG SLAVE ON

        SYStem.CONFIG ETMBASE          E:0xE0041000
        SYStem.CONFIG TPIUBASE         0

        SYStem.CONFIG MEMORYACCESSPORT 5.
        SYStem.CONFIG DEBUGACCESSPORT  1.
        SYStem.CONFIG AHBACCESSPORT    5.
        SYStem.CONFIG APBACCESSPORT    1.
        SYStem.CONFIG AXIACCESSPORT    0.

        SYStem.CONFIG DAPIRPOST 0.
        SYStem.CONFIG DAPDRPOST 0.
        SYStem.CONFIG DAPIRPOST 11.
        SYStem.CONFIG DAPDRPOST 1.

        SYStem.MEMACCESS DAP

        IF "&RUMI"=="TRUE"
        (
            SYStem.CONFIG DAPIRPOST 0.
            SYStem.CONFIG DAPDRPOST 0.
        )


    )
    
        // Common settings for all chipsets
    IF ((("&ARG2"=="SWD")||("&ARG2"=="swd"))&&(CABLE.TWOWIRE()))
    (
        SYSTEM.CONFIG SWDP ON 
        SYSTEM.CONFIG DEBUGPORTTYPE SWD
    )

    // Launch startup scripts
    IF (OS.ENV(STARTUPCMM)!="")
    (
        &STARTUPSCRIPT=OS.ENV(STARTUPCMM)
        do &STARTUPSCRIPT
    )
    &CURRENT_HW_BLOCK_NAME="&GPMU_HW_BLOCK_NAME"
    
    GOTO EXIT

EXIT:
    ENDDO

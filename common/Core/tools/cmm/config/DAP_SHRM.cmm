//============================================================================
//  Name:                                                                     
//    DAP_DDR.cmm
//
//  Description:                                                              
//    Setup script for the Apps Processor
//                                                                            
// Copyright (c) 2012 - 2014 by Qualcomm Technologies, Incorporated.  All Rights Reserved.        
//
//
//
//
//                      EDIT HISTORY FOR FILE
//  This section contains comments describing changes made to the module.
//  Notice that changes are listed in reverse chronological order.
//
// when       who             what, where, why
// --------   ---             ---------------------------------------------------------
// 08/26/2017 Martham         Updated for sdm670
// 02/01/2017 JBILLING        Created for SDM845

// The script accepts two input arguments
// ARG0 - Chipset name
// ARG1 - Core number
// Ideal case, the argument 'ARG0' would not have to be used
// as the parameters for a sub-system should be the same
// across the entire family of chipsets

ENTRY &ARG0 &ARG1 &ARG2
GLOBAL &DDR_HW_BLOCK_NAME &CURRENT_HW_BLOCK_NAME
&DDR_HW_BLOCK_NAME="DDR-CORTEXM3"
&CURRENT_HW_BLOCK_NAME="&DDR_HW_BLOCK_NAME"
MAIN:

    &ARG0=STR.UPR("&ARG0")
    

    IF (("&ARG0"=="SDM845")||("&ARG0"=="SDM670"))
    (

        SYStem.Reset
        SYStem.CPU XTENSA_LX6
        
        IF "&RUMI"=="TRUE"
        (
            SYSTEM.JTAGCLOCK 500khz
        )
        ELSE
        (
            SYSTEM.JTAGCLOCK 5Mhz
        )
        SYStem.OPTION ENRESET OFF
        SYStem.OPTION Endianess LITTLE

        SYStem.CONFIG SLAVE ON

        SYStem.CONFIG.COREDEBUG.Base   APB:0x869E8000

        SYStem.CONFIG MEMORYACCESSPORT 0.
        SYStem.CONFIG DEBUGACCESSPORT  1.
        ;SYStem.CONFIG AHBACCESSPORT    19.
        ;SYStem.CONFIG APBACCESSPORT    1.
        SYStem.CONFIG AXIACCESSPORT    0.

        SYStem.CONFIG DAPIRPOST 0.
        SYStem.CONFIG DAPDRPOST 0.
        SYStem.CONFIG DAPIRPOST 11.
        SYStem.CONFIG DAPDRPOST 1.

        SYStem.MEMACCESS DAP
        
        IF "&RUMI"=="TRUE"
        (
            SYStem.CONFIG DAPIRPOST 0.
            SYStem.CONFIG DAPDRPOST 0.
        )

        
        B.SEL PROGRAM AUTO
        RADIX HEX
        SETUP.VAR %HEX.ON
        MODE.HLL
       IF "&EUD"!="TRUE"
       (
           AUTOSTORE DAP_DDR HISTORY
       )
     
       
        
    )


 IF (("&ARG0"=="MDM9675")||("&ARG0"=="SDX24"))
    (

        SYStem.Reset
        SYStem.CPU XTENSA_LX6
        
        IF "&RUMI"=="TRUE"
        (
          SYStem.JTAGCLOCK CTCK 1.MHz
        )
        ELSE
        (
           SYStem.JTAGCLOCK CTCK 20.MHz
        )
        SYStem.OPTION ENRESET OFF
        SYStem.OPTION Endianess LITTLE

        SYStem.CONFIG SLAVE ON

        SYStem.CONFIG.COREDEBUG.Base   APB:0x869E8000

        SYStem.CONFIG MEMORYACCESSPORT 0.
        SYStem.CONFIG DEBUGACCESSPORT  1.
        ;SYStem.CONFIG AHBACCESSPORT    19.
        ;SYStem.CONFIG APBACCESSPORT    1.
        SYStem.CONFIG AXIACCESSPORT    0.

        SYStem.CONFIG DAPIRPOST 0.
        SYStem.CONFIG DAPDRPOST 0.
        SYStem.CONFIG DAPIRPOST 11.
        SYStem.CONFIG DAPDRPOST 1.

        SYStem.MEMACCESS DAP
        
        IF "&RUMI"=="TRUE"
        (
            SYStem.CONFIG DAPIRPOST 0.
            SYStem.CONFIG DAPDRPOST 0.
        )

        
        B.SEL PROGRAM AUTO
        RADIX HEX
        SETUP.VAR %HEX.ON
        MODE.HLL

        autostore , history
        
    )

    // Common settings for all chipsets
    IF ((("&ARG2"=="SWD")||("&ARG2"=="swd"))&&(CABLE.TWOWIRE()))
    (
        SYSTEM.CONFIG SWDP ON 
        SYSTEM.CONFIG DEBUGPORTTYPE SWD
        
    )

    // Launch startup scripts
    IF (OS.ENV(STARTUPCMM)!="")
    (
        &STARTUPSCRIPT=OS.ENV(STARTUPCMM)
        do &STARTUPSCRIPT
    )

    GOTO EXIT

EXIT:
    ENDDO

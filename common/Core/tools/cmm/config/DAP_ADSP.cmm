//============================================================================
//  Name:                                                                     
//    DAP_ADSP.cmm
//
//  Description:                                                              
//    Setup script for the Applications DSP Sub-system
//                                                                            
// Copyright (c) 2012 - 2014 by Qualcomm Technologies, Incorporated.  All Rights Reserved.        
//
//
//
//
//                      EDIT HISTORY FOR FILE
//  This section contains comments describing changes made to the module.
//  Notice that changes are listed in reverse chronological order.
//
// when       who             what, where, why
// --------   ---             --------------------------------------------------------
// 09/29/2017 JBILLING      Updated for EUD  arguments
// 09/02/2017 MARTHAM       Updated for sdm670
// 02/01/2017 JBILLING      Updated for sdm845
// 03/29/2016 JBILLING      Updated for 8998
// 02/20/2015 JBILLING      Remove JTAG hack
// 02/03/2015 JBILLING      Updated for Istari
// 05/21/2014 AJCheriyan    Updated for Elessar
// 04/15/2014 AJCheriyan    SWDTARGET removed
// 04/04/2014 AJCheriyan    SWD support auto-detect
// 04/13/2013 AJCheriyan    Support for QDSS Gen 2
// 04/04/2013 AJCheriyan    Added SWD support
// 02/11/2013 AJCheriyan    Added 8x26 support
// 08/25/2012 AJCheriyan    Bumped up JTAG clock
// 08/08/2012 AJCheriyan    Updated Hexagon version for July 2012 version
// 07/10/2012 AJCheriyan    Created for B-family
//

// The script accepts two input arguments
// ARG0 - Chipset name
// ARG1 - Core number
// ARG2 - JTAG / SWD option
// Ideal case, the argument 'ARG0' would not have to be used
// as the parameters for a sub-system should be the same
// across the entire family of chipsets

ENTRY &ARG0 &ARG1 &ARG2
GLOBAL &ADSP_HW_BLOCK_NAME &CURRENT_HW_BLOCK_NAME
&ADSP_HW_BLOCK_NAME="LPASS-Q6"

MAIN:
    &ARG0=STR.UPR("&ARG0")
    IF (("&ARG0"=="SDM670"))
    (
        IF "&EUD"!="TRUE"
        (
            SYSTEM.RESET
        )
        SYStem.CPU HexagonV65
        IF "&RUMI"=="TRUE"
        (
            SYSTEM.JTAGCLOCK 500khz
        )
        ELSE
        (
            SYSTEM.JTAGCLOCK 5Mhz
        )

        SYStem.CONFIG SLAVE ON
        SYStem.CONFIG MEMORYACCESSPORT 0.
        SYStem.CONFIG DEBUGACCESSPORT  17.
        SYStem.CONFIG AHBACCESSPORT    18.
        SYStem.CONFIG APBACCESSPORT    1.
        SYStem.CONFIG AXIACCESSPORT    0.
        SYStem.CONFIG MULTITAP NONE
        SYStem.CONFIG DAPIRPOST 0.
        SYStem.CONFIG DAPDRPOST 0.
        SYStem.CONFIG DAPIRPOST 11.
        SYStem.CONFIG DAPDRPOST 1.
        SYStem.CONFIG.ETM.Base           DAP:0x86B18000
        SYStem.CONFIG.COREDEBUG.Base     DAP:0x86B19000
        
        IF "&RUMI"=="TRUE"
        (
            SYStem.CONFIG DAPIRPOST 0.
            SYStem.CONFIG DAPDRPOST 0.
            System.CONFIG.debugtimescale 4.
        )
    )
    ELSE IF (("&ARG0"=="SDM845"))
    (
        IF "&EUD"!="TRUE"
        (
            SYSTEM.RESET
        )
        SYSTEM.CPU HEXAGONV65
        
        IF "&RUMI"=="TRUE"
        (
            SYSTEM.JTAGCLOCK 500khz
        )
        ELSE
        (
            SYSTEM.JTAGCLOCK 5Mhz
        )
        
        SYStem.CONFIG SLAVE ON
        SYStem.CONFIG MEMORYACCESSPORT 0.
        SYStem.CONFIG DEBUGACCESSPORT  1.
        SYStem.CONFIG AXIACCESSPORT    0.
        SYStem.CONFIG MULTITAP NONE
        SYStem.CONFIG DAPIRPOST 0.
        SYStem.CONFIG DAPDRPOST 0.
        SYStem.CONFIG DAPIRPOST 11.
        SYStem.CONFIG DAPDRPOST 1.
        SYStem.CONFIG.ETM.Base           DAP:0x86848000
        SYStem.CONFIG.COREDEBUG.Base     DAP:0x86849000
        
        IF "&RUMI"=="TRUE"
        (
            SYStem.CONFIG DAPIRPOST 0.
            SYStem.CONFIG DAPDRPOST 0.
            System.CONFIG.debugtimescale 4.
        )
    
    )
    ELSE IF (("&ARG0"=="MSM8996"))
    (
        SYSTEM.RESET
        SYSTEM.CPU HEXAGONV60 
        

        SYSTEM.JTAGCLOCK 10.0MHZ
        
        SYSTEM.CONFIG SLAVE ON    

        SYStem.CONFIG MEMORYACCESSPORT 0.
        SYStem.CONFIG DEBUGACCESSPORT  1.
        SYStem.CONFIG AXIACCESSPORT    0.
        SYStem.CONFIG JTAGACCESSPORT   2.
        SYStem.CONFIG COREJTAGPORT     1.
        SYStem.CONFIG MULTITAP NONE
        SYStem.CONFIG DAPIRPOST 0.
        SYStem.CONFIG DAPDRPOST 0.
        SYStem.CONFIG DAPIRPOST 16.
        SYStem.CONFIG DAPDRPOST 2.

                
        
        //ISDB issue workaround
        SYS.OPTION.ICFLUSH OFF
        
        ETM.OFF
        
    )
    IF (("&ARG0"=="MSM8998"))
    (
        SYSTEM.RESET
        SYSTEM.CPU HEXAGONV62
        

        SYSTEM.JTAGCLOCK 10.0MHZ
        
        SYSTEM.CONFIG SLAVE ON    

        SYStem.CONFIG MEMORYACCESSPORT 0.
        SYStem.CONFIG DEBUGACCESSPORT  1.
        SYStem.CONFIG AXIACCESSPORT    0.
        SYStem.CONFIG JTAGACCESSPORT   2.
        SYStem.CONFIG COREJTAGPORT     1.
        SYStem.CONFIG MULTITAP NONE
        SYStem.CONFIG DAPIRPOST 0.
        SYStem.CONFIG DAPDRPOST 0.
        SYStem.CONFIG DAPIRPOST 16.
        SYStem.CONFIG DAPDRPOST 2.

                
        
        //ISDB issue workaround
        SYS.OPTION.ICFLUSH OFF
        
        ETM.OFF
        
    )
    IF (("&ARG0"=="MSM8994"))
    (
        SYSTEM.CPU HEXAGONV56 
        SYSTEM.CONFIG SLAVE ON    

        SYSTEM.JTAGCLOCK 10.0MHZ

        SYSTEM.CONFIG.DAPIRPOST 16.
        SYSTEM.CONFIG.DAPDRPOST 2.
        SYSTEM.CONFIG.DAPIRPRE 0.
        SYSTEM.CONFIG.DAPDRPRE 0.
        SYSTEM.CONFIG.MEMORYACCESSPORT 0
        SYSTEM.CONFIG.DEBUGACCESSPORT 1
        SYSTEM.CONFIG.JTAGACCESSPORT 2
        SYSTEM.CONFIG.COREJTAGPORT 1
        SYSTEM.CONFIG.AXIACCESSPORT 0
        
        MMU.TABLEWALK ON
    )

    IF (("&ARG0"=="MSM8992"))
    (
        SYSTEM.CPU HEXAGONV56 
        SYSTEM.CONFIG SLAVE ON    

        SYSTEM.JTAGCLOCK 10.0MHZ

        SYSTEM.CONFIG.DAPIRPOST 16.
        SYSTEM.CONFIG.DAPDRPOST 2.
        SYSTEM.CONFIG.DAPIRPRE 0.
        SYSTEM.CONFIG.DAPDRPRE 0.
        SYSTEM.CONFIG.MEMORYACCESSPORT 0
        SYSTEM.CONFIG.DEBUGACCESSPORT 1
        SYSTEM.CONFIG.JTAGACCESSPORT 2
        SYSTEM.CONFIG.COREJTAGPORT 1
        SYSTEM.CONFIG.AXIACCESSPORT 0
        
        MMU.TABLEWALK ON
    )

    IF (("&ARG0"=="MSM8974"))
    (
        SYSTEM.CPU HEXAGONV5 
        SYSTEM.CONFIG SLAVE ON    

        SYSTEM.JTAGCLOCK 15.0MHZ

        SYSTEM.CONFIG.DAPIRPOST 16.
        SYSTEM.CONFIG.DAPDRPOST 2.
        SYSTEM.CONFIG.DAPIRPRE 0.
        SYSTEM.CONFIG.DAPDRPRE 0.
        SYSTEM.CONFIG.MEMORYACCESSPORT 0
        SYSTEM.CONFIG.DEBUGACCESSPORT 1
        SYSTEM.CONFIG.JTAGACCESSPORT 2
        SYSTEM.CONFIG.COREJTAGPORT 1

        MMU.TABLEWALK ON

    )

    IF (("&ARG0"=="MSM8X26")||("&ARG0"=="MSM8X10"))
    (
        SYSTEM.CPU HEXAGONV5 
        SYSTEM.CONFIG SLAVE ON    

        SYSTEM.JTAGCLOCK 15.0MHZ
        SYSTEM.CONFIG.DAPIRPOST 16.
        SYSTEM.CONFIG.DAPDRPOST 2.
        SYSTEM.CONFIG.DAPIRPRE 0.
        SYSTEM.CONFIG.DAPDRPRE 0.
        SYSTEM.CONFIG.MEMORYACCESSPORT 0
        SYSTEM.CONFIG.AXIACCESSPORT 0
        SYSTEM.CONFIG.DEBUGACCESSPORT 1
        SYSTEM.CONFIG.JTAGACCESSPORT 2
        SYSTEM.CONFIG.COREJTAGPORT 1

        MMU.TABLEWALK ON
    )
    
    IF (("&ARG0"=="APQ8084"))
    (
        SYSTEM.CPU HEXAGONV5 
        SYSTEM.CONFIG SLAVE ON    

        SYSTEM.JTAGCLOCK 15.0MHZ
        SYSTEM.CONFIG.DAPIRPOST 16.
        SYSTEM.CONFIG.DAPDRPOST 2.
        SYSTEM.CONFIG.DAPIRPRE 0.
        SYSTEM.CONFIG.DAPDRPRE 0.
        SYSTEM.CONFIG.MEMORYACCESSPORT 0
        SYSTEM.CONFIG.AXIACCESSPORT 0
        SYSTEM.CONFIG.DEBUGACCESSPORT 1
        SYSTEM.CONFIG.JTAGACCESSPORT 2
        SYSTEM.CONFIG.COREJTAGPORT 1

        // Other settings
        MMU.TABLEWALK ON
        
        // SYSTEM.CONFIG SWDPTARGETSEL 0X109000E1
    )
    
    IF (("&ARG0"=="MDM9X25"))
    (
        SYSTEM.CPU HEXAGONV5 
        SYSTEM.CONFIG SLAVE ON    

        SYSTEM.JTAGCLOCK 15.0MHZ

        SYSTEM.CONFIG.DAPIRPOST 16.
        SYSTEM.CONFIG.DAPDRPOST 2.
        SYSTEM.CONFIG.DAPIRPRE 0.
        SYSTEM.CONFIG.DAPDRPRE 0.
        SYSTEM.CONFIG.MEMORYACCESSPORT 0
        SYSTEM.CONFIG.DEBUGACCESSPORT 1
        SYSTEM.CONFIG.JTAGACCESSPORT 2
        SYSTEM.CONFIG.COREJTAGPORT 1

        // Other settings
        MMU.TABLEWALK ON
        
        // SYSTEM.CONFIG SWDPTARGETSEL    0x107F50E1

    )
    &CURRENT_HW_BLOCK_NAME="&ADSP_HW_BLOCK_NAME"
    IF "&EUD"!="TRUE"
    (
        // Common settings for all chipsets
        IF (("&ARG2"=="SWD")||("&ARG2"=="swd"))
        (
            SYSTEM.CONFIG SWDP ON 
            SYSTEM.CONFIG DEBUGPORTTYPE SWD
        )
        ELSE
        (
            SYStem.CONFIG DEBUGPORTTYPE JTAG
        )
    )
    // Launch startup scripts
    IF (OS.ENV(STARTUPCMM)!="")
    (
        &STARTUPSCRIPT=OS.ENV(STARTUPCMM)
        do &STARTUPSCRIPT
    )
    IF "&EUD"!="TRUE"
    (
        AUTOSTORE DAP_ADSP HISTORY
    )
    GOTO EXIT

EXIT:
    ENDDO

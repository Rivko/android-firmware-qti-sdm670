//============================================================================
//  Name:                                                                     
//    DAP_MPSS.cmm
//
//  Description:                                                              
//    Setup script for the Modem Sub-system
//                                                                            
// Copyright (c) 2012 - 2018 by Qualcomm Technologies, Incorporated.  All Rights Reserved.        
//
//
//
//
//                      EDIT HISTORY FOR FILE
//  This section contains comments describing changes made to the module.
//  Notice that changes are listed in reverse chronological order.
//
// when       who             what, where, why
// --------   ---             ---------------------------------------------------------
// 09/29/2017 JBILLING        Updated for EUD  arguments
// 08/26/2017 Martham         Updated for sdm670
// 02/01/2017 JBILLING        Updated for SDM845
// 03/29/2016 JBILLING        Updated for 8998
// 03/10/2016 JBILLING        Updates for 8998
// 07/22/2015 RSSRIDHA        Updates for MDM9x45
// 04/19/2015 JBILLIN         Updates for IstariV2
// 05/21/2014 AJCheriyan      Updated for Elessar
// 04/15/2014 AJCheriyan      SWDTARGET removed
// 04/04/2014 AJCheriyan      SWD support auto-detect
// 04/13/2013 AJCheriyan      Support for QDSS Gen 2
// 04/02/2013 AJCheriyan      Added SWD support
// 02/11/2013 AJCheriyan      Added 8x26 support
// 07/10/2012 AJCheriyan      Created for B-family
//

// The script accepts two input arguments
// ARG0 - Chipset name
// ARG1 - Core number
// Ideal case, the argument 'ARG0' would not have to be used
// as the parameters for a sub-system should be the same
// across the entire family of chipsets

ENTRY &ARG0 &ARG1 &ARG2
GLOBAL &MPSS_HW_BLOCK_NAME &CURRENT_HW_BLOCK_NAME
&MPSS_HW_BLOCK_NAME="MSS-Q6"
MAIN:

    &ARG0=STR.UPR("&ARG0")
    IF (("&ARG0"=="SDM845")||("&ARG0"=="SDM670"))
    (

        SYStem.CPU HexagonV65
        
        
        IF "&RUMI"=="TRUE"
        (
            SYSTEM.JTAGCLOCK 500khz
        )
        ELSE
        (
            SYSTEM.JTAGCLOCK 5Mhz
        )

        SYStem.CONFIG SLAVE ON
        SYStem.CONFIG MEMORYACCESSPORT 0.
        SYStem.CONFIG DEBUGACCESSPORT  1.
        SYStem.CONFIG AXIACCESSPORT    0.
        SYStem.CONFIG MULTITAP NONE
		//below port number reference from vi script and  below ports number has been change for sdx24
        SYStem.CONFIG DAPIRPOST 0.
        SYStem.CONFIG DAPDRPOST 0.
        SYStem.CONFIG DAPIRPOST 11.
        SYStem.CONFIG DAPDRPOST 1.
        SYStem.CONFIG.ETM.Base           DAP:0x86838000
        SYStem.CONFIG.COREDEBUG.Base     DAP:0x86839000
        
        IF "&RUMI"=="TRUE"
        (
            SYStem.CONFIG DAPIRPOST 0.
            SYStem.CONFIG DAPDRPOST 0.
            System.CONFIG.debugtimescale 4.
        )
    )    
    IF (("&ARG0"=="MSM8996"))
    (
        SYSTEM.CPU HEXAGONV56 
        SYSTEM.JTAGCLOCK 10.0MHZ
        SYStem.CONFIG SLAVE ON
        
        SYStem.CONFIG MEMORYACCESSPORT 0.
        SYStem.CONFIG DEBUGACCESSPORT  1.
        SYStem.CONFIG AXIACCESSPORT    0.
        SYStem.CONFIG JTAGACCESSPORT   2.
        SYStem.CONFIG COREJTAGPORT     0.
        SYStem.CONFIG MULTITAP NONE
        
        SYStem.CONFIG DAPIRPOST 0.
        SYStem.CONFIG DAPDRPOST 0.
        SYStem.CONFIG DAPIRPOST 16.
        SYStem.CONFIG DAPDRPOST 2.
    )
    IF (("&ARG0"=="MSM8998"))
    (
        SYSTEM.CPU HEXAGONV62
        SYSTEM.JTAGCLOCK 10.0MHZ
        SYStem.CONFIG SLAVE ON
        
        SYStem.CONFIG MEMORYACCESSPORT 0.
        SYStem.CONFIG DEBUGACCESSPORT  1.
        SYStem.CONFIG AXIACCESSPORT    0.
        SYStem.CONFIG JTAGACCESSPORT   2.
        SYStem.CONFIG COREJTAGPORT     0.
        SYStem.CONFIG MULTITAP NONE
        
        SYStem.CONFIG DAPIRPOST 0.
        SYStem.CONFIG DAPDRPOST 0.
        SYStem.CONFIG DAPIRPOST 16.
        SYStem.CONFIG DAPDRPOST 2.
    )
    IF (("&ARG0"=="MSM8994"))
    (
        SYSTEM.CPU HEXAGONV56 
        SYSTEM.CONFIG SLAVE ON    

        SYSTEM.JTAGCLOCK 10.0MHZ

        SYSTEM.CONFIG.DAPIRPOST 16.
        SYSTEM.CONFIG.DAPDRPOST 2.
        SYSTEM.CONFIG.DAPIRPRE 0.
        SYSTEM.CONFIG.DAPDRPRE 0.
        
        SYSTEM.CONFIG.MEMORYACCESSPORT 0
        SYSTEM.CONFIG.DEBUGACCESSPORT 1
        SYSTEM.CONFIG.JTAGACCESSPORT 2
        SYSTEM.CONFIG.COREJTAGPORT 0
        SYSTEM.CONFIG.AXIACCESSPORT 0
        
        
    )

    IF (("&ARG0"=="MSM8992"))
    (
    SYSTEM.CPU HEXAGONV56 
    SYSTEM.CONFIG SLAVE ON    

    SYSTEM.JTAGCLOCK 10.0MHZ

    SYSTEM.CONFIG.DAPIRPOST 16.
    SYSTEM.CONFIG.DAPDRPOST 2.
    SYSTEM.CONFIG.DAPIRPRE 0.
    SYSTEM.CONFIG.DAPDRPRE 0.
    SYSTEM.CONFIG.MEMORYACCESSPORT 0
    SYSTEM.CONFIG.DEBUGACCESSPORT 1
    SYSTEM.CONFIG.JTAGACCESSPORT 2
    SYSTEM.CONFIG.COREJTAGPORT 0
    SYSTEM.CONFIG.AXIACCESSPORT 0
    
    
    )
    IF (("&ARG0"=="MSM8974"))
    (
    SYSTEM.CPU HEXAGONV5 
    SYSTEM.CONFIG SLAVE ON    

    SYSTEM.JTAGCLOCK 15.0MHZ

    SYSTEM.CONFIG.DAPIRPOST 16.
    SYSTEM.CONFIG.DAPDRPOST 2.
    SYSTEM.CONFIG.DAPIRPRE 0.
    SYSTEM.CONFIG.DAPDRPRE 0.
    SYSTEM.CONFIG.MEMORYACCESSPORT 0
    SYSTEM.CONFIG.DEBUGACCESSPORT 1
    SYSTEM.CONFIG.JTAGACCESSPORT 2
    SYSTEM.CONFIG.COREJTAGPORT 0
    
    
    )

    IF (("&ARG0"=="MSM8X26"))
    (
        SYSTEM.CPU HEXAGONV5 
        SYSTEM.CONFIG SLAVE ON    

        SYSTEM.JTAGCLOCK 15.0MHZ
        SYSTEM.CONFIG.DAPIRPOST 16.
        SYSTEM.CONFIG.DAPDRPOST 2.
        SYSTEM.CONFIG.DAPIRPRE 0.
        SYSTEM.CONFIG.DAPDRPRE 0.
        SYSTEM.CONFIG.MEMORYACCESSPORT 0
        SYSTEM.CONFIG.DEBUGACCESSPORT 1
        SYSTEM.CONFIG.JTAGACCESSPORT 2
        SYSTEM.CONFIG.COREJTAGPORT 0
        
             
    )

    IF (("&ARG0"=="MSM8X10"))
    (
        SYSTEM.CPU HEXAGONV5 
        SYSTEM.CONFIG SLAVE ON    

        SYSTEM.JTAGCLOCK 15.0MHZ
        SYSTEM.CONFIG.DAPIRPOST 16.
        SYSTEM.CONFIG.DAPDRPOST 2.
        SYSTEM.CONFIG.DAPIRPRE 0.
        SYSTEM.CONFIG.DAPDRPRE 0.
        SYSTEM.CONFIG.MEMORYACCESSPORT 0
        SYSTEM.CONFIG.AXIACCESSPORT 0
        SYSTEM.CONFIG.DEBUGACCESSPORT 1
        SYSTEM.CONFIG.JTAGACCESSPORT 2
        SYSTEM.CONFIG.COREJTAGPORT 0
        
        
    )
    
    IF (("&ARG0"=="MDM9X25"))
    (
        SYSTEM.CPU HEXAGONV5 
        SYSTEM.CONFIG SLAVE ON    

        SYSTEM.JTAGCLOCK 15.0MHZ

        SYSTEM.CONFIG.DAPIRPOST 16.
        SYSTEM.CONFIG.DAPDRPOST 2.
        SYSTEM.CONFIG.DAPIRPRE 0.
        SYSTEM.CONFIG.DAPDRPRE 0.
        SYSTEM.CONFIG.MEMORYACCESSPORT 0
        SYSTEM.CONFIG.DEBUGACCESSPORT 1
        SYSTEM.CONFIG.JTAGACCESSPORT 2
        SYSTEM.CONFIG.COREJTAGPORT 0
        
        
        
        // SYSTEM.CONFIG SWDPTARGETSEL    0x107F50E1
    )

    IF ("&ARG0"=="MDM9645")
    (

        SYStem.Reset
    SYSTEM.CPU HEXAGONV56 
    SYSTEM.CONFIG SLAVE ON
    SYSTEM.JTAGCLOCK  CTCK 20.0MHZ
    SYStem.CONFIG DAPIRPOST 0.
    SYStem.CONFIG DAPDRPOST 0.
    SYStem.CONFIG DAPIRPOST 16.
    SYStem.CONFIG DAPDRPOST 2.
    SYStem.CONFIG MEMORYACCESSPORT 0.
    SYStem.CONFIG DEBUGACCESSPORT  1.
    SYStem.CONFIG JTAGACCESSPORT   2.
    SYStem.CONFIG COREJTAGPORT     0.
    SYStem.CONFIG AXIACCESSPORT    0.
    SYStem.CONFIG MULTITAP NONE
    sys.config.corenumber 4
    core.assign 1 2 3 4
    MMU.TABLEWALK ON
    RADIX HEX
    SETUP.VAR %HEX.ON
    MODE.HLL
    SYStem.STATE
    IF "&EUD"!="TRUE"
    (
        AUTOSTORE DAP_MPSS HISTORY
    )

    ETM.ON

    )
    IF ("&ARG0"=="SDX50")||("&ARG0"=="SDX50M")
    (
    
        SYStem.Reset
        
        SYSTEM.CPU HexagonV62
        
        SYSTEM.CONFIG SLAVE ON
        SYSTEM.JTAGCLOCK  CTCK 20.0MHZ
        SYStem.CONFIG DAPIRPOST 0.
        SYStem.CONFIG DAPDRPOST 0.
        SYStem.CONFIG DAPIRPOST 11.
        SYStem.CONFIG DAPDRPOST 1.
        SYStem.CONFIG MEMORYACCESSPORT 0.
        SYStem.CONFIG DEBUGACCESSPORT  1.
        SYStem.CONFIG JTAGACCESSPORT   2.
        SYStem.CONFIG COREJTAGPORT     0.
        SYStem.CONFIG AXIACCESSPORT    0.
        SYStem.CONFIG MULTITAP NONE
        sys.config.corenumber 4
        core.assign 1 2 3 4
        MMU.TABLEWALK ON
        RADIX HEX
        SETUP.VAR %HEX.ON
        MODE.HLL
        SYStem.STATE
        autostore , history
        ETM.ON

    )
     IF ("&ARG0"=="MDM9655")||("&ARG0"=="MDM9665")||("&ARG0"=="SDX20")||("&ARG0"=="SDX20M")
    (

        SYStem.Reset
        IF ("&ARG0"=="MDM9655")
        (
          SYSTEM.CPU HexagonV61
        ) 
        IF ("&ARG0"=="MDM9665")||("&ARG0"=="SDX20")||("&ARG0"=="SDX20M")
        (
          SYSTEM.CPU HexagonV62
        ) 
        SYSTEM.CONFIG SLAVE ON
        SYSTEM.JTAGCLOCK  CTCK 20.0MHZ
        SYStem.CONFIG DAPIRPOST 0.
        SYStem.CONFIG DAPDRPOST 0.
        SYStem.CONFIG DAPIRPOST 16.
        SYStem.CONFIG DAPDRPOST 2.
        SYStem.CONFIG MEMORYACCESSPORT 0.
        SYStem.CONFIG DEBUGACCESSPORT  1.
        SYStem.CONFIG JTAGACCESSPORT   2.
        SYStem.CONFIG COREJTAGPORT     0.
        SYStem.CONFIG AXIACCESSPORT    0.
        SYStem.CONFIG MULTITAP NONE
        sys.config.corenumber 4
        core.assign 1 2 3 4
        MMU.TABLEWALK ON
        RADIX HEX
        SETUP.VAR %HEX.ON
        MODE.HLL
        SYStem.STATE
        autostore , history
        ETM.ON

    )
	 IF ("&ARG0"=="MDM9675")||("&ARG0"=="SDX24")
    (

        SYStem.Reset
        SYStem.CPU HexagonV66
         
        SYSTEM.CONFIG SLAVE ON
		IF "&RUMI"=="TRUE"
		(
        SYSTEM.JTAGCLOCK  CTCK 1.MHz
		)
		ELSE 
		(
		SYSTEM.JTAGCLOCK  CTCK 20.MHz
		)
		
        SYStem.CONFIG DAPIRPOST 0.
        SYStem.CONFIG DAPDRPOST 0.
        SYStem.CONFIG DAPIRPOST 11.
        SYStem.CONFIG DAPDRPOST 1.
		
		
        SYStem.CONFIG MEMORYACCESSPORT 0.
        SYStem.CONFIG DEBUGACCESSPORT  1.
        SYStem.CONFIG JTAGACCESSPORT   2.
        SYStem.CONFIG COREJTAGPORT     0.
        SYStem.CONFIG AXIACCESSPORT    0.
		IF "&ARG1"=="1"
		(
		SYStem.CONFIG.COREDEBUG.Base     DAP:0x86839000
        SYStem.CONFIG ETMBASE            DAP:0x86838000    	
		)
		ELSE
		(
		SYStem.CONFIG.COREDEBUG.Base     DAP:0x86835000
        SYStem.CONFIG ETMBASE            DAP:0x86834000
		)
		
	    
		
		IF "&RUMI"=="TRUE"
        (
            SYStem.CONFIG DAPIRPOST 0.
            SYStem.CONFIG DAPDRPOST 0.
			IF "&ARG1"=="1"
			(
            System.CONFIG.debugtimescale 4.		
			)
			ELSE
			(
			System.CONFIG.debugtimescale 8.
			)
        )
		
        SYStem.CONFIG MULTITAP NONE
        sys.config.corenumber 4
        core.assign 1 2 3 4
        MMU.TABLEWALK ON
        RADIX HEX
        SETUP.VAR %HEX.ON
        MODE.HLL
        SYStem.STATE
        IF "&EUD"!="TRUE"
        (
            AUTOSTORE DAP_MPSS HISTORY
        )

        ETM.ON

    )
    
    &CURRENT_HW_BLOCK_NAME="&MPSS_HW_BLOCK_NAME"
    // Common settings for all chipsets
    IF "&EUD"!="TRUE"
    (
        IF (("&ARG2"=="SWD")||("&ARG2"=="swd"))
        (
            SYSTEM.CONFIG SWDP ON 
            SYSTEM.CONFIG DEBUGPORTTYPE SWD
        )
    )

    // Launch startup scripts
    IF (OS.ENV(STARTUPCMM)!="")
    (
        &STARTUPSCRIPT=OS.ENV(STARTUPCMM)
        do &STARTUPSCRIPT
    )
    
EXIT:
    ENDDO

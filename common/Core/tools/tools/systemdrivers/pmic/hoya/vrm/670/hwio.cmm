
entry &base_addr

if ("&base_addr"=="")
(
  &base_addr=0xb000000 
)

y.create.l HWIO_RPMH_VRM_VOLTAGE_VOTE_DRV0_REG0_ADDR A:&base_addr+0x800000
y.create.l HWIO_RPMH_VRM_VOLTAGE_VOTE_DRV0_REG1_ADDR A:&base_addr+0x800100
y.create.l HWIO_RPMH_VRM_VOLTAGE_VOTE_DRV0_REG2_ADDR A:&base_addr+0x800200
y.create.l HWIO_RPMH_VRM_VOLTAGE_VOTE_DRV0_REG3_ADDR A:&base_addr+0x800300
y.create.l HWIO_RPMH_VRM_VOLTAGE_VOTE_DRV0_REG4_ADDR A:&base_addr+0x800400
y.create.l HWIO_RPMH_VRM_VOLTAGE_VOTE_DRV0_REG5_ADDR A:&base_addr+0x800500
y.create.l HWIO_RPMH_VRM_VOLTAGE_VOTE_DRV0_REG6_ADDR A:&base_addr+0x800600
y.create.l HWIO_RPMH_VRM_VOLTAGE_VOTE_DRV0_REG7_ADDR A:&base_addr+0x800700
y.create.l HWIO_RPMH_VRM_VOLTAGE_VOTE_DRV0_REG8_ADDR A:&base_addr+0x800800
y.create.l HWIO_RPMH_VRM_VOLTAGE_VOTE_DRV0_REG9_ADDR A:&base_addr+0x800900
y.create.l HWIO_RPMH_VRM_VOLTAGE_VOTE_DRV0_REG10_ADDR A:&base_addr+0x800a00
y.create.l HWIO_RPMH_VRM_VOLTAGE_VOTE_DRV0_REG11_ADDR A:&base_addr+0x800b00
y.create.l HWIO_RPMH_VRM_VOLTAGE_VOTE_DRV0_REG12_ADDR A:&base_addr+0x800c00
y.create.l HWIO_RPMH_VRM_VOLTAGE_VOTE_DRV0_REG13_ADDR A:&base_addr+0x800d00
y.create.l HWIO_RPMH_VRM_VOLTAGE_VOTE_DRV0_REG14_ADDR A:&base_addr+0x800e00
y.create.l HWIO_RPMH_VRM_VOLTAGE_VOTE_DRV0_REG15_ADDR A:&base_addr+0x800f00
y.create.l HWIO_RPMH_VRM_VOLTAGE_VOTE_DRV0_REG16_ADDR A:&base_addr+0x801000
y.create.l HWIO_RPMH_VRM_VOLTAGE_VOTE_DRV0_REG17_ADDR A:&base_addr+0x801100
y.create.l HWIO_RPMH_VRM_VOLTAGE_VOTE_DRV0_REG18_ADDR A:&base_addr+0x801200
y.create.l HWIO_RPMH_VRM_VOLTAGE_VOTE_DRV0_REG19_ADDR A:&base_addr+0x801300
y.create.l HWIO_RPMH_VRM_VOLTAGE_VOTE_DRV0_REG20_ADDR A:&base_addr+0x801400
y.create.l HWIO_RPMH_VRM_VOLTAGE_VOTE_DRV0_REG21_ADDR A:&base_addr+0x801500
y.create.l HWIO_RPMH_VRM_VOLTAGE_VOTE_DRV0_REG22_ADDR A:&base_addr+0x801600
y.create.l HWIO_RPMH_VRM_VOLTAGE_VOTE_DRV0_REG23_ADDR A:&base_addr+0x801700
y.create.l HWIO_RPMH_VRM_VOLTAGE_VOTE_DRV0_REG24_ADDR A:&base_addr+0x801800
y.create.l HWIO_RPMH_VRM_VOLTAGE_VOTE_DRV0_REG25_ADDR A:&base_addr+0x801900
y.create.l HWIO_RPMH_VRM_VOLTAGE_VOTE_DRV0_REG26_ADDR A:&base_addr+0x801a00
y.create.l HWIO_RPMH_VRM_VOLTAGE_VOTE_DRV0_REG27_ADDR A:&base_addr+0x801b00
y.create.l HWIO_RPMH_VRM_VOLTAGE_VOTE_DRV0_REG28_ADDR A:&base_addr+0x801c00
y.create.l HWIO_RPMH_VRM_VOLTAGE_VOTE_DRV0_REG29_ADDR A:&base_addr+0x801d00
y.create.l HWIO_RPMH_VRM_VOLTAGE_VOTE_DRV0_REG30_ADDR A:&base_addr+0x801e00
y.create.l HWIO_RPMH_VRM_VOLTAGE_VOTE_DRV0_REG31_ADDR A:&base_addr+0x801f00
y.create.l HWIO_RPMH_VRM_VOLTAGE_VOTE_DRV0_REG32_ADDR A:&base_addr+0x802000
y.create.l HWIO_RPMH_VRM_VOLTAGE_VOTE_DRV0_REG33_ADDR A:&base_addr+0x802100
y.create.l HWIO_RPMH_VRM_VOLTAGE_VOTE_DRV0_REG34_ADDR A:&base_addr+0x802200
y.create.l HWIO_RPMH_VRM_VOLTAGE_VOTE_DRV0_REG35_ADDR A:&base_addr+0x802300
y.create.l HWIO_RPMH_VRM_VOLTAGE_VOTE_DRV0_REG36_ADDR A:&base_addr+0x802400
y.create.l HWIO_RPMH_VRM_VOLTAGE_VOTE_DRV0_REG37_ADDR A:&base_addr+0x802500
y.create.l HWIO_RPMH_VRM_VOLTAGE_VOTE_DRV0_REG38_ADDR A:&base_addr+0x802600
y.create.l HWIO_RPMH_VRM_VOLTAGE_VOTE_DRV0_REG39_ADDR A:&base_addr+0x802700
y.create.l HWIO_RPMH_VRM_VOLTAGE_VOTE_DRV0_REG40_ADDR A:&base_addr+0x802800
y.create.l HWIO_RPMH_VRM_VOLTAGE_VOTE_DRV0_REG41_ADDR A:&base_addr+0x802900
y.create.l HWIO_RPMH_VRM_VOLTAGE_VOTE_DRV0_REG42_ADDR A:&base_addr+0x802a00
y.create.l HWIO_RPMH_VRM_VOLTAGE_VOTE_DRV0_REG43_ADDR A:&base_addr+0x802b00
y.create.l HWIO_RPMH_VRM_VOLTAGE_VOTE_DRV0_REG44_ADDR A:&base_addr+0x802c00
y.create.l HWIO_RPMH_VRM_VOLTAGE_VOTE_DRV0_REG45_ADDR A:&base_addr+0x802d00
y.create.l HWIO_RPMH_VRM_VOLTAGE_VOTE_DRV1_REG0_ADDR A:&base_addr+0x810000
y.create.l HWIO_RPMH_VRM_VOLTAGE_VOTE_DRV1_REG1_ADDR A:&base_addr+0x810100
y.create.l HWIO_RPMH_VRM_VOLTAGE_VOTE_DRV1_REG2_ADDR A:&base_addr+0x810200
y.create.l HWIO_RPMH_VRM_VOLTAGE_VOTE_DRV1_REG3_ADDR A:&base_addr+0x810300
y.create.l HWIO_RPMH_VRM_VOLTAGE_VOTE_DRV1_REG4_ADDR A:&base_addr+0x810400
y.create.l HWIO_RPMH_VRM_VOLTAGE_VOTE_DRV1_REG5_ADDR A:&base_addr+0x810500
y.create.l HWIO_RPMH_VRM_VOLTAGE_VOTE_DRV1_REG6_ADDR A:&base_addr+0x810600
y.create.l HWIO_RPMH_VRM_VOLTAGE_VOTE_DRV1_REG7_ADDR A:&base_addr+0x810700
y.create.l HWIO_RPMH_VRM_VOLTAGE_VOTE_DRV1_REG8_ADDR A:&base_addr+0x810800
y.create.l HWIO_RPMH_VRM_VOLTAGE_VOTE_DRV1_REG9_ADDR A:&base_addr+0x810900
y.create.l HWIO_RPMH_VRM_VOLTAGE_VOTE_DRV1_REG10_ADDR A:&base_addr+0x810a00
y.create.l HWIO_RPMH_VRM_VOLTAGE_VOTE_DRV1_REG11_ADDR A:&base_addr+0x810b00
y.create.l HWIO_RPMH_VRM_VOLTAGE_VOTE_DRV1_REG12_ADDR A:&base_addr+0x810c00
y.create.l HWIO_RPMH_VRM_VOLTAGE_VOTE_DRV1_REG13_ADDR A:&base_addr+0x810d00
y.create.l HWIO_RPMH_VRM_VOLTAGE_VOTE_DRV1_REG14_ADDR A:&base_addr+0x810e00
y.create.l HWIO_RPMH_VRM_VOLTAGE_VOTE_DRV1_REG15_ADDR A:&base_addr+0x810f00
y.create.l HWIO_RPMH_VRM_VOLTAGE_VOTE_DRV1_REG16_ADDR A:&base_addr+0x811000
y.create.l HWIO_RPMH_VRM_VOLTAGE_VOTE_DRV1_REG17_ADDR A:&base_addr+0x811100
y.create.l HWIO_RPMH_VRM_VOLTAGE_VOTE_DRV1_REG18_ADDR A:&base_addr+0x811200
y.create.l HWIO_RPMH_VRM_VOLTAGE_VOTE_DRV1_REG19_ADDR A:&base_addr+0x811300
y.create.l HWIO_RPMH_VRM_VOLTAGE_VOTE_DRV1_REG20_ADDR A:&base_addr+0x811400
y.create.l HWIO_RPMH_VRM_VOLTAGE_VOTE_DRV1_REG21_ADDR A:&base_addr+0x811500
y.create.l HWIO_RPMH_VRM_VOLTAGE_VOTE_DRV1_REG22_ADDR A:&base_addr+0x811600
y.create.l HWIO_RPMH_VRM_VOLTAGE_VOTE_DRV1_REG23_ADDR A:&base_addr+0x811700
y.create.l HWIO_RPMH_VRM_VOLTAGE_VOTE_DRV1_REG24_ADDR A:&base_addr+0x811800
y.create.l HWIO_RPMH_VRM_VOLTAGE_VOTE_DRV1_REG25_ADDR A:&base_addr+0x811900
y.create.l HWIO_RPMH_VRM_VOLTAGE_VOTE_DRV1_REG26_ADDR A:&base_addr+0x811a00
y.create.l HWIO_RPMH_VRM_VOLTAGE_VOTE_DRV1_REG27_ADDR A:&base_addr+0x811b00
y.create.l HWIO_RPMH_VRM_VOLTAGE_VOTE_DRV1_REG28_ADDR A:&base_addr+0x811c00
y.create.l HWIO_RPMH_VRM_VOLTAGE_VOTE_DRV1_REG29_ADDR A:&base_addr+0x811d00
y.create.l HWIO_RPMH_VRM_VOLTAGE_VOTE_DRV1_REG30_ADDR A:&base_addr+0x811e00
y.create.l HWIO_RPMH_VRM_VOLTAGE_VOTE_DRV1_REG31_ADDR A:&base_addr+0x811f00
y.create.l HWIO_RPMH_VRM_VOLTAGE_VOTE_DRV1_REG32_ADDR A:&base_addr+0x812000
y.create.l HWIO_RPMH_VRM_VOLTAGE_VOTE_DRV1_REG33_ADDR A:&base_addr+0x812100
y.create.l HWIO_RPMH_VRM_VOLTAGE_VOTE_DRV1_REG34_ADDR A:&base_addr+0x812200
y.create.l HWIO_RPMH_VRM_VOLTAGE_VOTE_DRV1_REG35_ADDR A:&base_addr+0x812300
y.create.l HWIO_RPMH_VRM_VOLTAGE_VOTE_DRV1_REG36_ADDR A:&base_addr+0x812400
y.create.l HWIO_RPMH_VRM_VOLTAGE_VOTE_DRV1_REG37_ADDR A:&base_addr+0x812500
y.create.l HWIO_RPMH_VRM_VOLTAGE_VOTE_DRV1_REG38_ADDR A:&base_addr+0x812600
y.create.l HWIO_RPMH_VRM_VOLTAGE_VOTE_DRV1_REG39_ADDR A:&base_addr+0x812700
y.create.l HWIO_RPMH_VRM_VOLTAGE_VOTE_DRV1_REG40_ADDR A:&base_addr+0x812800
y.create.l HWIO_RPMH_VRM_VOLTAGE_VOTE_DRV1_REG41_ADDR A:&base_addr+0x812900
y.create.l HWIO_RPMH_VRM_VOLTAGE_VOTE_DRV1_REG42_ADDR A:&base_addr+0x812a00
y.create.l HWIO_RPMH_VRM_VOLTAGE_VOTE_DRV1_REG43_ADDR A:&base_addr+0x812b00
y.create.l HWIO_RPMH_VRM_VOLTAGE_VOTE_DRV1_REG44_ADDR A:&base_addr+0x812c00
y.create.l HWIO_RPMH_VRM_VOLTAGE_VOTE_DRV1_REG45_ADDR A:&base_addr+0x812d00
y.create.l HWIO_RPMH_VRM_VOLTAGE_VOTE_DRV2_REG0_ADDR A:&base_addr+0x820000
y.create.l HWIO_RPMH_VRM_VOLTAGE_VOTE_DRV2_REG1_ADDR A:&base_addr+0x820100
y.create.l HWIO_RPMH_VRM_VOLTAGE_VOTE_DRV2_REG2_ADDR A:&base_addr+0x820200
y.create.l HWIO_RPMH_VRM_VOLTAGE_VOTE_DRV2_REG3_ADDR A:&base_addr+0x820300
y.create.l HWIO_RPMH_VRM_VOLTAGE_VOTE_DRV2_REG4_ADDR A:&base_addr+0x820400
y.create.l HWIO_RPMH_VRM_VOLTAGE_VOTE_DRV2_REG5_ADDR A:&base_addr+0x820500
y.create.l HWIO_RPMH_VRM_VOLTAGE_VOTE_DRV2_REG6_ADDR A:&base_addr+0x820600
y.create.l HWIO_RPMH_VRM_VOLTAGE_VOTE_DRV2_REG7_ADDR A:&base_addr+0x820700
y.create.l HWIO_RPMH_VRM_VOLTAGE_VOTE_DRV2_REG8_ADDR A:&base_addr+0x820800
y.create.l HWIO_RPMH_VRM_VOLTAGE_VOTE_DRV2_REG9_ADDR A:&base_addr+0x820900
y.create.l HWIO_RPMH_VRM_VOLTAGE_VOTE_DRV2_REG10_ADDR A:&base_addr+0x820a00
y.create.l HWIO_RPMH_VRM_VOLTAGE_VOTE_DRV2_REG11_ADDR A:&base_addr+0x820b00
y.create.l HWIO_RPMH_VRM_VOLTAGE_VOTE_DRV2_REG12_ADDR A:&base_addr+0x820c00
y.create.l HWIO_RPMH_VRM_VOLTAGE_VOTE_DRV2_REG13_ADDR A:&base_addr+0x820d00
y.create.l HWIO_RPMH_VRM_VOLTAGE_VOTE_DRV2_REG14_ADDR A:&base_addr+0x820e00
y.create.l HWIO_RPMH_VRM_VOLTAGE_VOTE_DRV2_REG15_ADDR A:&base_addr+0x820f00
y.create.l HWIO_RPMH_VRM_VOLTAGE_VOTE_DRV2_REG16_ADDR A:&base_addr+0x821000
y.create.l HWIO_RPMH_VRM_VOLTAGE_VOTE_DRV2_REG17_ADDR A:&base_addr+0x821100
y.create.l HWIO_RPMH_VRM_VOLTAGE_VOTE_DRV2_REG18_ADDR A:&base_addr+0x821200
y.create.l HWIO_RPMH_VRM_VOLTAGE_VOTE_DRV2_REG19_ADDR A:&base_addr+0x821300
y.create.l HWIO_RPMH_VRM_VOLTAGE_VOTE_DRV2_REG20_ADDR A:&base_addr+0x821400
y.create.l HWIO_RPMH_VRM_VOLTAGE_VOTE_DRV2_REG21_ADDR A:&base_addr+0x821500
y.create.l HWIO_RPMH_VRM_VOLTAGE_VOTE_DRV2_REG22_ADDR A:&base_addr+0x821600
y.create.l HWIO_RPMH_VRM_VOLTAGE_VOTE_DRV2_REG23_ADDR A:&base_addr+0x821700
y.create.l HWIO_RPMH_VRM_VOLTAGE_VOTE_DRV2_REG24_ADDR A:&base_addr+0x821800
y.create.l HWIO_RPMH_VRM_VOLTAGE_VOTE_DRV2_REG25_ADDR A:&base_addr+0x821900
y.create.l HWIO_RPMH_VRM_VOLTAGE_VOTE_DRV2_REG26_ADDR A:&base_addr+0x821a00
y.create.l HWIO_RPMH_VRM_VOLTAGE_VOTE_DRV2_REG27_ADDR A:&base_addr+0x821b00
y.create.l HWIO_RPMH_VRM_VOLTAGE_VOTE_DRV2_REG28_ADDR A:&base_addr+0x821c00
y.create.l HWIO_RPMH_VRM_VOLTAGE_VOTE_DRV2_REG29_ADDR A:&base_addr+0x821d00
y.create.l HWIO_RPMH_VRM_VOLTAGE_VOTE_DRV2_REG30_ADDR A:&base_addr+0x821e00
y.create.l HWIO_RPMH_VRM_VOLTAGE_VOTE_DRV2_REG31_ADDR A:&base_addr+0x821f00
y.create.l HWIO_RPMH_VRM_VOLTAGE_VOTE_DRV2_REG32_ADDR A:&base_addr+0x822000
y.create.l HWIO_RPMH_VRM_VOLTAGE_VOTE_DRV2_REG33_ADDR A:&base_addr+0x822100
y.create.l HWIO_RPMH_VRM_VOLTAGE_VOTE_DRV2_REG34_ADDR A:&base_addr+0x822200
y.create.l HWIO_RPMH_VRM_VOLTAGE_VOTE_DRV2_REG35_ADDR A:&base_addr+0x822300
y.create.l HWIO_RPMH_VRM_VOLTAGE_VOTE_DRV2_REG36_ADDR A:&base_addr+0x822400
y.create.l HWIO_RPMH_VRM_VOLTAGE_VOTE_DRV2_REG37_ADDR A:&base_addr+0x822500
y.create.l HWIO_RPMH_VRM_VOLTAGE_VOTE_DRV2_REG38_ADDR A:&base_addr+0x822600
y.create.l HWIO_RPMH_VRM_VOLTAGE_VOTE_DRV2_REG39_ADDR A:&base_addr+0x822700
y.create.l HWIO_RPMH_VRM_VOLTAGE_VOTE_DRV2_REG40_ADDR A:&base_addr+0x822800
y.create.l HWIO_RPMH_VRM_VOLTAGE_VOTE_DRV2_REG41_ADDR A:&base_addr+0x822900
y.create.l HWIO_RPMH_VRM_VOLTAGE_VOTE_DRV2_REG42_ADDR A:&base_addr+0x822a00
y.create.l HWIO_RPMH_VRM_VOLTAGE_VOTE_DRV2_REG43_ADDR A:&base_addr+0x822b00
y.create.l HWIO_RPMH_VRM_VOLTAGE_VOTE_DRV2_REG44_ADDR A:&base_addr+0x822c00
y.create.l HWIO_RPMH_VRM_VOLTAGE_VOTE_DRV2_REG45_ADDR A:&base_addr+0x822d00
y.create.l HWIO_RPMH_VRM_VOLTAGE_VOTE_DRV3_REG0_ADDR A:&base_addr+0x830000
y.create.l HWIO_RPMH_VRM_VOLTAGE_VOTE_DRV3_REG1_ADDR A:&base_addr+0x830100
y.create.l HWIO_RPMH_VRM_VOLTAGE_VOTE_DRV3_REG2_ADDR A:&base_addr+0x830200
y.create.l HWIO_RPMH_VRM_VOLTAGE_VOTE_DRV3_REG3_ADDR A:&base_addr+0x830300
y.create.l HWIO_RPMH_VRM_VOLTAGE_VOTE_DRV3_REG4_ADDR A:&base_addr+0x830400
y.create.l HWIO_RPMH_VRM_VOLTAGE_VOTE_DRV3_REG5_ADDR A:&base_addr+0x830500
y.create.l HWIO_RPMH_VRM_VOLTAGE_VOTE_DRV3_REG6_ADDR A:&base_addr+0x830600
y.create.l HWIO_RPMH_VRM_VOLTAGE_VOTE_DRV3_REG7_ADDR A:&base_addr+0x830700
y.create.l HWIO_RPMH_VRM_VOLTAGE_VOTE_DRV3_REG8_ADDR A:&base_addr+0x830800
y.create.l HWIO_RPMH_VRM_VOLTAGE_VOTE_DRV3_REG9_ADDR A:&base_addr+0x830900
y.create.l HWIO_RPMH_VRM_VOLTAGE_VOTE_DRV3_REG10_ADDR A:&base_addr+0x830a00
y.create.l HWIO_RPMH_VRM_VOLTAGE_VOTE_DRV3_REG11_ADDR A:&base_addr+0x830b00
y.create.l HWIO_RPMH_VRM_VOLTAGE_VOTE_DRV3_REG12_ADDR A:&base_addr+0x830c00
y.create.l HWIO_RPMH_VRM_VOLTAGE_VOTE_DRV3_REG13_ADDR A:&base_addr+0x830d00
y.create.l HWIO_RPMH_VRM_VOLTAGE_VOTE_DRV3_REG14_ADDR A:&base_addr+0x830e00
y.create.l HWIO_RPMH_VRM_VOLTAGE_VOTE_DRV3_REG15_ADDR A:&base_addr+0x830f00
y.create.l HWIO_RPMH_VRM_VOLTAGE_VOTE_DRV3_REG16_ADDR A:&base_addr+0x831000
y.create.l HWIO_RPMH_VRM_VOLTAGE_VOTE_DRV3_REG17_ADDR A:&base_addr+0x831100
y.create.l HWIO_RPMH_VRM_VOLTAGE_VOTE_DRV3_REG18_ADDR A:&base_addr+0x831200
y.create.l HWIO_RPMH_VRM_VOLTAGE_VOTE_DRV3_REG19_ADDR A:&base_addr+0x831300
y.create.l HWIO_RPMH_VRM_VOLTAGE_VOTE_DRV3_REG20_ADDR A:&base_addr+0x831400
y.create.l HWIO_RPMH_VRM_VOLTAGE_VOTE_DRV3_REG21_ADDR A:&base_addr+0x831500
y.create.l HWIO_RPMH_VRM_VOLTAGE_VOTE_DRV3_REG22_ADDR A:&base_addr+0x831600
y.create.l HWIO_RPMH_VRM_VOLTAGE_VOTE_DRV3_REG23_ADDR A:&base_addr+0x831700
y.create.l HWIO_RPMH_VRM_VOLTAGE_VOTE_DRV3_REG24_ADDR A:&base_addr+0x831800
y.create.l HWIO_RPMH_VRM_VOLTAGE_VOTE_DRV3_REG25_ADDR A:&base_addr+0x831900
y.create.l HWIO_RPMH_VRM_VOLTAGE_VOTE_DRV3_REG26_ADDR A:&base_addr+0x831a00
y.create.l HWIO_RPMH_VRM_VOLTAGE_VOTE_DRV3_REG27_ADDR A:&base_addr+0x831b00
y.create.l HWIO_RPMH_VRM_VOLTAGE_VOTE_DRV3_REG28_ADDR A:&base_addr+0x831c00
y.create.l HWIO_RPMH_VRM_VOLTAGE_VOTE_DRV3_REG29_ADDR A:&base_addr+0x831d00
y.create.l HWIO_RPMH_VRM_VOLTAGE_VOTE_DRV3_REG30_ADDR A:&base_addr+0x831e00
y.create.l HWIO_RPMH_VRM_VOLTAGE_VOTE_DRV3_REG31_ADDR A:&base_addr+0x831f00
y.create.l HWIO_RPMH_VRM_VOLTAGE_VOTE_DRV3_REG32_ADDR A:&base_addr+0x832000
y.create.l HWIO_RPMH_VRM_VOLTAGE_VOTE_DRV3_REG33_ADDR A:&base_addr+0x832100
y.create.l HWIO_RPMH_VRM_VOLTAGE_VOTE_DRV3_REG34_ADDR A:&base_addr+0x832200
y.create.l HWIO_RPMH_VRM_VOLTAGE_VOTE_DRV3_REG35_ADDR A:&base_addr+0x832300
y.create.l HWIO_RPMH_VRM_VOLTAGE_VOTE_DRV3_REG36_ADDR A:&base_addr+0x832400
y.create.l HWIO_RPMH_VRM_VOLTAGE_VOTE_DRV3_REG37_ADDR A:&base_addr+0x832500
y.create.l HWIO_RPMH_VRM_VOLTAGE_VOTE_DRV3_REG38_ADDR A:&base_addr+0x832600
y.create.l HWIO_RPMH_VRM_VOLTAGE_VOTE_DRV3_REG39_ADDR A:&base_addr+0x832700
y.create.l HWIO_RPMH_VRM_VOLTAGE_VOTE_DRV3_REG40_ADDR A:&base_addr+0x832800
y.create.l HWIO_RPMH_VRM_VOLTAGE_VOTE_DRV3_REG41_ADDR A:&base_addr+0x832900
y.create.l HWIO_RPMH_VRM_VOLTAGE_VOTE_DRV3_REG42_ADDR A:&base_addr+0x832a00
y.create.l HWIO_RPMH_VRM_VOLTAGE_VOTE_DRV3_REG43_ADDR A:&base_addr+0x832b00
y.create.l HWIO_RPMH_VRM_VOLTAGE_VOTE_DRV3_REG44_ADDR A:&base_addr+0x832c00
y.create.l HWIO_RPMH_VRM_VOLTAGE_VOTE_DRV3_REG45_ADDR A:&base_addr+0x832d00
y.create.l HWIO_RPMH_VRM_VOLTAGE_VOTE_DRV4_REG0_ADDR A:&base_addr+0x840000
y.create.l HWIO_RPMH_VRM_VOLTAGE_VOTE_DRV4_REG1_ADDR A:&base_addr+0x840100
y.create.l HWIO_RPMH_VRM_VOLTAGE_VOTE_DRV4_REG2_ADDR A:&base_addr+0x840200
y.create.l HWIO_RPMH_VRM_VOLTAGE_VOTE_DRV4_REG3_ADDR A:&base_addr+0x840300
y.create.l HWIO_RPMH_VRM_VOLTAGE_VOTE_DRV4_REG4_ADDR A:&base_addr+0x840400
y.create.l HWIO_RPMH_VRM_VOLTAGE_VOTE_DRV4_REG5_ADDR A:&base_addr+0x840500
y.create.l HWIO_RPMH_VRM_VOLTAGE_VOTE_DRV4_REG6_ADDR A:&base_addr+0x840600
y.create.l HWIO_RPMH_VRM_VOLTAGE_VOTE_DRV4_REG7_ADDR A:&base_addr+0x840700
y.create.l HWIO_RPMH_VRM_VOLTAGE_VOTE_DRV4_REG8_ADDR A:&base_addr+0x840800
y.create.l HWIO_RPMH_VRM_VOLTAGE_VOTE_DRV4_REG9_ADDR A:&base_addr+0x840900
y.create.l HWIO_RPMH_VRM_VOLTAGE_VOTE_DRV4_REG10_ADDR A:&base_addr+0x840a00
y.create.l HWIO_RPMH_VRM_VOLTAGE_VOTE_DRV4_REG11_ADDR A:&base_addr+0x840b00
y.create.l HWIO_RPMH_VRM_VOLTAGE_VOTE_DRV4_REG12_ADDR A:&base_addr+0x840c00
y.create.l HWIO_RPMH_VRM_VOLTAGE_VOTE_DRV4_REG13_ADDR A:&base_addr+0x840d00
y.create.l HWIO_RPMH_VRM_VOLTAGE_VOTE_DRV4_REG14_ADDR A:&base_addr+0x840e00
y.create.l HWIO_RPMH_VRM_VOLTAGE_VOTE_DRV4_REG15_ADDR A:&base_addr+0x840f00
y.create.l HWIO_RPMH_VRM_VOLTAGE_VOTE_DRV4_REG16_ADDR A:&base_addr+0x841000
y.create.l HWIO_RPMH_VRM_VOLTAGE_VOTE_DRV4_REG17_ADDR A:&base_addr+0x841100
y.create.l HWIO_RPMH_VRM_VOLTAGE_VOTE_DRV4_REG18_ADDR A:&base_addr+0x841200
y.create.l HWIO_RPMH_VRM_VOLTAGE_VOTE_DRV4_REG19_ADDR A:&base_addr+0x841300
y.create.l HWIO_RPMH_VRM_VOLTAGE_VOTE_DRV4_REG20_ADDR A:&base_addr+0x841400
y.create.l HWIO_RPMH_VRM_VOLTAGE_VOTE_DRV4_REG21_ADDR A:&base_addr+0x841500
y.create.l HWIO_RPMH_VRM_VOLTAGE_VOTE_DRV4_REG22_ADDR A:&base_addr+0x841600
y.create.l HWIO_RPMH_VRM_VOLTAGE_VOTE_DRV4_REG23_ADDR A:&base_addr+0x841700
y.create.l HWIO_RPMH_VRM_VOLTAGE_VOTE_DRV4_REG24_ADDR A:&base_addr+0x841800
y.create.l HWIO_RPMH_VRM_VOLTAGE_VOTE_DRV4_REG25_ADDR A:&base_addr+0x841900
y.create.l HWIO_RPMH_VRM_VOLTAGE_VOTE_DRV4_REG26_ADDR A:&base_addr+0x841a00
y.create.l HWIO_RPMH_VRM_VOLTAGE_VOTE_DRV4_REG27_ADDR A:&base_addr+0x841b00
y.create.l HWIO_RPMH_VRM_VOLTAGE_VOTE_DRV4_REG28_ADDR A:&base_addr+0x841c00
y.create.l HWIO_RPMH_VRM_VOLTAGE_VOTE_DRV4_REG29_ADDR A:&base_addr+0x841d00
y.create.l HWIO_RPMH_VRM_VOLTAGE_VOTE_DRV4_REG30_ADDR A:&base_addr+0x841e00
y.create.l HWIO_RPMH_VRM_VOLTAGE_VOTE_DRV4_REG31_ADDR A:&base_addr+0x841f00
y.create.l HWIO_RPMH_VRM_VOLTAGE_VOTE_DRV4_REG32_ADDR A:&base_addr+0x842000
y.create.l HWIO_RPMH_VRM_VOLTAGE_VOTE_DRV4_REG33_ADDR A:&base_addr+0x842100
y.create.l HWIO_RPMH_VRM_VOLTAGE_VOTE_DRV4_REG34_ADDR A:&base_addr+0x842200
y.create.l HWIO_RPMH_VRM_VOLTAGE_VOTE_DRV4_REG35_ADDR A:&base_addr+0x842300
y.create.l HWIO_RPMH_VRM_VOLTAGE_VOTE_DRV4_REG36_ADDR A:&base_addr+0x842400
y.create.l HWIO_RPMH_VRM_VOLTAGE_VOTE_DRV4_REG37_ADDR A:&base_addr+0x842500
y.create.l HWIO_RPMH_VRM_VOLTAGE_VOTE_DRV4_REG38_ADDR A:&base_addr+0x842600
y.create.l HWIO_RPMH_VRM_VOLTAGE_VOTE_DRV4_REG39_ADDR A:&base_addr+0x842700
y.create.l HWIO_RPMH_VRM_VOLTAGE_VOTE_DRV4_REG40_ADDR A:&base_addr+0x842800
y.create.l HWIO_RPMH_VRM_VOLTAGE_VOTE_DRV4_REG41_ADDR A:&base_addr+0x842900
y.create.l HWIO_RPMH_VRM_VOLTAGE_VOTE_DRV4_REG42_ADDR A:&base_addr+0x842a00
y.create.l HWIO_RPMH_VRM_VOLTAGE_VOTE_DRV4_REG43_ADDR A:&base_addr+0x842b00
y.create.l HWIO_RPMH_VRM_VOLTAGE_VOTE_DRV4_REG44_ADDR A:&base_addr+0x842c00
y.create.l HWIO_RPMH_VRM_VOLTAGE_VOTE_DRV4_REG45_ADDR A:&base_addr+0x842d00
y.create.l HWIO_RPMH_VRM_VOLTAGE_VOTE_DRV5_REG0_ADDR A:&base_addr+0x850000
y.create.l HWIO_RPMH_VRM_VOLTAGE_VOTE_DRV5_REG1_ADDR A:&base_addr+0x850100
y.create.l HWIO_RPMH_VRM_VOLTAGE_VOTE_DRV5_REG2_ADDR A:&base_addr+0x850200
y.create.l HWIO_RPMH_VRM_VOLTAGE_VOTE_DRV5_REG3_ADDR A:&base_addr+0x850300
y.create.l HWIO_RPMH_VRM_VOLTAGE_VOTE_DRV5_REG4_ADDR A:&base_addr+0x850400
y.create.l HWIO_RPMH_VRM_VOLTAGE_VOTE_DRV5_REG5_ADDR A:&base_addr+0x850500
y.create.l HWIO_RPMH_VRM_VOLTAGE_VOTE_DRV5_REG6_ADDR A:&base_addr+0x850600
y.create.l HWIO_RPMH_VRM_VOLTAGE_VOTE_DRV5_REG7_ADDR A:&base_addr+0x850700
y.create.l HWIO_RPMH_VRM_VOLTAGE_VOTE_DRV5_REG8_ADDR A:&base_addr+0x850800
y.create.l HWIO_RPMH_VRM_VOLTAGE_VOTE_DRV5_REG9_ADDR A:&base_addr+0x850900
y.create.l HWIO_RPMH_VRM_VOLTAGE_VOTE_DRV5_REG10_ADDR A:&base_addr+0x850a00
y.create.l HWIO_RPMH_VRM_VOLTAGE_VOTE_DRV5_REG11_ADDR A:&base_addr+0x850b00
y.create.l HWIO_RPMH_VRM_VOLTAGE_VOTE_DRV5_REG12_ADDR A:&base_addr+0x850c00
y.create.l HWIO_RPMH_VRM_VOLTAGE_VOTE_DRV5_REG13_ADDR A:&base_addr+0x850d00
y.create.l HWIO_RPMH_VRM_VOLTAGE_VOTE_DRV5_REG14_ADDR A:&base_addr+0x850e00
y.create.l HWIO_RPMH_VRM_VOLTAGE_VOTE_DRV5_REG15_ADDR A:&base_addr+0x850f00
y.create.l HWIO_RPMH_VRM_VOLTAGE_VOTE_DRV5_REG16_ADDR A:&base_addr+0x851000
y.create.l HWIO_RPMH_VRM_VOLTAGE_VOTE_DRV5_REG17_ADDR A:&base_addr+0x851100
y.create.l HWIO_RPMH_VRM_VOLTAGE_VOTE_DRV5_REG18_ADDR A:&base_addr+0x851200
y.create.l HWIO_RPMH_VRM_VOLTAGE_VOTE_DRV5_REG19_ADDR A:&base_addr+0x851300
y.create.l HWIO_RPMH_VRM_VOLTAGE_VOTE_DRV5_REG20_ADDR A:&base_addr+0x851400
y.create.l HWIO_RPMH_VRM_VOLTAGE_VOTE_DRV5_REG21_ADDR A:&base_addr+0x851500
y.create.l HWIO_RPMH_VRM_VOLTAGE_VOTE_DRV5_REG22_ADDR A:&base_addr+0x851600
y.create.l HWIO_RPMH_VRM_VOLTAGE_VOTE_DRV5_REG23_ADDR A:&base_addr+0x851700
y.create.l HWIO_RPMH_VRM_VOLTAGE_VOTE_DRV5_REG24_ADDR A:&base_addr+0x851800
y.create.l HWIO_RPMH_VRM_VOLTAGE_VOTE_DRV5_REG25_ADDR A:&base_addr+0x851900
y.create.l HWIO_RPMH_VRM_VOLTAGE_VOTE_DRV5_REG26_ADDR A:&base_addr+0x851a00
y.create.l HWIO_RPMH_VRM_VOLTAGE_VOTE_DRV5_REG27_ADDR A:&base_addr+0x851b00
y.create.l HWIO_RPMH_VRM_VOLTAGE_VOTE_DRV5_REG28_ADDR A:&base_addr+0x851c00
y.create.l HWIO_RPMH_VRM_VOLTAGE_VOTE_DRV5_REG29_ADDR A:&base_addr+0x851d00
y.create.l HWIO_RPMH_VRM_VOLTAGE_VOTE_DRV5_REG30_ADDR A:&base_addr+0x851e00
y.create.l HWIO_RPMH_VRM_VOLTAGE_VOTE_DRV5_REG31_ADDR A:&base_addr+0x851f00
y.create.l HWIO_RPMH_VRM_VOLTAGE_VOTE_DRV5_REG32_ADDR A:&base_addr+0x852000
y.create.l HWIO_RPMH_VRM_VOLTAGE_VOTE_DRV5_REG33_ADDR A:&base_addr+0x852100
y.create.l HWIO_RPMH_VRM_VOLTAGE_VOTE_DRV5_REG34_ADDR A:&base_addr+0x852200
y.create.l HWIO_RPMH_VRM_VOLTAGE_VOTE_DRV5_REG35_ADDR A:&base_addr+0x852300
y.create.l HWIO_RPMH_VRM_VOLTAGE_VOTE_DRV5_REG36_ADDR A:&base_addr+0x852400
y.create.l HWIO_RPMH_VRM_VOLTAGE_VOTE_DRV5_REG37_ADDR A:&base_addr+0x852500
y.create.l HWIO_RPMH_VRM_VOLTAGE_VOTE_DRV5_REG38_ADDR A:&base_addr+0x852600
y.create.l HWIO_RPMH_VRM_VOLTAGE_VOTE_DRV5_REG39_ADDR A:&base_addr+0x852700
y.create.l HWIO_RPMH_VRM_VOLTAGE_VOTE_DRV5_REG40_ADDR A:&base_addr+0x852800
y.create.l HWIO_RPMH_VRM_VOLTAGE_VOTE_DRV5_REG41_ADDR A:&base_addr+0x852900
y.create.l HWIO_RPMH_VRM_VOLTAGE_VOTE_DRV5_REG42_ADDR A:&base_addr+0x852a00
y.create.l HWIO_RPMH_VRM_VOLTAGE_VOTE_DRV5_REG43_ADDR A:&base_addr+0x852b00
y.create.l HWIO_RPMH_VRM_VOLTAGE_VOTE_DRV5_REG44_ADDR A:&base_addr+0x852c00
y.create.l HWIO_RPMH_VRM_VOLTAGE_VOTE_DRV5_REG45_ADDR A:&base_addr+0x852d00
y.create.l HWIO_RPMH_VRM_VOLTAGE_VOTE_DRV6_REG0_ADDR A:&base_addr+0x860000
y.create.l HWIO_RPMH_VRM_VOLTAGE_VOTE_DRV6_REG1_ADDR A:&base_addr+0x860100
y.create.l HWIO_RPMH_VRM_VOLTAGE_VOTE_DRV6_REG2_ADDR A:&base_addr+0x860200
y.create.l HWIO_RPMH_VRM_VOLTAGE_VOTE_DRV6_REG3_ADDR A:&base_addr+0x860300
y.create.l HWIO_RPMH_VRM_VOLTAGE_VOTE_DRV6_REG4_ADDR A:&base_addr+0x860400
y.create.l HWIO_RPMH_VRM_VOLTAGE_VOTE_DRV6_REG5_ADDR A:&base_addr+0x860500
y.create.l HWIO_RPMH_VRM_VOLTAGE_VOTE_DRV6_REG6_ADDR A:&base_addr+0x860600
y.create.l HWIO_RPMH_VRM_VOLTAGE_VOTE_DRV6_REG7_ADDR A:&base_addr+0x860700
y.create.l HWIO_RPMH_VRM_VOLTAGE_VOTE_DRV6_REG8_ADDR A:&base_addr+0x860800
y.create.l HWIO_RPMH_VRM_VOLTAGE_VOTE_DRV6_REG9_ADDR A:&base_addr+0x860900
y.create.l HWIO_RPMH_VRM_VOLTAGE_VOTE_DRV6_REG10_ADDR A:&base_addr+0x860a00
y.create.l HWIO_RPMH_VRM_VOLTAGE_VOTE_DRV6_REG11_ADDR A:&base_addr+0x860b00
y.create.l HWIO_RPMH_VRM_VOLTAGE_VOTE_DRV6_REG12_ADDR A:&base_addr+0x860c00
y.create.l HWIO_RPMH_VRM_VOLTAGE_VOTE_DRV6_REG13_ADDR A:&base_addr+0x860d00
y.create.l HWIO_RPMH_VRM_VOLTAGE_VOTE_DRV6_REG14_ADDR A:&base_addr+0x860e00
y.create.l HWIO_RPMH_VRM_VOLTAGE_VOTE_DRV6_REG15_ADDR A:&base_addr+0x860f00
y.create.l HWIO_RPMH_VRM_VOLTAGE_VOTE_DRV6_REG16_ADDR A:&base_addr+0x861000
y.create.l HWIO_RPMH_VRM_VOLTAGE_VOTE_DRV6_REG17_ADDR A:&base_addr+0x861100
y.create.l HWIO_RPMH_VRM_VOLTAGE_VOTE_DRV6_REG18_ADDR A:&base_addr+0x861200
y.create.l HWIO_RPMH_VRM_VOLTAGE_VOTE_DRV6_REG19_ADDR A:&base_addr+0x861300
y.create.l HWIO_RPMH_VRM_VOLTAGE_VOTE_DRV6_REG20_ADDR A:&base_addr+0x861400
y.create.l HWIO_RPMH_VRM_VOLTAGE_VOTE_DRV6_REG21_ADDR A:&base_addr+0x861500
y.create.l HWIO_RPMH_VRM_VOLTAGE_VOTE_DRV6_REG22_ADDR A:&base_addr+0x861600
y.create.l HWIO_RPMH_VRM_VOLTAGE_VOTE_DRV6_REG23_ADDR A:&base_addr+0x861700
y.create.l HWIO_RPMH_VRM_VOLTAGE_VOTE_DRV6_REG24_ADDR A:&base_addr+0x861800
y.create.l HWIO_RPMH_VRM_VOLTAGE_VOTE_DRV6_REG25_ADDR A:&base_addr+0x861900
y.create.l HWIO_RPMH_VRM_VOLTAGE_VOTE_DRV6_REG26_ADDR A:&base_addr+0x861a00
y.create.l HWIO_RPMH_VRM_VOLTAGE_VOTE_DRV6_REG27_ADDR A:&base_addr+0x861b00
y.create.l HWIO_RPMH_VRM_VOLTAGE_VOTE_DRV6_REG28_ADDR A:&base_addr+0x861c00
y.create.l HWIO_RPMH_VRM_VOLTAGE_VOTE_DRV6_REG29_ADDR A:&base_addr+0x861d00
y.create.l HWIO_RPMH_VRM_VOLTAGE_VOTE_DRV6_REG30_ADDR A:&base_addr+0x861e00
y.create.l HWIO_RPMH_VRM_VOLTAGE_VOTE_DRV6_REG31_ADDR A:&base_addr+0x861f00
y.create.l HWIO_RPMH_VRM_VOLTAGE_VOTE_DRV6_REG32_ADDR A:&base_addr+0x862000
y.create.l HWIO_RPMH_VRM_VOLTAGE_VOTE_DRV6_REG33_ADDR A:&base_addr+0x862100
y.create.l HWIO_RPMH_VRM_VOLTAGE_VOTE_DRV6_REG34_ADDR A:&base_addr+0x862200
y.create.l HWIO_RPMH_VRM_VOLTAGE_VOTE_DRV6_REG35_ADDR A:&base_addr+0x862300
y.create.l HWIO_RPMH_VRM_VOLTAGE_VOTE_DRV6_REG36_ADDR A:&base_addr+0x862400
y.create.l HWIO_RPMH_VRM_VOLTAGE_VOTE_DRV6_REG37_ADDR A:&base_addr+0x862500
y.create.l HWIO_RPMH_VRM_VOLTAGE_VOTE_DRV6_REG38_ADDR A:&base_addr+0x862600
y.create.l HWIO_RPMH_VRM_VOLTAGE_VOTE_DRV6_REG39_ADDR A:&base_addr+0x862700
y.create.l HWIO_RPMH_VRM_VOLTAGE_VOTE_DRV6_REG40_ADDR A:&base_addr+0x862800
y.create.l HWIO_RPMH_VRM_VOLTAGE_VOTE_DRV6_REG41_ADDR A:&base_addr+0x862900
y.create.l HWIO_RPMH_VRM_VOLTAGE_VOTE_DRV6_REG42_ADDR A:&base_addr+0x862a00
y.create.l HWIO_RPMH_VRM_VOLTAGE_VOTE_DRV6_REG43_ADDR A:&base_addr+0x862b00
y.create.l HWIO_RPMH_VRM_VOLTAGE_VOTE_DRV6_REG44_ADDR A:&base_addr+0x862c00
y.create.l HWIO_RPMH_VRM_VOLTAGE_VOTE_DRV6_REG45_ADDR A:&base_addr+0x862d00
y.create.l HWIO_RPMH_VRM_VOLTAGE_VOTE_DRV7_REG0_ADDR A:&base_addr+0x870000
y.create.l HWIO_RPMH_VRM_VOLTAGE_VOTE_DRV7_REG1_ADDR A:&base_addr+0x870100
y.create.l HWIO_RPMH_VRM_VOLTAGE_VOTE_DRV7_REG2_ADDR A:&base_addr+0x870200
y.create.l HWIO_RPMH_VRM_VOLTAGE_VOTE_DRV7_REG3_ADDR A:&base_addr+0x870300
y.create.l HWIO_RPMH_VRM_VOLTAGE_VOTE_DRV7_REG4_ADDR A:&base_addr+0x870400
y.create.l HWIO_RPMH_VRM_VOLTAGE_VOTE_DRV7_REG5_ADDR A:&base_addr+0x870500
y.create.l HWIO_RPMH_VRM_VOLTAGE_VOTE_DRV7_REG6_ADDR A:&base_addr+0x870600
y.create.l HWIO_RPMH_VRM_VOLTAGE_VOTE_DRV7_REG7_ADDR A:&base_addr+0x870700
y.create.l HWIO_RPMH_VRM_VOLTAGE_VOTE_DRV7_REG8_ADDR A:&base_addr+0x870800
y.create.l HWIO_RPMH_VRM_VOLTAGE_VOTE_DRV7_REG9_ADDR A:&base_addr+0x870900
y.create.l HWIO_RPMH_VRM_VOLTAGE_VOTE_DRV7_REG10_ADDR A:&base_addr+0x870a00
y.create.l HWIO_RPMH_VRM_VOLTAGE_VOTE_DRV7_REG11_ADDR A:&base_addr+0x870b00
y.create.l HWIO_RPMH_VRM_VOLTAGE_VOTE_DRV7_REG12_ADDR A:&base_addr+0x870c00
y.create.l HWIO_RPMH_VRM_VOLTAGE_VOTE_DRV7_REG13_ADDR A:&base_addr+0x870d00
y.create.l HWIO_RPMH_VRM_VOLTAGE_VOTE_DRV7_REG14_ADDR A:&base_addr+0x870e00
y.create.l HWIO_RPMH_VRM_VOLTAGE_VOTE_DRV7_REG15_ADDR A:&base_addr+0x870f00
y.create.l HWIO_RPMH_VRM_VOLTAGE_VOTE_DRV7_REG16_ADDR A:&base_addr+0x871000
y.create.l HWIO_RPMH_VRM_VOLTAGE_VOTE_DRV7_REG17_ADDR A:&base_addr+0x871100
y.create.l HWIO_RPMH_VRM_VOLTAGE_VOTE_DRV7_REG18_ADDR A:&base_addr+0x871200
y.create.l HWIO_RPMH_VRM_VOLTAGE_VOTE_DRV7_REG19_ADDR A:&base_addr+0x871300
y.create.l HWIO_RPMH_VRM_VOLTAGE_VOTE_DRV7_REG20_ADDR A:&base_addr+0x871400
y.create.l HWIO_RPMH_VRM_VOLTAGE_VOTE_DRV7_REG21_ADDR A:&base_addr+0x871500
y.create.l HWIO_RPMH_VRM_VOLTAGE_VOTE_DRV7_REG22_ADDR A:&base_addr+0x871600
y.create.l HWIO_RPMH_VRM_VOLTAGE_VOTE_DRV7_REG23_ADDR A:&base_addr+0x871700
y.create.l HWIO_RPMH_VRM_VOLTAGE_VOTE_DRV7_REG24_ADDR A:&base_addr+0x871800
y.create.l HWIO_RPMH_VRM_VOLTAGE_VOTE_DRV7_REG25_ADDR A:&base_addr+0x871900
y.create.l HWIO_RPMH_VRM_VOLTAGE_VOTE_DRV7_REG26_ADDR A:&base_addr+0x871a00
y.create.l HWIO_RPMH_VRM_VOLTAGE_VOTE_DRV7_REG27_ADDR A:&base_addr+0x871b00
y.create.l HWIO_RPMH_VRM_VOLTAGE_VOTE_DRV7_REG28_ADDR A:&base_addr+0x871c00
y.create.l HWIO_RPMH_VRM_VOLTAGE_VOTE_DRV7_REG29_ADDR A:&base_addr+0x871d00
y.create.l HWIO_RPMH_VRM_VOLTAGE_VOTE_DRV7_REG30_ADDR A:&base_addr+0x871e00
y.create.l HWIO_RPMH_VRM_VOLTAGE_VOTE_DRV7_REG31_ADDR A:&base_addr+0x871f00
y.create.l HWIO_RPMH_VRM_VOLTAGE_VOTE_DRV7_REG32_ADDR A:&base_addr+0x872000
y.create.l HWIO_RPMH_VRM_VOLTAGE_VOTE_DRV7_REG33_ADDR A:&base_addr+0x872100
y.create.l HWIO_RPMH_VRM_VOLTAGE_VOTE_DRV7_REG34_ADDR A:&base_addr+0x872200
y.create.l HWIO_RPMH_VRM_VOLTAGE_VOTE_DRV7_REG35_ADDR A:&base_addr+0x872300
y.create.l HWIO_RPMH_VRM_VOLTAGE_VOTE_DRV7_REG36_ADDR A:&base_addr+0x872400
y.create.l HWIO_RPMH_VRM_VOLTAGE_VOTE_DRV7_REG37_ADDR A:&base_addr+0x872500
y.create.l HWIO_RPMH_VRM_VOLTAGE_VOTE_DRV7_REG38_ADDR A:&base_addr+0x872600
y.create.l HWIO_RPMH_VRM_VOLTAGE_VOTE_DRV7_REG39_ADDR A:&base_addr+0x872700
y.create.l HWIO_RPMH_VRM_VOLTAGE_VOTE_DRV7_REG40_ADDR A:&base_addr+0x872800
y.create.l HWIO_RPMH_VRM_VOLTAGE_VOTE_DRV7_REG41_ADDR A:&base_addr+0x872900
y.create.l HWIO_RPMH_VRM_VOLTAGE_VOTE_DRV7_REG42_ADDR A:&base_addr+0x872a00
y.create.l HWIO_RPMH_VRM_VOLTAGE_VOTE_DRV7_REG43_ADDR A:&base_addr+0x872b00
y.create.l HWIO_RPMH_VRM_VOLTAGE_VOTE_DRV7_REG44_ADDR A:&base_addr+0x872c00
y.create.l HWIO_RPMH_VRM_VOLTAGE_VOTE_DRV7_REG45_ADDR A:&base_addr+0x872d00
y.create.l HWIO_RPMH_VRM_VOLTAGE_VOTE_DRV8_REG0_ADDR A:&base_addr+0x880000
y.create.l HWIO_RPMH_VRM_VOLTAGE_VOTE_DRV8_REG1_ADDR A:&base_addr+0x880100
y.create.l HWIO_RPMH_VRM_VOLTAGE_VOTE_DRV8_REG2_ADDR A:&base_addr+0x880200
y.create.l HWIO_RPMH_VRM_VOLTAGE_VOTE_DRV8_REG3_ADDR A:&base_addr+0x880300
y.create.l HWIO_RPMH_VRM_VOLTAGE_VOTE_DRV8_REG4_ADDR A:&base_addr+0x880400
y.create.l HWIO_RPMH_VRM_VOLTAGE_VOTE_DRV8_REG5_ADDR A:&base_addr+0x880500
y.create.l HWIO_RPMH_VRM_VOLTAGE_VOTE_DRV8_REG6_ADDR A:&base_addr+0x880600
y.create.l HWIO_RPMH_VRM_VOLTAGE_VOTE_DRV8_REG7_ADDR A:&base_addr+0x880700
y.create.l HWIO_RPMH_VRM_VOLTAGE_VOTE_DRV8_REG8_ADDR A:&base_addr+0x880800
y.create.l HWIO_RPMH_VRM_VOLTAGE_VOTE_DRV8_REG9_ADDR A:&base_addr+0x880900
y.create.l HWIO_RPMH_VRM_VOLTAGE_VOTE_DRV8_REG10_ADDR A:&base_addr+0x880a00
y.create.l HWIO_RPMH_VRM_VOLTAGE_VOTE_DRV8_REG11_ADDR A:&base_addr+0x880b00
y.create.l HWIO_RPMH_VRM_VOLTAGE_VOTE_DRV8_REG12_ADDR A:&base_addr+0x880c00
y.create.l HWIO_RPMH_VRM_VOLTAGE_VOTE_DRV8_REG13_ADDR A:&base_addr+0x880d00
y.create.l HWIO_RPMH_VRM_VOLTAGE_VOTE_DRV8_REG14_ADDR A:&base_addr+0x880e00
y.create.l HWIO_RPMH_VRM_VOLTAGE_VOTE_DRV8_REG15_ADDR A:&base_addr+0x880f00
y.create.l HWIO_RPMH_VRM_VOLTAGE_VOTE_DRV8_REG16_ADDR A:&base_addr+0x881000
y.create.l HWIO_RPMH_VRM_VOLTAGE_VOTE_DRV8_REG17_ADDR A:&base_addr+0x881100
y.create.l HWIO_RPMH_VRM_VOLTAGE_VOTE_DRV8_REG18_ADDR A:&base_addr+0x881200
y.create.l HWIO_RPMH_VRM_VOLTAGE_VOTE_DRV8_REG19_ADDR A:&base_addr+0x881300
y.create.l HWIO_RPMH_VRM_VOLTAGE_VOTE_DRV8_REG20_ADDR A:&base_addr+0x881400
y.create.l HWIO_RPMH_VRM_VOLTAGE_VOTE_DRV8_REG21_ADDR A:&base_addr+0x881500
y.create.l HWIO_RPMH_VRM_VOLTAGE_VOTE_DRV8_REG22_ADDR A:&base_addr+0x881600
y.create.l HWIO_RPMH_VRM_VOLTAGE_VOTE_DRV8_REG23_ADDR A:&base_addr+0x881700
y.create.l HWIO_RPMH_VRM_VOLTAGE_VOTE_DRV8_REG24_ADDR A:&base_addr+0x881800
y.create.l HWIO_RPMH_VRM_VOLTAGE_VOTE_DRV8_REG25_ADDR A:&base_addr+0x881900
y.create.l HWIO_RPMH_VRM_VOLTAGE_VOTE_DRV8_REG26_ADDR A:&base_addr+0x881a00
y.create.l HWIO_RPMH_VRM_VOLTAGE_VOTE_DRV8_REG27_ADDR A:&base_addr+0x881b00
y.create.l HWIO_RPMH_VRM_VOLTAGE_VOTE_DRV8_REG28_ADDR A:&base_addr+0x881c00
y.create.l HWIO_RPMH_VRM_VOLTAGE_VOTE_DRV8_REG29_ADDR A:&base_addr+0x881d00
y.create.l HWIO_RPMH_VRM_VOLTAGE_VOTE_DRV8_REG30_ADDR A:&base_addr+0x881e00
y.create.l HWIO_RPMH_VRM_VOLTAGE_VOTE_DRV8_REG31_ADDR A:&base_addr+0x881f00
y.create.l HWIO_RPMH_VRM_VOLTAGE_VOTE_DRV8_REG32_ADDR A:&base_addr+0x882000
y.create.l HWIO_RPMH_VRM_VOLTAGE_VOTE_DRV8_REG33_ADDR A:&base_addr+0x882100
y.create.l HWIO_RPMH_VRM_VOLTAGE_VOTE_DRV8_REG34_ADDR A:&base_addr+0x882200
y.create.l HWIO_RPMH_VRM_VOLTAGE_VOTE_DRV8_REG35_ADDR A:&base_addr+0x882300
y.create.l HWIO_RPMH_VRM_VOLTAGE_VOTE_DRV8_REG36_ADDR A:&base_addr+0x882400
y.create.l HWIO_RPMH_VRM_VOLTAGE_VOTE_DRV8_REG37_ADDR A:&base_addr+0x882500
y.create.l HWIO_RPMH_VRM_VOLTAGE_VOTE_DRV8_REG38_ADDR A:&base_addr+0x882600
y.create.l HWIO_RPMH_VRM_VOLTAGE_VOTE_DRV8_REG39_ADDR A:&base_addr+0x882700
y.create.l HWIO_RPMH_VRM_VOLTAGE_VOTE_DRV8_REG40_ADDR A:&base_addr+0x882800
y.create.l HWIO_RPMH_VRM_VOLTAGE_VOTE_DRV8_REG41_ADDR A:&base_addr+0x882900
y.create.l HWIO_RPMH_VRM_VOLTAGE_VOTE_DRV8_REG42_ADDR A:&base_addr+0x882a00
y.create.l HWIO_RPMH_VRM_VOLTAGE_VOTE_DRV8_REG43_ADDR A:&base_addr+0x882b00
y.create.l HWIO_RPMH_VRM_VOLTAGE_VOTE_DRV8_REG44_ADDR A:&base_addr+0x882c00
y.create.l HWIO_RPMH_VRM_VOLTAGE_VOTE_DRV8_REG45_ADDR A:&base_addr+0x882d00
y.create.l HWIO_RPMH_VRM_VOLTAGE_VOTE_DRV9_REG0_ADDR A:&base_addr+0x890000
y.create.l HWIO_RPMH_VRM_VOLTAGE_VOTE_DRV9_REG1_ADDR A:&base_addr+0x890100
y.create.l HWIO_RPMH_VRM_VOLTAGE_VOTE_DRV9_REG2_ADDR A:&base_addr+0x890200
y.create.l HWIO_RPMH_VRM_VOLTAGE_VOTE_DRV9_REG3_ADDR A:&base_addr+0x890300
y.create.l HWIO_RPMH_VRM_VOLTAGE_VOTE_DRV9_REG4_ADDR A:&base_addr+0x890400
y.create.l HWIO_RPMH_VRM_VOLTAGE_VOTE_DRV9_REG5_ADDR A:&base_addr+0x890500
y.create.l HWIO_RPMH_VRM_VOLTAGE_VOTE_DRV9_REG6_ADDR A:&base_addr+0x890600
y.create.l HWIO_RPMH_VRM_VOLTAGE_VOTE_DRV9_REG7_ADDR A:&base_addr+0x890700
y.create.l HWIO_RPMH_VRM_VOLTAGE_VOTE_DRV9_REG8_ADDR A:&base_addr+0x890800
y.create.l HWIO_RPMH_VRM_VOLTAGE_VOTE_DRV9_REG9_ADDR A:&base_addr+0x890900
y.create.l HWIO_RPMH_VRM_VOLTAGE_VOTE_DRV9_REG10_ADDR A:&base_addr+0x890a00
y.create.l HWIO_RPMH_VRM_VOLTAGE_VOTE_DRV9_REG11_ADDR A:&base_addr+0x890b00
y.create.l HWIO_RPMH_VRM_VOLTAGE_VOTE_DRV9_REG12_ADDR A:&base_addr+0x890c00
y.create.l HWIO_RPMH_VRM_VOLTAGE_VOTE_DRV9_REG13_ADDR A:&base_addr+0x890d00
y.create.l HWIO_RPMH_VRM_VOLTAGE_VOTE_DRV9_REG14_ADDR A:&base_addr+0x890e00
y.create.l HWIO_RPMH_VRM_VOLTAGE_VOTE_DRV9_REG15_ADDR A:&base_addr+0x890f00
y.create.l HWIO_RPMH_VRM_VOLTAGE_VOTE_DRV9_REG16_ADDR A:&base_addr+0x891000
y.create.l HWIO_RPMH_VRM_VOLTAGE_VOTE_DRV9_REG17_ADDR A:&base_addr+0x891100
y.create.l HWIO_RPMH_VRM_VOLTAGE_VOTE_DRV9_REG18_ADDR A:&base_addr+0x891200
y.create.l HWIO_RPMH_VRM_VOLTAGE_VOTE_DRV9_REG19_ADDR A:&base_addr+0x891300
y.create.l HWIO_RPMH_VRM_VOLTAGE_VOTE_DRV9_REG20_ADDR A:&base_addr+0x891400
y.create.l HWIO_RPMH_VRM_VOLTAGE_VOTE_DRV9_REG21_ADDR A:&base_addr+0x891500
y.create.l HWIO_RPMH_VRM_VOLTAGE_VOTE_DRV9_REG22_ADDR A:&base_addr+0x891600
y.create.l HWIO_RPMH_VRM_VOLTAGE_VOTE_DRV9_REG23_ADDR A:&base_addr+0x891700
y.create.l HWIO_RPMH_VRM_VOLTAGE_VOTE_DRV9_REG24_ADDR A:&base_addr+0x891800
y.create.l HWIO_RPMH_VRM_VOLTAGE_VOTE_DRV9_REG25_ADDR A:&base_addr+0x891900
y.create.l HWIO_RPMH_VRM_VOLTAGE_VOTE_DRV9_REG26_ADDR A:&base_addr+0x891a00
y.create.l HWIO_RPMH_VRM_VOLTAGE_VOTE_DRV9_REG27_ADDR A:&base_addr+0x891b00
y.create.l HWIO_RPMH_VRM_VOLTAGE_VOTE_DRV9_REG28_ADDR A:&base_addr+0x891c00
y.create.l HWIO_RPMH_VRM_VOLTAGE_VOTE_DRV9_REG29_ADDR A:&base_addr+0x891d00
y.create.l HWIO_RPMH_VRM_VOLTAGE_VOTE_DRV9_REG30_ADDR A:&base_addr+0x891e00
y.create.l HWIO_RPMH_VRM_VOLTAGE_VOTE_DRV9_REG31_ADDR A:&base_addr+0x891f00
y.create.l HWIO_RPMH_VRM_VOLTAGE_VOTE_DRV9_REG32_ADDR A:&base_addr+0x892000
y.create.l HWIO_RPMH_VRM_VOLTAGE_VOTE_DRV9_REG33_ADDR A:&base_addr+0x892100
y.create.l HWIO_RPMH_VRM_VOLTAGE_VOTE_DRV9_REG34_ADDR A:&base_addr+0x892200
y.create.l HWIO_RPMH_VRM_VOLTAGE_VOTE_DRV9_REG35_ADDR A:&base_addr+0x892300
y.create.l HWIO_RPMH_VRM_VOLTAGE_VOTE_DRV9_REG36_ADDR A:&base_addr+0x892400
y.create.l HWIO_RPMH_VRM_VOLTAGE_VOTE_DRV9_REG37_ADDR A:&base_addr+0x892500
y.create.l HWIO_RPMH_VRM_VOLTAGE_VOTE_DRV9_REG38_ADDR A:&base_addr+0x892600
y.create.l HWIO_RPMH_VRM_VOLTAGE_VOTE_DRV9_REG39_ADDR A:&base_addr+0x892700
y.create.l HWIO_RPMH_VRM_VOLTAGE_VOTE_DRV9_REG40_ADDR A:&base_addr+0x892800
y.create.l HWIO_RPMH_VRM_VOLTAGE_VOTE_DRV9_REG41_ADDR A:&base_addr+0x892900
y.create.l HWIO_RPMH_VRM_VOLTAGE_VOTE_DRV9_REG42_ADDR A:&base_addr+0x892a00
y.create.l HWIO_RPMH_VRM_VOLTAGE_VOTE_DRV9_REG43_ADDR A:&base_addr+0x892b00
y.create.l HWIO_RPMH_VRM_VOLTAGE_VOTE_DRV9_REG44_ADDR A:&base_addr+0x892c00
y.create.l HWIO_RPMH_VRM_VOLTAGE_VOTE_DRV9_REG45_ADDR A:&base_addr+0x892d00
y.create.l HWIO_RPMH_VRM_VOLTAGE_VOTE_DRV10_REG0_ADDR A:&base_addr+0x8a0000
y.create.l HWIO_RPMH_VRM_VOLTAGE_VOTE_DRV10_REG1_ADDR A:&base_addr+0x8a0100
y.create.l HWIO_RPMH_VRM_VOLTAGE_VOTE_DRV10_REG2_ADDR A:&base_addr+0x8a0200
y.create.l HWIO_RPMH_VRM_VOLTAGE_VOTE_DRV10_REG3_ADDR A:&base_addr+0x8a0300
y.create.l HWIO_RPMH_VRM_VOLTAGE_VOTE_DRV10_REG4_ADDR A:&base_addr+0x8a0400
y.create.l HWIO_RPMH_VRM_VOLTAGE_VOTE_DRV10_REG5_ADDR A:&base_addr+0x8a0500
y.create.l HWIO_RPMH_VRM_VOLTAGE_VOTE_DRV10_REG6_ADDR A:&base_addr+0x8a0600
y.create.l HWIO_RPMH_VRM_VOLTAGE_VOTE_DRV10_REG7_ADDR A:&base_addr+0x8a0700
y.create.l HWIO_RPMH_VRM_VOLTAGE_VOTE_DRV10_REG8_ADDR A:&base_addr+0x8a0800
y.create.l HWIO_RPMH_VRM_VOLTAGE_VOTE_DRV10_REG9_ADDR A:&base_addr+0x8a0900
y.create.l HWIO_RPMH_VRM_VOLTAGE_VOTE_DRV10_REG10_ADDR A:&base_addr+0x8a0a00
y.create.l HWIO_RPMH_VRM_VOLTAGE_VOTE_DRV10_REG11_ADDR A:&base_addr+0x8a0b00
y.create.l HWIO_RPMH_VRM_VOLTAGE_VOTE_DRV10_REG12_ADDR A:&base_addr+0x8a0c00
y.create.l HWIO_RPMH_VRM_VOLTAGE_VOTE_DRV10_REG13_ADDR A:&base_addr+0x8a0d00
y.create.l HWIO_RPMH_VRM_VOLTAGE_VOTE_DRV10_REG14_ADDR A:&base_addr+0x8a0e00
y.create.l HWIO_RPMH_VRM_VOLTAGE_VOTE_DRV10_REG15_ADDR A:&base_addr+0x8a0f00
y.create.l HWIO_RPMH_VRM_VOLTAGE_VOTE_DRV10_REG16_ADDR A:&base_addr+0x8a1000
y.create.l HWIO_RPMH_VRM_VOLTAGE_VOTE_DRV10_REG17_ADDR A:&base_addr+0x8a1100
y.create.l HWIO_RPMH_VRM_VOLTAGE_VOTE_DRV10_REG18_ADDR A:&base_addr+0x8a1200
y.create.l HWIO_RPMH_VRM_VOLTAGE_VOTE_DRV10_REG19_ADDR A:&base_addr+0x8a1300
y.create.l HWIO_RPMH_VRM_VOLTAGE_VOTE_DRV10_REG20_ADDR A:&base_addr+0x8a1400
y.create.l HWIO_RPMH_VRM_VOLTAGE_VOTE_DRV10_REG21_ADDR A:&base_addr+0x8a1500
y.create.l HWIO_RPMH_VRM_VOLTAGE_VOTE_DRV10_REG22_ADDR A:&base_addr+0x8a1600
y.create.l HWIO_RPMH_VRM_VOLTAGE_VOTE_DRV10_REG23_ADDR A:&base_addr+0x8a1700
y.create.l HWIO_RPMH_VRM_VOLTAGE_VOTE_DRV10_REG24_ADDR A:&base_addr+0x8a1800
y.create.l HWIO_RPMH_VRM_VOLTAGE_VOTE_DRV10_REG25_ADDR A:&base_addr+0x8a1900
y.create.l HWIO_RPMH_VRM_VOLTAGE_VOTE_DRV10_REG26_ADDR A:&base_addr+0x8a1a00
y.create.l HWIO_RPMH_VRM_VOLTAGE_VOTE_DRV10_REG27_ADDR A:&base_addr+0x8a1b00
y.create.l HWIO_RPMH_VRM_VOLTAGE_VOTE_DRV10_REG28_ADDR A:&base_addr+0x8a1c00
y.create.l HWIO_RPMH_VRM_VOLTAGE_VOTE_DRV10_REG29_ADDR A:&base_addr+0x8a1d00
y.create.l HWIO_RPMH_VRM_VOLTAGE_VOTE_DRV10_REG30_ADDR A:&base_addr+0x8a1e00
y.create.l HWIO_RPMH_VRM_VOLTAGE_VOTE_DRV10_REG31_ADDR A:&base_addr+0x8a1f00
y.create.l HWIO_RPMH_VRM_VOLTAGE_VOTE_DRV10_REG32_ADDR A:&base_addr+0x8a2000
y.create.l HWIO_RPMH_VRM_VOLTAGE_VOTE_DRV10_REG33_ADDR A:&base_addr+0x8a2100
y.create.l HWIO_RPMH_VRM_VOLTAGE_VOTE_DRV10_REG34_ADDR A:&base_addr+0x8a2200
y.create.l HWIO_RPMH_VRM_VOLTAGE_VOTE_DRV10_REG35_ADDR A:&base_addr+0x8a2300
y.create.l HWIO_RPMH_VRM_VOLTAGE_VOTE_DRV10_REG36_ADDR A:&base_addr+0x8a2400
y.create.l HWIO_RPMH_VRM_VOLTAGE_VOTE_DRV10_REG37_ADDR A:&base_addr+0x8a2500
y.create.l HWIO_RPMH_VRM_VOLTAGE_VOTE_DRV10_REG38_ADDR A:&base_addr+0x8a2600
y.create.l HWIO_RPMH_VRM_VOLTAGE_VOTE_DRV10_REG39_ADDR A:&base_addr+0x8a2700
y.create.l HWIO_RPMH_VRM_VOLTAGE_VOTE_DRV10_REG40_ADDR A:&base_addr+0x8a2800
y.create.l HWIO_RPMH_VRM_VOLTAGE_VOTE_DRV10_REG41_ADDR A:&base_addr+0x8a2900
y.create.l HWIO_RPMH_VRM_VOLTAGE_VOTE_DRV10_REG42_ADDR A:&base_addr+0x8a2a00
y.create.l HWIO_RPMH_VRM_VOLTAGE_VOTE_DRV10_REG43_ADDR A:&base_addr+0x8a2b00
y.create.l HWIO_RPMH_VRM_VOLTAGE_VOTE_DRV10_REG44_ADDR A:&base_addr+0x8a2c00
y.create.l HWIO_RPMH_VRM_VOLTAGE_VOTE_DRV10_REG45_ADDR A:&base_addr+0x8a2d00
y.create.l HWIO_RPMH_VRM_VOLTAGE_VOTE_DRV11_REG0_ADDR A:&base_addr+0x8b0000
y.create.l HWIO_RPMH_VRM_VOLTAGE_VOTE_DRV11_REG1_ADDR A:&base_addr+0x8b0100
y.create.l HWIO_RPMH_VRM_VOLTAGE_VOTE_DRV11_REG2_ADDR A:&base_addr+0x8b0200
y.create.l HWIO_RPMH_VRM_VOLTAGE_VOTE_DRV11_REG3_ADDR A:&base_addr+0x8b0300
y.create.l HWIO_RPMH_VRM_VOLTAGE_VOTE_DRV11_REG4_ADDR A:&base_addr+0x8b0400
y.create.l HWIO_RPMH_VRM_VOLTAGE_VOTE_DRV11_REG5_ADDR A:&base_addr+0x8b0500
y.create.l HWIO_RPMH_VRM_VOLTAGE_VOTE_DRV11_REG6_ADDR A:&base_addr+0x8b0600
y.create.l HWIO_RPMH_VRM_VOLTAGE_VOTE_DRV11_REG7_ADDR A:&base_addr+0x8b0700
y.create.l HWIO_RPMH_VRM_VOLTAGE_VOTE_DRV11_REG8_ADDR A:&base_addr+0x8b0800
y.create.l HWIO_RPMH_VRM_VOLTAGE_VOTE_DRV11_REG9_ADDR A:&base_addr+0x8b0900
y.create.l HWIO_RPMH_VRM_VOLTAGE_VOTE_DRV11_REG10_ADDR A:&base_addr+0x8b0a00
y.create.l HWIO_RPMH_VRM_VOLTAGE_VOTE_DRV11_REG11_ADDR A:&base_addr+0x8b0b00
y.create.l HWIO_RPMH_VRM_VOLTAGE_VOTE_DRV11_REG12_ADDR A:&base_addr+0x8b0c00
y.create.l HWIO_RPMH_VRM_VOLTAGE_VOTE_DRV11_REG13_ADDR A:&base_addr+0x8b0d00
y.create.l HWIO_RPMH_VRM_VOLTAGE_VOTE_DRV11_REG14_ADDR A:&base_addr+0x8b0e00
y.create.l HWIO_RPMH_VRM_VOLTAGE_VOTE_DRV11_REG15_ADDR A:&base_addr+0x8b0f00
y.create.l HWIO_RPMH_VRM_VOLTAGE_VOTE_DRV11_REG16_ADDR A:&base_addr+0x8b1000
y.create.l HWIO_RPMH_VRM_VOLTAGE_VOTE_DRV11_REG17_ADDR A:&base_addr+0x8b1100
y.create.l HWIO_RPMH_VRM_VOLTAGE_VOTE_DRV11_REG18_ADDR A:&base_addr+0x8b1200
y.create.l HWIO_RPMH_VRM_VOLTAGE_VOTE_DRV11_REG19_ADDR A:&base_addr+0x8b1300
y.create.l HWIO_RPMH_VRM_VOLTAGE_VOTE_DRV11_REG20_ADDR A:&base_addr+0x8b1400
y.create.l HWIO_RPMH_VRM_VOLTAGE_VOTE_DRV11_REG21_ADDR A:&base_addr+0x8b1500
y.create.l HWIO_RPMH_VRM_VOLTAGE_VOTE_DRV11_REG22_ADDR A:&base_addr+0x8b1600
y.create.l HWIO_RPMH_VRM_VOLTAGE_VOTE_DRV11_REG23_ADDR A:&base_addr+0x8b1700
y.create.l HWIO_RPMH_VRM_VOLTAGE_VOTE_DRV11_REG24_ADDR A:&base_addr+0x8b1800
y.create.l HWIO_RPMH_VRM_VOLTAGE_VOTE_DRV11_REG25_ADDR A:&base_addr+0x8b1900
y.create.l HWIO_RPMH_VRM_VOLTAGE_VOTE_DRV11_REG26_ADDR A:&base_addr+0x8b1a00
y.create.l HWIO_RPMH_VRM_VOLTAGE_VOTE_DRV11_REG27_ADDR A:&base_addr+0x8b1b00
y.create.l HWIO_RPMH_VRM_VOLTAGE_VOTE_DRV11_REG28_ADDR A:&base_addr+0x8b1c00
y.create.l HWIO_RPMH_VRM_VOLTAGE_VOTE_DRV11_REG29_ADDR A:&base_addr+0x8b1d00
y.create.l HWIO_RPMH_VRM_VOLTAGE_VOTE_DRV11_REG30_ADDR A:&base_addr+0x8b1e00
y.create.l HWIO_RPMH_VRM_VOLTAGE_VOTE_DRV11_REG31_ADDR A:&base_addr+0x8b1f00
y.create.l HWIO_RPMH_VRM_VOLTAGE_VOTE_DRV11_REG32_ADDR A:&base_addr+0x8b2000
y.create.l HWIO_RPMH_VRM_VOLTAGE_VOTE_DRV11_REG33_ADDR A:&base_addr+0x8b2100
y.create.l HWIO_RPMH_VRM_VOLTAGE_VOTE_DRV11_REG34_ADDR A:&base_addr+0x8b2200
y.create.l HWIO_RPMH_VRM_VOLTAGE_VOTE_DRV11_REG35_ADDR A:&base_addr+0x8b2300
y.create.l HWIO_RPMH_VRM_VOLTAGE_VOTE_DRV11_REG36_ADDR A:&base_addr+0x8b2400
y.create.l HWIO_RPMH_VRM_VOLTAGE_VOTE_DRV11_REG37_ADDR A:&base_addr+0x8b2500
y.create.l HWIO_RPMH_VRM_VOLTAGE_VOTE_DRV11_REG38_ADDR A:&base_addr+0x8b2600
y.create.l HWIO_RPMH_VRM_VOLTAGE_VOTE_DRV11_REG39_ADDR A:&base_addr+0x8b2700
y.create.l HWIO_RPMH_VRM_VOLTAGE_VOTE_DRV11_REG40_ADDR A:&base_addr+0x8b2800
y.create.l HWIO_RPMH_VRM_VOLTAGE_VOTE_DRV11_REG41_ADDR A:&base_addr+0x8b2900
y.create.l HWIO_RPMH_VRM_VOLTAGE_VOTE_DRV11_REG42_ADDR A:&base_addr+0x8b2a00
y.create.l HWIO_RPMH_VRM_VOLTAGE_VOTE_DRV11_REG43_ADDR A:&base_addr+0x8b2b00
y.create.l HWIO_RPMH_VRM_VOLTAGE_VOTE_DRV11_REG44_ADDR A:&base_addr+0x8b2c00
y.create.l HWIO_RPMH_VRM_VOLTAGE_VOTE_DRV11_REG45_ADDR A:&base_addr+0x8b2d00
y.create.l HWIO_RPMH_VRM_VOLTAGE_VOTE_DRV12_REG0_ADDR A:&base_addr+0x8c0000
y.create.l HWIO_RPMH_VRM_VOLTAGE_VOTE_DRV12_REG1_ADDR A:&base_addr+0x8c0100
y.create.l HWIO_RPMH_VRM_VOLTAGE_VOTE_DRV12_REG2_ADDR A:&base_addr+0x8c0200
y.create.l HWIO_RPMH_VRM_VOLTAGE_VOTE_DRV12_REG3_ADDR A:&base_addr+0x8c0300
y.create.l HWIO_RPMH_VRM_VOLTAGE_VOTE_DRV12_REG4_ADDR A:&base_addr+0x8c0400
y.create.l HWIO_RPMH_VRM_VOLTAGE_VOTE_DRV12_REG5_ADDR A:&base_addr+0x8c0500
y.create.l HWIO_RPMH_VRM_VOLTAGE_VOTE_DRV12_REG6_ADDR A:&base_addr+0x8c0600
y.create.l HWIO_RPMH_VRM_VOLTAGE_VOTE_DRV12_REG7_ADDR A:&base_addr+0x8c0700
y.create.l HWIO_RPMH_VRM_VOLTAGE_VOTE_DRV12_REG8_ADDR A:&base_addr+0x8c0800
y.create.l HWIO_RPMH_VRM_VOLTAGE_VOTE_DRV12_REG9_ADDR A:&base_addr+0x8c0900
y.create.l HWIO_RPMH_VRM_VOLTAGE_VOTE_DRV12_REG10_ADDR A:&base_addr+0x8c0a00
y.create.l HWIO_RPMH_VRM_VOLTAGE_VOTE_DRV12_REG11_ADDR A:&base_addr+0x8c0b00
y.create.l HWIO_RPMH_VRM_VOLTAGE_VOTE_DRV12_REG12_ADDR A:&base_addr+0x8c0c00
y.create.l HWIO_RPMH_VRM_VOLTAGE_VOTE_DRV12_REG13_ADDR A:&base_addr+0x8c0d00
y.create.l HWIO_RPMH_VRM_VOLTAGE_VOTE_DRV12_REG14_ADDR A:&base_addr+0x8c0e00
y.create.l HWIO_RPMH_VRM_VOLTAGE_VOTE_DRV12_REG15_ADDR A:&base_addr+0x8c0f00
y.create.l HWIO_RPMH_VRM_VOLTAGE_VOTE_DRV12_REG16_ADDR A:&base_addr+0x8c1000
y.create.l HWIO_RPMH_VRM_VOLTAGE_VOTE_DRV12_REG17_ADDR A:&base_addr+0x8c1100
y.create.l HWIO_RPMH_VRM_VOLTAGE_VOTE_DRV12_REG18_ADDR A:&base_addr+0x8c1200
y.create.l HWIO_RPMH_VRM_VOLTAGE_VOTE_DRV12_REG19_ADDR A:&base_addr+0x8c1300
y.create.l HWIO_RPMH_VRM_VOLTAGE_VOTE_DRV12_REG20_ADDR A:&base_addr+0x8c1400
y.create.l HWIO_RPMH_VRM_VOLTAGE_VOTE_DRV12_REG21_ADDR A:&base_addr+0x8c1500
y.create.l HWIO_RPMH_VRM_VOLTAGE_VOTE_DRV12_REG22_ADDR A:&base_addr+0x8c1600
y.create.l HWIO_RPMH_VRM_VOLTAGE_VOTE_DRV12_REG23_ADDR A:&base_addr+0x8c1700
y.create.l HWIO_RPMH_VRM_VOLTAGE_VOTE_DRV12_REG24_ADDR A:&base_addr+0x8c1800
y.create.l HWIO_RPMH_VRM_VOLTAGE_VOTE_DRV12_REG25_ADDR A:&base_addr+0x8c1900
y.create.l HWIO_RPMH_VRM_VOLTAGE_VOTE_DRV12_REG26_ADDR A:&base_addr+0x8c1a00
y.create.l HWIO_RPMH_VRM_VOLTAGE_VOTE_DRV12_REG27_ADDR A:&base_addr+0x8c1b00
y.create.l HWIO_RPMH_VRM_VOLTAGE_VOTE_DRV12_REG28_ADDR A:&base_addr+0x8c1c00
y.create.l HWIO_RPMH_VRM_VOLTAGE_VOTE_DRV12_REG29_ADDR A:&base_addr+0x8c1d00
y.create.l HWIO_RPMH_VRM_VOLTAGE_VOTE_DRV12_REG30_ADDR A:&base_addr+0x8c1e00
y.create.l HWIO_RPMH_VRM_VOLTAGE_VOTE_DRV12_REG31_ADDR A:&base_addr+0x8c1f00
y.create.l HWIO_RPMH_VRM_VOLTAGE_VOTE_DRV12_REG32_ADDR A:&base_addr+0x8c2000
y.create.l HWIO_RPMH_VRM_VOLTAGE_VOTE_DRV12_REG33_ADDR A:&base_addr+0x8c2100
y.create.l HWIO_RPMH_VRM_VOLTAGE_VOTE_DRV12_REG34_ADDR A:&base_addr+0x8c2200
y.create.l HWIO_RPMH_VRM_VOLTAGE_VOTE_DRV12_REG35_ADDR A:&base_addr+0x8c2300
y.create.l HWIO_RPMH_VRM_VOLTAGE_VOTE_DRV12_REG36_ADDR A:&base_addr+0x8c2400
y.create.l HWIO_RPMH_VRM_VOLTAGE_VOTE_DRV12_REG37_ADDR A:&base_addr+0x8c2500
y.create.l HWIO_RPMH_VRM_VOLTAGE_VOTE_DRV12_REG38_ADDR A:&base_addr+0x8c2600
y.create.l HWIO_RPMH_VRM_VOLTAGE_VOTE_DRV12_REG39_ADDR A:&base_addr+0x8c2700
y.create.l HWIO_RPMH_VRM_VOLTAGE_VOTE_DRV12_REG40_ADDR A:&base_addr+0x8c2800
y.create.l HWIO_RPMH_VRM_VOLTAGE_VOTE_DRV12_REG41_ADDR A:&base_addr+0x8c2900
y.create.l HWIO_RPMH_VRM_VOLTAGE_VOTE_DRV12_REG42_ADDR A:&base_addr+0x8c2a00
y.create.l HWIO_RPMH_VRM_VOLTAGE_VOTE_DRV12_REG43_ADDR A:&base_addr+0x8c2b00
y.create.l HWIO_RPMH_VRM_VOLTAGE_VOTE_DRV12_REG44_ADDR A:&base_addr+0x8c2c00
y.create.l HWIO_RPMH_VRM_VOLTAGE_VOTE_DRV12_REG45_ADDR A:&base_addr+0x8c2d00
y.create.l HWIO_RPMH_VRM_VOLTAGE_VOTE_DRV13_REG0_ADDR A:&base_addr+0x8d0000
y.create.l HWIO_RPMH_VRM_VOLTAGE_VOTE_DRV13_REG1_ADDR A:&base_addr+0x8d0100
y.create.l HWIO_RPMH_VRM_VOLTAGE_VOTE_DRV13_REG2_ADDR A:&base_addr+0x8d0200
y.create.l HWIO_RPMH_VRM_VOLTAGE_VOTE_DRV13_REG3_ADDR A:&base_addr+0x8d0300
y.create.l HWIO_RPMH_VRM_VOLTAGE_VOTE_DRV13_REG4_ADDR A:&base_addr+0x8d0400
y.create.l HWIO_RPMH_VRM_VOLTAGE_VOTE_DRV13_REG5_ADDR A:&base_addr+0x8d0500
y.create.l HWIO_RPMH_VRM_VOLTAGE_VOTE_DRV13_REG6_ADDR A:&base_addr+0x8d0600
y.create.l HWIO_RPMH_VRM_VOLTAGE_VOTE_DRV13_REG7_ADDR A:&base_addr+0x8d0700
y.create.l HWIO_RPMH_VRM_VOLTAGE_VOTE_DRV13_REG8_ADDR A:&base_addr+0x8d0800
y.create.l HWIO_RPMH_VRM_VOLTAGE_VOTE_DRV13_REG9_ADDR A:&base_addr+0x8d0900
y.create.l HWIO_RPMH_VRM_VOLTAGE_VOTE_DRV13_REG10_ADDR A:&base_addr+0x8d0a00
y.create.l HWIO_RPMH_VRM_VOLTAGE_VOTE_DRV13_REG11_ADDR A:&base_addr+0x8d0b00
y.create.l HWIO_RPMH_VRM_VOLTAGE_VOTE_DRV13_REG12_ADDR A:&base_addr+0x8d0c00
y.create.l HWIO_RPMH_VRM_VOLTAGE_VOTE_DRV13_REG13_ADDR A:&base_addr+0x8d0d00
y.create.l HWIO_RPMH_VRM_VOLTAGE_VOTE_DRV13_REG14_ADDR A:&base_addr+0x8d0e00
y.create.l HWIO_RPMH_VRM_VOLTAGE_VOTE_DRV13_REG15_ADDR A:&base_addr+0x8d0f00
y.create.l HWIO_RPMH_VRM_VOLTAGE_VOTE_DRV13_REG16_ADDR A:&base_addr+0x8d1000
y.create.l HWIO_RPMH_VRM_VOLTAGE_VOTE_DRV13_REG17_ADDR A:&base_addr+0x8d1100
y.create.l HWIO_RPMH_VRM_VOLTAGE_VOTE_DRV13_REG18_ADDR A:&base_addr+0x8d1200
y.create.l HWIO_RPMH_VRM_VOLTAGE_VOTE_DRV13_REG19_ADDR A:&base_addr+0x8d1300
y.create.l HWIO_RPMH_VRM_VOLTAGE_VOTE_DRV13_REG20_ADDR A:&base_addr+0x8d1400
y.create.l HWIO_RPMH_VRM_VOLTAGE_VOTE_DRV13_REG21_ADDR A:&base_addr+0x8d1500
y.create.l HWIO_RPMH_VRM_VOLTAGE_VOTE_DRV13_REG22_ADDR A:&base_addr+0x8d1600
y.create.l HWIO_RPMH_VRM_VOLTAGE_VOTE_DRV13_REG23_ADDR A:&base_addr+0x8d1700
y.create.l HWIO_RPMH_VRM_VOLTAGE_VOTE_DRV13_REG24_ADDR A:&base_addr+0x8d1800
y.create.l HWIO_RPMH_VRM_VOLTAGE_VOTE_DRV13_REG25_ADDR A:&base_addr+0x8d1900
y.create.l HWIO_RPMH_VRM_VOLTAGE_VOTE_DRV13_REG26_ADDR A:&base_addr+0x8d1a00
y.create.l HWIO_RPMH_VRM_VOLTAGE_VOTE_DRV13_REG27_ADDR A:&base_addr+0x8d1b00
y.create.l HWIO_RPMH_VRM_VOLTAGE_VOTE_DRV13_REG28_ADDR A:&base_addr+0x8d1c00
y.create.l HWIO_RPMH_VRM_VOLTAGE_VOTE_DRV13_REG29_ADDR A:&base_addr+0x8d1d00
y.create.l HWIO_RPMH_VRM_VOLTAGE_VOTE_DRV13_REG30_ADDR A:&base_addr+0x8d1e00
y.create.l HWIO_RPMH_VRM_VOLTAGE_VOTE_DRV13_REG31_ADDR A:&base_addr+0x8d1f00
y.create.l HWIO_RPMH_VRM_VOLTAGE_VOTE_DRV13_REG32_ADDR A:&base_addr+0x8d2000
y.create.l HWIO_RPMH_VRM_VOLTAGE_VOTE_DRV13_REG33_ADDR A:&base_addr+0x8d2100
y.create.l HWIO_RPMH_VRM_VOLTAGE_VOTE_DRV13_REG34_ADDR A:&base_addr+0x8d2200
y.create.l HWIO_RPMH_VRM_VOLTAGE_VOTE_DRV13_REG35_ADDR A:&base_addr+0x8d2300
y.create.l HWIO_RPMH_VRM_VOLTAGE_VOTE_DRV13_REG36_ADDR A:&base_addr+0x8d2400
y.create.l HWIO_RPMH_VRM_VOLTAGE_VOTE_DRV13_REG37_ADDR A:&base_addr+0x8d2500
y.create.l HWIO_RPMH_VRM_VOLTAGE_VOTE_DRV13_REG38_ADDR A:&base_addr+0x8d2600
y.create.l HWIO_RPMH_VRM_VOLTAGE_VOTE_DRV13_REG39_ADDR A:&base_addr+0x8d2700
y.create.l HWIO_RPMH_VRM_VOLTAGE_VOTE_DRV13_REG40_ADDR A:&base_addr+0x8d2800
y.create.l HWIO_RPMH_VRM_VOLTAGE_VOTE_DRV13_REG41_ADDR A:&base_addr+0x8d2900
y.create.l HWIO_RPMH_VRM_VOLTAGE_VOTE_DRV13_REG42_ADDR A:&base_addr+0x8d2a00
y.create.l HWIO_RPMH_VRM_VOLTAGE_VOTE_DRV13_REG43_ADDR A:&base_addr+0x8d2b00
y.create.l HWIO_RPMH_VRM_VOLTAGE_VOTE_DRV13_REG44_ADDR A:&base_addr+0x8d2c00
y.create.l HWIO_RPMH_VRM_VOLTAGE_VOTE_DRV13_REG45_ADDR A:&base_addr+0x8d2d00
y.create.l HWIO_RPMH_VRM_VOLTAGE_VOTE_DRV14_REG0_ADDR A:&base_addr+0x8e0000
y.create.l HWIO_RPMH_VRM_VOLTAGE_VOTE_DRV14_REG1_ADDR A:&base_addr+0x8e0100
y.create.l HWIO_RPMH_VRM_VOLTAGE_VOTE_DRV14_REG2_ADDR A:&base_addr+0x8e0200
y.create.l HWIO_RPMH_VRM_VOLTAGE_VOTE_DRV14_REG3_ADDR A:&base_addr+0x8e0300
y.create.l HWIO_RPMH_VRM_VOLTAGE_VOTE_DRV14_REG4_ADDR A:&base_addr+0x8e0400
y.create.l HWIO_RPMH_VRM_VOLTAGE_VOTE_DRV14_REG5_ADDR A:&base_addr+0x8e0500
y.create.l HWIO_RPMH_VRM_VOLTAGE_VOTE_DRV14_REG6_ADDR A:&base_addr+0x8e0600
y.create.l HWIO_RPMH_VRM_VOLTAGE_VOTE_DRV14_REG7_ADDR A:&base_addr+0x8e0700
y.create.l HWIO_RPMH_VRM_VOLTAGE_VOTE_DRV14_REG8_ADDR A:&base_addr+0x8e0800
y.create.l HWIO_RPMH_VRM_VOLTAGE_VOTE_DRV14_REG9_ADDR A:&base_addr+0x8e0900
y.create.l HWIO_RPMH_VRM_VOLTAGE_VOTE_DRV14_REG10_ADDR A:&base_addr+0x8e0a00
y.create.l HWIO_RPMH_VRM_VOLTAGE_VOTE_DRV14_REG11_ADDR A:&base_addr+0x8e0b00
y.create.l HWIO_RPMH_VRM_VOLTAGE_VOTE_DRV14_REG12_ADDR A:&base_addr+0x8e0c00
y.create.l HWIO_RPMH_VRM_VOLTAGE_VOTE_DRV14_REG13_ADDR A:&base_addr+0x8e0d00
y.create.l HWIO_RPMH_VRM_VOLTAGE_VOTE_DRV14_REG14_ADDR A:&base_addr+0x8e0e00
y.create.l HWIO_RPMH_VRM_VOLTAGE_VOTE_DRV14_REG15_ADDR A:&base_addr+0x8e0f00
y.create.l HWIO_RPMH_VRM_VOLTAGE_VOTE_DRV14_REG16_ADDR A:&base_addr+0x8e1000
y.create.l HWIO_RPMH_VRM_VOLTAGE_VOTE_DRV14_REG17_ADDR A:&base_addr+0x8e1100
y.create.l HWIO_RPMH_VRM_VOLTAGE_VOTE_DRV14_REG18_ADDR A:&base_addr+0x8e1200
y.create.l HWIO_RPMH_VRM_VOLTAGE_VOTE_DRV14_REG19_ADDR A:&base_addr+0x8e1300
y.create.l HWIO_RPMH_VRM_VOLTAGE_VOTE_DRV14_REG20_ADDR A:&base_addr+0x8e1400
y.create.l HWIO_RPMH_VRM_VOLTAGE_VOTE_DRV14_REG21_ADDR A:&base_addr+0x8e1500
y.create.l HWIO_RPMH_VRM_VOLTAGE_VOTE_DRV14_REG22_ADDR A:&base_addr+0x8e1600
y.create.l HWIO_RPMH_VRM_VOLTAGE_VOTE_DRV14_REG23_ADDR A:&base_addr+0x8e1700
y.create.l HWIO_RPMH_VRM_VOLTAGE_VOTE_DRV14_REG24_ADDR A:&base_addr+0x8e1800
y.create.l HWIO_RPMH_VRM_VOLTAGE_VOTE_DRV14_REG25_ADDR A:&base_addr+0x8e1900
y.create.l HWIO_RPMH_VRM_VOLTAGE_VOTE_DRV14_REG26_ADDR A:&base_addr+0x8e1a00
y.create.l HWIO_RPMH_VRM_VOLTAGE_VOTE_DRV14_REG27_ADDR A:&base_addr+0x8e1b00
y.create.l HWIO_RPMH_VRM_VOLTAGE_VOTE_DRV14_REG28_ADDR A:&base_addr+0x8e1c00
y.create.l HWIO_RPMH_VRM_VOLTAGE_VOTE_DRV14_REG29_ADDR A:&base_addr+0x8e1d00
y.create.l HWIO_RPMH_VRM_VOLTAGE_VOTE_DRV14_REG30_ADDR A:&base_addr+0x8e1e00
y.create.l HWIO_RPMH_VRM_VOLTAGE_VOTE_DRV14_REG31_ADDR A:&base_addr+0x8e1f00
y.create.l HWIO_RPMH_VRM_VOLTAGE_VOTE_DRV14_REG32_ADDR A:&base_addr+0x8e2000
y.create.l HWIO_RPMH_VRM_VOLTAGE_VOTE_DRV14_REG33_ADDR A:&base_addr+0x8e2100
y.create.l HWIO_RPMH_VRM_VOLTAGE_VOTE_DRV14_REG34_ADDR A:&base_addr+0x8e2200
y.create.l HWIO_RPMH_VRM_VOLTAGE_VOTE_DRV14_REG35_ADDR A:&base_addr+0x8e2300
y.create.l HWIO_RPMH_VRM_VOLTAGE_VOTE_DRV14_REG36_ADDR A:&base_addr+0x8e2400
y.create.l HWIO_RPMH_VRM_VOLTAGE_VOTE_DRV14_REG37_ADDR A:&base_addr+0x8e2500
y.create.l HWIO_RPMH_VRM_VOLTAGE_VOTE_DRV14_REG38_ADDR A:&base_addr+0x8e2600
y.create.l HWIO_RPMH_VRM_VOLTAGE_VOTE_DRV14_REG39_ADDR A:&base_addr+0x8e2700
y.create.l HWIO_RPMH_VRM_VOLTAGE_VOTE_DRV14_REG40_ADDR A:&base_addr+0x8e2800
y.create.l HWIO_RPMH_VRM_VOLTAGE_VOTE_DRV14_REG41_ADDR A:&base_addr+0x8e2900
y.create.l HWIO_RPMH_VRM_VOLTAGE_VOTE_DRV14_REG42_ADDR A:&base_addr+0x8e2a00
y.create.l HWIO_RPMH_VRM_VOLTAGE_VOTE_DRV14_REG43_ADDR A:&base_addr+0x8e2b00
y.create.l HWIO_RPMH_VRM_VOLTAGE_VOTE_DRV14_REG44_ADDR A:&base_addr+0x8e2c00
y.create.l HWIO_RPMH_VRM_VOLTAGE_VOTE_DRV14_REG45_ADDR A:&base_addr+0x8e2d00
y.create.l HWIO_RPMH_VRM_ENABLE_VOTE_DRV0_REG0_ADDR A:&base_addr+0x800004
y.create.l HWIO_RPMH_VRM_ENABLE_VOTE_DRV0_REG1_ADDR A:&base_addr+0x800104
y.create.l HWIO_RPMH_VRM_ENABLE_VOTE_DRV0_REG2_ADDR A:&base_addr+0x800204
y.create.l HWIO_RPMH_VRM_ENABLE_VOTE_DRV0_REG3_ADDR A:&base_addr+0x800304
y.create.l HWIO_RPMH_VRM_ENABLE_VOTE_DRV0_REG4_ADDR A:&base_addr+0x800404
y.create.l HWIO_RPMH_VRM_ENABLE_VOTE_DRV0_REG5_ADDR A:&base_addr+0x800504
y.create.l HWIO_RPMH_VRM_ENABLE_VOTE_DRV0_REG6_ADDR A:&base_addr+0x800604
y.create.l HWIO_RPMH_VRM_ENABLE_VOTE_DRV0_REG7_ADDR A:&base_addr+0x800704
y.create.l HWIO_RPMH_VRM_ENABLE_VOTE_DRV0_REG8_ADDR A:&base_addr+0x800804
y.create.l HWIO_RPMH_VRM_ENABLE_VOTE_DRV0_REG9_ADDR A:&base_addr+0x800904
y.create.l HWIO_RPMH_VRM_ENABLE_VOTE_DRV0_REG10_ADDR A:&base_addr+0x800a04
y.create.l HWIO_RPMH_VRM_ENABLE_VOTE_DRV0_REG11_ADDR A:&base_addr+0x800b04
y.create.l HWIO_RPMH_VRM_ENABLE_VOTE_DRV0_REG12_ADDR A:&base_addr+0x800c04
y.create.l HWIO_RPMH_VRM_ENABLE_VOTE_DRV0_REG13_ADDR A:&base_addr+0x800d04
y.create.l HWIO_RPMH_VRM_ENABLE_VOTE_DRV0_REG14_ADDR A:&base_addr+0x800e04
y.create.l HWIO_RPMH_VRM_ENABLE_VOTE_DRV0_REG15_ADDR A:&base_addr+0x800f04
y.create.l HWIO_RPMH_VRM_ENABLE_VOTE_DRV0_REG16_ADDR A:&base_addr+0x801004
y.create.l HWIO_RPMH_VRM_ENABLE_VOTE_DRV0_REG17_ADDR A:&base_addr+0x801104
y.create.l HWIO_RPMH_VRM_ENABLE_VOTE_DRV0_REG18_ADDR A:&base_addr+0x801204
y.create.l HWIO_RPMH_VRM_ENABLE_VOTE_DRV0_REG19_ADDR A:&base_addr+0x801304
y.create.l HWIO_RPMH_VRM_ENABLE_VOTE_DRV0_REG20_ADDR A:&base_addr+0x801404
y.create.l HWIO_RPMH_VRM_ENABLE_VOTE_DRV0_REG21_ADDR A:&base_addr+0x801504
y.create.l HWIO_RPMH_VRM_ENABLE_VOTE_DRV0_REG22_ADDR A:&base_addr+0x801604
y.create.l HWIO_RPMH_VRM_ENABLE_VOTE_DRV0_REG23_ADDR A:&base_addr+0x801704
y.create.l HWIO_RPMH_VRM_ENABLE_VOTE_DRV0_REG24_ADDR A:&base_addr+0x801804
y.create.l HWIO_RPMH_VRM_ENABLE_VOTE_DRV0_REG25_ADDR A:&base_addr+0x801904
y.create.l HWIO_RPMH_VRM_ENABLE_VOTE_DRV0_REG26_ADDR A:&base_addr+0x801a04
y.create.l HWIO_RPMH_VRM_ENABLE_VOTE_DRV0_REG27_ADDR A:&base_addr+0x801b04
y.create.l HWIO_RPMH_VRM_ENABLE_VOTE_DRV0_REG28_ADDR A:&base_addr+0x801c04
y.create.l HWIO_RPMH_VRM_ENABLE_VOTE_DRV0_REG29_ADDR A:&base_addr+0x801d04
y.create.l HWIO_RPMH_VRM_ENABLE_VOTE_DRV0_REG30_ADDR A:&base_addr+0x801e04
y.create.l HWIO_RPMH_VRM_ENABLE_VOTE_DRV0_REG31_ADDR A:&base_addr+0x801f04
y.create.l HWIO_RPMH_VRM_ENABLE_VOTE_DRV0_REG32_ADDR A:&base_addr+0x802004
y.create.l HWIO_RPMH_VRM_ENABLE_VOTE_DRV0_REG33_ADDR A:&base_addr+0x802104
y.create.l HWIO_RPMH_VRM_ENABLE_VOTE_DRV0_REG34_ADDR A:&base_addr+0x802204
y.create.l HWIO_RPMH_VRM_ENABLE_VOTE_DRV0_REG35_ADDR A:&base_addr+0x802304
y.create.l HWIO_RPMH_VRM_ENABLE_VOTE_DRV0_REG36_ADDR A:&base_addr+0x802404
y.create.l HWIO_RPMH_VRM_ENABLE_VOTE_DRV0_REG37_ADDR A:&base_addr+0x802504
y.create.l HWIO_RPMH_VRM_ENABLE_VOTE_DRV0_REG38_ADDR A:&base_addr+0x802604
y.create.l HWIO_RPMH_VRM_ENABLE_VOTE_DRV0_REG39_ADDR A:&base_addr+0x802704
y.create.l HWIO_RPMH_VRM_ENABLE_VOTE_DRV0_REG40_ADDR A:&base_addr+0x802804
y.create.l HWIO_RPMH_VRM_ENABLE_VOTE_DRV0_REG41_ADDR A:&base_addr+0x802904
y.create.l HWIO_RPMH_VRM_ENABLE_VOTE_DRV0_REG42_ADDR A:&base_addr+0x802a04
y.create.l HWIO_RPMH_VRM_ENABLE_VOTE_DRV0_REG43_ADDR A:&base_addr+0x802b04
y.create.l HWIO_RPMH_VRM_ENABLE_VOTE_DRV0_REG44_ADDR A:&base_addr+0x802c04
y.create.l HWIO_RPMH_VRM_ENABLE_VOTE_DRV0_REG45_ADDR A:&base_addr+0x802d04
y.create.l HWIO_RPMH_VRM_ENABLE_VOTE_DRV1_REG0_ADDR A:&base_addr+0x810004
y.create.l HWIO_RPMH_VRM_ENABLE_VOTE_DRV1_REG1_ADDR A:&base_addr+0x810104
y.create.l HWIO_RPMH_VRM_ENABLE_VOTE_DRV1_REG2_ADDR A:&base_addr+0x810204
y.create.l HWIO_RPMH_VRM_ENABLE_VOTE_DRV1_REG3_ADDR A:&base_addr+0x810304
y.create.l HWIO_RPMH_VRM_ENABLE_VOTE_DRV1_REG4_ADDR A:&base_addr+0x810404
y.create.l HWIO_RPMH_VRM_ENABLE_VOTE_DRV1_REG5_ADDR A:&base_addr+0x810504
y.create.l HWIO_RPMH_VRM_ENABLE_VOTE_DRV1_REG6_ADDR A:&base_addr+0x810604
y.create.l HWIO_RPMH_VRM_ENABLE_VOTE_DRV1_REG7_ADDR A:&base_addr+0x810704
y.create.l HWIO_RPMH_VRM_ENABLE_VOTE_DRV1_REG8_ADDR A:&base_addr+0x810804
y.create.l HWIO_RPMH_VRM_ENABLE_VOTE_DRV1_REG9_ADDR A:&base_addr+0x810904
y.create.l HWIO_RPMH_VRM_ENABLE_VOTE_DRV1_REG10_ADDR A:&base_addr+0x810a04
y.create.l HWIO_RPMH_VRM_ENABLE_VOTE_DRV1_REG11_ADDR A:&base_addr+0x810b04
y.create.l HWIO_RPMH_VRM_ENABLE_VOTE_DRV1_REG12_ADDR A:&base_addr+0x810c04
y.create.l HWIO_RPMH_VRM_ENABLE_VOTE_DRV1_REG13_ADDR A:&base_addr+0x810d04
y.create.l HWIO_RPMH_VRM_ENABLE_VOTE_DRV1_REG14_ADDR A:&base_addr+0x810e04
y.create.l HWIO_RPMH_VRM_ENABLE_VOTE_DRV1_REG15_ADDR A:&base_addr+0x810f04
y.create.l HWIO_RPMH_VRM_ENABLE_VOTE_DRV1_REG16_ADDR A:&base_addr+0x811004
y.create.l HWIO_RPMH_VRM_ENABLE_VOTE_DRV1_REG17_ADDR A:&base_addr+0x811104
y.create.l HWIO_RPMH_VRM_ENABLE_VOTE_DRV1_REG18_ADDR A:&base_addr+0x811204
y.create.l HWIO_RPMH_VRM_ENABLE_VOTE_DRV1_REG19_ADDR A:&base_addr+0x811304
y.create.l HWIO_RPMH_VRM_ENABLE_VOTE_DRV1_REG20_ADDR A:&base_addr+0x811404
y.create.l HWIO_RPMH_VRM_ENABLE_VOTE_DRV1_REG21_ADDR A:&base_addr+0x811504
y.create.l HWIO_RPMH_VRM_ENABLE_VOTE_DRV1_REG22_ADDR A:&base_addr+0x811604
y.create.l HWIO_RPMH_VRM_ENABLE_VOTE_DRV1_REG23_ADDR A:&base_addr+0x811704
y.create.l HWIO_RPMH_VRM_ENABLE_VOTE_DRV1_REG24_ADDR A:&base_addr+0x811804
y.create.l HWIO_RPMH_VRM_ENABLE_VOTE_DRV1_REG25_ADDR A:&base_addr+0x811904
y.create.l HWIO_RPMH_VRM_ENABLE_VOTE_DRV1_REG26_ADDR A:&base_addr+0x811a04
y.create.l HWIO_RPMH_VRM_ENABLE_VOTE_DRV1_REG27_ADDR A:&base_addr+0x811b04
y.create.l HWIO_RPMH_VRM_ENABLE_VOTE_DRV1_REG28_ADDR A:&base_addr+0x811c04
y.create.l HWIO_RPMH_VRM_ENABLE_VOTE_DRV1_REG29_ADDR A:&base_addr+0x811d04
y.create.l HWIO_RPMH_VRM_ENABLE_VOTE_DRV1_REG30_ADDR A:&base_addr+0x811e04
y.create.l HWIO_RPMH_VRM_ENABLE_VOTE_DRV1_REG31_ADDR A:&base_addr+0x811f04
y.create.l HWIO_RPMH_VRM_ENABLE_VOTE_DRV1_REG32_ADDR A:&base_addr+0x812004
y.create.l HWIO_RPMH_VRM_ENABLE_VOTE_DRV1_REG33_ADDR A:&base_addr+0x812104
y.create.l HWIO_RPMH_VRM_ENABLE_VOTE_DRV1_REG34_ADDR A:&base_addr+0x812204
y.create.l HWIO_RPMH_VRM_ENABLE_VOTE_DRV1_REG35_ADDR A:&base_addr+0x812304
y.create.l HWIO_RPMH_VRM_ENABLE_VOTE_DRV1_REG36_ADDR A:&base_addr+0x812404
y.create.l HWIO_RPMH_VRM_ENABLE_VOTE_DRV1_REG37_ADDR A:&base_addr+0x812504
y.create.l HWIO_RPMH_VRM_ENABLE_VOTE_DRV1_REG38_ADDR A:&base_addr+0x812604
y.create.l HWIO_RPMH_VRM_ENABLE_VOTE_DRV1_REG39_ADDR A:&base_addr+0x812704
y.create.l HWIO_RPMH_VRM_ENABLE_VOTE_DRV1_REG40_ADDR A:&base_addr+0x812804
y.create.l HWIO_RPMH_VRM_ENABLE_VOTE_DRV1_REG41_ADDR A:&base_addr+0x812904
y.create.l HWIO_RPMH_VRM_ENABLE_VOTE_DRV1_REG42_ADDR A:&base_addr+0x812a04
y.create.l HWIO_RPMH_VRM_ENABLE_VOTE_DRV1_REG43_ADDR A:&base_addr+0x812b04
y.create.l HWIO_RPMH_VRM_ENABLE_VOTE_DRV1_REG44_ADDR A:&base_addr+0x812c04
y.create.l HWIO_RPMH_VRM_ENABLE_VOTE_DRV1_REG45_ADDR A:&base_addr+0x812d04
y.create.l HWIO_RPMH_VRM_ENABLE_VOTE_DRV2_REG0_ADDR A:&base_addr+0x820004
y.create.l HWIO_RPMH_VRM_ENABLE_VOTE_DRV2_REG1_ADDR A:&base_addr+0x820104
y.create.l HWIO_RPMH_VRM_ENABLE_VOTE_DRV2_REG2_ADDR A:&base_addr+0x820204
y.create.l HWIO_RPMH_VRM_ENABLE_VOTE_DRV2_REG3_ADDR A:&base_addr+0x820304
y.create.l HWIO_RPMH_VRM_ENABLE_VOTE_DRV2_REG4_ADDR A:&base_addr+0x820404
y.create.l HWIO_RPMH_VRM_ENABLE_VOTE_DRV2_REG5_ADDR A:&base_addr+0x820504
y.create.l HWIO_RPMH_VRM_ENABLE_VOTE_DRV2_REG6_ADDR A:&base_addr+0x820604
y.create.l HWIO_RPMH_VRM_ENABLE_VOTE_DRV2_REG7_ADDR A:&base_addr+0x820704
y.create.l HWIO_RPMH_VRM_ENABLE_VOTE_DRV2_REG8_ADDR A:&base_addr+0x820804
y.create.l HWIO_RPMH_VRM_ENABLE_VOTE_DRV2_REG9_ADDR A:&base_addr+0x820904
y.create.l HWIO_RPMH_VRM_ENABLE_VOTE_DRV2_REG10_ADDR A:&base_addr+0x820a04
y.create.l HWIO_RPMH_VRM_ENABLE_VOTE_DRV2_REG11_ADDR A:&base_addr+0x820b04
y.create.l HWIO_RPMH_VRM_ENABLE_VOTE_DRV2_REG12_ADDR A:&base_addr+0x820c04
y.create.l HWIO_RPMH_VRM_ENABLE_VOTE_DRV2_REG13_ADDR A:&base_addr+0x820d04
y.create.l HWIO_RPMH_VRM_ENABLE_VOTE_DRV2_REG14_ADDR A:&base_addr+0x820e04
y.create.l HWIO_RPMH_VRM_ENABLE_VOTE_DRV2_REG15_ADDR A:&base_addr+0x820f04
y.create.l HWIO_RPMH_VRM_ENABLE_VOTE_DRV2_REG16_ADDR A:&base_addr+0x821004
y.create.l HWIO_RPMH_VRM_ENABLE_VOTE_DRV2_REG17_ADDR A:&base_addr+0x821104
y.create.l HWIO_RPMH_VRM_ENABLE_VOTE_DRV2_REG18_ADDR A:&base_addr+0x821204
y.create.l HWIO_RPMH_VRM_ENABLE_VOTE_DRV2_REG19_ADDR A:&base_addr+0x821304
y.create.l HWIO_RPMH_VRM_ENABLE_VOTE_DRV2_REG20_ADDR A:&base_addr+0x821404
y.create.l HWIO_RPMH_VRM_ENABLE_VOTE_DRV2_REG21_ADDR A:&base_addr+0x821504
y.create.l HWIO_RPMH_VRM_ENABLE_VOTE_DRV2_REG22_ADDR A:&base_addr+0x821604
y.create.l HWIO_RPMH_VRM_ENABLE_VOTE_DRV2_REG23_ADDR A:&base_addr+0x821704
y.create.l HWIO_RPMH_VRM_ENABLE_VOTE_DRV2_REG24_ADDR A:&base_addr+0x821804
y.create.l HWIO_RPMH_VRM_ENABLE_VOTE_DRV2_REG25_ADDR A:&base_addr+0x821904
y.create.l HWIO_RPMH_VRM_ENABLE_VOTE_DRV2_REG26_ADDR A:&base_addr+0x821a04
y.create.l HWIO_RPMH_VRM_ENABLE_VOTE_DRV2_REG27_ADDR A:&base_addr+0x821b04
y.create.l HWIO_RPMH_VRM_ENABLE_VOTE_DRV2_REG28_ADDR A:&base_addr+0x821c04
y.create.l HWIO_RPMH_VRM_ENABLE_VOTE_DRV2_REG29_ADDR A:&base_addr+0x821d04
y.create.l HWIO_RPMH_VRM_ENABLE_VOTE_DRV2_REG30_ADDR A:&base_addr+0x821e04
y.create.l HWIO_RPMH_VRM_ENABLE_VOTE_DRV2_REG31_ADDR A:&base_addr+0x821f04
y.create.l HWIO_RPMH_VRM_ENABLE_VOTE_DRV2_REG32_ADDR A:&base_addr+0x822004
y.create.l HWIO_RPMH_VRM_ENABLE_VOTE_DRV2_REG33_ADDR A:&base_addr+0x822104
y.create.l HWIO_RPMH_VRM_ENABLE_VOTE_DRV2_REG34_ADDR A:&base_addr+0x822204
y.create.l HWIO_RPMH_VRM_ENABLE_VOTE_DRV2_REG35_ADDR A:&base_addr+0x822304
y.create.l HWIO_RPMH_VRM_ENABLE_VOTE_DRV2_REG36_ADDR A:&base_addr+0x822404
y.create.l HWIO_RPMH_VRM_ENABLE_VOTE_DRV2_REG37_ADDR A:&base_addr+0x822504
y.create.l HWIO_RPMH_VRM_ENABLE_VOTE_DRV2_REG38_ADDR A:&base_addr+0x822604
y.create.l HWIO_RPMH_VRM_ENABLE_VOTE_DRV2_REG39_ADDR A:&base_addr+0x822704
y.create.l HWIO_RPMH_VRM_ENABLE_VOTE_DRV2_REG40_ADDR A:&base_addr+0x822804
y.create.l HWIO_RPMH_VRM_ENABLE_VOTE_DRV2_REG41_ADDR A:&base_addr+0x822904
y.create.l HWIO_RPMH_VRM_ENABLE_VOTE_DRV2_REG42_ADDR A:&base_addr+0x822a04
y.create.l HWIO_RPMH_VRM_ENABLE_VOTE_DRV2_REG43_ADDR A:&base_addr+0x822b04
y.create.l HWIO_RPMH_VRM_ENABLE_VOTE_DRV2_REG44_ADDR A:&base_addr+0x822c04
y.create.l HWIO_RPMH_VRM_ENABLE_VOTE_DRV2_REG45_ADDR A:&base_addr+0x822d04
y.create.l HWIO_RPMH_VRM_ENABLE_VOTE_DRV3_REG0_ADDR A:&base_addr+0x830004
y.create.l HWIO_RPMH_VRM_ENABLE_VOTE_DRV3_REG1_ADDR A:&base_addr+0x830104
y.create.l HWIO_RPMH_VRM_ENABLE_VOTE_DRV3_REG2_ADDR A:&base_addr+0x830204
y.create.l HWIO_RPMH_VRM_ENABLE_VOTE_DRV3_REG3_ADDR A:&base_addr+0x830304
y.create.l HWIO_RPMH_VRM_ENABLE_VOTE_DRV3_REG4_ADDR A:&base_addr+0x830404
y.create.l HWIO_RPMH_VRM_ENABLE_VOTE_DRV3_REG5_ADDR A:&base_addr+0x830504
y.create.l HWIO_RPMH_VRM_ENABLE_VOTE_DRV3_REG6_ADDR A:&base_addr+0x830604
y.create.l HWIO_RPMH_VRM_ENABLE_VOTE_DRV3_REG7_ADDR A:&base_addr+0x830704
y.create.l HWIO_RPMH_VRM_ENABLE_VOTE_DRV3_REG8_ADDR A:&base_addr+0x830804
y.create.l HWIO_RPMH_VRM_ENABLE_VOTE_DRV3_REG9_ADDR A:&base_addr+0x830904
y.create.l HWIO_RPMH_VRM_ENABLE_VOTE_DRV3_REG10_ADDR A:&base_addr+0x830a04
y.create.l HWIO_RPMH_VRM_ENABLE_VOTE_DRV3_REG11_ADDR A:&base_addr+0x830b04
y.create.l HWIO_RPMH_VRM_ENABLE_VOTE_DRV3_REG12_ADDR A:&base_addr+0x830c04
y.create.l HWIO_RPMH_VRM_ENABLE_VOTE_DRV3_REG13_ADDR A:&base_addr+0x830d04
y.create.l HWIO_RPMH_VRM_ENABLE_VOTE_DRV3_REG14_ADDR A:&base_addr+0x830e04
y.create.l HWIO_RPMH_VRM_ENABLE_VOTE_DRV3_REG15_ADDR A:&base_addr+0x830f04
y.create.l HWIO_RPMH_VRM_ENABLE_VOTE_DRV3_REG16_ADDR A:&base_addr+0x831004
y.create.l HWIO_RPMH_VRM_ENABLE_VOTE_DRV3_REG17_ADDR A:&base_addr+0x831104
y.create.l HWIO_RPMH_VRM_ENABLE_VOTE_DRV3_REG18_ADDR A:&base_addr+0x831204
y.create.l HWIO_RPMH_VRM_ENABLE_VOTE_DRV3_REG19_ADDR A:&base_addr+0x831304
y.create.l HWIO_RPMH_VRM_ENABLE_VOTE_DRV3_REG20_ADDR A:&base_addr+0x831404
y.create.l HWIO_RPMH_VRM_ENABLE_VOTE_DRV3_REG21_ADDR A:&base_addr+0x831504
y.create.l HWIO_RPMH_VRM_ENABLE_VOTE_DRV3_REG22_ADDR A:&base_addr+0x831604
y.create.l HWIO_RPMH_VRM_ENABLE_VOTE_DRV3_REG23_ADDR A:&base_addr+0x831704
y.create.l HWIO_RPMH_VRM_ENABLE_VOTE_DRV3_REG24_ADDR A:&base_addr+0x831804
y.create.l HWIO_RPMH_VRM_ENABLE_VOTE_DRV3_REG25_ADDR A:&base_addr+0x831904
y.create.l HWIO_RPMH_VRM_ENABLE_VOTE_DRV3_REG26_ADDR A:&base_addr+0x831a04
y.create.l HWIO_RPMH_VRM_ENABLE_VOTE_DRV3_REG27_ADDR A:&base_addr+0x831b04
y.create.l HWIO_RPMH_VRM_ENABLE_VOTE_DRV3_REG28_ADDR A:&base_addr+0x831c04
y.create.l HWIO_RPMH_VRM_ENABLE_VOTE_DRV3_REG29_ADDR A:&base_addr+0x831d04
y.create.l HWIO_RPMH_VRM_ENABLE_VOTE_DRV3_REG30_ADDR A:&base_addr+0x831e04
y.create.l HWIO_RPMH_VRM_ENABLE_VOTE_DRV3_REG31_ADDR A:&base_addr+0x831f04
y.create.l HWIO_RPMH_VRM_ENABLE_VOTE_DRV3_REG32_ADDR A:&base_addr+0x832004
y.create.l HWIO_RPMH_VRM_ENABLE_VOTE_DRV3_REG33_ADDR A:&base_addr+0x832104
y.create.l HWIO_RPMH_VRM_ENABLE_VOTE_DRV3_REG34_ADDR A:&base_addr+0x832204
y.create.l HWIO_RPMH_VRM_ENABLE_VOTE_DRV3_REG35_ADDR A:&base_addr+0x832304
y.create.l HWIO_RPMH_VRM_ENABLE_VOTE_DRV3_REG36_ADDR A:&base_addr+0x832404
y.create.l HWIO_RPMH_VRM_ENABLE_VOTE_DRV3_REG37_ADDR A:&base_addr+0x832504
y.create.l HWIO_RPMH_VRM_ENABLE_VOTE_DRV3_REG38_ADDR A:&base_addr+0x832604
y.create.l HWIO_RPMH_VRM_ENABLE_VOTE_DRV3_REG39_ADDR A:&base_addr+0x832704
y.create.l HWIO_RPMH_VRM_ENABLE_VOTE_DRV3_REG40_ADDR A:&base_addr+0x832804
y.create.l HWIO_RPMH_VRM_ENABLE_VOTE_DRV3_REG41_ADDR A:&base_addr+0x832904
y.create.l HWIO_RPMH_VRM_ENABLE_VOTE_DRV3_REG42_ADDR A:&base_addr+0x832a04
y.create.l HWIO_RPMH_VRM_ENABLE_VOTE_DRV3_REG43_ADDR A:&base_addr+0x832b04
y.create.l HWIO_RPMH_VRM_ENABLE_VOTE_DRV3_REG44_ADDR A:&base_addr+0x832c04
y.create.l HWIO_RPMH_VRM_ENABLE_VOTE_DRV3_REG45_ADDR A:&base_addr+0x832d04
y.create.l HWIO_RPMH_VRM_ENABLE_VOTE_DRV4_REG0_ADDR A:&base_addr+0x840004
y.create.l HWIO_RPMH_VRM_ENABLE_VOTE_DRV4_REG1_ADDR A:&base_addr+0x840104
y.create.l HWIO_RPMH_VRM_ENABLE_VOTE_DRV4_REG2_ADDR A:&base_addr+0x840204
y.create.l HWIO_RPMH_VRM_ENABLE_VOTE_DRV4_REG3_ADDR A:&base_addr+0x840304
y.create.l HWIO_RPMH_VRM_ENABLE_VOTE_DRV4_REG4_ADDR A:&base_addr+0x840404
y.create.l HWIO_RPMH_VRM_ENABLE_VOTE_DRV4_REG5_ADDR A:&base_addr+0x840504
y.create.l HWIO_RPMH_VRM_ENABLE_VOTE_DRV4_REG6_ADDR A:&base_addr+0x840604
y.create.l HWIO_RPMH_VRM_ENABLE_VOTE_DRV4_REG7_ADDR A:&base_addr+0x840704
y.create.l HWIO_RPMH_VRM_ENABLE_VOTE_DRV4_REG8_ADDR A:&base_addr+0x840804
y.create.l HWIO_RPMH_VRM_ENABLE_VOTE_DRV4_REG9_ADDR A:&base_addr+0x840904
y.create.l HWIO_RPMH_VRM_ENABLE_VOTE_DRV4_REG10_ADDR A:&base_addr+0x840a04
y.create.l HWIO_RPMH_VRM_ENABLE_VOTE_DRV4_REG11_ADDR A:&base_addr+0x840b04
y.create.l HWIO_RPMH_VRM_ENABLE_VOTE_DRV4_REG12_ADDR A:&base_addr+0x840c04
y.create.l HWIO_RPMH_VRM_ENABLE_VOTE_DRV4_REG13_ADDR A:&base_addr+0x840d04
y.create.l HWIO_RPMH_VRM_ENABLE_VOTE_DRV4_REG14_ADDR A:&base_addr+0x840e04
y.create.l HWIO_RPMH_VRM_ENABLE_VOTE_DRV4_REG15_ADDR A:&base_addr+0x840f04
y.create.l HWIO_RPMH_VRM_ENABLE_VOTE_DRV4_REG16_ADDR A:&base_addr+0x841004
y.create.l HWIO_RPMH_VRM_ENABLE_VOTE_DRV4_REG17_ADDR A:&base_addr+0x841104
y.create.l HWIO_RPMH_VRM_ENABLE_VOTE_DRV4_REG18_ADDR A:&base_addr+0x841204
y.create.l HWIO_RPMH_VRM_ENABLE_VOTE_DRV4_REG19_ADDR A:&base_addr+0x841304
y.create.l HWIO_RPMH_VRM_ENABLE_VOTE_DRV4_REG20_ADDR A:&base_addr+0x841404
y.create.l HWIO_RPMH_VRM_ENABLE_VOTE_DRV4_REG21_ADDR A:&base_addr+0x841504
y.create.l HWIO_RPMH_VRM_ENABLE_VOTE_DRV4_REG22_ADDR A:&base_addr+0x841604
y.create.l HWIO_RPMH_VRM_ENABLE_VOTE_DRV4_REG23_ADDR A:&base_addr+0x841704
y.create.l HWIO_RPMH_VRM_ENABLE_VOTE_DRV4_REG24_ADDR A:&base_addr+0x841804
y.create.l HWIO_RPMH_VRM_ENABLE_VOTE_DRV4_REG25_ADDR A:&base_addr+0x841904
y.create.l HWIO_RPMH_VRM_ENABLE_VOTE_DRV4_REG26_ADDR A:&base_addr+0x841a04
y.create.l HWIO_RPMH_VRM_ENABLE_VOTE_DRV4_REG27_ADDR A:&base_addr+0x841b04
y.create.l HWIO_RPMH_VRM_ENABLE_VOTE_DRV4_REG28_ADDR A:&base_addr+0x841c04
y.create.l HWIO_RPMH_VRM_ENABLE_VOTE_DRV4_REG29_ADDR A:&base_addr+0x841d04
y.create.l HWIO_RPMH_VRM_ENABLE_VOTE_DRV4_REG30_ADDR A:&base_addr+0x841e04
y.create.l HWIO_RPMH_VRM_ENABLE_VOTE_DRV4_REG31_ADDR A:&base_addr+0x841f04
y.create.l HWIO_RPMH_VRM_ENABLE_VOTE_DRV4_REG32_ADDR A:&base_addr+0x842004
y.create.l HWIO_RPMH_VRM_ENABLE_VOTE_DRV4_REG33_ADDR A:&base_addr+0x842104
y.create.l HWIO_RPMH_VRM_ENABLE_VOTE_DRV4_REG34_ADDR A:&base_addr+0x842204
y.create.l HWIO_RPMH_VRM_ENABLE_VOTE_DRV4_REG35_ADDR A:&base_addr+0x842304
y.create.l HWIO_RPMH_VRM_ENABLE_VOTE_DRV4_REG36_ADDR A:&base_addr+0x842404
y.create.l HWIO_RPMH_VRM_ENABLE_VOTE_DRV4_REG37_ADDR A:&base_addr+0x842504
y.create.l HWIO_RPMH_VRM_ENABLE_VOTE_DRV4_REG38_ADDR A:&base_addr+0x842604
y.create.l HWIO_RPMH_VRM_ENABLE_VOTE_DRV4_REG39_ADDR A:&base_addr+0x842704
y.create.l HWIO_RPMH_VRM_ENABLE_VOTE_DRV4_REG40_ADDR A:&base_addr+0x842804
y.create.l HWIO_RPMH_VRM_ENABLE_VOTE_DRV4_REG41_ADDR A:&base_addr+0x842904
y.create.l HWIO_RPMH_VRM_ENABLE_VOTE_DRV4_REG42_ADDR A:&base_addr+0x842a04
y.create.l HWIO_RPMH_VRM_ENABLE_VOTE_DRV4_REG43_ADDR A:&base_addr+0x842b04
y.create.l HWIO_RPMH_VRM_ENABLE_VOTE_DRV4_REG44_ADDR A:&base_addr+0x842c04
y.create.l HWIO_RPMH_VRM_ENABLE_VOTE_DRV4_REG45_ADDR A:&base_addr+0x842d04
y.create.l HWIO_RPMH_VRM_ENABLE_VOTE_DRV5_REG0_ADDR A:&base_addr+0x850004
y.create.l HWIO_RPMH_VRM_ENABLE_VOTE_DRV5_REG1_ADDR A:&base_addr+0x850104
y.create.l HWIO_RPMH_VRM_ENABLE_VOTE_DRV5_REG2_ADDR A:&base_addr+0x850204
y.create.l HWIO_RPMH_VRM_ENABLE_VOTE_DRV5_REG3_ADDR A:&base_addr+0x850304
y.create.l HWIO_RPMH_VRM_ENABLE_VOTE_DRV5_REG4_ADDR A:&base_addr+0x850404
y.create.l HWIO_RPMH_VRM_ENABLE_VOTE_DRV5_REG5_ADDR A:&base_addr+0x850504
y.create.l HWIO_RPMH_VRM_ENABLE_VOTE_DRV5_REG6_ADDR A:&base_addr+0x850604
y.create.l HWIO_RPMH_VRM_ENABLE_VOTE_DRV5_REG7_ADDR A:&base_addr+0x850704
y.create.l HWIO_RPMH_VRM_ENABLE_VOTE_DRV5_REG8_ADDR A:&base_addr+0x850804
y.create.l HWIO_RPMH_VRM_ENABLE_VOTE_DRV5_REG9_ADDR A:&base_addr+0x850904
y.create.l HWIO_RPMH_VRM_ENABLE_VOTE_DRV5_REG10_ADDR A:&base_addr+0x850a04
y.create.l HWIO_RPMH_VRM_ENABLE_VOTE_DRV5_REG11_ADDR A:&base_addr+0x850b04
y.create.l HWIO_RPMH_VRM_ENABLE_VOTE_DRV5_REG12_ADDR A:&base_addr+0x850c04
y.create.l HWIO_RPMH_VRM_ENABLE_VOTE_DRV5_REG13_ADDR A:&base_addr+0x850d04
y.create.l HWIO_RPMH_VRM_ENABLE_VOTE_DRV5_REG14_ADDR A:&base_addr+0x850e04
y.create.l HWIO_RPMH_VRM_ENABLE_VOTE_DRV5_REG15_ADDR A:&base_addr+0x850f04
y.create.l HWIO_RPMH_VRM_ENABLE_VOTE_DRV5_REG16_ADDR A:&base_addr+0x851004
y.create.l HWIO_RPMH_VRM_ENABLE_VOTE_DRV5_REG17_ADDR A:&base_addr+0x851104
y.create.l HWIO_RPMH_VRM_ENABLE_VOTE_DRV5_REG18_ADDR A:&base_addr+0x851204
y.create.l HWIO_RPMH_VRM_ENABLE_VOTE_DRV5_REG19_ADDR A:&base_addr+0x851304
y.create.l HWIO_RPMH_VRM_ENABLE_VOTE_DRV5_REG20_ADDR A:&base_addr+0x851404
y.create.l HWIO_RPMH_VRM_ENABLE_VOTE_DRV5_REG21_ADDR A:&base_addr+0x851504
y.create.l HWIO_RPMH_VRM_ENABLE_VOTE_DRV5_REG22_ADDR A:&base_addr+0x851604
y.create.l HWIO_RPMH_VRM_ENABLE_VOTE_DRV5_REG23_ADDR A:&base_addr+0x851704
y.create.l HWIO_RPMH_VRM_ENABLE_VOTE_DRV5_REG24_ADDR A:&base_addr+0x851804
y.create.l HWIO_RPMH_VRM_ENABLE_VOTE_DRV5_REG25_ADDR A:&base_addr+0x851904
y.create.l HWIO_RPMH_VRM_ENABLE_VOTE_DRV5_REG26_ADDR A:&base_addr+0x851a04
y.create.l HWIO_RPMH_VRM_ENABLE_VOTE_DRV5_REG27_ADDR A:&base_addr+0x851b04
y.create.l HWIO_RPMH_VRM_ENABLE_VOTE_DRV5_REG28_ADDR A:&base_addr+0x851c04
y.create.l HWIO_RPMH_VRM_ENABLE_VOTE_DRV5_REG29_ADDR A:&base_addr+0x851d04
y.create.l HWIO_RPMH_VRM_ENABLE_VOTE_DRV5_REG30_ADDR A:&base_addr+0x851e04
y.create.l HWIO_RPMH_VRM_ENABLE_VOTE_DRV5_REG31_ADDR A:&base_addr+0x851f04
y.create.l HWIO_RPMH_VRM_ENABLE_VOTE_DRV5_REG32_ADDR A:&base_addr+0x852004
y.create.l HWIO_RPMH_VRM_ENABLE_VOTE_DRV5_REG33_ADDR A:&base_addr+0x852104
y.create.l HWIO_RPMH_VRM_ENABLE_VOTE_DRV5_REG34_ADDR A:&base_addr+0x852204
y.create.l HWIO_RPMH_VRM_ENABLE_VOTE_DRV5_REG35_ADDR A:&base_addr+0x852304
y.create.l HWIO_RPMH_VRM_ENABLE_VOTE_DRV5_REG36_ADDR A:&base_addr+0x852404
y.create.l HWIO_RPMH_VRM_ENABLE_VOTE_DRV5_REG37_ADDR A:&base_addr+0x852504
y.create.l HWIO_RPMH_VRM_ENABLE_VOTE_DRV5_REG38_ADDR A:&base_addr+0x852604
y.create.l HWIO_RPMH_VRM_ENABLE_VOTE_DRV5_REG39_ADDR A:&base_addr+0x852704
y.create.l HWIO_RPMH_VRM_ENABLE_VOTE_DRV5_REG40_ADDR A:&base_addr+0x852804
y.create.l HWIO_RPMH_VRM_ENABLE_VOTE_DRV5_REG41_ADDR A:&base_addr+0x852904
y.create.l HWIO_RPMH_VRM_ENABLE_VOTE_DRV5_REG42_ADDR A:&base_addr+0x852a04
y.create.l HWIO_RPMH_VRM_ENABLE_VOTE_DRV5_REG43_ADDR A:&base_addr+0x852b04
y.create.l HWIO_RPMH_VRM_ENABLE_VOTE_DRV5_REG44_ADDR A:&base_addr+0x852c04
y.create.l HWIO_RPMH_VRM_ENABLE_VOTE_DRV5_REG45_ADDR A:&base_addr+0x852d04
y.create.l HWIO_RPMH_VRM_ENABLE_VOTE_DRV6_REG0_ADDR A:&base_addr+0x860004
y.create.l HWIO_RPMH_VRM_ENABLE_VOTE_DRV6_REG1_ADDR A:&base_addr+0x860104
y.create.l HWIO_RPMH_VRM_ENABLE_VOTE_DRV6_REG2_ADDR A:&base_addr+0x860204
y.create.l HWIO_RPMH_VRM_ENABLE_VOTE_DRV6_REG3_ADDR A:&base_addr+0x860304
y.create.l HWIO_RPMH_VRM_ENABLE_VOTE_DRV6_REG4_ADDR A:&base_addr+0x860404
y.create.l HWIO_RPMH_VRM_ENABLE_VOTE_DRV6_REG5_ADDR A:&base_addr+0x860504
y.create.l HWIO_RPMH_VRM_ENABLE_VOTE_DRV6_REG6_ADDR A:&base_addr+0x860604
y.create.l HWIO_RPMH_VRM_ENABLE_VOTE_DRV6_REG7_ADDR A:&base_addr+0x860704
y.create.l HWIO_RPMH_VRM_ENABLE_VOTE_DRV6_REG8_ADDR A:&base_addr+0x860804
y.create.l HWIO_RPMH_VRM_ENABLE_VOTE_DRV6_REG9_ADDR A:&base_addr+0x860904
y.create.l HWIO_RPMH_VRM_ENABLE_VOTE_DRV6_REG10_ADDR A:&base_addr+0x860a04
y.create.l HWIO_RPMH_VRM_ENABLE_VOTE_DRV6_REG11_ADDR A:&base_addr+0x860b04
y.create.l HWIO_RPMH_VRM_ENABLE_VOTE_DRV6_REG12_ADDR A:&base_addr+0x860c04
y.create.l HWIO_RPMH_VRM_ENABLE_VOTE_DRV6_REG13_ADDR A:&base_addr+0x860d04
y.create.l HWIO_RPMH_VRM_ENABLE_VOTE_DRV6_REG14_ADDR A:&base_addr+0x860e04
y.create.l HWIO_RPMH_VRM_ENABLE_VOTE_DRV6_REG15_ADDR A:&base_addr+0x860f04
y.create.l HWIO_RPMH_VRM_ENABLE_VOTE_DRV6_REG16_ADDR A:&base_addr+0x861004
y.create.l HWIO_RPMH_VRM_ENABLE_VOTE_DRV6_REG17_ADDR A:&base_addr+0x861104
y.create.l HWIO_RPMH_VRM_ENABLE_VOTE_DRV6_REG18_ADDR A:&base_addr+0x861204
y.create.l HWIO_RPMH_VRM_ENABLE_VOTE_DRV6_REG19_ADDR A:&base_addr+0x861304
y.create.l HWIO_RPMH_VRM_ENABLE_VOTE_DRV6_REG20_ADDR A:&base_addr+0x861404
y.create.l HWIO_RPMH_VRM_ENABLE_VOTE_DRV6_REG21_ADDR A:&base_addr+0x861504
y.create.l HWIO_RPMH_VRM_ENABLE_VOTE_DRV6_REG22_ADDR A:&base_addr+0x861604
y.create.l HWIO_RPMH_VRM_ENABLE_VOTE_DRV6_REG23_ADDR A:&base_addr+0x861704
y.create.l HWIO_RPMH_VRM_ENABLE_VOTE_DRV6_REG24_ADDR A:&base_addr+0x861804
y.create.l HWIO_RPMH_VRM_ENABLE_VOTE_DRV6_REG25_ADDR A:&base_addr+0x861904
y.create.l HWIO_RPMH_VRM_ENABLE_VOTE_DRV6_REG26_ADDR A:&base_addr+0x861a04
y.create.l HWIO_RPMH_VRM_ENABLE_VOTE_DRV6_REG27_ADDR A:&base_addr+0x861b04
y.create.l HWIO_RPMH_VRM_ENABLE_VOTE_DRV6_REG28_ADDR A:&base_addr+0x861c04
y.create.l HWIO_RPMH_VRM_ENABLE_VOTE_DRV6_REG29_ADDR A:&base_addr+0x861d04
y.create.l HWIO_RPMH_VRM_ENABLE_VOTE_DRV6_REG30_ADDR A:&base_addr+0x861e04
y.create.l HWIO_RPMH_VRM_ENABLE_VOTE_DRV6_REG31_ADDR A:&base_addr+0x861f04
y.create.l HWIO_RPMH_VRM_ENABLE_VOTE_DRV6_REG32_ADDR A:&base_addr+0x862004
y.create.l HWIO_RPMH_VRM_ENABLE_VOTE_DRV6_REG33_ADDR A:&base_addr+0x862104
y.create.l HWIO_RPMH_VRM_ENABLE_VOTE_DRV6_REG34_ADDR A:&base_addr+0x862204
y.create.l HWIO_RPMH_VRM_ENABLE_VOTE_DRV6_REG35_ADDR A:&base_addr+0x862304
y.create.l HWIO_RPMH_VRM_ENABLE_VOTE_DRV6_REG36_ADDR A:&base_addr+0x862404
y.create.l HWIO_RPMH_VRM_ENABLE_VOTE_DRV6_REG37_ADDR A:&base_addr+0x862504
y.create.l HWIO_RPMH_VRM_ENABLE_VOTE_DRV6_REG38_ADDR A:&base_addr+0x862604
y.create.l HWIO_RPMH_VRM_ENABLE_VOTE_DRV6_REG39_ADDR A:&base_addr+0x862704
y.create.l HWIO_RPMH_VRM_ENABLE_VOTE_DRV6_REG40_ADDR A:&base_addr+0x862804
y.create.l HWIO_RPMH_VRM_ENABLE_VOTE_DRV6_REG41_ADDR A:&base_addr+0x862904
y.create.l HWIO_RPMH_VRM_ENABLE_VOTE_DRV6_REG42_ADDR A:&base_addr+0x862a04
y.create.l HWIO_RPMH_VRM_ENABLE_VOTE_DRV6_REG43_ADDR A:&base_addr+0x862b04
y.create.l HWIO_RPMH_VRM_ENABLE_VOTE_DRV6_REG44_ADDR A:&base_addr+0x862c04
y.create.l HWIO_RPMH_VRM_ENABLE_VOTE_DRV6_REG45_ADDR A:&base_addr+0x862d04
y.create.l HWIO_RPMH_VRM_ENABLE_VOTE_DRV7_REG0_ADDR A:&base_addr+0x870004
y.create.l HWIO_RPMH_VRM_ENABLE_VOTE_DRV7_REG1_ADDR A:&base_addr+0x870104
y.create.l HWIO_RPMH_VRM_ENABLE_VOTE_DRV7_REG2_ADDR A:&base_addr+0x870204
y.create.l HWIO_RPMH_VRM_ENABLE_VOTE_DRV7_REG3_ADDR A:&base_addr+0x870304
y.create.l HWIO_RPMH_VRM_ENABLE_VOTE_DRV7_REG4_ADDR A:&base_addr+0x870404
y.create.l HWIO_RPMH_VRM_ENABLE_VOTE_DRV7_REG5_ADDR A:&base_addr+0x870504
y.create.l HWIO_RPMH_VRM_ENABLE_VOTE_DRV7_REG6_ADDR A:&base_addr+0x870604
y.create.l HWIO_RPMH_VRM_ENABLE_VOTE_DRV7_REG7_ADDR A:&base_addr+0x870704
y.create.l HWIO_RPMH_VRM_ENABLE_VOTE_DRV7_REG8_ADDR A:&base_addr+0x870804
y.create.l HWIO_RPMH_VRM_ENABLE_VOTE_DRV7_REG9_ADDR A:&base_addr+0x870904
y.create.l HWIO_RPMH_VRM_ENABLE_VOTE_DRV7_REG10_ADDR A:&base_addr+0x870a04
y.create.l HWIO_RPMH_VRM_ENABLE_VOTE_DRV7_REG11_ADDR A:&base_addr+0x870b04
y.create.l HWIO_RPMH_VRM_ENABLE_VOTE_DRV7_REG12_ADDR A:&base_addr+0x870c04
y.create.l HWIO_RPMH_VRM_ENABLE_VOTE_DRV7_REG13_ADDR A:&base_addr+0x870d04
y.create.l HWIO_RPMH_VRM_ENABLE_VOTE_DRV7_REG14_ADDR A:&base_addr+0x870e04
y.create.l HWIO_RPMH_VRM_ENABLE_VOTE_DRV7_REG15_ADDR A:&base_addr+0x870f04
y.create.l HWIO_RPMH_VRM_ENABLE_VOTE_DRV7_REG16_ADDR A:&base_addr+0x871004
y.create.l HWIO_RPMH_VRM_ENABLE_VOTE_DRV7_REG17_ADDR A:&base_addr+0x871104
y.create.l HWIO_RPMH_VRM_ENABLE_VOTE_DRV7_REG18_ADDR A:&base_addr+0x871204
y.create.l HWIO_RPMH_VRM_ENABLE_VOTE_DRV7_REG19_ADDR A:&base_addr+0x871304
y.create.l HWIO_RPMH_VRM_ENABLE_VOTE_DRV7_REG20_ADDR A:&base_addr+0x871404
y.create.l HWIO_RPMH_VRM_ENABLE_VOTE_DRV7_REG21_ADDR A:&base_addr+0x871504
y.create.l HWIO_RPMH_VRM_ENABLE_VOTE_DRV7_REG22_ADDR A:&base_addr+0x871604
y.create.l HWIO_RPMH_VRM_ENABLE_VOTE_DRV7_REG23_ADDR A:&base_addr+0x871704
y.create.l HWIO_RPMH_VRM_ENABLE_VOTE_DRV7_REG24_ADDR A:&base_addr+0x871804
y.create.l HWIO_RPMH_VRM_ENABLE_VOTE_DRV7_REG25_ADDR A:&base_addr+0x871904
y.create.l HWIO_RPMH_VRM_ENABLE_VOTE_DRV7_REG26_ADDR A:&base_addr+0x871a04
y.create.l HWIO_RPMH_VRM_ENABLE_VOTE_DRV7_REG27_ADDR A:&base_addr+0x871b04
y.create.l HWIO_RPMH_VRM_ENABLE_VOTE_DRV7_REG28_ADDR A:&base_addr+0x871c04
y.create.l HWIO_RPMH_VRM_ENABLE_VOTE_DRV7_REG29_ADDR A:&base_addr+0x871d04
y.create.l HWIO_RPMH_VRM_ENABLE_VOTE_DRV7_REG30_ADDR A:&base_addr+0x871e04
y.create.l HWIO_RPMH_VRM_ENABLE_VOTE_DRV7_REG31_ADDR A:&base_addr+0x871f04
y.create.l HWIO_RPMH_VRM_ENABLE_VOTE_DRV7_REG32_ADDR A:&base_addr+0x872004
y.create.l HWIO_RPMH_VRM_ENABLE_VOTE_DRV7_REG33_ADDR A:&base_addr+0x872104
y.create.l HWIO_RPMH_VRM_ENABLE_VOTE_DRV7_REG34_ADDR A:&base_addr+0x872204
y.create.l HWIO_RPMH_VRM_ENABLE_VOTE_DRV7_REG35_ADDR A:&base_addr+0x872304
y.create.l HWIO_RPMH_VRM_ENABLE_VOTE_DRV7_REG36_ADDR A:&base_addr+0x872404
y.create.l HWIO_RPMH_VRM_ENABLE_VOTE_DRV7_REG37_ADDR A:&base_addr+0x872504
y.create.l HWIO_RPMH_VRM_ENABLE_VOTE_DRV7_REG38_ADDR A:&base_addr+0x872604
y.create.l HWIO_RPMH_VRM_ENABLE_VOTE_DRV7_REG39_ADDR A:&base_addr+0x872704
y.create.l HWIO_RPMH_VRM_ENABLE_VOTE_DRV7_REG40_ADDR A:&base_addr+0x872804
y.create.l HWIO_RPMH_VRM_ENABLE_VOTE_DRV7_REG41_ADDR A:&base_addr+0x872904
y.create.l HWIO_RPMH_VRM_ENABLE_VOTE_DRV7_REG42_ADDR A:&base_addr+0x872a04
y.create.l HWIO_RPMH_VRM_ENABLE_VOTE_DRV7_REG43_ADDR A:&base_addr+0x872b04
y.create.l HWIO_RPMH_VRM_ENABLE_VOTE_DRV7_REG44_ADDR A:&base_addr+0x872c04
y.create.l HWIO_RPMH_VRM_ENABLE_VOTE_DRV7_REG45_ADDR A:&base_addr+0x872d04
y.create.l HWIO_RPMH_VRM_ENABLE_VOTE_DRV8_REG0_ADDR A:&base_addr+0x880004
y.create.l HWIO_RPMH_VRM_ENABLE_VOTE_DRV8_REG1_ADDR A:&base_addr+0x880104
y.create.l HWIO_RPMH_VRM_ENABLE_VOTE_DRV8_REG2_ADDR A:&base_addr+0x880204
y.create.l HWIO_RPMH_VRM_ENABLE_VOTE_DRV8_REG3_ADDR A:&base_addr+0x880304
y.create.l HWIO_RPMH_VRM_ENABLE_VOTE_DRV8_REG4_ADDR A:&base_addr+0x880404
y.create.l HWIO_RPMH_VRM_ENABLE_VOTE_DRV8_REG5_ADDR A:&base_addr+0x880504
y.create.l HWIO_RPMH_VRM_ENABLE_VOTE_DRV8_REG6_ADDR A:&base_addr+0x880604
y.create.l HWIO_RPMH_VRM_ENABLE_VOTE_DRV8_REG7_ADDR A:&base_addr+0x880704
y.create.l HWIO_RPMH_VRM_ENABLE_VOTE_DRV8_REG8_ADDR A:&base_addr+0x880804
y.create.l HWIO_RPMH_VRM_ENABLE_VOTE_DRV8_REG9_ADDR A:&base_addr+0x880904
y.create.l HWIO_RPMH_VRM_ENABLE_VOTE_DRV8_REG10_ADDR A:&base_addr+0x880a04
y.create.l HWIO_RPMH_VRM_ENABLE_VOTE_DRV8_REG11_ADDR A:&base_addr+0x880b04
y.create.l HWIO_RPMH_VRM_ENABLE_VOTE_DRV8_REG12_ADDR A:&base_addr+0x880c04
y.create.l HWIO_RPMH_VRM_ENABLE_VOTE_DRV8_REG13_ADDR A:&base_addr+0x880d04
y.create.l HWIO_RPMH_VRM_ENABLE_VOTE_DRV8_REG14_ADDR A:&base_addr+0x880e04
y.create.l HWIO_RPMH_VRM_ENABLE_VOTE_DRV8_REG15_ADDR A:&base_addr+0x880f04
y.create.l HWIO_RPMH_VRM_ENABLE_VOTE_DRV8_REG16_ADDR A:&base_addr+0x881004
y.create.l HWIO_RPMH_VRM_ENABLE_VOTE_DRV8_REG17_ADDR A:&base_addr+0x881104
y.create.l HWIO_RPMH_VRM_ENABLE_VOTE_DRV8_REG18_ADDR A:&base_addr+0x881204
y.create.l HWIO_RPMH_VRM_ENABLE_VOTE_DRV8_REG19_ADDR A:&base_addr+0x881304
y.create.l HWIO_RPMH_VRM_ENABLE_VOTE_DRV8_REG20_ADDR A:&base_addr+0x881404
y.create.l HWIO_RPMH_VRM_ENABLE_VOTE_DRV8_REG21_ADDR A:&base_addr+0x881504
y.create.l HWIO_RPMH_VRM_ENABLE_VOTE_DRV8_REG22_ADDR A:&base_addr+0x881604
y.create.l HWIO_RPMH_VRM_ENABLE_VOTE_DRV8_REG23_ADDR A:&base_addr+0x881704
y.create.l HWIO_RPMH_VRM_ENABLE_VOTE_DRV8_REG24_ADDR A:&base_addr+0x881804
y.create.l HWIO_RPMH_VRM_ENABLE_VOTE_DRV8_REG25_ADDR A:&base_addr+0x881904
y.create.l HWIO_RPMH_VRM_ENABLE_VOTE_DRV8_REG26_ADDR A:&base_addr+0x881a04
y.create.l HWIO_RPMH_VRM_ENABLE_VOTE_DRV8_REG27_ADDR A:&base_addr+0x881b04
y.create.l HWIO_RPMH_VRM_ENABLE_VOTE_DRV8_REG28_ADDR A:&base_addr+0x881c04
y.create.l HWIO_RPMH_VRM_ENABLE_VOTE_DRV8_REG29_ADDR A:&base_addr+0x881d04
y.create.l HWIO_RPMH_VRM_ENABLE_VOTE_DRV8_REG30_ADDR A:&base_addr+0x881e04
y.create.l HWIO_RPMH_VRM_ENABLE_VOTE_DRV8_REG31_ADDR A:&base_addr+0x881f04
y.create.l HWIO_RPMH_VRM_ENABLE_VOTE_DRV8_REG32_ADDR A:&base_addr+0x882004
y.create.l HWIO_RPMH_VRM_ENABLE_VOTE_DRV8_REG33_ADDR A:&base_addr+0x882104
y.create.l HWIO_RPMH_VRM_ENABLE_VOTE_DRV8_REG34_ADDR A:&base_addr+0x882204
y.create.l HWIO_RPMH_VRM_ENABLE_VOTE_DRV8_REG35_ADDR A:&base_addr+0x882304
y.create.l HWIO_RPMH_VRM_ENABLE_VOTE_DRV8_REG36_ADDR A:&base_addr+0x882404
y.create.l HWIO_RPMH_VRM_ENABLE_VOTE_DRV8_REG37_ADDR A:&base_addr+0x882504
y.create.l HWIO_RPMH_VRM_ENABLE_VOTE_DRV8_REG38_ADDR A:&base_addr+0x882604
y.create.l HWIO_RPMH_VRM_ENABLE_VOTE_DRV8_REG39_ADDR A:&base_addr+0x882704
y.create.l HWIO_RPMH_VRM_ENABLE_VOTE_DRV8_REG40_ADDR A:&base_addr+0x882804
y.create.l HWIO_RPMH_VRM_ENABLE_VOTE_DRV8_REG41_ADDR A:&base_addr+0x882904
y.create.l HWIO_RPMH_VRM_ENABLE_VOTE_DRV8_REG42_ADDR A:&base_addr+0x882a04
y.create.l HWIO_RPMH_VRM_ENABLE_VOTE_DRV8_REG43_ADDR A:&base_addr+0x882b04
y.create.l HWIO_RPMH_VRM_ENABLE_VOTE_DRV8_REG44_ADDR A:&base_addr+0x882c04
y.create.l HWIO_RPMH_VRM_ENABLE_VOTE_DRV8_REG45_ADDR A:&base_addr+0x882d04
y.create.l HWIO_RPMH_VRM_ENABLE_VOTE_DRV9_REG0_ADDR A:&base_addr+0x890004
y.create.l HWIO_RPMH_VRM_ENABLE_VOTE_DRV9_REG1_ADDR A:&base_addr+0x890104
y.create.l HWIO_RPMH_VRM_ENABLE_VOTE_DRV9_REG2_ADDR A:&base_addr+0x890204
y.create.l HWIO_RPMH_VRM_ENABLE_VOTE_DRV9_REG3_ADDR A:&base_addr+0x890304
y.create.l HWIO_RPMH_VRM_ENABLE_VOTE_DRV9_REG4_ADDR A:&base_addr+0x890404
y.create.l HWIO_RPMH_VRM_ENABLE_VOTE_DRV9_REG5_ADDR A:&base_addr+0x890504
y.create.l HWIO_RPMH_VRM_ENABLE_VOTE_DRV9_REG6_ADDR A:&base_addr+0x890604
y.create.l HWIO_RPMH_VRM_ENABLE_VOTE_DRV9_REG7_ADDR A:&base_addr+0x890704
y.create.l HWIO_RPMH_VRM_ENABLE_VOTE_DRV9_REG8_ADDR A:&base_addr+0x890804
y.create.l HWIO_RPMH_VRM_ENABLE_VOTE_DRV9_REG9_ADDR A:&base_addr+0x890904
y.create.l HWIO_RPMH_VRM_ENABLE_VOTE_DRV9_REG10_ADDR A:&base_addr+0x890a04
y.create.l HWIO_RPMH_VRM_ENABLE_VOTE_DRV9_REG11_ADDR A:&base_addr+0x890b04
y.create.l HWIO_RPMH_VRM_ENABLE_VOTE_DRV9_REG12_ADDR A:&base_addr+0x890c04
y.create.l HWIO_RPMH_VRM_ENABLE_VOTE_DRV9_REG13_ADDR A:&base_addr+0x890d04
y.create.l HWIO_RPMH_VRM_ENABLE_VOTE_DRV9_REG14_ADDR A:&base_addr+0x890e04
y.create.l HWIO_RPMH_VRM_ENABLE_VOTE_DRV9_REG15_ADDR A:&base_addr+0x890f04
y.create.l HWIO_RPMH_VRM_ENABLE_VOTE_DRV9_REG16_ADDR A:&base_addr+0x891004
y.create.l HWIO_RPMH_VRM_ENABLE_VOTE_DRV9_REG17_ADDR A:&base_addr+0x891104
y.create.l HWIO_RPMH_VRM_ENABLE_VOTE_DRV9_REG18_ADDR A:&base_addr+0x891204
y.create.l HWIO_RPMH_VRM_ENABLE_VOTE_DRV9_REG19_ADDR A:&base_addr+0x891304
y.create.l HWIO_RPMH_VRM_ENABLE_VOTE_DRV9_REG20_ADDR A:&base_addr+0x891404
y.create.l HWIO_RPMH_VRM_ENABLE_VOTE_DRV9_REG21_ADDR A:&base_addr+0x891504
y.create.l HWIO_RPMH_VRM_ENABLE_VOTE_DRV9_REG22_ADDR A:&base_addr+0x891604
y.create.l HWIO_RPMH_VRM_ENABLE_VOTE_DRV9_REG23_ADDR A:&base_addr+0x891704
y.create.l HWIO_RPMH_VRM_ENABLE_VOTE_DRV9_REG24_ADDR A:&base_addr+0x891804
y.create.l HWIO_RPMH_VRM_ENABLE_VOTE_DRV9_REG25_ADDR A:&base_addr+0x891904
y.create.l HWIO_RPMH_VRM_ENABLE_VOTE_DRV9_REG26_ADDR A:&base_addr+0x891a04
y.create.l HWIO_RPMH_VRM_ENABLE_VOTE_DRV9_REG27_ADDR A:&base_addr+0x891b04
y.create.l HWIO_RPMH_VRM_ENABLE_VOTE_DRV9_REG28_ADDR A:&base_addr+0x891c04
y.create.l HWIO_RPMH_VRM_ENABLE_VOTE_DRV9_REG29_ADDR A:&base_addr+0x891d04
y.create.l HWIO_RPMH_VRM_ENABLE_VOTE_DRV9_REG30_ADDR A:&base_addr+0x891e04
y.create.l HWIO_RPMH_VRM_ENABLE_VOTE_DRV9_REG31_ADDR A:&base_addr+0x891f04
y.create.l HWIO_RPMH_VRM_ENABLE_VOTE_DRV9_REG32_ADDR A:&base_addr+0x892004
y.create.l HWIO_RPMH_VRM_ENABLE_VOTE_DRV9_REG33_ADDR A:&base_addr+0x892104
y.create.l HWIO_RPMH_VRM_ENABLE_VOTE_DRV9_REG34_ADDR A:&base_addr+0x892204
y.create.l HWIO_RPMH_VRM_ENABLE_VOTE_DRV9_REG35_ADDR A:&base_addr+0x892304
y.create.l HWIO_RPMH_VRM_ENABLE_VOTE_DRV9_REG36_ADDR A:&base_addr+0x892404
y.create.l HWIO_RPMH_VRM_ENABLE_VOTE_DRV9_REG37_ADDR A:&base_addr+0x892504
y.create.l HWIO_RPMH_VRM_ENABLE_VOTE_DRV9_REG38_ADDR A:&base_addr+0x892604
y.create.l HWIO_RPMH_VRM_ENABLE_VOTE_DRV9_REG39_ADDR A:&base_addr+0x892704
y.create.l HWIO_RPMH_VRM_ENABLE_VOTE_DRV9_REG40_ADDR A:&base_addr+0x892804
y.create.l HWIO_RPMH_VRM_ENABLE_VOTE_DRV9_REG41_ADDR A:&base_addr+0x892904
y.create.l HWIO_RPMH_VRM_ENABLE_VOTE_DRV9_REG42_ADDR A:&base_addr+0x892a04
y.create.l HWIO_RPMH_VRM_ENABLE_VOTE_DRV9_REG43_ADDR A:&base_addr+0x892b04
y.create.l HWIO_RPMH_VRM_ENABLE_VOTE_DRV9_REG44_ADDR A:&base_addr+0x892c04
y.create.l HWIO_RPMH_VRM_ENABLE_VOTE_DRV9_REG45_ADDR A:&base_addr+0x892d04
y.create.l HWIO_RPMH_VRM_ENABLE_VOTE_DRV10_REG0_ADDR A:&base_addr+0x8a0004
y.create.l HWIO_RPMH_VRM_ENABLE_VOTE_DRV10_REG1_ADDR A:&base_addr+0x8a0104
y.create.l HWIO_RPMH_VRM_ENABLE_VOTE_DRV10_REG2_ADDR A:&base_addr+0x8a0204
y.create.l HWIO_RPMH_VRM_ENABLE_VOTE_DRV10_REG3_ADDR A:&base_addr+0x8a0304
y.create.l HWIO_RPMH_VRM_ENABLE_VOTE_DRV10_REG4_ADDR A:&base_addr+0x8a0404
y.create.l HWIO_RPMH_VRM_ENABLE_VOTE_DRV10_REG5_ADDR A:&base_addr+0x8a0504
y.create.l HWIO_RPMH_VRM_ENABLE_VOTE_DRV10_REG6_ADDR A:&base_addr+0x8a0604
y.create.l HWIO_RPMH_VRM_ENABLE_VOTE_DRV10_REG7_ADDR A:&base_addr+0x8a0704
y.create.l HWIO_RPMH_VRM_ENABLE_VOTE_DRV10_REG8_ADDR A:&base_addr+0x8a0804
y.create.l HWIO_RPMH_VRM_ENABLE_VOTE_DRV10_REG9_ADDR A:&base_addr+0x8a0904
y.create.l HWIO_RPMH_VRM_ENABLE_VOTE_DRV10_REG10_ADDR A:&base_addr+0x8a0a04
y.create.l HWIO_RPMH_VRM_ENABLE_VOTE_DRV10_REG11_ADDR A:&base_addr+0x8a0b04
y.create.l HWIO_RPMH_VRM_ENABLE_VOTE_DRV10_REG12_ADDR A:&base_addr+0x8a0c04
y.create.l HWIO_RPMH_VRM_ENABLE_VOTE_DRV10_REG13_ADDR A:&base_addr+0x8a0d04
y.create.l HWIO_RPMH_VRM_ENABLE_VOTE_DRV10_REG14_ADDR A:&base_addr+0x8a0e04
y.create.l HWIO_RPMH_VRM_ENABLE_VOTE_DRV10_REG15_ADDR A:&base_addr+0x8a0f04
y.create.l HWIO_RPMH_VRM_ENABLE_VOTE_DRV10_REG16_ADDR A:&base_addr+0x8a1004
y.create.l HWIO_RPMH_VRM_ENABLE_VOTE_DRV10_REG17_ADDR A:&base_addr+0x8a1104
y.create.l HWIO_RPMH_VRM_ENABLE_VOTE_DRV10_REG18_ADDR A:&base_addr+0x8a1204
y.create.l HWIO_RPMH_VRM_ENABLE_VOTE_DRV10_REG19_ADDR A:&base_addr+0x8a1304
y.create.l HWIO_RPMH_VRM_ENABLE_VOTE_DRV10_REG20_ADDR A:&base_addr+0x8a1404
y.create.l HWIO_RPMH_VRM_ENABLE_VOTE_DRV10_REG21_ADDR A:&base_addr+0x8a1504
y.create.l HWIO_RPMH_VRM_ENABLE_VOTE_DRV10_REG22_ADDR A:&base_addr+0x8a1604
y.create.l HWIO_RPMH_VRM_ENABLE_VOTE_DRV10_REG23_ADDR A:&base_addr+0x8a1704
y.create.l HWIO_RPMH_VRM_ENABLE_VOTE_DRV10_REG24_ADDR A:&base_addr+0x8a1804
y.create.l HWIO_RPMH_VRM_ENABLE_VOTE_DRV10_REG25_ADDR A:&base_addr+0x8a1904
y.create.l HWIO_RPMH_VRM_ENABLE_VOTE_DRV10_REG26_ADDR A:&base_addr+0x8a1a04
y.create.l HWIO_RPMH_VRM_ENABLE_VOTE_DRV10_REG27_ADDR A:&base_addr+0x8a1b04
y.create.l HWIO_RPMH_VRM_ENABLE_VOTE_DRV10_REG28_ADDR A:&base_addr+0x8a1c04
y.create.l HWIO_RPMH_VRM_ENABLE_VOTE_DRV10_REG29_ADDR A:&base_addr+0x8a1d04
y.create.l HWIO_RPMH_VRM_ENABLE_VOTE_DRV10_REG30_ADDR A:&base_addr+0x8a1e04
y.create.l HWIO_RPMH_VRM_ENABLE_VOTE_DRV10_REG31_ADDR A:&base_addr+0x8a1f04
y.create.l HWIO_RPMH_VRM_ENABLE_VOTE_DRV10_REG32_ADDR A:&base_addr+0x8a2004
y.create.l HWIO_RPMH_VRM_ENABLE_VOTE_DRV10_REG33_ADDR A:&base_addr+0x8a2104
y.create.l HWIO_RPMH_VRM_ENABLE_VOTE_DRV10_REG34_ADDR A:&base_addr+0x8a2204
y.create.l HWIO_RPMH_VRM_ENABLE_VOTE_DRV10_REG35_ADDR A:&base_addr+0x8a2304
y.create.l HWIO_RPMH_VRM_ENABLE_VOTE_DRV10_REG36_ADDR A:&base_addr+0x8a2404
y.create.l HWIO_RPMH_VRM_ENABLE_VOTE_DRV10_REG37_ADDR A:&base_addr+0x8a2504
y.create.l HWIO_RPMH_VRM_ENABLE_VOTE_DRV10_REG38_ADDR A:&base_addr+0x8a2604
y.create.l HWIO_RPMH_VRM_ENABLE_VOTE_DRV10_REG39_ADDR A:&base_addr+0x8a2704
y.create.l HWIO_RPMH_VRM_ENABLE_VOTE_DRV10_REG40_ADDR A:&base_addr+0x8a2804
y.create.l HWIO_RPMH_VRM_ENABLE_VOTE_DRV10_REG41_ADDR A:&base_addr+0x8a2904
y.create.l HWIO_RPMH_VRM_ENABLE_VOTE_DRV10_REG42_ADDR A:&base_addr+0x8a2a04
y.create.l HWIO_RPMH_VRM_ENABLE_VOTE_DRV10_REG43_ADDR A:&base_addr+0x8a2b04
y.create.l HWIO_RPMH_VRM_ENABLE_VOTE_DRV10_REG44_ADDR A:&base_addr+0x8a2c04
y.create.l HWIO_RPMH_VRM_ENABLE_VOTE_DRV10_REG45_ADDR A:&base_addr+0x8a2d04
y.create.l HWIO_RPMH_VRM_ENABLE_VOTE_DRV11_REG0_ADDR A:&base_addr+0x8b0004
y.create.l HWIO_RPMH_VRM_ENABLE_VOTE_DRV11_REG1_ADDR A:&base_addr+0x8b0104
y.create.l HWIO_RPMH_VRM_ENABLE_VOTE_DRV11_REG2_ADDR A:&base_addr+0x8b0204
y.create.l HWIO_RPMH_VRM_ENABLE_VOTE_DRV11_REG3_ADDR A:&base_addr+0x8b0304
y.create.l HWIO_RPMH_VRM_ENABLE_VOTE_DRV11_REG4_ADDR A:&base_addr+0x8b0404
y.create.l HWIO_RPMH_VRM_ENABLE_VOTE_DRV11_REG5_ADDR A:&base_addr+0x8b0504
y.create.l HWIO_RPMH_VRM_ENABLE_VOTE_DRV11_REG6_ADDR A:&base_addr+0x8b0604
y.create.l HWIO_RPMH_VRM_ENABLE_VOTE_DRV11_REG7_ADDR A:&base_addr+0x8b0704
y.create.l HWIO_RPMH_VRM_ENABLE_VOTE_DRV11_REG8_ADDR A:&base_addr+0x8b0804
y.create.l HWIO_RPMH_VRM_ENABLE_VOTE_DRV11_REG9_ADDR A:&base_addr+0x8b0904
y.create.l HWIO_RPMH_VRM_ENABLE_VOTE_DRV11_REG10_ADDR A:&base_addr+0x8b0a04
y.create.l HWIO_RPMH_VRM_ENABLE_VOTE_DRV11_REG11_ADDR A:&base_addr+0x8b0b04
y.create.l HWIO_RPMH_VRM_ENABLE_VOTE_DRV11_REG12_ADDR A:&base_addr+0x8b0c04
y.create.l HWIO_RPMH_VRM_ENABLE_VOTE_DRV11_REG13_ADDR A:&base_addr+0x8b0d04
y.create.l HWIO_RPMH_VRM_ENABLE_VOTE_DRV11_REG14_ADDR A:&base_addr+0x8b0e04
y.create.l HWIO_RPMH_VRM_ENABLE_VOTE_DRV11_REG15_ADDR A:&base_addr+0x8b0f04
y.create.l HWIO_RPMH_VRM_ENABLE_VOTE_DRV11_REG16_ADDR A:&base_addr+0x8b1004
y.create.l HWIO_RPMH_VRM_ENABLE_VOTE_DRV11_REG17_ADDR A:&base_addr+0x8b1104
y.create.l HWIO_RPMH_VRM_ENABLE_VOTE_DRV11_REG18_ADDR A:&base_addr+0x8b1204
y.create.l HWIO_RPMH_VRM_ENABLE_VOTE_DRV11_REG19_ADDR A:&base_addr+0x8b1304
y.create.l HWIO_RPMH_VRM_ENABLE_VOTE_DRV11_REG20_ADDR A:&base_addr+0x8b1404
y.create.l HWIO_RPMH_VRM_ENABLE_VOTE_DRV11_REG21_ADDR A:&base_addr+0x8b1504
y.create.l HWIO_RPMH_VRM_ENABLE_VOTE_DRV11_REG22_ADDR A:&base_addr+0x8b1604
y.create.l HWIO_RPMH_VRM_ENABLE_VOTE_DRV11_REG23_ADDR A:&base_addr+0x8b1704
y.create.l HWIO_RPMH_VRM_ENABLE_VOTE_DRV11_REG24_ADDR A:&base_addr+0x8b1804
y.create.l HWIO_RPMH_VRM_ENABLE_VOTE_DRV11_REG25_ADDR A:&base_addr+0x8b1904
y.create.l HWIO_RPMH_VRM_ENABLE_VOTE_DRV11_REG26_ADDR A:&base_addr+0x8b1a04
y.create.l HWIO_RPMH_VRM_ENABLE_VOTE_DRV11_REG27_ADDR A:&base_addr+0x8b1b04
y.create.l HWIO_RPMH_VRM_ENABLE_VOTE_DRV11_REG28_ADDR A:&base_addr+0x8b1c04
y.create.l HWIO_RPMH_VRM_ENABLE_VOTE_DRV11_REG29_ADDR A:&base_addr+0x8b1d04
y.create.l HWIO_RPMH_VRM_ENABLE_VOTE_DRV11_REG30_ADDR A:&base_addr+0x8b1e04
y.create.l HWIO_RPMH_VRM_ENABLE_VOTE_DRV11_REG31_ADDR A:&base_addr+0x8b1f04
y.create.l HWIO_RPMH_VRM_ENABLE_VOTE_DRV11_REG32_ADDR A:&base_addr+0x8b2004
y.create.l HWIO_RPMH_VRM_ENABLE_VOTE_DRV11_REG33_ADDR A:&base_addr+0x8b2104
y.create.l HWIO_RPMH_VRM_ENABLE_VOTE_DRV11_REG34_ADDR A:&base_addr+0x8b2204
y.create.l HWIO_RPMH_VRM_ENABLE_VOTE_DRV11_REG35_ADDR A:&base_addr+0x8b2304
y.create.l HWIO_RPMH_VRM_ENABLE_VOTE_DRV11_REG36_ADDR A:&base_addr+0x8b2404
y.create.l HWIO_RPMH_VRM_ENABLE_VOTE_DRV11_REG37_ADDR A:&base_addr+0x8b2504
y.create.l HWIO_RPMH_VRM_ENABLE_VOTE_DRV11_REG38_ADDR A:&base_addr+0x8b2604
y.create.l HWIO_RPMH_VRM_ENABLE_VOTE_DRV11_REG39_ADDR A:&base_addr+0x8b2704
y.create.l HWIO_RPMH_VRM_ENABLE_VOTE_DRV11_REG40_ADDR A:&base_addr+0x8b2804
y.create.l HWIO_RPMH_VRM_ENABLE_VOTE_DRV11_REG41_ADDR A:&base_addr+0x8b2904
y.create.l HWIO_RPMH_VRM_ENABLE_VOTE_DRV11_REG42_ADDR A:&base_addr+0x8b2a04
y.create.l HWIO_RPMH_VRM_ENABLE_VOTE_DRV11_REG43_ADDR A:&base_addr+0x8b2b04
y.create.l HWIO_RPMH_VRM_ENABLE_VOTE_DRV11_REG44_ADDR A:&base_addr+0x8b2c04
y.create.l HWIO_RPMH_VRM_ENABLE_VOTE_DRV11_REG45_ADDR A:&base_addr+0x8b2d04
y.create.l HWIO_RPMH_VRM_ENABLE_VOTE_DRV12_REG0_ADDR A:&base_addr+0x8c0004
y.create.l HWIO_RPMH_VRM_ENABLE_VOTE_DRV12_REG1_ADDR A:&base_addr+0x8c0104
y.create.l HWIO_RPMH_VRM_ENABLE_VOTE_DRV12_REG2_ADDR A:&base_addr+0x8c0204
y.create.l HWIO_RPMH_VRM_ENABLE_VOTE_DRV12_REG3_ADDR A:&base_addr+0x8c0304
y.create.l HWIO_RPMH_VRM_ENABLE_VOTE_DRV12_REG4_ADDR A:&base_addr+0x8c0404
y.create.l HWIO_RPMH_VRM_ENABLE_VOTE_DRV12_REG5_ADDR A:&base_addr+0x8c0504
y.create.l HWIO_RPMH_VRM_ENABLE_VOTE_DRV12_REG6_ADDR A:&base_addr+0x8c0604
y.create.l HWIO_RPMH_VRM_ENABLE_VOTE_DRV12_REG7_ADDR A:&base_addr+0x8c0704
y.create.l HWIO_RPMH_VRM_ENABLE_VOTE_DRV12_REG8_ADDR A:&base_addr+0x8c0804
y.create.l HWIO_RPMH_VRM_ENABLE_VOTE_DRV12_REG9_ADDR A:&base_addr+0x8c0904
y.create.l HWIO_RPMH_VRM_ENABLE_VOTE_DRV12_REG10_ADDR A:&base_addr+0x8c0a04
y.create.l HWIO_RPMH_VRM_ENABLE_VOTE_DRV12_REG11_ADDR A:&base_addr+0x8c0b04
y.create.l HWIO_RPMH_VRM_ENABLE_VOTE_DRV12_REG12_ADDR A:&base_addr+0x8c0c04
y.create.l HWIO_RPMH_VRM_ENABLE_VOTE_DRV12_REG13_ADDR A:&base_addr+0x8c0d04
y.create.l HWIO_RPMH_VRM_ENABLE_VOTE_DRV12_REG14_ADDR A:&base_addr+0x8c0e04
y.create.l HWIO_RPMH_VRM_ENABLE_VOTE_DRV12_REG15_ADDR A:&base_addr+0x8c0f04
y.create.l HWIO_RPMH_VRM_ENABLE_VOTE_DRV12_REG16_ADDR A:&base_addr+0x8c1004
y.create.l HWIO_RPMH_VRM_ENABLE_VOTE_DRV12_REG17_ADDR A:&base_addr+0x8c1104
y.create.l HWIO_RPMH_VRM_ENABLE_VOTE_DRV12_REG18_ADDR A:&base_addr+0x8c1204
y.create.l HWIO_RPMH_VRM_ENABLE_VOTE_DRV12_REG19_ADDR A:&base_addr+0x8c1304
y.create.l HWIO_RPMH_VRM_ENABLE_VOTE_DRV12_REG20_ADDR A:&base_addr+0x8c1404
y.create.l HWIO_RPMH_VRM_ENABLE_VOTE_DRV12_REG21_ADDR A:&base_addr+0x8c1504
y.create.l HWIO_RPMH_VRM_ENABLE_VOTE_DRV12_REG22_ADDR A:&base_addr+0x8c1604
y.create.l HWIO_RPMH_VRM_ENABLE_VOTE_DRV12_REG23_ADDR A:&base_addr+0x8c1704
y.create.l HWIO_RPMH_VRM_ENABLE_VOTE_DRV12_REG24_ADDR A:&base_addr+0x8c1804
y.create.l HWIO_RPMH_VRM_ENABLE_VOTE_DRV12_REG25_ADDR A:&base_addr+0x8c1904
y.create.l HWIO_RPMH_VRM_ENABLE_VOTE_DRV12_REG26_ADDR A:&base_addr+0x8c1a04
y.create.l HWIO_RPMH_VRM_ENABLE_VOTE_DRV12_REG27_ADDR A:&base_addr+0x8c1b04
y.create.l HWIO_RPMH_VRM_ENABLE_VOTE_DRV12_REG28_ADDR A:&base_addr+0x8c1c04
y.create.l HWIO_RPMH_VRM_ENABLE_VOTE_DRV12_REG29_ADDR A:&base_addr+0x8c1d04
y.create.l HWIO_RPMH_VRM_ENABLE_VOTE_DRV12_REG30_ADDR A:&base_addr+0x8c1e04
y.create.l HWIO_RPMH_VRM_ENABLE_VOTE_DRV12_REG31_ADDR A:&base_addr+0x8c1f04
y.create.l HWIO_RPMH_VRM_ENABLE_VOTE_DRV12_REG32_ADDR A:&base_addr+0x8c2004
y.create.l HWIO_RPMH_VRM_ENABLE_VOTE_DRV12_REG33_ADDR A:&base_addr+0x8c2104
y.create.l HWIO_RPMH_VRM_ENABLE_VOTE_DRV12_REG34_ADDR A:&base_addr+0x8c2204
y.create.l HWIO_RPMH_VRM_ENABLE_VOTE_DRV12_REG35_ADDR A:&base_addr+0x8c2304
y.create.l HWIO_RPMH_VRM_ENABLE_VOTE_DRV12_REG36_ADDR A:&base_addr+0x8c2404
y.create.l HWIO_RPMH_VRM_ENABLE_VOTE_DRV12_REG37_ADDR A:&base_addr+0x8c2504
y.create.l HWIO_RPMH_VRM_ENABLE_VOTE_DRV12_REG38_ADDR A:&base_addr+0x8c2604
y.create.l HWIO_RPMH_VRM_ENABLE_VOTE_DRV12_REG39_ADDR A:&base_addr+0x8c2704
y.create.l HWIO_RPMH_VRM_ENABLE_VOTE_DRV12_REG40_ADDR A:&base_addr+0x8c2804
y.create.l HWIO_RPMH_VRM_ENABLE_VOTE_DRV12_REG41_ADDR A:&base_addr+0x8c2904
y.create.l HWIO_RPMH_VRM_ENABLE_VOTE_DRV12_REG42_ADDR A:&base_addr+0x8c2a04
y.create.l HWIO_RPMH_VRM_ENABLE_VOTE_DRV12_REG43_ADDR A:&base_addr+0x8c2b04
y.create.l HWIO_RPMH_VRM_ENABLE_VOTE_DRV12_REG44_ADDR A:&base_addr+0x8c2c04
y.create.l HWIO_RPMH_VRM_ENABLE_VOTE_DRV12_REG45_ADDR A:&base_addr+0x8c2d04
y.create.l HWIO_RPMH_VRM_ENABLE_VOTE_DRV13_REG0_ADDR A:&base_addr+0x8d0004
y.create.l HWIO_RPMH_VRM_ENABLE_VOTE_DRV13_REG1_ADDR A:&base_addr+0x8d0104
y.create.l HWIO_RPMH_VRM_ENABLE_VOTE_DRV13_REG2_ADDR A:&base_addr+0x8d0204
y.create.l HWIO_RPMH_VRM_ENABLE_VOTE_DRV13_REG3_ADDR A:&base_addr+0x8d0304
y.create.l HWIO_RPMH_VRM_ENABLE_VOTE_DRV13_REG4_ADDR A:&base_addr+0x8d0404
y.create.l HWIO_RPMH_VRM_ENABLE_VOTE_DRV13_REG5_ADDR A:&base_addr+0x8d0504
y.create.l HWIO_RPMH_VRM_ENABLE_VOTE_DRV13_REG6_ADDR A:&base_addr+0x8d0604
y.create.l HWIO_RPMH_VRM_ENABLE_VOTE_DRV13_REG7_ADDR A:&base_addr+0x8d0704
y.create.l HWIO_RPMH_VRM_ENABLE_VOTE_DRV13_REG8_ADDR A:&base_addr+0x8d0804
y.create.l HWIO_RPMH_VRM_ENABLE_VOTE_DRV13_REG9_ADDR A:&base_addr+0x8d0904
y.create.l HWIO_RPMH_VRM_ENABLE_VOTE_DRV13_REG10_ADDR A:&base_addr+0x8d0a04
y.create.l HWIO_RPMH_VRM_ENABLE_VOTE_DRV13_REG11_ADDR A:&base_addr+0x8d0b04
y.create.l HWIO_RPMH_VRM_ENABLE_VOTE_DRV13_REG12_ADDR A:&base_addr+0x8d0c04
y.create.l HWIO_RPMH_VRM_ENABLE_VOTE_DRV13_REG13_ADDR A:&base_addr+0x8d0d04
y.create.l HWIO_RPMH_VRM_ENABLE_VOTE_DRV13_REG14_ADDR A:&base_addr+0x8d0e04
y.create.l HWIO_RPMH_VRM_ENABLE_VOTE_DRV13_REG15_ADDR A:&base_addr+0x8d0f04
y.create.l HWIO_RPMH_VRM_ENABLE_VOTE_DRV13_REG16_ADDR A:&base_addr+0x8d1004
y.create.l HWIO_RPMH_VRM_ENABLE_VOTE_DRV13_REG17_ADDR A:&base_addr+0x8d1104
y.create.l HWIO_RPMH_VRM_ENABLE_VOTE_DRV13_REG18_ADDR A:&base_addr+0x8d1204
y.create.l HWIO_RPMH_VRM_ENABLE_VOTE_DRV13_REG19_ADDR A:&base_addr+0x8d1304
y.create.l HWIO_RPMH_VRM_ENABLE_VOTE_DRV13_REG20_ADDR A:&base_addr+0x8d1404
y.create.l HWIO_RPMH_VRM_ENABLE_VOTE_DRV13_REG21_ADDR A:&base_addr+0x8d1504
y.create.l HWIO_RPMH_VRM_ENABLE_VOTE_DRV13_REG22_ADDR A:&base_addr+0x8d1604
y.create.l HWIO_RPMH_VRM_ENABLE_VOTE_DRV13_REG23_ADDR A:&base_addr+0x8d1704
y.create.l HWIO_RPMH_VRM_ENABLE_VOTE_DRV13_REG24_ADDR A:&base_addr+0x8d1804
y.create.l HWIO_RPMH_VRM_ENABLE_VOTE_DRV13_REG25_ADDR A:&base_addr+0x8d1904
y.create.l HWIO_RPMH_VRM_ENABLE_VOTE_DRV13_REG26_ADDR A:&base_addr+0x8d1a04
y.create.l HWIO_RPMH_VRM_ENABLE_VOTE_DRV13_REG27_ADDR A:&base_addr+0x8d1b04
y.create.l HWIO_RPMH_VRM_ENABLE_VOTE_DRV13_REG28_ADDR A:&base_addr+0x8d1c04
y.create.l HWIO_RPMH_VRM_ENABLE_VOTE_DRV13_REG29_ADDR A:&base_addr+0x8d1d04
y.create.l HWIO_RPMH_VRM_ENABLE_VOTE_DRV13_REG30_ADDR A:&base_addr+0x8d1e04
y.create.l HWIO_RPMH_VRM_ENABLE_VOTE_DRV13_REG31_ADDR A:&base_addr+0x8d1f04
y.create.l HWIO_RPMH_VRM_ENABLE_VOTE_DRV13_REG32_ADDR A:&base_addr+0x8d2004
y.create.l HWIO_RPMH_VRM_ENABLE_VOTE_DRV13_REG33_ADDR A:&base_addr+0x8d2104
y.create.l HWIO_RPMH_VRM_ENABLE_VOTE_DRV13_REG34_ADDR A:&base_addr+0x8d2204
y.create.l HWIO_RPMH_VRM_ENABLE_VOTE_DRV13_REG35_ADDR A:&base_addr+0x8d2304
y.create.l HWIO_RPMH_VRM_ENABLE_VOTE_DRV13_REG36_ADDR A:&base_addr+0x8d2404
y.create.l HWIO_RPMH_VRM_ENABLE_VOTE_DRV13_REG37_ADDR A:&base_addr+0x8d2504
y.create.l HWIO_RPMH_VRM_ENABLE_VOTE_DRV13_REG38_ADDR A:&base_addr+0x8d2604
y.create.l HWIO_RPMH_VRM_ENABLE_VOTE_DRV13_REG39_ADDR A:&base_addr+0x8d2704
y.create.l HWIO_RPMH_VRM_ENABLE_VOTE_DRV13_REG40_ADDR A:&base_addr+0x8d2804
y.create.l HWIO_RPMH_VRM_ENABLE_VOTE_DRV13_REG41_ADDR A:&base_addr+0x8d2904
y.create.l HWIO_RPMH_VRM_ENABLE_VOTE_DRV13_REG42_ADDR A:&base_addr+0x8d2a04
y.create.l HWIO_RPMH_VRM_ENABLE_VOTE_DRV13_REG43_ADDR A:&base_addr+0x8d2b04
y.create.l HWIO_RPMH_VRM_ENABLE_VOTE_DRV13_REG44_ADDR A:&base_addr+0x8d2c04
y.create.l HWIO_RPMH_VRM_ENABLE_VOTE_DRV13_REG45_ADDR A:&base_addr+0x8d2d04
y.create.l HWIO_RPMH_VRM_ENABLE_VOTE_DRV14_REG0_ADDR A:&base_addr+0x8e0004
y.create.l HWIO_RPMH_VRM_ENABLE_VOTE_DRV14_REG1_ADDR A:&base_addr+0x8e0104
y.create.l HWIO_RPMH_VRM_ENABLE_VOTE_DRV14_REG2_ADDR A:&base_addr+0x8e0204
y.create.l HWIO_RPMH_VRM_ENABLE_VOTE_DRV14_REG3_ADDR A:&base_addr+0x8e0304
y.create.l HWIO_RPMH_VRM_ENABLE_VOTE_DRV14_REG4_ADDR A:&base_addr+0x8e0404
y.create.l HWIO_RPMH_VRM_ENABLE_VOTE_DRV14_REG5_ADDR A:&base_addr+0x8e0504
y.create.l HWIO_RPMH_VRM_ENABLE_VOTE_DRV14_REG6_ADDR A:&base_addr+0x8e0604
y.create.l HWIO_RPMH_VRM_ENABLE_VOTE_DRV14_REG7_ADDR A:&base_addr+0x8e0704
y.create.l HWIO_RPMH_VRM_ENABLE_VOTE_DRV14_REG8_ADDR A:&base_addr+0x8e0804
y.create.l HWIO_RPMH_VRM_ENABLE_VOTE_DRV14_REG9_ADDR A:&base_addr+0x8e0904
y.create.l HWIO_RPMH_VRM_ENABLE_VOTE_DRV14_REG10_ADDR A:&base_addr+0x8e0a04
y.create.l HWIO_RPMH_VRM_ENABLE_VOTE_DRV14_REG11_ADDR A:&base_addr+0x8e0b04
y.create.l HWIO_RPMH_VRM_ENABLE_VOTE_DRV14_REG12_ADDR A:&base_addr+0x8e0c04
y.create.l HWIO_RPMH_VRM_ENABLE_VOTE_DRV14_REG13_ADDR A:&base_addr+0x8e0d04
y.create.l HWIO_RPMH_VRM_ENABLE_VOTE_DRV14_REG14_ADDR A:&base_addr+0x8e0e04
y.create.l HWIO_RPMH_VRM_ENABLE_VOTE_DRV14_REG15_ADDR A:&base_addr+0x8e0f04
y.create.l HWIO_RPMH_VRM_ENABLE_VOTE_DRV14_REG16_ADDR A:&base_addr+0x8e1004
y.create.l HWIO_RPMH_VRM_ENABLE_VOTE_DRV14_REG17_ADDR A:&base_addr+0x8e1104
y.create.l HWIO_RPMH_VRM_ENABLE_VOTE_DRV14_REG18_ADDR A:&base_addr+0x8e1204
y.create.l HWIO_RPMH_VRM_ENABLE_VOTE_DRV14_REG19_ADDR A:&base_addr+0x8e1304
y.create.l HWIO_RPMH_VRM_ENABLE_VOTE_DRV14_REG20_ADDR A:&base_addr+0x8e1404
y.create.l HWIO_RPMH_VRM_ENABLE_VOTE_DRV14_REG21_ADDR A:&base_addr+0x8e1504
y.create.l HWIO_RPMH_VRM_ENABLE_VOTE_DRV14_REG22_ADDR A:&base_addr+0x8e1604
y.create.l HWIO_RPMH_VRM_ENABLE_VOTE_DRV14_REG23_ADDR A:&base_addr+0x8e1704
y.create.l HWIO_RPMH_VRM_ENABLE_VOTE_DRV14_REG24_ADDR A:&base_addr+0x8e1804
y.create.l HWIO_RPMH_VRM_ENABLE_VOTE_DRV14_REG25_ADDR A:&base_addr+0x8e1904
y.create.l HWIO_RPMH_VRM_ENABLE_VOTE_DRV14_REG26_ADDR A:&base_addr+0x8e1a04
y.create.l HWIO_RPMH_VRM_ENABLE_VOTE_DRV14_REG27_ADDR A:&base_addr+0x8e1b04
y.create.l HWIO_RPMH_VRM_ENABLE_VOTE_DRV14_REG28_ADDR A:&base_addr+0x8e1c04
y.create.l HWIO_RPMH_VRM_ENABLE_VOTE_DRV14_REG29_ADDR A:&base_addr+0x8e1d04
y.create.l HWIO_RPMH_VRM_ENABLE_VOTE_DRV14_REG30_ADDR A:&base_addr+0x8e1e04
y.create.l HWIO_RPMH_VRM_ENABLE_VOTE_DRV14_REG31_ADDR A:&base_addr+0x8e1f04
y.create.l HWIO_RPMH_VRM_ENABLE_VOTE_DRV14_REG32_ADDR A:&base_addr+0x8e2004
y.create.l HWIO_RPMH_VRM_ENABLE_VOTE_DRV14_REG33_ADDR A:&base_addr+0x8e2104
y.create.l HWIO_RPMH_VRM_ENABLE_VOTE_DRV14_REG34_ADDR A:&base_addr+0x8e2204
y.create.l HWIO_RPMH_VRM_ENABLE_VOTE_DRV14_REG35_ADDR A:&base_addr+0x8e2304
y.create.l HWIO_RPMH_VRM_ENABLE_VOTE_DRV14_REG36_ADDR A:&base_addr+0x8e2404
y.create.l HWIO_RPMH_VRM_ENABLE_VOTE_DRV14_REG37_ADDR A:&base_addr+0x8e2504
y.create.l HWIO_RPMH_VRM_ENABLE_VOTE_DRV14_REG38_ADDR A:&base_addr+0x8e2604
y.create.l HWIO_RPMH_VRM_ENABLE_VOTE_DRV14_REG39_ADDR A:&base_addr+0x8e2704
y.create.l HWIO_RPMH_VRM_ENABLE_VOTE_DRV14_REG40_ADDR A:&base_addr+0x8e2804
y.create.l HWIO_RPMH_VRM_ENABLE_VOTE_DRV14_REG41_ADDR A:&base_addr+0x8e2904
y.create.l HWIO_RPMH_VRM_ENABLE_VOTE_DRV14_REG42_ADDR A:&base_addr+0x8e2a04
y.create.l HWIO_RPMH_VRM_ENABLE_VOTE_DRV14_REG43_ADDR A:&base_addr+0x8e2b04
y.create.l HWIO_RPMH_VRM_ENABLE_VOTE_DRV14_REG44_ADDR A:&base_addr+0x8e2c04
y.create.l HWIO_RPMH_VRM_ENABLE_VOTE_DRV14_REG45_ADDR A:&base_addr+0x8e2d04
y.create.l HWIO_RPMH_VRM_MODE_VOTE_DRV0_REG0_ADDR A:&base_addr+0x800008
y.create.l HWIO_RPMH_VRM_MODE_VOTE_DRV0_REG1_ADDR A:&base_addr+0x800108
y.create.l HWIO_RPMH_VRM_MODE_VOTE_DRV0_REG2_ADDR A:&base_addr+0x800208
y.create.l HWIO_RPMH_VRM_MODE_VOTE_DRV0_REG3_ADDR A:&base_addr+0x800308
y.create.l HWIO_RPMH_VRM_MODE_VOTE_DRV0_REG4_ADDR A:&base_addr+0x800408
y.create.l HWIO_RPMH_VRM_MODE_VOTE_DRV0_REG5_ADDR A:&base_addr+0x800508
y.create.l HWIO_RPMH_VRM_MODE_VOTE_DRV0_REG6_ADDR A:&base_addr+0x800608
y.create.l HWIO_RPMH_VRM_MODE_VOTE_DRV0_REG7_ADDR A:&base_addr+0x800708
y.create.l HWIO_RPMH_VRM_MODE_VOTE_DRV0_REG8_ADDR A:&base_addr+0x800808
y.create.l HWIO_RPMH_VRM_MODE_VOTE_DRV0_REG9_ADDR A:&base_addr+0x800908
y.create.l HWIO_RPMH_VRM_MODE_VOTE_DRV0_REG10_ADDR A:&base_addr+0x800a08
y.create.l HWIO_RPMH_VRM_MODE_VOTE_DRV0_REG11_ADDR A:&base_addr+0x800b08
y.create.l HWIO_RPMH_VRM_MODE_VOTE_DRV0_REG12_ADDR A:&base_addr+0x800c08
y.create.l HWIO_RPMH_VRM_MODE_VOTE_DRV0_REG13_ADDR A:&base_addr+0x800d08
y.create.l HWIO_RPMH_VRM_MODE_VOTE_DRV0_REG14_ADDR A:&base_addr+0x800e08
y.create.l HWIO_RPMH_VRM_MODE_VOTE_DRV0_REG15_ADDR A:&base_addr+0x800f08
y.create.l HWIO_RPMH_VRM_MODE_VOTE_DRV0_REG16_ADDR A:&base_addr+0x801008
y.create.l HWIO_RPMH_VRM_MODE_VOTE_DRV0_REG17_ADDR A:&base_addr+0x801108
y.create.l HWIO_RPMH_VRM_MODE_VOTE_DRV0_REG18_ADDR A:&base_addr+0x801208
y.create.l HWIO_RPMH_VRM_MODE_VOTE_DRV0_REG19_ADDR A:&base_addr+0x801308
y.create.l HWIO_RPMH_VRM_MODE_VOTE_DRV0_REG20_ADDR A:&base_addr+0x801408
y.create.l HWIO_RPMH_VRM_MODE_VOTE_DRV0_REG21_ADDR A:&base_addr+0x801508
y.create.l HWIO_RPMH_VRM_MODE_VOTE_DRV0_REG22_ADDR A:&base_addr+0x801608
y.create.l HWIO_RPMH_VRM_MODE_VOTE_DRV0_REG23_ADDR A:&base_addr+0x801708
y.create.l HWIO_RPMH_VRM_MODE_VOTE_DRV0_REG24_ADDR A:&base_addr+0x801808
y.create.l HWIO_RPMH_VRM_MODE_VOTE_DRV0_REG25_ADDR A:&base_addr+0x801908
y.create.l HWIO_RPMH_VRM_MODE_VOTE_DRV0_REG26_ADDR A:&base_addr+0x801a08
y.create.l HWIO_RPMH_VRM_MODE_VOTE_DRV0_REG27_ADDR A:&base_addr+0x801b08
y.create.l HWIO_RPMH_VRM_MODE_VOTE_DRV0_REG28_ADDR A:&base_addr+0x801c08
y.create.l HWIO_RPMH_VRM_MODE_VOTE_DRV0_REG29_ADDR A:&base_addr+0x801d08
y.create.l HWIO_RPMH_VRM_MODE_VOTE_DRV0_REG30_ADDR A:&base_addr+0x801e08
y.create.l HWIO_RPMH_VRM_MODE_VOTE_DRV0_REG31_ADDR A:&base_addr+0x801f08
y.create.l HWIO_RPMH_VRM_MODE_VOTE_DRV0_REG32_ADDR A:&base_addr+0x802008
y.create.l HWIO_RPMH_VRM_MODE_VOTE_DRV0_REG33_ADDR A:&base_addr+0x802108
y.create.l HWIO_RPMH_VRM_MODE_VOTE_DRV0_REG34_ADDR A:&base_addr+0x802208
y.create.l HWIO_RPMH_VRM_MODE_VOTE_DRV0_REG35_ADDR A:&base_addr+0x802308
y.create.l HWIO_RPMH_VRM_MODE_VOTE_DRV0_REG36_ADDR A:&base_addr+0x802408
y.create.l HWIO_RPMH_VRM_MODE_VOTE_DRV0_REG37_ADDR A:&base_addr+0x802508
y.create.l HWIO_RPMH_VRM_MODE_VOTE_DRV0_REG38_ADDR A:&base_addr+0x802608
y.create.l HWIO_RPMH_VRM_MODE_VOTE_DRV0_REG39_ADDR A:&base_addr+0x802708
y.create.l HWIO_RPMH_VRM_MODE_VOTE_DRV0_REG40_ADDR A:&base_addr+0x802808
y.create.l HWIO_RPMH_VRM_MODE_VOTE_DRV0_REG41_ADDR A:&base_addr+0x802908
y.create.l HWIO_RPMH_VRM_MODE_VOTE_DRV0_REG42_ADDR A:&base_addr+0x802a08
y.create.l HWIO_RPMH_VRM_MODE_VOTE_DRV0_REG43_ADDR A:&base_addr+0x802b08
y.create.l HWIO_RPMH_VRM_MODE_VOTE_DRV0_REG44_ADDR A:&base_addr+0x802c08
y.create.l HWIO_RPMH_VRM_MODE_VOTE_DRV0_REG45_ADDR A:&base_addr+0x802d08
y.create.l HWIO_RPMH_VRM_MODE_VOTE_DRV1_REG0_ADDR A:&base_addr+0x810008
y.create.l HWIO_RPMH_VRM_MODE_VOTE_DRV1_REG1_ADDR A:&base_addr+0x810108
y.create.l HWIO_RPMH_VRM_MODE_VOTE_DRV1_REG2_ADDR A:&base_addr+0x810208
y.create.l HWIO_RPMH_VRM_MODE_VOTE_DRV1_REG3_ADDR A:&base_addr+0x810308
y.create.l HWIO_RPMH_VRM_MODE_VOTE_DRV1_REG4_ADDR A:&base_addr+0x810408
y.create.l HWIO_RPMH_VRM_MODE_VOTE_DRV1_REG5_ADDR A:&base_addr+0x810508
y.create.l HWIO_RPMH_VRM_MODE_VOTE_DRV1_REG6_ADDR A:&base_addr+0x810608
y.create.l HWIO_RPMH_VRM_MODE_VOTE_DRV1_REG7_ADDR A:&base_addr+0x810708
y.create.l HWIO_RPMH_VRM_MODE_VOTE_DRV1_REG8_ADDR A:&base_addr+0x810808
y.create.l HWIO_RPMH_VRM_MODE_VOTE_DRV1_REG9_ADDR A:&base_addr+0x810908
y.create.l HWIO_RPMH_VRM_MODE_VOTE_DRV1_REG10_ADDR A:&base_addr+0x810a08
y.create.l HWIO_RPMH_VRM_MODE_VOTE_DRV1_REG11_ADDR A:&base_addr+0x810b08
y.create.l HWIO_RPMH_VRM_MODE_VOTE_DRV1_REG12_ADDR A:&base_addr+0x810c08
y.create.l HWIO_RPMH_VRM_MODE_VOTE_DRV1_REG13_ADDR A:&base_addr+0x810d08
y.create.l HWIO_RPMH_VRM_MODE_VOTE_DRV1_REG14_ADDR A:&base_addr+0x810e08
y.create.l HWIO_RPMH_VRM_MODE_VOTE_DRV1_REG15_ADDR A:&base_addr+0x810f08
y.create.l HWIO_RPMH_VRM_MODE_VOTE_DRV1_REG16_ADDR A:&base_addr+0x811008
y.create.l HWIO_RPMH_VRM_MODE_VOTE_DRV1_REG17_ADDR A:&base_addr+0x811108
y.create.l HWIO_RPMH_VRM_MODE_VOTE_DRV1_REG18_ADDR A:&base_addr+0x811208
y.create.l HWIO_RPMH_VRM_MODE_VOTE_DRV1_REG19_ADDR A:&base_addr+0x811308
y.create.l HWIO_RPMH_VRM_MODE_VOTE_DRV1_REG20_ADDR A:&base_addr+0x811408
y.create.l HWIO_RPMH_VRM_MODE_VOTE_DRV1_REG21_ADDR A:&base_addr+0x811508
y.create.l HWIO_RPMH_VRM_MODE_VOTE_DRV1_REG22_ADDR A:&base_addr+0x811608
y.create.l HWIO_RPMH_VRM_MODE_VOTE_DRV1_REG23_ADDR A:&base_addr+0x811708
y.create.l HWIO_RPMH_VRM_MODE_VOTE_DRV1_REG24_ADDR A:&base_addr+0x811808
y.create.l HWIO_RPMH_VRM_MODE_VOTE_DRV1_REG25_ADDR A:&base_addr+0x811908
y.create.l HWIO_RPMH_VRM_MODE_VOTE_DRV1_REG26_ADDR A:&base_addr+0x811a08
y.create.l HWIO_RPMH_VRM_MODE_VOTE_DRV1_REG27_ADDR A:&base_addr+0x811b08
y.create.l HWIO_RPMH_VRM_MODE_VOTE_DRV1_REG28_ADDR A:&base_addr+0x811c08
y.create.l HWIO_RPMH_VRM_MODE_VOTE_DRV1_REG29_ADDR A:&base_addr+0x811d08
y.create.l HWIO_RPMH_VRM_MODE_VOTE_DRV1_REG30_ADDR A:&base_addr+0x811e08
y.create.l HWIO_RPMH_VRM_MODE_VOTE_DRV1_REG31_ADDR A:&base_addr+0x811f08
y.create.l HWIO_RPMH_VRM_MODE_VOTE_DRV1_REG32_ADDR A:&base_addr+0x812008
y.create.l HWIO_RPMH_VRM_MODE_VOTE_DRV1_REG33_ADDR A:&base_addr+0x812108
y.create.l HWIO_RPMH_VRM_MODE_VOTE_DRV1_REG34_ADDR A:&base_addr+0x812208
y.create.l HWIO_RPMH_VRM_MODE_VOTE_DRV1_REG35_ADDR A:&base_addr+0x812308
y.create.l HWIO_RPMH_VRM_MODE_VOTE_DRV1_REG36_ADDR A:&base_addr+0x812408
y.create.l HWIO_RPMH_VRM_MODE_VOTE_DRV1_REG37_ADDR A:&base_addr+0x812508
y.create.l HWIO_RPMH_VRM_MODE_VOTE_DRV1_REG38_ADDR A:&base_addr+0x812608
y.create.l HWIO_RPMH_VRM_MODE_VOTE_DRV1_REG39_ADDR A:&base_addr+0x812708
y.create.l HWIO_RPMH_VRM_MODE_VOTE_DRV1_REG40_ADDR A:&base_addr+0x812808
y.create.l HWIO_RPMH_VRM_MODE_VOTE_DRV1_REG41_ADDR A:&base_addr+0x812908
y.create.l HWIO_RPMH_VRM_MODE_VOTE_DRV1_REG42_ADDR A:&base_addr+0x812a08
y.create.l HWIO_RPMH_VRM_MODE_VOTE_DRV1_REG43_ADDR A:&base_addr+0x812b08
y.create.l HWIO_RPMH_VRM_MODE_VOTE_DRV1_REG44_ADDR A:&base_addr+0x812c08
y.create.l HWIO_RPMH_VRM_MODE_VOTE_DRV1_REG45_ADDR A:&base_addr+0x812d08
y.create.l HWIO_RPMH_VRM_MODE_VOTE_DRV2_REG0_ADDR A:&base_addr+0x820008
y.create.l HWIO_RPMH_VRM_MODE_VOTE_DRV2_REG1_ADDR A:&base_addr+0x820108
y.create.l HWIO_RPMH_VRM_MODE_VOTE_DRV2_REG2_ADDR A:&base_addr+0x820208
y.create.l HWIO_RPMH_VRM_MODE_VOTE_DRV2_REG3_ADDR A:&base_addr+0x820308
y.create.l HWIO_RPMH_VRM_MODE_VOTE_DRV2_REG4_ADDR A:&base_addr+0x820408
y.create.l HWIO_RPMH_VRM_MODE_VOTE_DRV2_REG5_ADDR A:&base_addr+0x820508
y.create.l HWIO_RPMH_VRM_MODE_VOTE_DRV2_REG6_ADDR A:&base_addr+0x820608
y.create.l HWIO_RPMH_VRM_MODE_VOTE_DRV2_REG7_ADDR A:&base_addr+0x820708
y.create.l HWIO_RPMH_VRM_MODE_VOTE_DRV2_REG8_ADDR A:&base_addr+0x820808
y.create.l HWIO_RPMH_VRM_MODE_VOTE_DRV2_REG9_ADDR A:&base_addr+0x820908
y.create.l HWIO_RPMH_VRM_MODE_VOTE_DRV2_REG10_ADDR A:&base_addr+0x820a08
y.create.l HWIO_RPMH_VRM_MODE_VOTE_DRV2_REG11_ADDR A:&base_addr+0x820b08
y.create.l HWIO_RPMH_VRM_MODE_VOTE_DRV2_REG12_ADDR A:&base_addr+0x820c08
y.create.l HWIO_RPMH_VRM_MODE_VOTE_DRV2_REG13_ADDR A:&base_addr+0x820d08
y.create.l HWIO_RPMH_VRM_MODE_VOTE_DRV2_REG14_ADDR A:&base_addr+0x820e08
y.create.l HWIO_RPMH_VRM_MODE_VOTE_DRV2_REG15_ADDR A:&base_addr+0x820f08
y.create.l HWIO_RPMH_VRM_MODE_VOTE_DRV2_REG16_ADDR A:&base_addr+0x821008
y.create.l HWIO_RPMH_VRM_MODE_VOTE_DRV2_REG17_ADDR A:&base_addr+0x821108
y.create.l HWIO_RPMH_VRM_MODE_VOTE_DRV2_REG18_ADDR A:&base_addr+0x821208
y.create.l HWIO_RPMH_VRM_MODE_VOTE_DRV2_REG19_ADDR A:&base_addr+0x821308
y.create.l HWIO_RPMH_VRM_MODE_VOTE_DRV2_REG20_ADDR A:&base_addr+0x821408
y.create.l HWIO_RPMH_VRM_MODE_VOTE_DRV2_REG21_ADDR A:&base_addr+0x821508
y.create.l HWIO_RPMH_VRM_MODE_VOTE_DRV2_REG22_ADDR A:&base_addr+0x821608
y.create.l HWIO_RPMH_VRM_MODE_VOTE_DRV2_REG23_ADDR A:&base_addr+0x821708
y.create.l HWIO_RPMH_VRM_MODE_VOTE_DRV2_REG24_ADDR A:&base_addr+0x821808
y.create.l HWIO_RPMH_VRM_MODE_VOTE_DRV2_REG25_ADDR A:&base_addr+0x821908
y.create.l HWIO_RPMH_VRM_MODE_VOTE_DRV2_REG26_ADDR A:&base_addr+0x821a08
y.create.l HWIO_RPMH_VRM_MODE_VOTE_DRV2_REG27_ADDR A:&base_addr+0x821b08
y.create.l HWIO_RPMH_VRM_MODE_VOTE_DRV2_REG28_ADDR A:&base_addr+0x821c08
y.create.l HWIO_RPMH_VRM_MODE_VOTE_DRV2_REG29_ADDR A:&base_addr+0x821d08
y.create.l HWIO_RPMH_VRM_MODE_VOTE_DRV2_REG30_ADDR A:&base_addr+0x821e08
y.create.l HWIO_RPMH_VRM_MODE_VOTE_DRV2_REG31_ADDR A:&base_addr+0x821f08
y.create.l HWIO_RPMH_VRM_MODE_VOTE_DRV2_REG32_ADDR A:&base_addr+0x822008
y.create.l HWIO_RPMH_VRM_MODE_VOTE_DRV2_REG33_ADDR A:&base_addr+0x822108
y.create.l HWIO_RPMH_VRM_MODE_VOTE_DRV2_REG34_ADDR A:&base_addr+0x822208
y.create.l HWIO_RPMH_VRM_MODE_VOTE_DRV2_REG35_ADDR A:&base_addr+0x822308
y.create.l HWIO_RPMH_VRM_MODE_VOTE_DRV2_REG36_ADDR A:&base_addr+0x822408
y.create.l HWIO_RPMH_VRM_MODE_VOTE_DRV2_REG37_ADDR A:&base_addr+0x822508
y.create.l HWIO_RPMH_VRM_MODE_VOTE_DRV2_REG38_ADDR A:&base_addr+0x822608
y.create.l HWIO_RPMH_VRM_MODE_VOTE_DRV2_REG39_ADDR A:&base_addr+0x822708
y.create.l HWIO_RPMH_VRM_MODE_VOTE_DRV2_REG40_ADDR A:&base_addr+0x822808
y.create.l HWIO_RPMH_VRM_MODE_VOTE_DRV2_REG41_ADDR A:&base_addr+0x822908
y.create.l HWIO_RPMH_VRM_MODE_VOTE_DRV2_REG42_ADDR A:&base_addr+0x822a08
y.create.l HWIO_RPMH_VRM_MODE_VOTE_DRV2_REG43_ADDR A:&base_addr+0x822b08
y.create.l HWIO_RPMH_VRM_MODE_VOTE_DRV2_REG44_ADDR A:&base_addr+0x822c08
y.create.l HWIO_RPMH_VRM_MODE_VOTE_DRV2_REG45_ADDR A:&base_addr+0x822d08
y.create.l HWIO_RPMH_VRM_MODE_VOTE_DRV3_REG0_ADDR A:&base_addr+0x830008
y.create.l HWIO_RPMH_VRM_MODE_VOTE_DRV3_REG1_ADDR A:&base_addr+0x830108
y.create.l HWIO_RPMH_VRM_MODE_VOTE_DRV3_REG2_ADDR A:&base_addr+0x830208
y.create.l HWIO_RPMH_VRM_MODE_VOTE_DRV3_REG3_ADDR A:&base_addr+0x830308
y.create.l HWIO_RPMH_VRM_MODE_VOTE_DRV3_REG4_ADDR A:&base_addr+0x830408
y.create.l HWIO_RPMH_VRM_MODE_VOTE_DRV3_REG5_ADDR A:&base_addr+0x830508
y.create.l HWIO_RPMH_VRM_MODE_VOTE_DRV3_REG6_ADDR A:&base_addr+0x830608
y.create.l HWIO_RPMH_VRM_MODE_VOTE_DRV3_REG7_ADDR A:&base_addr+0x830708
y.create.l HWIO_RPMH_VRM_MODE_VOTE_DRV3_REG8_ADDR A:&base_addr+0x830808
y.create.l HWIO_RPMH_VRM_MODE_VOTE_DRV3_REG9_ADDR A:&base_addr+0x830908
y.create.l HWIO_RPMH_VRM_MODE_VOTE_DRV3_REG10_ADDR A:&base_addr+0x830a08
y.create.l HWIO_RPMH_VRM_MODE_VOTE_DRV3_REG11_ADDR A:&base_addr+0x830b08
y.create.l HWIO_RPMH_VRM_MODE_VOTE_DRV3_REG12_ADDR A:&base_addr+0x830c08
y.create.l HWIO_RPMH_VRM_MODE_VOTE_DRV3_REG13_ADDR A:&base_addr+0x830d08
y.create.l HWIO_RPMH_VRM_MODE_VOTE_DRV3_REG14_ADDR A:&base_addr+0x830e08
y.create.l HWIO_RPMH_VRM_MODE_VOTE_DRV3_REG15_ADDR A:&base_addr+0x830f08
y.create.l HWIO_RPMH_VRM_MODE_VOTE_DRV3_REG16_ADDR A:&base_addr+0x831008
y.create.l HWIO_RPMH_VRM_MODE_VOTE_DRV3_REG17_ADDR A:&base_addr+0x831108
y.create.l HWIO_RPMH_VRM_MODE_VOTE_DRV3_REG18_ADDR A:&base_addr+0x831208
y.create.l HWIO_RPMH_VRM_MODE_VOTE_DRV3_REG19_ADDR A:&base_addr+0x831308
y.create.l HWIO_RPMH_VRM_MODE_VOTE_DRV3_REG20_ADDR A:&base_addr+0x831408
y.create.l HWIO_RPMH_VRM_MODE_VOTE_DRV3_REG21_ADDR A:&base_addr+0x831508
y.create.l HWIO_RPMH_VRM_MODE_VOTE_DRV3_REG22_ADDR A:&base_addr+0x831608
y.create.l HWIO_RPMH_VRM_MODE_VOTE_DRV3_REG23_ADDR A:&base_addr+0x831708
y.create.l HWIO_RPMH_VRM_MODE_VOTE_DRV3_REG24_ADDR A:&base_addr+0x831808
y.create.l HWIO_RPMH_VRM_MODE_VOTE_DRV3_REG25_ADDR A:&base_addr+0x831908
y.create.l HWIO_RPMH_VRM_MODE_VOTE_DRV3_REG26_ADDR A:&base_addr+0x831a08
y.create.l HWIO_RPMH_VRM_MODE_VOTE_DRV3_REG27_ADDR A:&base_addr+0x831b08
y.create.l HWIO_RPMH_VRM_MODE_VOTE_DRV3_REG28_ADDR A:&base_addr+0x831c08
y.create.l HWIO_RPMH_VRM_MODE_VOTE_DRV3_REG29_ADDR A:&base_addr+0x831d08
y.create.l HWIO_RPMH_VRM_MODE_VOTE_DRV3_REG30_ADDR A:&base_addr+0x831e08
y.create.l HWIO_RPMH_VRM_MODE_VOTE_DRV3_REG31_ADDR A:&base_addr+0x831f08
y.create.l HWIO_RPMH_VRM_MODE_VOTE_DRV3_REG32_ADDR A:&base_addr+0x832008
y.create.l HWIO_RPMH_VRM_MODE_VOTE_DRV3_REG33_ADDR A:&base_addr+0x832108
y.create.l HWIO_RPMH_VRM_MODE_VOTE_DRV3_REG34_ADDR A:&base_addr+0x832208
y.create.l HWIO_RPMH_VRM_MODE_VOTE_DRV3_REG35_ADDR A:&base_addr+0x832308
y.create.l HWIO_RPMH_VRM_MODE_VOTE_DRV3_REG36_ADDR A:&base_addr+0x832408
y.create.l HWIO_RPMH_VRM_MODE_VOTE_DRV3_REG37_ADDR A:&base_addr+0x832508
y.create.l HWIO_RPMH_VRM_MODE_VOTE_DRV3_REG38_ADDR A:&base_addr+0x832608
y.create.l HWIO_RPMH_VRM_MODE_VOTE_DRV3_REG39_ADDR A:&base_addr+0x832708
y.create.l HWIO_RPMH_VRM_MODE_VOTE_DRV3_REG40_ADDR A:&base_addr+0x832808
y.create.l HWIO_RPMH_VRM_MODE_VOTE_DRV3_REG41_ADDR A:&base_addr+0x832908
y.create.l HWIO_RPMH_VRM_MODE_VOTE_DRV3_REG42_ADDR A:&base_addr+0x832a08
y.create.l HWIO_RPMH_VRM_MODE_VOTE_DRV3_REG43_ADDR A:&base_addr+0x832b08
y.create.l HWIO_RPMH_VRM_MODE_VOTE_DRV3_REG44_ADDR A:&base_addr+0x832c08
y.create.l HWIO_RPMH_VRM_MODE_VOTE_DRV3_REG45_ADDR A:&base_addr+0x832d08
y.create.l HWIO_RPMH_VRM_MODE_VOTE_DRV4_REG0_ADDR A:&base_addr+0x840008
y.create.l HWIO_RPMH_VRM_MODE_VOTE_DRV4_REG1_ADDR A:&base_addr+0x840108
y.create.l HWIO_RPMH_VRM_MODE_VOTE_DRV4_REG2_ADDR A:&base_addr+0x840208
y.create.l HWIO_RPMH_VRM_MODE_VOTE_DRV4_REG3_ADDR A:&base_addr+0x840308
y.create.l HWIO_RPMH_VRM_MODE_VOTE_DRV4_REG4_ADDR A:&base_addr+0x840408
y.create.l HWIO_RPMH_VRM_MODE_VOTE_DRV4_REG5_ADDR A:&base_addr+0x840508
y.create.l HWIO_RPMH_VRM_MODE_VOTE_DRV4_REG6_ADDR A:&base_addr+0x840608
y.create.l HWIO_RPMH_VRM_MODE_VOTE_DRV4_REG7_ADDR A:&base_addr+0x840708
y.create.l HWIO_RPMH_VRM_MODE_VOTE_DRV4_REG8_ADDR A:&base_addr+0x840808
y.create.l HWIO_RPMH_VRM_MODE_VOTE_DRV4_REG9_ADDR A:&base_addr+0x840908
y.create.l HWIO_RPMH_VRM_MODE_VOTE_DRV4_REG10_ADDR A:&base_addr+0x840a08
y.create.l HWIO_RPMH_VRM_MODE_VOTE_DRV4_REG11_ADDR A:&base_addr+0x840b08
y.create.l HWIO_RPMH_VRM_MODE_VOTE_DRV4_REG12_ADDR A:&base_addr+0x840c08
y.create.l HWIO_RPMH_VRM_MODE_VOTE_DRV4_REG13_ADDR A:&base_addr+0x840d08
y.create.l HWIO_RPMH_VRM_MODE_VOTE_DRV4_REG14_ADDR A:&base_addr+0x840e08
y.create.l HWIO_RPMH_VRM_MODE_VOTE_DRV4_REG15_ADDR A:&base_addr+0x840f08
y.create.l HWIO_RPMH_VRM_MODE_VOTE_DRV4_REG16_ADDR A:&base_addr+0x841008
y.create.l HWIO_RPMH_VRM_MODE_VOTE_DRV4_REG17_ADDR A:&base_addr+0x841108
y.create.l HWIO_RPMH_VRM_MODE_VOTE_DRV4_REG18_ADDR A:&base_addr+0x841208
y.create.l HWIO_RPMH_VRM_MODE_VOTE_DRV4_REG19_ADDR A:&base_addr+0x841308
y.create.l HWIO_RPMH_VRM_MODE_VOTE_DRV4_REG20_ADDR A:&base_addr+0x841408
y.create.l HWIO_RPMH_VRM_MODE_VOTE_DRV4_REG21_ADDR A:&base_addr+0x841508
y.create.l HWIO_RPMH_VRM_MODE_VOTE_DRV4_REG22_ADDR A:&base_addr+0x841608
y.create.l HWIO_RPMH_VRM_MODE_VOTE_DRV4_REG23_ADDR A:&base_addr+0x841708
y.create.l HWIO_RPMH_VRM_MODE_VOTE_DRV4_REG24_ADDR A:&base_addr+0x841808
y.create.l HWIO_RPMH_VRM_MODE_VOTE_DRV4_REG25_ADDR A:&base_addr+0x841908
y.create.l HWIO_RPMH_VRM_MODE_VOTE_DRV4_REG26_ADDR A:&base_addr+0x841a08
y.create.l HWIO_RPMH_VRM_MODE_VOTE_DRV4_REG27_ADDR A:&base_addr+0x841b08
y.create.l HWIO_RPMH_VRM_MODE_VOTE_DRV4_REG28_ADDR A:&base_addr+0x841c08
y.create.l HWIO_RPMH_VRM_MODE_VOTE_DRV4_REG29_ADDR A:&base_addr+0x841d08
y.create.l HWIO_RPMH_VRM_MODE_VOTE_DRV4_REG30_ADDR A:&base_addr+0x841e08
y.create.l HWIO_RPMH_VRM_MODE_VOTE_DRV4_REG31_ADDR A:&base_addr+0x841f08
y.create.l HWIO_RPMH_VRM_MODE_VOTE_DRV4_REG32_ADDR A:&base_addr+0x842008
y.create.l HWIO_RPMH_VRM_MODE_VOTE_DRV4_REG33_ADDR A:&base_addr+0x842108
y.create.l HWIO_RPMH_VRM_MODE_VOTE_DRV4_REG34_ADDR A:&base_addr+0x842208
y.create.l HWIO_RPMH_VRM_MODE_VOTE_DRV4_REG35_ADDR A:&base_addr+0x842308
y.create.l HWIO_RPMH_VRM_MODE_VOTE_DRV4_REG36_ADDR A:&base_addr+0x842408
y.create.l HWIO_RPMH_VRM_MODE_VOTE_DRV4_REG37_ADDR A:&base_addr+0x842508
y.create.l HWIO_RPMH_VRM_MODE_VOTE_DRV4_REG38_ADDR A:&base_addr+0x842608
y.create.l HWIO_RPMH_VRM_MODE_VOTE_DRV4_REG39_ADDR A:&base_addr+0x842708
y.create.l HWIO_RPMH_VRM_MODE_VOTE_DRV4_REG40_ADDR A:&base_addr+0x842808
y.create.l HWIO_RPMH_VRM_MODE_VOTE_DRV4_REG41_ADDR A:&base_addr+0x842908
y.create.l HWIO_RPMH_VRM_MODE_VOTE_DRV4_REG42_ADDR A:&base_addr+0x842a08
y.create.l HWIO_RPMH_VRM_MODE_VOTE_DRV4_REG43_ADDR A:&base_addr+0x842b08
y.create.l HWIO_RPMH_VRM_MODE_VOTE_DRV4_REG44_ADDR A:&base_addr+0x842c08
y.create.l HWIO_RPMH_VRM_MODE_VOTE_DRV4_REG45_ADDR A:&base_addr+0x842d08
y.create.l HWIO_RPMH_VRM_MODE_VOTE_DRV5_REG0_ADDR A:&base_addr+0x850008
y.create.l HWIO_RPMH_VRM_MODE_VOTE_DRV5_REG1_ADDR A:&base_addr+0x850108
y.create.l HWIO_RPMH_VRM_MODE_VOTE_DRV5_REG2_ADDR A:&base_addr+0x850208
y.create.l HWIO_RPMH_VRM_MODE_VOTE_DRV5_REG3_ADDR A:&base_addr+0x850308
y.create.l HWIO_RPMH_VRM_MODE_VOTE_DRV5_REG4_ADDR A:&base_addr+0x850408
y.create.l HWIO_RPMH_VRM_MODE_VOTE_DRV5_REG5_ADDR A:&base_addr+0x850508
y.create.l HWIO_RPMH_VRM_MODE_VOTE_DRV5_REG6_ADDR A:&base_addr+0x850608
y.create.l HWIO_RPMH_VRM_MODE_VOTE_DRV5_REG7_ADDR A:&base_addr+0x850708
y.create.l HWIO_RPMH_VRM_MODE_VOTE_DRV5_REG8_ADDR A:&base_addr+0x850808
y.create.l HWIO_RPMH_VRM_MODE_VOTE_DRV5_REG9_ADDR A:&base_addr+0x850908
y.create.l HWIO_RPMH_VRM_MODE_VOTE_DRV5_REG10_ADDR A:&base_addr+0x850a08
y.create.l HWIO_RPMH_VRM_MODE_VOTE_DRV5_REG11_ADDR A:&base_addr+0x850b08
y.create.l HWIO_RPMH_VRM_MODE_VOTE_DRV5_REG12_ADDR A:&base_addr+0x850c08
y.create.l HWIO_RPMH_VRM_MODE_VOTE_DRV5_REG13_ADDR A:&base_addr+0x850d08
y.create.l HWIO_RPMH_VRM_MODE_VOTE_DRV5_REG14_ADDR A:&base_addr+0x850e08
y.create.l HWIO_RPMH_VRM_MODE_VOTE_DRV5_REG15_ADDR A:&base_addr+0x850f08
y.create.l HWIO_RPMH_VRM_MODE_VOTE_DRV5_REG16_ADDR A:&base_addr+0x851008
y.create.l HWIO_RPMH_VRM_MODE_VOTE_DRV5_REG17_ADDR A:&base_addr+0x851108
y.create.l HWIO_RPMH_VRM_MODE_VOTE_DRV5_REG18_ADDR A:&base_addr+0x851208
y.create.l HWIO_RPMH_VRM_MODE_VOTE_DRV5_REG19_ADDR A:&base_addr+0x851308
y.create.l HWIO_RPMH_VRM_MODE_VOTE_DRV5_REG20_ADDR A:&base_addr+0x851408
y.create.l HWIO_RPMH_VRM_MODE_VOTE_DRV5_REG21_ADDR A:&base_addr+0x851508
y.create.l HWIO_RPMH_VRM_MODE_VOTE_DRV5_REG22_ADDR A:&base_addr+0x851608
y.create.l HWIO_RPMH_VRM_MODE_VOTE_DRV5_REG23_ADDR A:&base_addr+0x851708
y.create.l HWIO_RPMH_VRM_MODE_VOTE_DRV5_REG24_ADDR A:&base_addr+0x851808
y.create.l HWIO_RPMH_VRM_MODE_VOTE_DRV5_REG25_ADDR A:&base_addr+0x851908
y.create.l HWIO_RPMH_VRM_MODE_VOTE_DRV5_REG26_ADDR A:&base_addr+0x851a08
y.create.l HWIO_RPMH_VRM_MODE_VOTE_DRV5_REG27_ADDR A:&base_addr+0x851b08
y.create.l HWIO_RPMH_VRM_MODE_VOTE_DRV5_REG28_ADDR A:&base_addr+0x851c08
y.create.l HWIO_RPMH_VRM_MODE_VOTE_DRV5_REG29_ADDR A:&base_addr+0x851d08
y.create.l HWIO_RPMH_VRM_MODE_VOTE_DRV5_REG30_ADDR A:&base_addr+0x851e08
y.create.l HWIO_RPMH_VRM_MODE_VOTE_DRV5_REG31_ADDR A:&base_addr+0x851f08
y.create.l HWIO_RPMH_VRM_MODE_VOTE_DRV5_REG32_ADDR A:&base_addr+0x852008
y.create.l HWIO_RPMH_VRM_MODE_VOTE_DRV5_REG33_ADDR A:&base_addr+0x852108
y.create.l HWIO_RPMH_VRM_MODE_VOTE_DRV5_REG34_ADDR A:&base_addr+0x852208
y.create.l HWIO_RPMH_VRM_MODE_VOTE_DRV5_REG35_ADDR A:&base_addr+0x852308
y.create.l HWIO_RPMH_VRM_MODE_VOTE_DRV5_REG36_ADDR A:&base_addr+0x852408
y.create.l HWIO_RPMH_VRM_MODE_VOTE_DRV5_REG37_ADDR A:&base_addr+0x852508
y.create.l HWIO_RPMH_VRM_MODE_VOTE_DRV5_REG38_ADDR A:&base_addr+0x852608
y.create.l HWIO_RPMH_VRM_MODE_VOTE_DRV5_REG39_ADDR A:&base_addr+0x852708
y.create.l HWIO_RPMH_VRM_MODE_VOTE_DRV5_REG40_ADDR A:&base_addr+0x852808
y.create.l HWIO_RPMH_VRM_MODE_VOTE_DRV5_REG41_ADDR A:&base_addr+0x852908
y.create.l HWIO_RPMH_VRM_MODE_VOTE_DRV5_REG42_ADDR A:&base_addr+0x852a08
y.create.l HWIO_RPMH_VRM_MODE_VOTE_DRV5_REG43_ADDR A:&base_addr+0x852b08
y.create.l HWIO_RPMH_VRM_MODE_VOTE_DRV5_REG44_ADDR A:&base_addr+0x852c08
y.create.l HWIO_RPMH_VRM_MODE_VOTE_DRV5_REG45_ADDR A:&base_addr+0x852d08
y.create.l HWIO_RPMH_VRM_MODE_VOTE_DRV6_REG0_ADDR A:&base_addr+0x860008
y.create.l HWIO_RPMH_VRM_MODE_VOTE_DRV6_REG1_ADDR A:&base_addr+0x860108
y.create.l HWIO_RPMH_VRM_MODE_VOTE_DRV6_REG2_ADDR A:&base_addr+0x860208
y.create.l HWIO_RPMH_VRM_MODE_VOTE_DRV6_REG3_ADDR A:&base_addr+0x860308
y.create.l HWIO_RPMH_VRM_MODE_VOTE_DRV6_REG4_ADDR A:&base_addr+0x860408
y.create.l HWIO_RPMH_VRM_MODE_VOTE_DRV6_REG5_ADDR A:&base_addr+0x860508
y.create.l HWIO_RPMH_VRM_MODE_VOTE_DRV6_REG6_ADDR A:&base_addr+0x860608
y.create.l HWIO_RPMH_VRM_MODE_VOTE_DRV6_REG7_ADDR A:&base_addr+0x860708
y.create.l HWIO_RPMH_VRM_MODE_VOTE_DRV6_REG8_ADDR A:&base_addr+0x860808
y.create.l HWIO_RPMH_VRM_MODE_VOTE_DRV6_REG9_ADDR A:&base_addr+0x860908
y.create.l HWIO_RPMH_VRM_MODE_VOTE_DRV6_REG10_ADDR A:&base_addr+0x860a08
y.create.l HWIO_RPMH_VRM_MODE_VOTE_DRV6_REG11_ADDR A:&base_addr+0x860b08
y.create.l HWIO_RPMH_VRM_MODE_VOTE_DRV6_REG12_ADDR A:&base_addr+0x860c08
y.create.l HWIO_RPMH_VRM_MODE_VOTE_DRV6_REG13_ADDR A:&base_addr+0x860d08
y.create.l HWIO_RPMH_VRM_MODE_VOTE_DRV6_REG14_ADDR A:&base_addr+0x860e08
y.create.l HWIO_RPMH_VRM_MODE_VOTE_DRV6_REG15_ADDR A:&base_addr+0x860f08
y.create.l HWIO_RPMH_VRM_MODE_VOTE_DRV6_REG16_ADDR A:&base_addr+0x861008
y.create.l HWIO_RPMH_VRM_MODE_VOTE_DRV6_REG17_ADDR A:&base_addr+0x861108
y.create.l HWIO_RPMH_VRM_MODE_VOTE_DRV6_REG18_ADDR A:&base_addr+0x861208
y.create.l HWIO_RPMH_VRM_MODE_VOTE_DRV6_REG19_ADDR A:&base_addr+0x861308
y.create.l HWIO_RPMH_VRM_MODE_VOTE_DRV6_REG20_ADDR A:&base_addr+0x861408
y.create.l HWIO_RPMH_VRM_MODE_VOTE_DRV6_REG21_ADDR A:&base_addr+0x861508
y.create.l HWIO_RPMH_VRM_MODE_VOTE_DRV6_REG22_ADDR A:&base_addr+0x861608
y.create.l HWIO_RPMH_VRM_MODE_VOTE_DRV6_REG23_ADDR A:&base_addr+0x861708
y.create.l HWIO_RPMH_VRM_MODE_VOTE_DRV6_REG24_ADDR A:&base_addr+0x861808
y.create.l HWIO_RPMH_VRM_MODE_VOTE_DRV6_REG25_ADDR A:&base_addr+0x861908
y.create.l HWIO_RPMH_VRM_MODE_VOTE_DRV6_REG26_ADDR A:&base_addr+0x861a08
y.create.l HWIO_RPMH_VRM_MODE_VOTE_DRV6_REG27_ADDR A:&base_addr+0x861b08
y.create.l HWIO_RPMH_VRM_MODE_VOTE_DRV6_REG28_ADDR A:&base_addr+0x861c08
y.create.l HWIO_RPMH_VRM_MODE_VOTE_DRV6_REG29_ADDR A:&base_addr+0x861d08
y.create.l HWIO_RPMH_VRM_MODE_VOTE_DRV6_REG30_ADDR A:&base_addr+0x861e08
y.create.l HWIO_RPMH_VRM_MODE_VOTE_DRV6_REG31_ADDR A:&base_addr+0x861f08
y.create.l HWIO_RPMH_VRM_MODE_VOTE_DRV6_REG32_ADDR A:&base_addr+0x862008
y.create.l HWIO_RPMH_VRM_MODE_VOTE_DRV6_REG33_ADDR A:&base_addr+0x862108
y.create.l HWIO_RPMH_VRM_MODE_VOTE_DRV6_REG34_ADDR A:&base_addr+0x862208
y.create.l HWIO_RPMH_VRM_MODE_VOTE_DRV6_REG35_ADDR A:&base_addr+0x862308
y.create.l HWIO_RPMH_VRM_MODE_VOTE_DRV6_REG36_ADDR A:&base_addr+0x862408
y.create.l HWIO_RPMH_VRM_MODE_VOTE_DRV6_REG37_ADDR A:&base_addr+0x862508
y.create.l HWIO_RPMH_VRM_MODE_VOTE_DRV6_REG38_ADDR A:&base_addr+0x862608
y.create.l HWIO_RPMH_VRM_MODE_VOTE_DRV6_REG39_ADDR A:&base_addr+0x862708
y.create.l HWIO_RPMH_VRM_MODE_VOTE_DRV6_REG40_ADDR A:&base_addr+0x862808
y.create.l HWIO_RPMH_VRM_MODE_VOTE_DRV6_REG41_ADDR A:&base_addr+0x862908
y.create.l HWIO_RPMH_VRM_MODE_VOTE_DRV6_REG42_ADDR A:&base_addr+0x862a08
y.create.l HWIO_RPMH_VRM_MODE_VOTE_DRV6_REG43_ADDR A:&base_addr+0x862b08
y.create.l HWIO_RPMH_VRM_MODE_VOTE_DRV6_REG44_ADDR A:&base_addr+0x862c08
y.create.l HWIO_RPMH_VRM_MODE_VOTE_DRV6_REG45_ADDR A:&base_addr+0x862d08
y.create.l HWIO_RPMH_VRM_MODE_VOTE_DRV7_REG0_ADDR A:&base_addr+0x870008
y.create.l HWIO_RPMH_VRM_MODE_VOTE_DRV7_REG1_ADDR A:&base_addr+0x870108
y.create.l HWIO_RPMH_VRM_MODE_VOTE_DRV7_REG2_ADDR A:&base_addr+0x870208
y.create.l HWIO_RPMH_VRM_MODE_VOTE_DRV7_REG3_ADDR A:&base_addr+0x870308
y.create.l HWIO_RPMH_VRM_MODE_VOTE_DRV7_REG4_ADDR A:&base_addr+0x870408
y.create.l HWIO_RPMH_VRM_MODE_VOTE_DRV7_REG5_ADDR A:&base_addr+0x870508
y.create.l HWIO_RPMH_VRM_MODE_VOTE_DRV7_REG6_ADDR A:&base_addr+0x870608
y.create.l HWIO_RPMH_VRM_MODE_VOTE_DRV7_REG7_ADDR A:&base_addr+0x870708
y.create.l HWIO_RPMH_VRM_MODE_VOTE_DRV7_REG8_ADDR A:&base_addr+0x870808
y.create.l HWIO_RPMH_VRM_MODE_VOTE_DRV7_REG9_ADDR A:&base_addr+0x870908
y.create.l HWIO_RPMH_VRM_MODE_VOTE_DRV7_REG10_ADDR A:&base_addr+0x870a08
y.create.l HWIO_RPMH_VRM_MODE_VOTE_DRV7_REG11_ADDR A:&base_addr+0x870b08
y.create.l HWIO_RPMH_VRM_MODE_VOTE_DRV7_REG12_ADDR A:&base_addr+0x870c08
y.create.l HWIO_RPMH_VRM_MODE_VOTE_DRV7_REG13_ADDR A:&base_addr+0x870d08
y.create.l HWIO_RPMH_VRM_MODE_VOTE_DRV7_REG14_ADDR A:&base_addr+0x870e08
y.create.l HWIO_RPMH_VRM_MODE_VOTE_DRV7_REG15_ADDR A:&base_addr+0x870f08
y.create.l HWIO_RPMH_VRM_MODE_VOTE_DRV7_REG16_ADDR A:&base_addr+0x871008
y.create.l HWIO_RPMH_VRM_MODE_VOTE_DRV7_REG17_ADDR A:&base_addr+0x871108
y.create.l HWIO_RPMH_VRM_MODE_VOTE_DRV7_REG18_ADDR A:&base_addr+0x871208
y.create.l HWIO_RPMH_VRM_MODE_VOTE_DRV7_REG19_ADDR A:&base_addr+0x871308
y.create.l HWIO_RPMH_VRM_MODE_VOTE_DRV7_REG20_ADDR A:&base_addr+0x871408
y.create.l HWIO_RPMH_VRM_MODE_VOTE_DRV7_REG21_ADDR A:&base_addr+0x871508
y.create.l HWIO_RPMH_VRM_MODE_VOTE_DRV7_REG22_ADDR A:&base_addr+0x871608
y.create.l HWIO_RPMH_VRM_MODE_VOTE_DRV7_REG23_ADDR A:&base_addr+0x871708
y.create.l HWIO_RPMH_VRM_MODE_VOTE_DRV7_REG24_ADDR A:&base_addr+0x871808
y.create.l HWIO_RPMH_VRM_MODE_VOTE_DRV7_REG25_ADDR A:&base_addr+0x871908
y.create.l HWIO_RPMH_VRM_MODE_VOTE_DRV7_REG26_ADDR A:&base_addr+0x871a08
y.create.l HWIO_RPMH_VRM_MODE_VOTE_DRV7_REG27_ADDR A:&base_addr+0x871b08
y.create.l HWIO_RPMH_VRM_MODE_VOTE_DRV7_REG28_ADDR A:&base_addr+0x871c08
y.create.l HWIO_RPMH_VRM_MODE_VOTE_DRV7_REG29_ADDR A:&base_addr+0x871d08
y.create.l HWIO_RPMH_VRM_MODE_VOTE_DRV7_REG30_ADDR A:&base_addr+0x871e08
y.create.l HWIO_RPMH_VRM_MODE_VOTE_DRV7_REG31_ADDR A:&base_addr+0x871f08
y.create.l HWIO_RPMH_VRM_MODE_VOTE_DRV7_REG32_ADDR A:&base_addr+0x872008
y.create.l HWIO_RPMH_VRM_MODE_VOTE_DRV7_REG33_ADDR A:&base_addr+0x872108
y.create.l HWIO_RPMH_VRM_MODE_VOTE_DRV7_REG34_ADDR A:&base_addr+0x872208
y.create.l HWIO_RPMH_VRM_MODE_VOTE_DRV7_REG35_ADDR A:&base_addr+0x872308
y.create.l HWIO_RPMH_VRM_MODE_VOTE_DRV7_REG36_ADDR A:&base_addr+0x872408
y.create.l HWIO_RPMH_VRM_MODE_VOTE_DRV7_REG37_ADDR A:&base_addr+0x872508
y.create.l HWIO_RPMH_VRM_MODE_VOTE_DRV7_REG38_ADDR A:&base_addr+0x872608
y.create.l HWIO_RPMH_VRM_MODE_VOTE_DRV7_REG39_ADDR A:&base_addr+0x872708
y.create.l HWIO_RPMH_VRM_MODE_VOTE_DRV7_REG40_ADDR A:&base_addr+0x872808
y.create.l HWIO_RPMH_VRM_MODE_VOTE_DRV7_REG41_ADDR A:&base_addr+0x872908
y.create.l HWIO_RPMH_VRM_MODE_VOTE_DRV7_REG42_ADDR A:&base_addr+0x872a08
y.create.l HWIO_RPMH_VRM_MODE_VOTE_DRV7_REG43_ADDR A:&base_addr+0x872b08
y.create.l HWIO_RPMH_VRM_MODE_VOTE_DRV7_REG44_ADDR A:&base_addr+0x872c08
y.create.l HWIO_RPMH_VRM_MODE_VOTE_DRV7_REG45_ADDR A:&base_addr+0x872d08
y.create.l HWIO_RPMH_VRM_MODE_VOTE_DRV8_REG0_ADDR A:&base_addr+0x880008
y.create.l HWIO_RPMH_VRM_MODE_VOTE_DRV8_REG1_ADDR A:&base_addr+0x880108
y.create.l HWIO_RPMH_VRM_MODE_VOTE_DRV8_REG2_ADDR A:&base_addr+0x880208
y.create.l HWIO_RPMH_VRM_MODE_VOTE_DRV8_REG3_ADDR A:&base_addr+0x880308
y.create.l HWIO_RPMH_VRM_MODE_VOTE_DRV8_REG4_ADDR A:&base_addr+0x880408
y.create.l HWIO_RPMH_VRM_MODE_VOTE_DRV8_REG5_ADDR A:&base_addr+0x880508
y.create.l HWIO_RPMH_VRM_MODE_VOTE_DRV8_REG6_ADDR A:&base_addr+0x880608
y.create.l HWIO_RPMH_VRM_MODE_VOTE_DRV8_REG7_ADDR A:&base_addr+0x880708
y.create.l HWIO_RPMH_VRM_MODE_VOTE_DRV8_REG8_ADDR A:&base_addr+0x880808
y.create.l HWIO_RPMH_VRM_MODE_VOTE_DRV8_REG9_ADDR A:&base_addr+0x880908
y.create.l HWIO_RPMH_VRM_MODE_VOTE_DRV8_REG10_ADDR A:&base_addr+0x880a08
y.create.l HWIO_RPMH_VRM_MODE_VOTE_DRV8_REG11_ADDR A:&base_addr+0x880b08
y.create.l HWIO_RPMH_VRM_MODE_VOTE_DRV8_REG12_ADDR A:&base_addr+0x880c08
y.create.l HWIO_RPMH_VRM_MODE_VOTE_DRV8_REG13_ADDR A:&base_addr+0x880d08
y.create.l HWIO_RPMH_VRM_MODE_VOTE_DRV8_REG14_ADDR A:&base_addr+0x880e08
y.create.l HWIO_RPMH_VRM_MODE_VOTE_DRV8_REG15_ADDR A:&base_addr+0x880f08
y.create.l HWIO_RPMH_VRM_MODE_VOTE_DRV8_REG16_ADDR A:&base_addr+0x881008
y.create.l HWIO_RPMH_VRM_MODE_VOTE_DRV8_REG17_ADDR A:&base_addr+0x881108
y.create.l HWIO_RPMH_VRM_MODE_VOTE_DRV8_REG18_ADDR A:&base_addr+0x881208
y.create.l HWIO_RPMH_VRM_MODE_VOTE_DRV8_REG19_ADDR A:&base_addr+0x881308
y.create.l HWIO_RPMH_VRM_MODE_VOTE_DRV8_REG20_ADDR A:&base_addr+0x881408
y.create.l HWIO_RPMH_VRM_MODE_VOTE_DRV8_REG21_ADDR A:&base_addr+0x881508
y.create.l HWIO_RPMH_VRM_MODE_VOTE_DRV8_REG22_ADDR A:&base_addr+0x881608
y.create.l HWIO_RPMH_VRM_MODE_VOTE_DRV8_REG23_ADDR A:&base_addr+0x881708
y.create.l HWIO_RPMH_VRM_MODE_VOTE_DRV8_REG24_ADDR A:&base_addr+0x881808
y.create.l HWIO_RPMH_VRM_MODE_VOTE_DRV8_REG25_ADDR A:&base_addr+0x881908
y.create.l HWIO_RPMH_VRM_MODE_VOTE_DRV8_REG26_ADDR A:&base_addr+0x881a08
y.create.l HWIO_RPMH_VRM_MODE_VOTE_DRV8_REG27_ADDR A:&base_addr+0x881b08
y.create.l HWIO_RPMH_VRM_MODE_VOTE_DRV8_REG28_ADDR A:&base_addr+0x881c08
y.create.l HWIO_RPMH_VRM_MODE_VOTE_DRV8_REG29_ADDR A:&base_addr+0x881d08
y.create.l HWIO_RPMH_VRM_MODE_VOTE_DRV8_REG30_ADDR A:&base_addr+0x881e08
y.create.l HWIO_RPMH_VRM_MODE_VOTE_DRV8_REG31_ADDR A:&base_addr+0x881f08
y.create.l HWIO_RPMH_VRM_MODE_VOTE_DRV8_REG32_ADDR A:&base_addr+0x882008
y.create.l HWIO_RPMH_VRM_MODE_VOTE_DRV8_REG33_ADDR A:&base_addr+0x882108
y.create.l HWIO_RPMH_VRM_MODE_VOTE_DRV8_REG34_ADDR A:&base_addr+0x882208
y.create.l HWIO_RPMH_VRM_MODE_VOTE_DRV8_REG35_ADDR A:&base_addr+0x882308
y.create.l HWIO_RPMH_VRM_MODE_VOTE_DRV8_REG36_ADDR A:&base_addr+0x882408
y.create.l HWIO_RPMH_VRM_MODE_VOTE_DRV8_REG37_ADDR A:&base_addr+0x882508
y.create.l HWIO_RPMH_VRM_MODE_VOTE_DRV8_REG38_ADDR A:&base_addr+0x882608
y.create.l HWIO_RPMH_VRM_MODE_VOTE_DRV8_REG39_ADDR A:&base_addr+0x882708
y.create.l HWIO_RPMH_VRM_MODE_VOTE_DRV8_REG40_ADDR A:&base_addr+0x882808
y.create.l HWIO_RPMH_VRM_MODE_VOTE_DRV8_REG41_ADDR A:&base_addr+0x882908
y.create.l HWIO_RPMH_VRM_MODE_VOTE_DRV8_REG42_ADDR A:&base_addr+0x882a08
y.create.l HWIO_RPMH_VRM_MODE_VOTE_DRV8_REG43_ADDR A:&base_addr+0x882b08
y.create.l HWIO_RPMH_VRM_MODE_VOTE_DRV8_REG44_ADDR A:&base_addr+0x882c08
y.create.l HWIO_RPMH_VRM_MODE_VOTE_DRV8_REG45_ADDR A:&base_addr+0x882d08
y.create.l HWIO_RPMH_VRM_MODE_VOTE_DRV9_REG0_ADDR A:&base_addr+0x890008
y.create.l HWIO_RPMH_VRM_MODE_VOTE_DRV9_REG1_ADDR A:&base_addr+0x890108
y.create.l HWIO_RPMH_VRM_MODE_VOTE_DRV9_REG2_ADDR A:&base_addr+0x890208
y.create.l HWIO_RPMH_VRM_MODE_VOTE_DRV9_REG3_ADDR A:&base_addr+0x890308
y.create.l HWIO_RPMH_VRM_MODE_VOTE_DRV9_REG4_ADDR A:&base_addr+0x890408
y.create.l HWIO_RPMH_VRM_MODE_VOTE_DRV9_REG5_ADDR A:&base_addr+0x890508
y.create.l HWIO_RPMH_VRM_MODE_VOTE_DRV9_REG6_ADDR A:&base_addr+0x890608
y.create.l HWIO_RPMH_VRM_MODE_VOTE_DRV9_REG7_ADDR A:&base_addr+0x890708
y.create.l HWIO_RPMH_VRM_MODE_VOTE_DRV9_REG8_ADDR A:&base_addr+0x890808
y.create.l HWIO_RPMH_VRM_MODE_VOTE_DRV9_REG9_ADDR A:&base_addr+0x890908
y.create.l HWIO_RPMH_VRM_MODE_VOTE_DRV9_REG10_ADDR A:&base_addr+0x890a08
y.create.l HWIO_RPMH_VRM_MODE_VOTE_DRV9_REG11_ADDR A:&base_addr+0x890b08
y.create.l HWIO_RPMH_VRM_MODE_VOTE_DRV9_REG12_ADDR A:&base_addr+0x890c08
y.create.l HWIO_RPMH_VRM_MODE_VOTE_DRV9_REG13_ADDR A:&base_addr+0x890d08
y.create.l HWIO_RPMH_VRM_MODE_VOTE_DRV9_REG14_ADDR A:&base_addr+0x890e08
y.create.l HWIO_RPMH_VRM_MODE_VOTE_DRV9_REG15_ADDR A:&base_addr+0x890f08
y.create.l HWIO_RPMH_VRM_MODE_VOTE_DRV9_REG16_ADDR A:&base_addr+0x891008
y.create.l HWIO_RPMH_VRM_MODE_VOTE_DRV9_REG17_ADDR A:&base_addr+0x891108
y.create.l HWIO_RPMH_VRM_MODE_VOTE_DRV9_REG18_ADDR A:&base_addr+0x891208
y.create.l HWIO_RPMH_VRM_MODE_VOTE_DRV9_REG19_ADDR A:&base_addr+0x891308
y.create.l HWIO_RPMH_VRM_MODE_VOTE_DRV9_REG20_ADDR A:&base_addr+0x891408
y.create.l HWIO_RPMH_VRM_MODE_VOTE_DRV9_REG21_ADDR A:&base_addr+0x891508
y.create.l HWIO_RPMH_VRM_MODE_VOTE_DRV9_REG22_ADDR A:&base_addr+0x891608
y.create.l HWIO_RPMH_VRM_MODE_VOTE_DRV9_REG23_ADDR A:&base_addr+0x891708
y.create.l HWIO_RPMH_VRM_MODE_VOTE_DRV9_REG24_ADDR A:&base_addr+0x891808
y.create.l HWIO_RPMH_VRM_MODE_VOTE_DRV9_REG25_ADDR A:&base_addr+0x891908
y.create.l HWIO_RPMH_VRM_MODE_VOTE_DRV9_REG26_ADDR A:&base_addr+0x891a08
y.create.l HWIO_RPMH_VRM_MODE_VOTE_DRV9_REG27_ADDR A:&base_addr+0x891b08
y.create.l HWIO_RPMH_VRM_MODE_VOTE_DRV9_REG28_ADDR A:&base_addr+0x891c08
y.create.l HWIO_RPMH_VRM_MODE_VOTE_DRV9_REG29_ADDR A:&base_addr+0x891d08
y.create.l HWIO_RPMH_VRM_MODE_VOTE_DRV9_REG30_ADDR A:&base_addr+0x891e08
y.create.l HWIO_RPMH_VRM_MODE_VOTE_DRV9_REG31_ADDR A:&base_addr+0x891f08
y.create.l HWIO_RPMH_VRM_MODE_VOTE_DRV9_REG32_ADDR A:&base_addr+0x892008
y.create.l HWIO_RPMH_VRM_MODE_VOTE_DRV9_REG33_ADDR A:&base_addr+0x892108
y.create.l HWIO_RPMH_VRM_MODE_VOTE_DRV9_REG34_ADDR A:&base_addr+0x892208
y.create.l HWIO_RPMH_VRM_MODE_VOTE_DRV9_REG35_ADDR A:&base_addr+0x892308
y.create.l HWIO_RPMH_VRM_MODE_VOTE_DRV9_REG36_ADDR A:&base_addr+0x892408
y.create.l HWIO_RPMH_VRM_MODE_VOTE_DRV9_REG37_ADDR A:&base_addr+0x892508
y.create.l HWIO_RPMH_VRM_MODE_VOTE_DRV9_REG38_ADDR A:&base_addr+0x892608
y.create.l HWIO_RPMH_VRM_MODE_VOTE_DRV9_REG39_ADDR A:&base_addr+0x892708
y.create.l HWIO_RPMH_VRM_MODE_VOTE_DRV9_REG40_ADDR A:&base_addr+0x892808
y.create.l HWIO_RPMH_VRM_MODE_VOTE_DRV9_REG41_ADDR A:&base_addr+0x892908
y.create.l HWIO_RPMH_VRM_MODE_VOTE_DRV9_REG42_ADDR A:&base_addr+0x892a08
y.create.l HWIO_RPMH_VRM_MODE_VOTE_DRV9_REG43_ADDR A:&base_addr+0x892b08
y.create.l HWIO_RPMH_VRM_MODE_VOTE_DRV9_REG44_ADDR A:&base_addr+0x892c08
y.create.l HWIO_RPMH_VRM_MODE_VOTE_DRV9_REG45_ADDR A:&base_addr+0x892d08
y.create.l HWIO_RPMH_VRM_MODE_VOTE_DRV10_REG0_ADDR A:&base_addr+0x8a0008
y.create.l HWIO_RPMH_VRM_MODE_VOTE_DRV10_REG1_ADDR A:&base_addr+0x8a0108
y.create.l HWIO_RPMH_VRM_MODE_VOTE_DRV10_REG2_ADDR A:&base_addr+0x8a0208
y.create.l HWIO_RPMH_VRM_MODE_VOTE_DRV10_REG3_ADDR A:&base_addr+0x8a0308
y.create.l HWIO_RPMH_VRM_MODE_VOTE_DRV10_REG4_ADDR A:&base_addr+0x8a0408
y.create.l HWIO_RPMH_VRM_MODE_VOTE_DRV10_REG5_ADDR A:&base_addr+0x8a0508
y.create.l HWIO_RPMH_VRM_MODE_VOTE_DRV10_REG6_ADDR A:&base_addr+0x8a0608
y.create.l HWIO_RPMH_VRM_MODE_VOTE_DRV10_REG7_ADDR A:&base_addr+0x8a0708
y.create.l HWIO_RPMH_VRM_MODE_VOTE_DRV10_REG8_ADDR A:&base_addr+0x8a0808
y.create.l HWIO_RPMH_VRM_MODE_VOTE_DRV10_REG9_ADDR A:&base_addr+0x8a0908
y.create.l HWIO_RPMH_VRM_MODE_VOTE_DRV10_REG10_ADDR A:&base_addr+0x8a0a08
y.create.l HWIO_RPMH_VRM_MODE_VOTE_DRV10_REG11_ADDR A:&base_addr+0x8a0b08
y.create.l HWIO_RPMH_VRM_MODE_VOTE_DRV10_REG12_ADDR A:&base_addr+0x8a0c08
y.create.l HWIO_RPMH_VRM_MODE_VOTE_DRV10_REG13_ADDR A:&base_addr+0x8a0d08
y.create.l HWIO_RPMH_VRM_MODE_VOTE_DRV10_REG14_ADDR A:&base_addr+0x8a0e08
y.create.l HWIO_RPMH_VRM_MODE_VOTE_DRV10_REG15_ADDR A:&base_addr+0x8a0f08
y.create.l HWIO_RPMH_VRM_MODE_VOTE_DRV10_REG16_ADDR A:&base_addr+0x8a1008
y.create.l HWIO_RPMH_VRM_MODE_VOTE_DRV10_REG17_ADDR A:&base_addr+0x8a1108
y.create.l HWIO_RPMH_VRM_MODE_VOTE_DRV10_REG18_ADDR A:&base_addr+0x8a1208
y.create.l HWIO_RPMH_VRM_MODE_VOTE_DRV10_REG19_ADDR A:&base_addr+0x8a1308
y.create.l HWIO_RPMH_VRM_MODE_VOTE_DRV10_REG20_ADDR A:&base_addr+0x8a1408
y.create.l HWIO_RPMH_VRM_MODE_VOTE_DRV10_REG21_ADDR A:&base_addr+0x8a1508
y.create.l HWIO_RPMH_VRM_MODE_VOTE_DRV10_REG22_ADDR A:&base_addr+0x8a1608
y.create.l HWIO_RPMH_VRM_MODE_VOTE_DRV10_REG23_ADDR A:&base_addr+0x8a1708
y.create.l HWIO_RPMH_VRM_MODE_VOTE_DRV10_REG24_ADDR A:&base_addr+0x8a1808
y.create.l HWIO_RPMH_VRM_MODE_VOTE_DRV10_REG25_ADDR A:&base_addr+0x8a1908
y.create.l HWIO_RPMH_VRM_MODE_VOTE_DRV10_REG26_ADDR A:&base_addr+0x8a1a08
y.create.l HWIO_RPMH_VRM_MODE_VOTE_DRV10_REG27_ADDR A:&base_addr+0x8a1b08
y.create.l HWIO_RPMH_VRM_MODE_VOTE_DRV10_REG28_ADDR A:&base_addr+0x8a1c08
y.create.l HWIO_RPMH_VRM_MODE_VOTE_DRV10_REG29_ADDR A:&base_addr+0x8a1d08
y.create.l HWIO_RPMH_VRM_MODE_VOTE_DRV10_REG30_ADDR A:&base_addr+0x8a1e08
y.create.l HWIO_RPMH_VRM_MODE_VOTE_DRV10_REG31_ADDR A:&base_addr+0x8a1f08
y.create.l HWIO_RPMH_VRM_MODE_VOTE_DRV10_REG32_ADDR A:&base_addr+0x8a2008
y.create.l HWIO_RPMH_VRM_MODE_VOTE_DRV10_REG33_ADDR A:&base_addr+0x8a2108
y.create.l HWIO_RPMH_VRM_MODE_VOTE_DRV10_REG34_ADDR A:&base_addr+0x8a2208
y.create.l HWIO_RPMH_VRM_MODE_VOTE_DRV10_REG35_ADDR A:&base_addr+0x8a2308
y.create.l HWIO_RPMH_VRM_MODE_VOTE_DRV10_REG36_ADDR A:&base_addr+0x8a2408
y.create.l HWIO_RPMH_VRM_MODE_VOTE_DRV10_REG37_ADDR A:&base_addr+0x8a2508
y.create.l HWIO_RPMH_VRM_MODE_VOTE_DRV10_REG38_ADDR A:&base_addr+0x8a2608
y.create.l HWIO_RPMH_VRM_MODE_VOTE_DRV10_REG39_ADDR A:&base_addr+0x8a2708
y.create.l HWIO_RPMH_VRM_MODE_VOTE_DRV10_REG40_ADDR A:&base_addr+0x8a2808
y.create.l HWIO_RPMH_VRM_MODE_VOTE_DRV10_REG41_ADDR A:&base_addr+0x8a2908
y.create.l HWIO_RPMH_VRM_MODE_VOTE_DRV10_REG42_ADDR A:&base_addr+0x8a2a08
y.create.l HWIO_RPMH_VRM_MODE_VOTE_DRV10_REG43_ADDR A:&base_addr+0x8a2b08
y.create.l HWIO_RPMH_VRM_MODE_VOTE_DRV10_REG44_ADDR A:&base_addr+0x8a2c08
y.create.l HWIO_RPMH_VRM_MODE_VOTE_DRV10_REG45_ADDR A:&base_addr+0x8a2d08
y.create.l HWIO_RPMH_VRM_MODE_VOTE_DRV11_REG0_ADDR A:&base_addr+0x8b0008
y.create.l HWIO_RPMH_VRM_MODE_VOTE_DRV11_REG1_ADDR A:&base_addr+0x8b0108
y.create.l HWIO_RPMH_VRM_MODE_VOTE_DRV11_REG2_ADDR A:&base_addr+0x8b0208
y.create.l HWIO_RPMH_VRM_MODE_VOTE_DRV11_REG3_ADDR A:&base_addr+0x8b0308
y.create.l HWIO_RPMH_VRM_MODE_VOTE_DRV11_REG4_ADDR A:&base_addr+0x8b0408
y.create.l HWIO_RPMH_VRM_MODE_VOTE_DRV11_REG5_ADDR A:&base_addr+0x8b0508
y.create.l HWIO_RPMH_VRM_MODE_VOTE_DRV11_REG6_ADDR A:&base_addr+0x8b0608
y.create.l HWIO_RPMH_VRM_MODE_VOTE_DRV11_REG7_ADDR A:&base_addr+0x8b0708
y.create.l HWIO_RPMH_VRM_MODE_VOTE_DRV11_REG8_ADDR A:&base_addr+0x8b0808
y.create.l HWIO_RPMH_VRM_MODE_VOTE_DRV11_REG9_ADDR A:&base_addr+0x8b0908
y.create.l HWIO_RPMH_VRM_MODE_VOTE_DRV11_REG10_ADDR A:&base_addr+0x8b0a08
y.create.l HWIO_RPMH_VRM_MODE_VOTE_DRV11_REG11_ADDR A:&base_addr+0x8b0b08
y.create.l HWIO_RPMH_VRM_MODE_VOTE_DRV11_REG12_ADDR A:&base_addr+0x8b0c08
y.create.l HWIO_RPMH_VRM_MODE_VOTE_DRV11_REG13_ADDR A:&base_addr+0x8b0d08
y.create.l HWIO_RPMH_VRM_MODE_VOTE_DRV11_REG14_ADDR A:&base_addr+0x8b0e08
y.create.l HWIO_RPMH_VRM_MODE_VOTE_DRV11_REG15_ADDR A:&base_addr+0x8b0f08
y.create.l HWIO_RPMH_VRM_MODE_VOTE_DRV11_REG16_ADDR A:&base_addr+0x8b1008
y.create.l HWIO_RPMH_VRM_MODE_VOTE_DRV11_REG17_ADDR A:&base_addr+0x8b1108
y.create.l HWIO_RPMH_VRM_MODE_VOTE_DRV11_REG18_ADDR A:&base_addr+0x8b1208
y.create.l HWIO_RPMH_VRM_MODE_VOTE_DRV11_REG19_ADDR A:&base_addr+0x8b1308
y.create.l HWIO_RPMH_VRM_MODE_VOTE_DRV11_REG20_ADDR A:&base_addr+0x8b1408
y.create.l HWIO_RPMH_VRM_MODE_VOTE_DRV11_REG21_ADDR A:&base_addr+0x8b1508
y.create.l HWIO_RPMH_VRM_MODE_VOTE_DRV11_REG22_ADDR A:&base_addr+0x8b1608
y.create.l HWIO_RPMH_VRM_MODE_VOTE_DRV11_REG23_ADDR A:&base_addr+0x8b1708
y.create.l HWIO_RPMH_VRM_MODE_VOTE_DRV11_REG24_ADDR A:&base_addr+0x8b1808
y.create.l HWIO_RPMH_VRM_MODE_VOTE_DRV11_REG25_ADDR A:&base_addr+0x8b1908
y.create.l HWIO_RPMH_VRM_MODE_VOTE_DRV11_REG26_ADDR A:&base_addr+0x8b1a08
y.create.l HWIO_RPMH_VRM_MODE_VOTE_DRV11_REG27_ADDR A:&base_addr+0x8b1b08
y.create.l HWIO_RPMH_VRM_MODE_VOTE_DRV11_REG28_ADDR A:&base_addr+0x8b1c08
y.create.l HWIO_RPMH_VRM_MODE_VOTE_DRV11_REG29_ADDR A:&base_addr+0x8b1d08
y.create.l HWIO_RPMH_VRM_MODE_VOTE_DRV11_REG30_ADDR A:&base_addr+0x8b1e08
y.create.l HWIO_RPMH_VRM_MODE_VOTE_DRV11_REG31_ADDR A:&base_addr+0x8b1f08
y.create.l HWIO_RPMH_VRM_MODE_VOTE_DRV11_REG32_ADDR A:&base_addr+0x8b2008
y.create.l HWIO_RPMH_VRM_MODE_VOTE_DRV11_REG33_ADDR A:&base_addr+0x8b2108
y.create.l HWIO_RPMH_VRM_MODE_VOTE_DRV11_REG34_ADDR A:&base_addr+0x8b2208
y.create.l HWIO_RPMH_VRM_MODE_VOTE_DRV11_REG35_ADDR A:&base_addr+0x8b2308
y.create.l HWIO_RPMH_VRM_MODE_VOTE_DRV11_REG36_ADDR A:&base_addr+0x8b2408
y.create.l HWIO_RPMH_VRM_MODE_VOTE_DRV11_REG37_ADDR A:&base_addr+0x8b2508
y.create.l HWIO_RPMH_VRM_MODE_VOTE_DRV11_REG38_ADDR A:&base_addr+0x8b2608
y.create.l HWIO_RPMH_VRM_MODE_VOTE_DRV11_REG39_ADDR A:&base_addr+0x8b2708
y.create.l HWIO_RPMH_VRM_MODE_VOTE_DRV11_REG40_ADDR A:&base_addr+0x8b2808
y.create.l HWIO_RPMH_VRM_MODE_VOTE_DRV11_REG41_ADDR A:&base_addr+0x8b2908
y.create.l HWIO_RPMH_VRM_MODE_VOTE_DRV11_REG42_ADDR A:&base_addr+0x8b2a08
y.create.l HWIO_RPMH_VRM_MODE_VOTE_DRV11_REG43_ADDR A:&base_addr+0x8b2b08
y.create.l HWIO_RPMH_VRM_MODE_VOTE_DRV11_REG44_ADDR A:&base_addr+0x8b2c08
y.create.l HWIO_RPMH_VRM_MODE_VOTE_DRV11_REG45_ADDR A:&base_addr+0x8b2d08
y.create.l HWIO_RPMH_VRM_MODE_VOTE_DRV12_REG0_ADDR A:&base_addr+0x8c0008
y.create.l HWIO_RPMH_VRM_MODE_VOTE_DRV12_REG1_ADDR A:&base_addr+0x8c0108
y.create.l HWIO_RPMH_VRM_MODE_VOTE_DRV12_REG2_ADDR A:&base_addr+0x8c0208
y.create.l HWIO_RPMH_VRM_MODE_VOTE_DRV12_REG3_ADDR A:&base_addr+0x8c0308
y.create.l HWIO_RPMH_VRM_MODE_VOTE_DRV12_REG4_ADDR A:&base_addr+0x8c0408
y.create.l HWIO_RPMH_VRM_MODE_VOTE_DRV12_REG5_ADDR A:&base_addr+0x8c0508
y.create.l HWIO_RPMH_VRM_MODE_VOTE_DRV12_REG6_ADDR A:&base_addr+0x8c0608
y.create.l HWIO_RPMH_VRM_MODE_VOTE_DRV12_REG7_ADDR A:&base_addr+0x8c0708
y.create.l HWIO_RPMH_VRM_MODE_VOTE_DRV12_REG8_ADDR A:&base_addr+0x8c0808
y.create.l HWIO_RPMH_VRM_MODE_VOTE_DRV12_REG9_ADDR A:&base_addr+0x8c0908
y.create.l HWIO_RPMH_VRM_MODE_VOTE_DRV12_REG10_ADDR A:&base_addr+0x8c0a08
y.create.l HWIO_RPMH_VRM_MODE_VOTE_DRV12_REG11_ADDR A:&base_addr+0x8c0b08
y.create.l HWIO_RPMH_VRM_MODE_VOTE_DRV12_REG12_ADDR A:&base_addr+0x8c0c08
y.create.l HWIO_RPMH_VRM_MODE_VOTE_DRV12_REG13_ADDR A:&base_addr+0x8c0d08
y.create.l HWIO_RPMH_VRM_MODE_VOTE_DRV12_REG14_ADDR A:&base_addr+0x8c0e08
y.create.l HWIO_RPMH_VRM_MODE_VOTE_DRV12_REG15_ADDR A:&base_addr+0x8c0f08
y.create.l HWIO_RPMH_VRM_MODE_VOTE_DRV12_REG16_ADDR A:&base_addr+0x8c1008
y.create.l HWIO_RPMH_VRM_MODE_VOTE_DRV12_REG17_ADDR A:&base_addr+0x8c1108
y.create.l HWIO_RPMH_VRM_MODE_VOTE_DRV12_REG18_ADDR A:&base_addr+0x8c1208
y.create.l HWIO_RPMH_VRM_MODE_VOTE_DRV12_REG19_ADDR A:&base_addr+0x8c1308
y.create.l HWIO_RPMH_VRM_MODE_VOTE_DRV12_REG20_ADDR A:&base_addr+0x8c1408
y.create.l HWIO_RPMH_VRM_MODE_VOTE_DRV12_REG21_ADDR A:&base_addr+0x8c1508
y.create.l HWIO_RPMH_VRM_MODE_VOTE_DRV12_REG22_ADDR A:&base_addr+0x8c1608
y.create.l HWIO_RPMH_VRM_MODE_VOTE_DRV12_REG23_ADDR A:&base_addr+0x8c1708
y.create.l HWIO_RPMH_VRM_MODE_VOTE_DRV12_REG24_ADDR A:&base_addr+0x8c1808
y.create.l HWIO_RPMH_VRM_MODE_VOTE_DRV12_REG25_ADDR A:&base_addr+0x8c1908
y.create.l HWIO_RPMH_VRM_MODE_VOTE_DRV12_REG26_ADDR A:&base_addr+0x8c1a08
y.create.l HWIO_RPMH_VRM_MODE_VOTE_DRV12_REG27_ADDR A:&base_addr+0x8c1b08
y.create.l HWIO_RPMH_VRM_MODE_VOTE_DRV12_REG28_ADDR A:&base_addr+0x8c1c08
y.create.l HWIO_RPMH_VRM_MODE_VOTE_DRV12_REG29_ADDR A:&base_addr+0x8c1d08
y.create.l HWIO_RPMH_VRM_MODE_VOTE_DRV12_REG30_ADDR A:&base_addr+0x8c1e08
y.create.l HWIO_RPMH_VRM_MODE_VOTE_DRV12_REG31_ADDR A:&base_addr+0x8c1f08
y.create.l HWIO_RPMH_VRM_MODE_VOTE_DRV12_REG32_ADDR A:&base_addr+0x8c2008
y.create.l HWIO_RPMH_VRM_MODE_VOTE_DRV12_REG33_ADDR A:&base_addr+0x8c2108
y.create.l HWIO_RPMH_VRM_MODE_VOTE_DRV12_REG34_ADDR A:&base_addr+0x8c2208
y.create.l HWIO_RPMH_VRM_MODE_VOTE_DRV12_REG35_ADDR A:&base_addr+0x8c2308
y.create.l HWIO_RPMH_VRM_MODE_VOTE_DRV12_REG36_ADDR A:&base_addr+0x8c2408
y.create.l HWIO_RPMH_VRM_MODE_VOTE_DRV12_REG37_ADDR A:&base_addr+0x8c2508
y.create.l HWIO_RPMH_VRM_MODE_VOTE_DRV12_REG38_ADDR A:&base_addr+0x8c2608
y.create.l HWIO_RPMH_VRM_MODE_VOTE_DRV12_REG39_ADDR A:&base_addr+0x8c2708
y.create.l HWIO_RPMH_VRM_MODE_VOTE_DRV12_REG40_ADDR A:&base_addr+0x8c2808
y.create.l HWIO_RPMH_VRM_MODE_VOTE_DRV12_REG41_ADDR A:&base_addr+0x8c2908
y.create.l HWIO_RPMH_VRM_MODE_VOTE_DRV12_REG42_ADDR A:&base_addr+0x8c2a08
y.create.l HWIO_RPMH_VRM_MODE_VOTE_DRV12_REG43_ADDR A:&base_addr+0x8c2b08
y.create.l HWIO_RPMH_VRM_MODE_VOTE_DRV12_REG44_ADDR A:&base_addr+0x8c2c08
y.create.l HWIO_RPMH_VRM_MODE_VOTE_DRV12_REG45_ADDR A:&base_addr+0x8c2d08
y.create.l HWIO_RPMH_VRM_MODE_VOTE_DRV13_REG0_ADDR A:&base_addr+0x8d0008
y.create.l HWIO_RPMH_VRM_MODE_VOTE_DRV13_REG1_ADDR A:&base_addr+0x8d0108
y.create.l HWIO_RPMH_VRM_MODE_VOTE_DRV13_REG2_ADDR A:&base_addr+0x8d0208
y.create.l HWIO_RPMH_VRM_MODE_VOTE_DRV13_REG3_ADDR A:&base_addr+0x8d0308
y.create.l HWIO_RPMH_VRM_MODE_VOTE_DRV13_REG4_ADDR A:&base_addr+0x8d0408
y.create.l HWIO_RPMH_VRM_MODE_VOTE_DRV13_REG5_ADDR A:&base_addr+0x8d0508
y.create.l HWIO_RPMH_VRM_MODE_VOTE_DRV13_REG6_ADDR A:&base_addr+0x8d0608
y.create.l HWIO_RPMH_VRM_MODE_VOTE_DRV13_REG7_ADDR A:&base_addr+0x8d0708
y.create.l HWIO_RPMH_VRM_MODE_VOTE_DRV13_REG8_ADDR A:&base_addr+0x8d0808
y.create.l HWIO_RPMH_VRM_MODE_VOTE_DRV13_REG9_ADDR A:&base_addr+0x8d0908
y.create.l HWIO_RPMH_VRM_MODE_VOTE_DRV13_REG10_ADDR A:&base_addr+0x8d0a08
y.create.l HWIO_RPMH_VRM_MODE_VOTE_DRV13_REG11_ADDR A:&base_addr+0x8d0b08
y.create.l HWIO_RPMH_VRM_MODE_VOTE_DRV13_REG12_ADDR A:&base_addr+0x8d0c08
y.create.l HWIO_RPMH_VRM_MODE_VOTE_DRV13_REG13_ADDR A:&base_addr+0x8d0d08
y.create.l HWIO_RPMH_VRM_MODE_VOTE_DRV13_REG14_ADDR A:&base_addr+0x8d0e08
y.create.l HWIO_RPMH_VRM_MODE_VOTE_DRV13_REG15_ADDR A:&base_addr+0x8d0f08
y.create.l HWIO_RPMH_VRM_MODE_VOTE_DRV13_REG16_ADDR A:&base_addr+0x8d1008
y.create.l HWIO_RPMH_VRM_MODE_VOTE_DRV13_REG17_ADDR A:&base_addr+0x8d1108
y.create.l HWIO_RPMH_VRM_MODE_VOTE_DRV13_REG18_ADDR A:&base_addr+0x8d1208
y.create.l HWIO_RPMH_VRM_MODE_VOTE_DRV13_REG19_ADDR A:&base_addr+0x8d1308
y.create.l HWIO_RPMH_VRM_MODE_VOTE_DRV13_REG20_ADDR A:&base_addr+0x8d1408
y.create.l HWIO_RPMH_VRM_MODE_VOTE_DRV13_REG21_ADDR A:&base_addr+0x8d1508
y.create.l HWIO_RPMH_VRM_MODE_VOTE_DRV13_REG22_ADDR A:&base_addr+0x8d1608
y.create.l HWIO_RPMH_VRM_MODE_VOTE_DRV13_REG23_ADDR A:&base_addr+0x8d1708
y.create.l HWIO_RPMH_VRM_MODE_VOTE_DRV13_REG24_ADDR A:&base_addr+0x8d1808
y.create.l HWIO_RPMH_VRM_MODE_VOTE_DRV13_REG25_ADDR A:&base_addr+0x8d1908
y.create.l HWIO_RPMH_VRM_MODE_VOTE_DRV13_REG26_ADDR A:&base_addr+0x8d1a08
y.create.l HWIO_RPMH_VRM_MODE_VOTE_DRV13_REG27_ADDR A:&base_addr+0x8d1b08
y.create.l HWIO_RPMH_VRM_MODE_VOTE_DRV13_REG28_ADDR A:&base_addr+0x8d1c08
y.create.l HWIO_RPMH_VRM_MODE_VOTE_DRV13_REG29_ADDR A:&base_addr+0x8d1d08
y.create.l HWIO_RPMH_VRM_MODE_VOTE_DRV13_REG30_ADDR A:&base_addr+0x8d1e08
y.create.l HWIO_RPMH_VRM_MODE_VOTE_DRV13_REG31_ADDR A:&base_addr+0x8d1f08
y.create.l HWIO_RPMH_VRM_MODE_VOTE_DRV13_REG32_ADDR A:&base_addr+0x8d2008
y.create.l HWIO_RPMH_VRM_MODE_VOTE_DRV13_REG33_ADDR A:&base_addr+0x8d2108
y.create.l HWIO_RPMH_VRM_MODE_VOTE_DRV13_REG34_ADDR A:&base_addr+0x8d2208
y.create.l HWIO_RPMH_VRM_MODE_VOTE_DRV13_REG35_ADDR A:&base_addr+0x8d2308
y.create.l HWIO_RPMH_VRM_MODE_VOTE_DRV13_REG36_ADDR A:&base_addr+0x8d2408
y.create.l HWIO_RPMH_VRM_MODE_VOTE_DRV13_REG37_ADDR A:&base_addr+0x8d2508
y.create.l HWIO_RPMH_VRM_MODE_VOTE_DRV13_REG38_ADDR A:&base_addr+0x8d2608
y.create.l HWIO_RPMH_VRM_MODE_VOTE_DRV13_REG39_ADDR A:&base_addr+0x8d2708
y.create.l HWIO_RPMH_VRM_MODE_VOTE_DRV13_REG40_ADDR A:&base_addr+0x8d2808
y.create.l HWIO_RPMH_VRM_MODE_VOTE_DRV13_REG41_ADDR A:&base_addr+0x8d2908
y.create.l HWIO_RPMH_VRM_MODE_VOTE_DRV13_REG42_ADDR A:&base_addr+0x8d2a08
y.create.l HWIO_RPMH_VRM_MODE_VOTE_DRV13_REG43_ADDR A:&base_addr+0x8d2b08
y.create.l HWIO_RPMH_VRM_MODE_VOTE_DRV13_REG44_ADDR A:&base_addr+0x8d2c08
y.create.l HWIO_RPMH_VRM_MODE_VOTE_DRV13_REG45_ADDR A:&base_addr+0x8d2d08
y.create.l HWIO_RPMH_VRM_MODE_VOTE_DRV14_REG0_ADDR A:&base_addr+0x8e0008
y.create.l HWIO_RPMH_VRM_MODE_VOTE_DRV14_REG1_ADDR A:&base_addr+0x8e0108
y.create.l HWIO_RPMH_VRM_MODE_VOTE_DRV14_REG2_ADDR A:&base_addr+0x8e0208
y.create.l HWIO_RPMH_VRM_MODE_VOTE_DRV14_REG3_ADDR A:&base_addr+0x8e0308
y.create.l HWIO_RPMH_VRM_MODE_VOTE_DRV14_REG4_ADDR A:&base_addr+0x8e0408
y.create.l HWIO_RPMH_VRM_MODE_VOTE_DRV14_REG5_ADDR A:&base_addr+0x8e0508
y.create.l HWIO_RPMH_VRM_MODE_VOTE_DRV14_REG6_ADDR A:&base_addr+0x8e0608
y.create.l HWIO_RPMH_VRM_MODE_VOTE_DRV14_REG7_ADDR A:&base_addr+0x8e0708
y.create.l HWIO_RPMH_VRM_MODE_VOTE_DRV14_REG8_ADDR A:&base_addr+0x8e0808
y.create.l HWIO_RPMH_VRM_MODE_VOTE_DRV14_REG9_ADDR A:&base_addr+0x8e0908
y.create.l HWIO_RPMH_VRM_MODE_VOTE_DRV14_REG10_ADDR A:&base_addr+0x8e0a08
y.create.l HWIO_RPMH_VRM_MODE_VOTE_DRV14_REG11_ADDR A:&base_addr+0x8e0b08
y.create.l HWIO_RPMH_VRM_MODE_VOTE_DRV14_REG12_ADDR A:&base_addr+0x8e0c08
y.create.l HWIO_RPMH_VRM_MODE_VOTE_DRV14_REG13_ADDR A:&base_addr+0x8e0d08
y.create.l HWIO_RPMH_VRM_MODE_VOTE_DRV14_REG14_ADDR A:&base_addr+0x8e0e08
y.create.l HWIO_RPMH_VRM_MODE_VOTE_DRV14_REG15_ADDR A:&base_addr+0x8e0f08
y.create.l HWIO_RPMH_VRM_MODE_VOTE_DRV14_REG16_ADDR A:&base_addr+0x8e1008
y.create.l HWIO_RPMH_VRM_MODE_VOTE_DRV14_REG17_ADDR A:&base_addr+0x8e1108
y.create.l HWIO_RPMH_VRM_MODE_VOTE_DRV14_REG18_ADDR A:&base_addr+0x8e1208
y.create.l HWIO_RPMH_VRM_MODE_VOTE_DRV14_REG19_ADDR A:&base_addr+0x8e1308
y.create.l HWIO_RPMH_VRM_MODE_VOTE_DRV14_REG20_ADDR A:&base_addr+0x8e1408
y.create.l HWIO_RPMH_VRM_MODE_VOTE_DRV14_REG21_ADDR A:&base_addr+0x8e1508
y.create.l HWIO_RPMH_VRM_MODE_VOTE_DRV14_REG22_ADDR A:&base_addr+0x8e1608
y.create.l HWIO_RPMH_VRM_MODE_VOTE_DRV14_REG23_ADDR A:&base_addr+0x8e1708
y.create.l HWIO_RPMH_VRM_MODE_VOTE_DRV14_REG24_ADDR A:&base_addr+0x8e1808
y.create.l HWIO_RPMH_VRM_MODE_VOTE_DRV14_REG25_ADDR A:&base_addr+0x8e1908
y.create.l HWIO_RPMH_VRM_MODE_VOTE_DRV14_REG26_ADDR A:&base_addr+0x8e1a08
y.create.l HWIO_RPMH_VRM_MODE_VOTE_DRV14_REG27_ADDR A:&base_addr+0x8e1b08
y.create.l HWIO_RPMH_VRM_MODE_VOTE_DRV14_REG28_ADDR A:&base_addr+0x8e1c08
y.create.l HWIO_RPMH_VRM_MODE_VOTE_DRV14_REG29_ADDR A:&base_addr+0x8e1d08
y.create.l HWIO_RPMH_VRM_MODE_VOTE_DRV14_REG30_ADDR A:&base_addr+0x8e1e08
y.create.l HWIO_RPMH_VRM_MODE_VOTE_DRV14_REG31_ADDR A:&base_addr+0x8e1f08
y.create.l HWIO_RPMH_VRM_MODE_VOTE_DRV14_REG32_ADDR A:&base_addr+0x8e2008
y.create.l HWIO_RPMH_VRM_MODE_VOTE_DRV14_REG33_ADDR A:&base_addr+0x8e2108
y.create.l HWIO_RPMH_VRM_MODE_VOTE_DRV14_REG34_ADDR A:&base_addr+0x8e2208
y.create.l HWIO_RPMH_VRM_MODE_VOTE_DRV14_REG35_ADDR A:&base_addr+0x8e2308
y.create.l HWIO_RPMH_VRM_MODE_VOTE_DRV14_REG36_ADDR A:&base_addr+0x8e2408
y.create.l HWIO_RPMH_VRM_MODE_VOTE_DRV14_REG37_ADDR A:&base_addr+0x8e2508
y.create.l HWIO_RPMH_VRM_MODE_VOTE_DRV14_REG38_ADDR A:&base_addr+0x8e2608
y.create.l HWIO_RPMH_VRM_MODE_VOTE_DRV14_REG39_ADDR A:&base_addr+0x8e2708
y.create.l HWIO_RPMH_VRM_MODE_VOTE_DRV14_REG40_ADDR A:&base_addr+0x8e2808
y.create.l HWIO_RPMH_VRM_MODE_VOTE_DRV14_REG41_ADDR A:&base_addr+0x8e2908
y.create.l HWIO_RPMH_VRM_MODE_VOTE_DRV14_REG42_ADDR A:&base_addr+0x8e2a08
y.create.l HWIO_RPMH_VRM_MODE_VOTE_DRV14_REG43_ADDR A:&base_addr+0x8e2b08
y.create.l HWIO_RPMH_VRM_MODE_VOTE_DRV14_REG44_ADDR A:&base_addr+0x8e2c08
y.create.l HWIO_RPMH_VRM_MODE_VOTE_DRV14_REG45_ADDR A:&base_addr+0x8e2d08
y.create.l HWIO_RPMH_VRM_HEADROOM_VOTE_DRV0_REG0_ADDR A:&base_addr+0x80000c
y.create.l HWIO_RPMH_VRM_HEADROOM_VOTE_DRV0_REG1_ADDR A:&base_addr+0x80010c
y.create.l HWIO_RPMH_VRM_HEADROOM_VOTE_DRV0_REG2_ADDR A:&base_addr+0x80020c
y.create.l HWIO_RPMH_VRM_HEADROOM_VOTE_DRV0_REG3_ADDR A:&base_addr+0x80030c
y.create.l HWIO_RPMH_VRM_HEADROOM_VOTE_DRV0_REG4_ADDR A:&base_addr+0x80040c
y.create.l HWIO_RPMH_VRM_HEADROOM_VOTE_DRV0_REG5_ADDR A:&base_addr+0x80050c
y.create.l HWIO_RPMH_VRM_HEADROOM_VOTE_DRV0_REG6_ADDR A:&base_addr+0x80060c
y.create.l HWIO_RPMH_VRM_HEADROOM_VOTE_DRV0_REG7_ADDR A:&base_addr+0x80070c
y.create.l HWIO_RPMH_VRM_HEADROOM_VOTE_DRV0_REG8_ADDR A:&base_addr+0x80080c
y.create.l HWIO_RPMH_VRM_HEADROOM_VOTE_DRV0_REG9_ADDR A:&base_addr+0x80090c
y.create.l HWIO_RPMH_VRM_HEADROOM_VOTE_DRV0_REG10_ADDR A:&base_addr+0x800a0c
y.create.l HWIO_RPMH_VRM_HEADROOM_VOTE_DRV0_REG11_ADDR A:&base_addr+0x800b0c
y.create.l HWIO_RPMH_VRM_HEADROOM_VOTE_DRV0_REG12_ADDR A:&base_addr+0x800c0c
y.create.l HWIO_RPMH_VRM_HEADROOM_VOTE_DRV0_REG13_ADDR A:&base_addr+0x800d0c
y.create.l HWIO_RPMH_VRM_HEADROOM_VOTE_DRV0_REG14_ADDR A:&base_addr+0x800e0c
y.create.l HWIO_RPMH_VRM_HEADROOM_VOTE_DRV0_REG15_ADDR A:&base_addr+0x800f0c
y.create.l HWIO_RPMH_VRM_HEADROOM_VOTE_DRV0_REG16_ADDR A:&base_addr+0x80100c
y.create.l HWIO_RPMH_VRM_HEADROOM_VOTE_DRV0_REG17_ADDR A:&base_addr+0x80110c
y.create.l HWIO_RPMH_VRM_HEADROOM_VOTE_DRV0_REG18_ADDR A:&base_addr+0x80120c
y.create.l HWIO_RPMH_VRM_HEADROOM_VOTE_DRV0_REG19_ADDR A:&base_addr+0x80130c
y.create.l HWIO_RPMH_VRM_HEADROOM_VOTE_DRV0_REG20_ADDR A:&base_addr+0x80140c
y.create.l HWIO_RPMH_VRM_HEADROOM_VOTE_DRV0_REG21_ADDR A:&base_addr+0x80150c
y.create.l HWIO_RPMH_VRM_HEADROOM_VOTE_DRV0_REG22_ADDR A:&base_addr+0x80160c
y.create.l HWIO_RPMH_VRM_HEADROOM_VOTE_DRV0_REG23_ADDR A:&base_addr+0x80170c
y.create.l HWIO_RPMH_VRM_HEADROOM_VOTE_DRV0_REG24_ADDR A:&base_addr+0x80180c
y.create.l HWIO_RPMH_VRM_HEADROOM_VOTE_DRV0_REG25_ADDR A:&base_addr+0x80190c
y.create.l HWIO_RPMH_VRM_HEADROOM_VOTE_DRV0_REG26_ADDR A:&base_addr+0x801a0c
y.create.l HWIO_RPMH_VRM_HEADROOM_VOTE_DRV0_REG27_ADDR A:&base_addr+0x801b0c
y.create.l HWIO_RPMH_VRM_HEADROOM_VOTE_DRV0_REG28_ADDR A:&base_addr+0x801c0c
y.create.l HWIO_RPMH_VRM_HEADROOM_VOTE_DRV0_REG29_ADDR A:&base_addr+0x801d0c
y.create.l HWIO_RPMH_VRM_HEADROOM_VOTE_DRV0_REG30_ADDR A:&base_addr+0x801e0c
y.create.l HWIO_RPMH_VRM_HEADROOM_VOTE_DRV0_REG31_ADDR A:&base_addr+0x801f0c
y.create.l HWIO_RPMH_VRM_HEADROOM_VOTE_DRV0_REG32_ADDR A:&base_addr+0x80200c
y.create.l HWIO_RPMH_VRM_HEADROOM_VOTE_DRV0_REG33_ADDR A:&base_addr+0x80210c
y.create.l HWIO_RPMH_VRM_HEADROOM_VOTE_DRV0_REG34_ADDR A:&base_addr+0x80220c
y.create.l HWIO_RPMH_VRM_HEADROOM_VOTE_DRV0_REG35_ADDR A:&base_addr+0x80230c
y.create.l HWIO_RPMH_VRM_HEADROOM_VOTE_DRV0_REG36_ADDR A:&base_addr+0x80240c
y.create.l HWIO_RPMH_VRM_HEADROOM_VOTE_DRV0_REG37_ADDR A:&base_addr+0x80250c
y.create.l HWIO_RPMH_VRM_HEADROOM_VOTE_DRV0_REG38_ADDR A:&base_addr+0x80260c
y.create.l HWIO_RPMH_VRM_HEADROOM_VOTE_DRV0_REG39_ADDR A:&base_addr+0x80270c
y.create.l HWIO_RPMH_VRM_HEADROOM_VOTE_DRV0_REG40_ADDR A:&base_addr+0x80280c
y.create.l HWIO_RPMH_VRM_HEADROOM_VOTE_DRV0_REG41_ADDR A:&base_addr+0x80290c
y.create.l HWIO_RPMH_VRM_HEADROOM_VOTE_DRV0_REG42_ADDR A:&base_addr+0x802a0c
y.create.l HWIO_RPMH_VRM_HEADROOM_VOTE_DRV0_REG43_ADDR A:&base_addr+0x802b0c
y.create.l HWIO_RPMH_VRM_HEADROOM_VOTE_DRV0_REG44_ADDR A:&base_addr+0x802c0c
y.create.l HWIO_RPMH_VRM_HEADROOM_VOTE_DRV0_REG45_ADDR A:&base_addr+0x802d0c
y.create.l HWIO_RPMH_VRM_HEADROOM_VOTE_DRV1_REG0_ADDR A:&base_addr+0x81000c
y.create.l HWIO_RPMH_VRM_HEADROOM_VOTE_DRV1_REG1_ADDR A:&base_addr+0x81010c
y.create.l HWIO_RPMH_VRM_HEADROOM_VOTE_DRV1_REG2_ADDR A:&base_addr+0x81020c
y.create.l HWIO_RPMH_VRM_HEADROOM_VOTE_DRV1_REG3_ADDR A:&base_addr+0x81030c
y.create.l HWIO_RPMH_VRM_HEADROOM_VOTE_DRV1_REG4_ADDR A:&base_addr+0x81040c
y.create.l HWIO_RPMH_VRM_HEADROOM_VOTE_DRV1_REG5_ADDR A:&base_addr+0x81050c
y.create.l HWIO_RPMH_VRM_HEADROOM_VOTE_DRV1_REG6_ADDR A:&base_addr+0x81060c
y.create.l HWIO_RPMH_VRM_HEADROOM_VOTE_DRV1_REG7_ADDR A:&base_addr+0x81070c
y.create.l HWIO_RPMH_VRM_HEADROOM_VOTE_DRV1_REG8_ADDR A:&base_addr+0x81080c
y.create.l HWIO_RPMH_VRM_HEADROOM_VOTE_DRV1_REG9_ADDR A:&base_addr+0x81090c
y.create.l HWIO_RPMH_VRM_HEADROOM_VOTE_DRV1_REG10_ADDR A:&base_addr+0x810a0c
y.create.l HWIO_RPMH_VRM_HEADROOM_VOTE_DRV1_REG11_ADDR A:&base_addr+0x810b0c
y.create.l HWIO_RPMH_VRM_HEADROOM_VOTE_DRV1_REG12_ADDR A:&base_addr+0x810c0c
y.create.l HWIO_RPMH_VRM_HEADROOM_VOTE_DRV1_REG13_ADDR A:&base_addr+0x810d0c
y.create.l HWIO_RPMH_VRM_HEADROOM_VOTE_DRV1_REG14_ADDR A:&base_addr+0x810e0c
y.create.l HWIO_RPMH_VRM_HEADROOM_VOTE_DRV1_REG15_ADDR A:&base_addr+0x810f0c
y.create.l HWIO_RPMH_VRM_HEADROOM_VOTE_DRV1_REG16_ADDR A:&base_addr+0x81100c
y.create.l HWIO_RPMH_VRM_HEADROOM_VOTE_DRV1_REG17_ADDR A:&base_addr+0x81110c
y.create.l HWIO_RPMH_VRM_HEADROOM_VOTE_DRV1_REG18_ADDR A:&base_addr+0x81120c
y.create.l HWIO_RPMH_VRM_HEADROOM_VOTE_DRV1_REG19_ADDR A:&base_addr+0x81130c
y.create.l HWIO_RPMH_VRM_HEADROOM_VOTE_DRV1_REG20_ADDR A:&base_addr+0x81140c
y.create.l HWIO_RPMH_VRM_HEADROOM_VOTE_DRV1_REG21_ADDR A:&base_addr+0x81150c
y.create.l HWIO_RPMH_VRM_HEADROOM_VOTE_DRV1_REG22_ADDR A:&base_addr+0x81160c
y.create.l HWIO_RPMH_VRM_HEADROOM_VOTE_DRV1_REG23_ADDR A:&base_addr+0x81170c
y.create.l HWIO_RPMH_VRM_HEADROOM_VOTE_DRV1_REG24_ADDR A:&base_addr+0x81180c
y.create.l HWIO_RPMH_VRM_HEADROOM_VOTE_DRV1_REG25_ADDR A:&base_addr+0x81190c
y.create.l HWIO_RPMH_VRM_HEADROOM_VOTE_DRV1_REG26_ADDR A:&base_addr+0x811a0c
y.create.l HWIO_RPMH_VRM_HEADROOM_VOTE_DRV1_REG27_ADDR A:&base_addr+0x811b0c
y.create.l HWIO_RPMH_VRM_HEADROOM_VOTE_DRV1_REG28_ADDR A:&base_addr+0x811c0c
y.create.l HWIO_RPMH_VRM_HEADROOM_VOTE_DRV1_REG29_ADDR A:&base_addr+0x811d0c
y.create.l HWIO_RPMH_VRM_HEADROOM_VOTE_DRV1_REG30_ADDR A:&base_addr+0x811e0c
y.create.l HWIO_RPMH_VRM_HEADROOM_VOTE_DRV1_REG31_ADDR A:&base_addr+0x811f0c
y.create.l HWIO_RPMH_VRM_HEADROOM_VOTE_DRV1_REG32_ADDR A:&base_addr+0x81200c
y.create.l HWIO_RPMH_VRM_HEADROOM_VOTE_DRV1_REG33_ADDR A:&base_addr+0x81210c
y.create.l HWIO_RPMH_VRM_HEADROOM_VOTE_DRV1_REG34_ADDR A:&base_addr+0x81220c
y.create.l HWIO_RPMH_VRM_HEADROOM_VOTE_DRV1_REG35_ADDR A:&base_addr+0x81230c
y.create.l HWIO_RPMH_VRM_HEADROOM_VOTE_DRV1_REG36_ADDR A:&base_addr+0x81240c
y.create.l HWIO_RPMH_VRM_HEADROOM_VOTE_DRV1_REG37_ADDR A:&base_addr+0x81250c
y.create.l HWIO_RPMH_VRM_HEADROOM_VOTE_DRV1_REG38_ADDR A:&base_addr+0x81260c
y.create.l HWIO_RPMH_VRM_HEADROOM_VOTE_DRV1_REG39_ADDR A:&base_addr+0x81270c
y.create.l HWIO_RPMH_VRM_HEADROOM_VOTE_DRV1_REG40_ADDR A:&base_addr+0x81280c
y.create.l HWIO_RPMH_VRM_HEADROOM_VOTE_DRV1_REG41_ADDR A:&base_addr+0x81290c
y.create.l HWIO_RPMH_VRM_HEADROOM_VOTE_DRV1_REG42_ADDR A:&base_addr+0x812a0c
y.create.l HWIO_RPMH_VRM_HEADROOM_VOTE_DRV1_REG43_ADDR A:&base_addr+0x812b0c
y.create.l HWIO_RPMH_VRM_HEADROOM_VOTE_DRV1_REG44_ADDR A:&base_addr+0x812c0c
y.create.l HWIO_RPMH_VRM_HEADROOM_VOTE_DRV1_REG45_ADDR A:&base_addr+0x812d0c
y.create.l HWIO_RPMH_VRM_HEADROOM_VOTE_DRV2_REG0_ADDR A:&base_addr+0x82000c
y.create.l HWIO_RPMH_VRM_HEADROOM_VOTE_DRV2_REG1_ADDR A:&base_addr+0x82010c
y.create.l HWIO_RPMH_VRM_HEADROOM_VOTE_DRV2_REG2_ADDR A:&base_addr+0x82020c
y.create.l HWIO_RPMH_VRM_HEADROOM_VOTE_DRV2_REG3_ADDR A:&base_addr+0x82030c
y.create.l HWIO_RPMH_VRM_HEADROOM_VOTE_DRV2_REG4_ADDR A:&base_addr+0x82040c
y.create.l HWIO_RPMH_VRM_HEADROOM_VOTE_DRV2_REG5_ADDR A:&base_addr+0x82050c
y.create.l HWIO_RPMH_VRM_HEADROOM_VOTE_DRV2_REG6_ADDR A:&base_addr+0x82060c
y.create.l HWIO_RPMH_VRM_HEADROOM_VOTE_DRV2_REG7_ADDR A:&base_addr+0x82070c
y.create.l HWIO_RPMH_VRM_HEADROOM_VOTE_DRV2_REG8_ADDR A:&base_addr+0x82080c
y.create.l HWIO_RPMH_VRM_HEADROOM_VOTE_DRV2_REG9_ADDR A:&base_addr+0x82090c
y.create.l HWIO_RPMH_VRM_HEADROOM_VOTE_DRV2_REG10_ADDR A:&base_addr+0x820a0c
y.create.l HWIO_RPMH_VRM_HEADROOM_VOTE_DRV2_REG11_ADDR A:&base_addr+0x820b0c
y.create.l HWIO_RPMH_VRM_HEADROOM_VOTE_DRV2_REG12_ADDR A:&base_addr+0x820c0c
y.create.l HWIO_RPMH_VRM_HEADROOM_VOTE_DRV2_REG13_ADDR A:&base_addr+0x820d0c
y.create.l HWIO_RPMH_VRM_HEADROOM_VOTE_DRV2_REG14_ADDR A:&base_addr+0x820e0c
y.create.l HWIO_RPMH_VRM_HEADROOM_VOTE_DRV2_REG15_ADDR A:&base_addr+0x820f0c
y.create.l HWIO_RPMH_VRM_HEADROOM_VOTE_DRV2_REG16_ADDR A:&base_addr+0x82100c
y.create.l HWIO_RPMH_VRM_HEADROOM_VOTE_DRV2_REG17_ADDR A:&base_addr+0x82110c
y.create.l HWIO_RPMH_VRM_HEADROOM_VOTE_DRV2_REG18_ADDR A:&base_addr+0x82120c
y.create.l HWIO_RPMH_VRM_HEADROOM_VOTE_DRV2_REG19_ADDR A:&base_addr+0x82130c
y.create.l HWIO_RPMH_VRM_HEADROOM_VOTE_DRV2_REG20_ADDR A:&base_addr+0x82140c
y.create.l HWIO_RPMH_VRM_HEADROOM_VOTE_DRV2_REG21_ADDR A:&base_addr+0x82150c
y.create.l HWIO_RPMH_VRM_HEADROOM_VOTE_DRV2_REG22_ADDR A:&base_addr+0x82160c
y.create.l HWIO_RPMH_VRM_HEADROOM_VOTE_DRV2_REG23_ADDR A:&base_addr+0x82170c
y.create.l HWIO_RPMH_VRM_HEADROOM_VOTE_DRV2_REG24_ADDR A:&base_addr+0x82180c
y.create.l HWIO_RPMH_VRM_HEADROOM_VOTE_DRV2_REG25_ADDR A:&base_addr+0x82190c
y.create.l HWIO_RPMH_VRM_HEADROOM_VOTE_DRV2_REG26_ADDR A:&base_addr+0x821a0c
y.create.l HWIO_RPMH_VRM_HEADROOM_VOTE_DRV2_REG27_ADDR A:&base_addr+0x821b0c
y.create.l HWIO_RPMH_VRM_HEADROOM_VOTE_DRV2_REG28_ADDR A:&base_addr+0x821c0c
y.create.l HWIO_RPMH_VRM_HEADROOM_VOTE_DRV2_REG29_ADDR A:&base_addr+0x821d0c
y.create.l HWIO_RPMH_VRM_HEADROOM_VOTE_DRV2_REG30_ADDR A:&base_addr+0x821e0c
y.create.l HWIO_RPMH_VRM_HEADROOM_VOTE_DRV2_REG31_ADDR A:&base_addr+0x821f0c
y.create.l HWIO_RPMH_VRM_HEADROOM_VOTE_DRV2_REG32_ADDR A:&base_addr+0x82200c
y.create.l HWIO_RPMH_VRM_HEADROOM_VOTE_DRV2_REG33_ADDR A:&base_addr+0x82210c
y.create.l HWIO_RPMH_VRM_HEADROOM_VOTE_DRV2_REG34_ADDR A:&base_addr+0x82220c
y.create.l HWIO_RPMH_VRM_HEADROOM_VOTE_DRV2_REG35_ADDR A:&base_addr+0x82230c
y.create.l HWIO_RPMH_VRM_HEADROOM_VOTE_DRV2_REG36_ADDR A:&base_addr+0x82240c
y.create.l HWIO_RPMH_VRM_HEADROOM_VOTE_DRV2_REG37_ADDR A:&base_addr+0x82250c
y.create.l HWIO_RPMH_VRM_HEADROOM_VOTE_DRV2_REG38_ADDR A:&base_addr+0x82260c
y.create.l HWIO_RPMH_VRM_HEADROOM_VOTE_DRV2_REG39_ADDR A:&base_addr+0x82270c
y.create.l HWIO_RPMH_VRM_HEADROOM_VOTE_DRV2_REG40_ADDR A:&base_addr+0x82280c
y.create.l HWIO_RPMH_VRM_HEADROOM_VOTE_DRV2_REG41_ADDR A:&base_addr+0x82290c
y.create.l HWIO_RPMH_VRM_HEADROOM_VOTE_DRV2_REG42_ADDR A:&base_addr+0x822a0c
y.create.l HWIO_RPMH_VRM_HEADROOM_VOTE_DRV2_REG43_ADDR A:&base_addr+0x822b0c
y.create.l HWIO_RPMH_VRM_HEADROOM_VOTE_DRV2_REG44_ADDR A:&base_addr+0x822c0c
y.create.l HWIO_RPMH_VRM_HEADROOM_VOTE_DRV2_REG45_ADDR A:&base_addr+0x822d0c
y.create.l HWIO_RPMH_VRM_HEADROOM_VOTE_DRV3_REG0_ADDR A:&base_addr+0x83000c
y.create.l HWIO_RPMH_VRM_HEADROOM_VOTE_DRV3_REG1_ADDR A:&base_addr+0x83010c
y.create.l HWIO_RPMH_VRM_HEADROOM_VOTE_DRV3_REG2_ADDR A:&base_addr+0x83020c
y.create.l HWIO_RPMH_VRM_HEADROOM_VOTE_DRV3_REG3_ADDR A:&base_addr+0x83030c
y.create.l HWIO_RPMH_VRM_HEADROOM_VOTE_DRV3_REG4_ADDR A:&base_addr+0x83040c
y.create.l HWIO_RPMH_VRM_HEADROOM_VOTE_DRV3_REG5_ADDR A:&base_addr+0x83050c
y.create.l HWIO_RPMH_VRM_HEADROOM_VOTE_DRV3_REG6_ADDR A:&base_addr+0x83060c
y.create.l HWIO_RPMH_VRM_HEADROOM_VOTE_DRV3_REG7_ADDR A:&base_addr+0x83070c
y.create.l HWIO_RPMH_VRM_HEADROOM_VOTE_DRV3_REG8_ADDR A:&base_addr+0x83080c
y.create.l HWIO_RPMH_VRM_HEADROOM_VOTE_DRV3_REG9_ADDR A:&base_addr+0x83090c
y.create.l HWIO_RPMH_VRM_HEADROOM_VOTE_DRV3_REG10_ADDR A:&base_addr+0x830a0c
y.create.l HWIO_RPMH_VRM_HEADROOM_VOTE_DRV3_REG11_ADDR A:&base_addr+0x830b0c
y.create.l HWIO_RPMH_VRM_HEADROOM_VOTE_DRV3_REG12_ADDR A:&base_addr+0x830c0c
y.create.l HWIO_RPMH_VRM_HEADROOM_VOTE_DRV3_REG13_ADDR A:&base_addr+0x830d0c
y.create.l HWIO_RPMH_VRM_HEADROOM_VOTE_DRV3_REG14_ADDR A:&base_addr+0x830e0c
y.create.l HWIO_RPMH_VRM_HEADROOM_VOTE_DRV3_REG15_ADDR A:&base_addr+0x830f0c
y.create.l HWIO_RPMH_VRM_HEADROOM_VOTE_DRV3_REG16_ADDR A:&base_addr+0x83100c
y.create.l HWIO_RPMH_VRM_HEADROOM_VOTE_DRV3_REG17_ADDR A:&base_addr+0x83110c
y.create.l HWIO_RPMH_VRM_HEADROOM_VOTE_DRV3_REG18_ADDR A:&base_addr+0x83120c
y.create.l HWIO_RPMH_VRM_HEADROOM_VOTE_DRV3_REG19_ADDR A:&base_addr+0x83130c
y.create.l HWIO_RPMH_VRM_HEADROOM_VOTE_DRV3_REG20_ADDR A:&base_addr+0x83140c
y.create.l HWIO_RPMH_VRM_HEADROOM_VOTE_DRV3_REG21_ADDR A:&base_addr+0x83150c
y.create.l HWIO_RPMH_VRM_HEADROOM_VOTE_DRV3_REG22_ADDR A:&base_addr+0x83160c
y.create.l HWIO_RPMH_VRM_HEADROOM_VOTE_DRV3_REG23_ADDR A:&base_addr+0x83170c
y.create.l HWIO_RPMH_VRM_HEADROOM_VOTE_DRV3_REG24_ADDR A:&base_addr+0x83180c
y.create.l HWIO_RPMH_VRM_HEADROOM_VOTE_DRV3_REG25_ADDR A:&base_addr+0x83190c
y.create.l HWIO_RPMH_VRM_HEADROOM_VOTE_DRV3_REG26_ADDR A:&base_addr+0x831a0c
y.create.l HWIO_RPMH_VRM_HEADROOM_VOTE_DRV3_REG27_ADDR A:&base_addr+0x831b0c
y.create.l HWIO_RPMH_VRM_HEADROOM_VOTE_DRV3_REG28_ADDR A:&base_addr+0x831c0c
y.create.l HWIO_RPMH_VRM_HEADROOM_VOTE_DRV3_REG29_ADDR A:&base_addr+0x831d0c
y.create.l HWIO_RPMH_VRM_HEADROOM_VOTE_DRV3_REG30_ADDR A:&base_addr+0x831e0c
y.create.l HWIO_RPMH_VRM_HEADROOM_VOTE_DRV3_REG31_ADDR A:&base_addr+0x831f0c
y.create.l HWIO_RPMH_VRM_HEADROOM_VOTE_DRV3_REG32_ADDR A:&base_addr+0x83200c
y.create.l HWIO_RPMH_VRM_HEADROOM_VOTE_DRV3_REG33_ADDR A:&base_addr+0x83210c
y.create.l HWIO_RPMH_VRM_HEADROOM_VOTE_DRV3_REG34_ADDR A:&base_addr+0x83220c
y.create.l HWIO_RPMH_VRM_HEADROOM_VOTE_DRV3_REG35_ADDR A:&base_addr+0x83230c
y.create.l HWIO_RPMH_VRM_HEADROOM_VOTE_DRV3_REG36_ADDR A:&base_addr+0x83240c
y.create.l HWIO_RPMH_VRM_HEADROOM_VOTE_DRV3_REG37_ADDR A:&base_addr+0x83250c
y.create.l HWIO_RPMH_VRM_HEADROOM_VOTE_DRV3_REG38_ADDR A:&base_addr+0x83260c
y.create.l HWIO_RPMH_VRM_HEADROOM_VOTE_DRV3_REG39_ADDR A:&base_addr+0x83270c
y.create.l HWIO_RPMH_VRM_HEADROOM_VOTE_DRV3_REG40_ADDR A:&base_addr+0x83280c
y.create.l HWIO_RPMH_VRM_HEADROOM_VOTE_DRV3_REG41_ADDR A:&base_addr+0x83290c
y.create.l HWIO_RPMH_VRM_HEADROOM_VOTE_DRV3_REG42_ADDR A:&base_addr+0x832a0c
y.create.l HWIO_RPMH_VRM_HEADROOM_VOTE_DRV3_REG43_ADDR A:&base_addr+0x832b0c
y.create.l HWIO_RPMH_VRM_HEADROOM_VOTE_DRV3_REG44_ADDR A:&base_addr+0x832c0c
y.create.l HWIO_RPMH_VRM_HEADROOM_VOTE_DRV3_REG45_ADDR A:&base_addr+0x832d0c
y.create.l HWIO_RPMH_VRM_HEADROOM_VOTE_DRV4_REG0_ADDR A:&base_addr+0x84000c
y.create.l HWIO_RPMH_VRM_HEADROOM_VOTE_DRV4_REG1_ADDR A:&base_addr+0x84010c
y.create.l HWIO_RPMH_VRM_HEADROOM_VOTE_DRV4_REG2_ADDR A:&base_addr+0x84020c
y.create.l HWIO_RPMH_VRM_HEADROOM_VOTE_DRV4_REG3_ADDR A:&base_addr+0x84030c
y.create.l HWIO_RPMH_VRM_HEADROOM_VOTE_DRV4_REG4_ADDR A:&base_addr+0x84040c
y.create.l HWIO_RPMH_VRM_HEADROOM_VOTE_DRV4_REG5_ADDR A:&base_addr+0x84050c
y.create.l HWIO_RPMH_VRM_HEADROOM_VOTE_DRV4_REG6_ADDR A:&base_addr+0x84060c
y.create.l HWIO_RPMH_VRM_HEADROOM_VOTE_DRV4_REG7_ADDR A:&base_addr+0x84070c
y.create.l HWIO_RPMH_VRM_HEADROOM_VOTE_DRV4_REG8_ADDR A:&base_addr+0x84080c
y.create.l HWIO_RPMH_VRM_HEADROOM_VOTE_DRV4_REG9_ADDR A:&base_addr+0x84090c
y.create.l HWIO_RPMH_VRM_HEADROOM_VOTE_DRV4_REG10_ADDR A:&base_addr+0x840a0c
y.create.l HWIO_RPMH_VRM_HEADROOM_VOTE_DRV4_REG11_ADDR A:&base_addr+0x840b0c
y.create.l HWIO_RPMH_VRM_HEADROOM_VOTE_DRV4_REG12_ADDR A:&base_addr+0x840c0c
y.create.l HWIO_RPMH_VRM_HEADROOM_VOTE_DRV4_REG13_ADDR A:&base_addr+0x840d0c
y.create.l HWIO_RPMH_VRM_HEADROOM_VOTE_DRV4_REG14_ADDR A:&base_addr+0x840e0c
y.create.l HWIO_RPMH_VRM_HEADROOM_VOTE_DRV4_REG15_ADDR A:&base_addr+0x840f0c
y.create.l HWIO_RPMH_VRM_HEADROOM_VOTE_DRV4_REG16_ADDR A:&base_addr+0x84100c
y.create.l HWIO_RPMH_VRM_HEADROOM_VOTE_DRV4_REG17_ADDR A:&base_addr+0x84110c
y.create.l HWIO_RPMH_VRM_HEADROOM_VOTE_DRV4_REG18_ADDR A:&base_addr+0x84120c
y.create.l HWIO_RPMH_VRM_HEADROOM_VOTE_DRV4_REG19_ADDR A:&base_addr+0x84130c
y.create.l HWIO_RPMH_VRM_HEADROOM_VOTE_DRV4_REG20_ADDR A:&base_addr+0x84140c
y.create.l HWIO_RPMH_VRM_HEADROOM_VOTE_DRV4_REG21_ADDR A:&base_addr+0x84150c
y.create.l HWIO_RPMH_VRM_HEADROOM_VOTE_DRV4_REG22_ADDR A:&base_addr+0x84160c
y.create.l HWIO_RPMH_VRM_HEADROOM_VOTE_DRV4_REG23_ADDR A:&base_addr+0x84170c
y.create.l HWIO_RPMH_VRM_HEADROOM_VOTE_DRV4_REG24_ADDR A:&base_addr+0x84180c
y.create.l HWIO_RPMH_VRM_HEADROOM_VOTE_DRV4_REG25_ADDR A:&base_addr+0x84190c
y.create.l HWIO_RPMH_VRM_HEADROOM_VOTE_DRV4_REG26_ADDR A:&base_addr+0x841a0c
y.create.l HWIO_RPMH_VRM_HEADROOM_VOTE_DRV4_REG27_ADDR A:&base_addr+0x841b0c
y.create.l HWIO_RPMH_VRM_HEADROOM_VOTE_DRV4_REG28_ADDR A:&base_addr+0x841c0c
y.create.l HWIO_RPMH_VRM_HEADROOM_VOTE_DRV4_REG29_ADDR A:&base_addr+0x841d0c
y.create.l HWIO_RPMH_VRM_HEADROOM_VOTE_DRV4_REG30_ADDR A:&base_addr+0x841e0c
y.create.l HWIO_RPMH_VRM_HEADROOM_VOTE_DRV4_REG31_ADDR A:&base_addr+0x841f0c
y.create.l HWIO_RPMH_VRM_HEADROOM_VOTE_DRV4_REG32_ADDR A:&base_addr+0x84200c
y.create.l HWIO_RPMH_VRM_HEADROOM_VOTE_DRV4_REG33_ADDR A:&base_addr+0x84210c
y.create.l HWIO_RPMH_VRM_HEADROOM_VOTE_DRV4_REG34_ADDR A:&base_addr+0x84220c
y.create.l HWIO_RPMH_VRM_HEADROOM_VOTE_DRV4_REG35_ADDR A:&base_addr+0x84230c
y.create.l HWIO_RPMH_VRM_HEADROOM_VOTE_DRV4_REG36_ADDR A:&base_addr+0x84240c
y.create.l HWIO_RPMH_VRM_HEADROOM_VOTE_DRV4_REG37_ADDR A:&base_addr+0x84250c
y.create.l HWIO_RPMH_VRM_HEADROOM_VOTE_DRV4_REG38_ADDR A:&base_addr+0x84260c
y.create.l HWIO_RPMH_VRM_HEADROOM_VOTE_DRV4_REG39_ADDR A:&base_addr+0x84270c
y.create.l HWIO_RPMH_VRM_HEADROOM_VOTE_DRV4_REG40_ADDR A:&base_addr+0x84280c
y.create.l HWIO_RPMH_VRM_HEADROOM_VOTE_DRV4_REG41_ADDR A:&base_addr+0x84290c
y.create.l HWIO_RPMH_VRM_HEADROOM_VOTE_DRV4_REG42_ADDR A:&base_addr+0x842a0c
y.create.l HWIO_RPMH_VRM_HEADROOM_VOTE_DRV4_REG43_ADDR A:&base_addr+0x842b0c
y.create.l HWIO_RPMH_VRM_HEADROOM_VOTE_DRV4_REG44_ADDR A:&base_addr+0x842c0c
y.create.l HWIO_RPMH_VRM_HEADROOM_VOTE_DRV4_REG45_ADDR A:&base_addr+0x842d0c
y.create.l HWIO_RPMH_VRM_HEADROOM_VOTE_DRV5_REG0_ADDR A:&base_addr+0x85000c
y.create.l HWIO_RPMH_VRM_HEADROOM_VOTE_DRV5_REG1_ADDR A:&base_addr+0x85010c
y.create.l HWIO_RPMH_VRM_HEADROOM_VOTE_DRV5_REG2_ADDR A:&base_addr+0x85020c
y.create.l HWIO_RPMH_VRM_HEADROOM_VOTE_DRV5_REG3_ADDR A:&base_addr+0x85030c
y.create.l HWIO_RPMH_VRM_HEADROOM_VOTE_DRV5_REG4_ADDR A:&base_addr+0x85040c
y.create.l HWIO_RPMH_VRM_HEADROOM_VOTE_DRV5_REG5_ADDR A:&base_addr+0x85050c
y.create.l HWIO_RPMH_VRM_HEADROOM_VOTE_DRV5_REG6_ADDR A:&base_addr+0x85060c
y.create.l HWIO_RPMH_VRM_HEADROOM_VOTE_DRV5_REG7_ADDR A:&base_addr+0x85070c
y.create.l HWIO_RPMH_VRM_HEADROOM_VOTE_DRV5_REG8_ADDR A:&base_addr+0x85080c
y.create.l HWIO_RPMH_VRM_HEADROOM_VOTE_DRV5_REG9_ADDR A:&base_addr+0x85090c
y.create.l HWIO_RPMH_VRM_HEADROOM_VOTE_DRV5_REG10_ADDR A:&base_addr+0x850a0c
y.create.l HWIO_RPMH_VRM_HEADROOM_VOTE_DRV5_REG11_ADDR A:&base_addr+0x850b0c
y.create.l HWIO_RPMH_VRM_HEADROOM_VOTE_DRV5_REG12_ADDR A:&base_addr+0x850c0c
y.create.l HWIO_RPMH_VRM_HEADROOM_VOTE_DRV5_REG13_ADDR A:&base_addr+0x850d0c
y.create.l HWIO_RPMH_VRM_HEADROOM_VOTE_DRV5_REG14_ADDR A:&base_addr+0x850e0c
y.create.l HWIO_RPMH_VRM_HEADROOM_VOTE_DRV5_REG15_ADDR A:&base_addr+0x850f0c
y.create.l HWIO_RPMH_VRM_HEADROOM_VOTE_DRV5_REG16_ADDR A:&base_addr+0x85100c
y.create.l HWIO_RPMH_VRM_HEADROOM_VOTE_DRV5_REG17_ADDR A:&base_addr+0x85110c
y.create.l HWIO_RPMH_VRM_HEADROOM_VOTE_DRV5_REG18_ADDR A:&base_addr+0x85120c
y.create.l HWIO_RPMH_VRM_HEADROOM_VOTE_DRV5_REG19_ADDR A:&base_addr+0x85130c
y.create.l HWIO_RPMH_VRM_HEADROOM_VOTE_DRV5_REG20_ADDR A:&base_addr+0x85140c
y.create.l HWIO_RPMH_VRM_HEADROOM_VOTE_DRV5_REG21_ADDR A:&base_addr+0x85150c
y.create.l HWIO_RPMH_VRM_HEADROOM_VOTE_DRV5_REG22_ADDR A:&base_addr+0x85160c
y.create.l HWIO_RPMH_VRM_HEADROOM_VOTE_DRV5_REG23_ADDR A:&base_addr+0x85170c
y.create.l HWIO_RPMH_VRM_HEADROOM_VOTE_DRV5_REG24_ADDR A:&base_addr+0x85180c
y.create.l HWIO_RPMH_VRM_HEADROOM_VOTE_DRV5_REG25_ADDR A:&base_addr+0x85190c
y.create.l HWIO_RPMH_VRM_HEADROOM_VOTE_DRV5_REG26_ADDR A:&base_addr+0x851a0c
y.create.l HWIO_RPMH_VRM_HEADROOM_VOTE_DRV5_REG27_ADDR A:&base_addr+0x851b0c
y.create.l HWIO_RPMH_VRM_HEADROOM_VOTE_DRV5_REG28_ADDR A:&base_addr+0x851c0c
y.create.l HWIO_RPMH_VRM_HEADROOM_VOTE_DRV5_REG29_ADDR A:&base_addr+0x851d0c
y.create.l HWIO_RPMH_VRM_HEADROOM_VOTE_DRV5_REG30_ADDR A:&base_addr+0x851e0c
y.create.l HWIO_RPMH_VRM_HEADROOM_VOTE_DRV5_REG31_ADDR A:&base_addr+0x851f0c
y.create.l HWIO_RPMH_VRM_HEADROOM_VOTE_DRV5_REG32_ADDR A:&base_addr+0x85200c
y.create.l HWIO_RPMH_VRM_HEADROOM_VOTE_DRV5_REG33_ADDR A:&base_addr+0x85210c
y.create.l HWIO_RPMH_VRM_HEADROOM_VOTE_DRV5_REG34_ADDR A:&base_addr+0x85220c
y.create.l HWIO_RPMH_VRM_HEADROOM_VOTE_DRV5_REG35_ADDR A:&base_addr+0x85230c
y.create.l HWIO_RPMH_VRM_HEADROOM_VOTE_DRV5_REG36_ADDR A:&base_addr+0x85240c
y.create.l HWIO_RPMH_VRM_HEADROOM_VOTE_DRV5_REG37_ADDR A:&base_addr+0x85250c
y.create.l HWIO_RPMH_VRM_HEADROOM_VOTE_DRV5_REG38_ADDR A:&base_addr+0x85260c
y.create.l HWIO_RPMH_VRM_HEADROOM_VOTE_DRV5_REG39_ADDR A:&base_addr+0x85270c
y.create.l HWIO_RPMH_VRM_HEADROOM_VOTE_DRV5_REG40_ADDR A:&base_addr+0x85280c
y.create.l HWIO_RPMH_VRM_HEADROOM_VOTE_DRV5_REG41_ADDR A:&base_addr+0x85290c
y.create.l HWIO_RPMH_VRM_HEADROOM_VOTE_DRV5_REG42_ADDR A:&base_addr+0x852a0c
y.create.l HWIO_RPMH_VRM_HEADROOM_VOTE_DRV5_REG43_ADDR A:&base_addr+0x852b0c
y.create.l HWIO_RPMH_VRM_HEADROOM_VOTE_DRV5_REG44_ADDR A:&base_addr+0x852c0c
y.create.l HWIO_RPMH_VRM_HEADROOM_VOTE_DRV5_REG45_ADDR A:&base_addr+0x852d0c
y.create.l HWIO_RPMH_VRM_HEADROOM_VOTE_DRV6_REG0_ADDR A:&base_addr+0x86000c
y.create.l HWIO_RPMH_VRM_HEADROOM_VOTE_DRV6_REG1_ADDR A:&base_addr+0x86010c
y.create.l HWIO_RPMH_VRM_HEADROOM_VOTE_DRV6_REG2_ADDR A:&base_addr+0x86020c
y.create.l HWIO_RPMH_VRM_HEADROOM_VOTE_DRV6_REG3_ADDR A:&base_addr+0x86030c
y.create.l HWIO_RPMH_VRM_HEADROOM_VOTE_DRV6_REG4_ADDR A:&base_addr+0x86040c
y.create.l HWIO_RPMH_VRM_HEADROOM_VOTE_DRV6_REG5_ADDR A:&base_addr+0x86050c
y.create.l HWIO_RPMH_VRM_HEADROOM_VOTE_DRV6_REG6_ADDR A:&base_addr+0x86060c
y.create.l HWIO_RPMH_VRM_HEADROOM_VOTE_DRV6_REG7_ADDR A:&base_addr+0x86070c
y.create.l HWIO_RPMH_VRM_HEADROOM_VOTE_DRV6_REG8_ADDR A:&base_addr+0x86080c
y.create.l HWIO_RPMH_VRM_HEADROOM_VOTE_DRV6_REG9_ADDR A:&base_addr+0x86090c
y.create.l HWIO_RPMH_VRM_HEADROOM_VOTE_DRV6_REG10_ADDR A:&base_addr+0x860a0c
y.create.l HWIO_RPMH_VRM_HEADROOM_VOTE_DRV6_REG11_ADDR A:&base_addr+0x860b0c
y.create.l HWIO_RPMH_VRM_HEADROOM_VOTE_DRV6_REG12_ADDR A:&base_addr+0x860c0c
y.create.l HWIO_RPMH_VRM_HEADROOM_VOTE_DRV6_REG13_ADDR A:&base_addr+0x860d0c
y.create.l HWIO_RPMH_VRM_HEADROOM_VOTE_DRV6_REG14_ADDR A:&base_addr+0x860e0c
y.create.l HWIO_RPMH_VRM_HEADROOM_VOTE_DRV6_REG15_ADDR A:&base_addr+0x860f0c
y.create.l HWIO_RPMH_VRM_HEADROOM_VOTE_DRV6_REG16_ADDR A:&base_addr+0x86100c
y.create.l HWIO_RPMH_VRM_HEADROOM_VOTE_DRV6_REG17_ADDR A:&base_addr+0x86110c
y.create.l HWIO_RPMH_VRM_HEADROOM_VOTE_DRV6_REG18_ADDR A:&base_addr+0x86120c
y.create.l HWIO_RPMH_VRM_HEADROOM_VOTE_DRV6_REG19_ADDR A:&base_addr+0x86130c
y.create.l HWIO_RPMH_VRM_HEADROOM_VOTE_DRV6_REG20_ADDR A:&base_addr+0x86140c
y.create.l HWIO_RPMH_VRM_HEADROOM_VOTE_DRV6_REG21_ADDR A:&base_addr+0x86150c
y.create.l HWIO_RPMH_VRM_HEADROOM_VOTE_DRV6_REG22_ADDR A:&base_addr+0x86160c
y.create.l HWIO_RPMH_VRM_HEADROOM_VOTE_DRV6_REG23_ADDR A:&base_addr+0x86170c
y.create.l HWIO_RPMH_VRM_HEADROOM_VOTE_DRV6_REG24_ADDR A:&base_addr+0x86180c
y.create.l HWIO_RPMH_VRM_HEADROOM_VOTE_DRV6_REG25_ADDR A:&base_addr+0x86190c
y.create.l HWIO_RPMH_VRM_HEADROOM_VOTE_DRV6_REG26_ADDR A:&base_addr+0x861a0c
y.create.l HWIO_RPMH_VRM_HEADROOM_VOTE_DRV6_REG27_ADDR A:&base_addr+0x861b0c
y.create.l HWIO_RPMH_VRM_HEADROOM_VOTE_DRV6_REG28_ADDR A:&base_addr+0x861c0c
y.create.l HWIO_RPMH_VRM_HEADROOM_VOTE_DRV6_REG29_ADDR A:&base_addr+0x861d0c
y.create.l HWIO_RPMH_VRM_HEADROOM_VOTE_DRV6_REG30_ADDR A:&base_addr+0x861e0c
y.create.l HWIO_RPMH_VRM_HEADROOM_VOTE_DRV6_REG31_ADDR A:&base_addr+0x861f0c
y.create.l HWIO_RPMH_VRM_HEADROOM_VOTE_DRV6_REG32_ADDR A:&base_addr+0x86200c
y.create.l HWIO_RPMH_VRM_HEADROOM_VOTE_DRV6_REG33_ADDR A:&base_addr+0x86210c
y.create.l HWIO_RPMH_VRM_HEADROOM_VOTE_DRV6_REG34_ADDR A:&base_addr+0x86220c
y.create.l HWIO_RPMH_VRM_HEADROOM_VOTE_DRV6_REG35_ADDR A:&base_addr+0x86230c
y.create.l HWIO_RPMH_VRM_HEADROOM_VOTE_DRV6_REG36_ADDR A:&base_addr+0x86240c
y.create.l HWIO_RPMH_VRM_HEADROOM_VOTE_DRV6_REG37_ADDR A:&base_addr+0x86250c
y.create.l HWIO_RPMH_VRM_HEADROOM_VOTE_DRV6_REG38_ADDR A:&base_addr+0x86260c
y.create.l HWIO_RPMH_VRM_HEADROOM_VOTE_DRV6_REG39_ADDR A:&base_addr+0x86270c
y.create.l HWIO_RPMH_VRM_HEADROOM_VOTE_DRV6_REG40_ADDR A:&base_addr+0x86280c
y.create.l HWIO_RPMH_VRM_HEADROOM_VOTE_DRV6_REG41_ADDR A:&base_addr+0x86290c
y.create.l HWIO_RPMH_VRM_HEADROOM_VOTE_DRV6_REG42_ADDR A:&base_addr+0x862a0c
y.create.l HWIO_RPMH_VRM_HEADROOM_VOTE_DRV6_REG43_ADDR A:&base_addr+0x862b0c
y.create.l HWIO_RPMH_VRM_HEADROOM_VOTE_DRV6_REG44_ADDR A:&base_addr+0x862c0c
y.create.l HWIO_RPMH_VRM_HEADROOM_VOTE_DRV6_REG45_ADDR A:&base_addr+0x862d0c
y.create.l HWIO_RPMH_VRM_HEADROOM_VOTE_DRV7_REG0_ADDR A:&base_addr+0x87000c
y.create.l HWIO_RPMH_VRM_HEADROOM_VOTE_DRV7_REG1_ADDR A:&base_addr+0x87010c
y.create.l HWIO_RPMH_VRM_HEADROOM_VOTE_DRV7_REG2_ADDR A:&base_addr+0x87020c
y.create.l HWIO_RPMH_VRM_HEADROOM_VOTE_DRV7_REG3_ADDR A:&base_addr+0x87030c
y.create.l HWIO_RPMH_VRM_HEADROOM_VOTE_DRV7_REG4_ADDR A:&base_addr+0x87040c
y.create.l HWIO_RPMH_VRM_HEADROOM_VOTE_DRV7_REG5_ADDR A:&base_addr+0x87050c
y.create.l HWIO_RPMH_VRM_HEADROOM_VOTE_DRV7_REG6_ADDR A:&base_addr+0x87060c
y.create.l HWIO_RPMH_VRM_HEADROOM_VOTE_DRV7_REG7_ADDR A:&base_addr+0x87070c
y.create.l HWIO_RPMH_VRM_HEADROOM_VOTE_DRV7_REG8_ADDR A:&base_addr+0x87080c
y.create.l HWIO_RPMH_VRM_HEADROOM_VOTE_DRV7_REG9_ADDR A:&base_addr+0x87090c
y.create.l HWIO_RPMH_VRM_HEADROOM_VOTE_DRV7_REG10_ADDR A:&base_addr+0x870a0c
y.create.l HWIO_RPMH_VRM_HEADROOM_VOTE_DRV7_REG11_ADDR A:&base_addr+0x870b0c
y.create.l HWIO_RPMH_VRM_HEADROOM_VOTE_DRV7_REG12_ADDR A:&base_addr+0x870c0c
y.create.l HWIO_RPMH_VRM_HEADROOM_VOTE_DRV7_REG13_ADDR A:&base_addr+0x870d0c
y.create.l HWIO_RPMH_VRM_HEADROOM_VOTE_DRV7_REG14_ADDR A:&base_addr+0x870e0c
y.create.l HWIO_RPMH_VRM_HEADROOM_VOTE_DRV7_REG15_ADDR A:&base_addr+0x870f0c
y.create.l HWIO_RPMH_VRM_HEADROOM_VOTE_DRV7_REG16_ADDR A:&base_addr+0x87100c
y.create.l HWIO_RPMH_VRM_HEADROOM_VOTE_DRV7_REG17_ADDR A:&base_addr+0x87110c
y.create.l HWIO_RPMH_VRM_HEADROOM_VOTE_DRV7_REG18_ADDR A:&base_addr+0x87120c
y.create.l HWIO_RPMH_VRM_HEADROOM_VOTE_DRV7_REG19_ADDR A:&base_addr+0x87130c
y.create.l HWIO_RPMH_VRM_HEADROOM_VOTE_DRV7_REG20_ADDR A:&base_addr+0x87140c
y.create.l HWIO_RPMH_VRM_HEADROOM_VOTE_DRV7_REG21_ADDR A:&base_addr+0x87150c
y.create.l HWIO_RPMH_VRM_HEADROOM_VOTE_DRV7_REG22_ADDR A:&base_addr+0x87160c
y.create.l HWIO_RPMH_VRM_HEADROOM_VOTE_DRV7_REG23_ADDR A:&base_addr+0x87170c
y.create.l HWIO_RPMH_VRM_HEADROOM_VOTE_DRV7_REG24_ADDR A:&base_addr+0x87180c
y.create.l HWIO_RPMH_VRM_HEADROOM_VOTE_DRV7_REG25_ADDR A:&base_addr+0x87190c
y.create.l HWIO_RPMH_VRM_HEADROOM_VOTE_DRV7_REG26_ADDR A:&base_addr+0x871a0c
y.create.l HWIO_RPMH_VRM_HEADROOM_VOTE_DRV7_REG27_ADDR A:&base_addr+0x871b0c
y.create.l HWIO_RPMH_VRM_HEADROOM_VOTE_DRV7_REG28_ADDR A:&base_addr+0x871c0c
y.create.l HWIO_RPMH_VRM_HEADROOM_VOTE_DRV7_REG29_ADDR A:&base_addr+0x871d0c
y.create.l HWIO_RPMH_VRM_HEADROOM_VOTE_DRV7_REG30_ADDR A:&base_addr+0x871e0c
y.create.l HWIO_RPMH_VRM_HEADROOM_VOTE_DRV7_REG31_ADDR A:&base_addr+0x871f0c
y.create.l HWIO_RPMH_VRM_HEADROOM_VOTE_DRV7_REG32_ADDR A:&base_addr+0x87200c
y.create.l HWIO_RPMH_VRM_HEADROOM_VOTE_DRV7_REG33_ADDR A:&base_addr+0x87210c
y.create.l HWIO_RPMH_VRM_HEADROOM_VOTE_DRV7_REG34_ADDR A:&base_addr+0x87220c
y.create.l HWIO_RPMH_VRM_HEADROOM_VOTE_DRV7_REG35_ADDR A:&base_addr+0x87230c
y.create.l HWIO_RPMH_VRM_HEADROOM_VOTE_DRV7_REG36_ADDR A:&base_addr+0x87240c
y.create.l HWIO_RPMH_VRM_HEADROOM_VOTE_DRV7_REG37_ADDR A:&base_addr+0x87250c
y.create.l HWIO_RPMH_VRM_HEADROOM_VOTE_DRV7_REG38_ADDR A:&base_addr+0x87260c
y.create.l HWIO_RPMH_VRM_HEADROOM_VOTE_DRV7_REG39_ADDR A:&base_addr+0x87270c
y.create.l HWIO_RPMH_VRM_HEADROOM_VOTE_DRV7_REG40_ADDR A:&base_addr+0x87280c
y.create.l HWIO_RPMH_VRM_HEADROOM_VOTE_DRV7_REG41_ADDR A:&base_addr+0x87290c
y.create.l HWIO_RPMH_VRM_HEADROOM_VOTE_DRV7_REG42_ADDR A:&base_addr+0x872a0c
y.create.l HWIO_RPMH_VRM_HEADROOM_VOTE_DRV7_REG43_ADDR A:&base_addr+0x872b0c
y.create.l HWIO_RPMH_VRM_HEADROOM_VOTE_DRV7_REG44_ADDR A:&base_addr+0x872c0c
y.create.l HWIO_RPMH_VRM_HEADROOM_VOTE_DRV7_REG45_ADDR A:&base_addr+0x872d0c
y.create.l HWIO_RPMH_VRM_HEADROOM_VOTE_DRV8_REG0_ADDR A:&base_addr+0x88000c
y.create.l HWIO_RPMH_VRM_HEADROOM_VOTE_DRV8_REG1_ADDR A:&base_addr+0x88010c
y.create.l HWIO_RPMH_VRM_HEADROOM_VOTE_DRV8_REG2_ADDR A:&base_addr+0x88020c
y.create.l HWIO_RPMH_VRM_HEADROOM_VOTE_DRV8_REG3_ADDR A:&base_addr+0x88030c
y.create.l HWIO_RPMH_VRM_HEADROOM_VOTE_DRV8_REG4_ADDR A:&base_addr+0x88040c
y.create.l HWIO_RPMH_VRM_HEADROOM_VOTE_DRV8_REG5_ADDR A:&base_addr+0x88050c
y.create.l HWIO_RPMH_VRM_HEADROOM_VOTE_DRV8_REG6_ADDR A:&base_addr+0x88060c
y.create.l HWIO_RPMH_VRM_HEADROOM_VOTE_DRV8_REG7_ADDR A:&base_addr+0x88070c
y.create.l HWIO_RPMH_VRM_HEADROOM_VOTE_DRV8_REG8_ADDR A:&base_addr+0x88080c
y.create.l HWIO_RPMH_VRM_HEADROOM_VOTE_DRV8_REG9_ADDR A:&base_addr+0x88090c
y.create.l HWIO_RPMH_VRM_HEADROOM_VOTE_DRV8_REG10_ADDR A:&base_addr+0x880a0c
y.create.l HWIO_RPMH_VRM_HEADROOM_VOTE_DRV8_REG11_ADDR A:&base_addr+0x880b0c
y.create.l HWIO_RPMH_VRM_HEADROOM_VOTE_DRV8_REG12_ADDR A:&base_addr+0x880c0c
y.create.l HWIO_RPMH_VRM_HEADROOM_VOTE_DRV8_REG13_ADDR A:&base_addr+0x880d0c
y.create.l HWIO_RPMH_VRM_HEADROOM_VOTE_DRV8_REG14_ADDR A:&base_addr+0x880e0c
y.create.l HWIO_RPMH_VRM_HEADROOM_VOTE_DRV8_REG15_ADDR A:&base_addr+0x880f0c
y.create.l HWIO_RPMH_VRM_HEADROOM_VOTE_DRV8_REG16_ADDR A:&base_addr+0x88100c
y.create.l HWIO_RPMH_VRM_HEADROOM_VOTE_DRV8_REG17_ADDR A:&base_addr+0x88110c
y.create.l HWIO_RPMH_VRM_HEADROOM_VOTE_DRV8_REG18_ADDR A:&base_addr+0x88120c
y.create.l HWIO_RPMH_VRM_HEADROOM_VOTE_DRV8_REG19_ADDR A:&base_addr+0x88130c
y.create.l HWIO_RPMH_VRM_HEADROOM_VOTE_DRV8_REG20_ADDR A:&base_addr+0x88140c
y.create.l HWIO_RPMH_VRM_HEADROOM_VOTE_DRV8_REG21_ADDR A:&base_addr+0x88150c
y.create.l HWIO_RPMH_VRM_HEADROOM_VOTE_DRV8_REG22_ADDR A:&base_addr+0x88160c
y.create.l HWIO_RPMH_VRM_HEADROOM_VOTE_DRV8_REG23_ADDR A:&base_addr+0x88170c
y.create.l HWIO_RPMH_VRM_HEADROOM_VOTE_DRV8_REG24_ADDR A:&base_addr+0x88180c
y.create.l HWIO_RPMH_VRM_HEADROOM_VOTE_DRV8_REG25_ADDR A:&base_addr+0x88190c
y.create.l HWIO_RPMH_VRM_HEADROOM_VOTE_DRV8_REG26_ADDR A:&base_addr+0x881a0c
y.create.l HWIO_RPMH_VRM_HEADROOM_VOTE_DRV8_REG27_ADDR A:&base_addr+0x881b0c
y.create.l HWIO_RPMH_VRM_HEADROOM_VOTE_DRV8_REG28_ADDR A:&base_addr+0x881c0c
y.create.l HWIO_RPMH_VRM_HEADROOM_VOTE_DRV8_REG29_ADDR A:&base_addr+0x881d0c
y.create.l HWIO_RPMH_VRM_HEADROOM_VOTE_DRV8_REG30_ADDR A:&base_addr+0x881e0c
y.create.l HWIO_RPMH_VRM_HEADROOM_VOTE_DRV8_REG31_ADDR A:&base_addr+0x881f0c
y.create.l HWIO_RPMH_VRM_HEADROOM_VOTE_DRV8_REG32_ADDR A:&base_addr+0x88200c
y.create.l HWIO_RPMH_VRM_HEADROOM_VOTE_DRV8_REG33_ADDR A:&base_addr+0x88210c
y.create.l HWIO_RPMH_VRM_HEADROOM_VOTE_DRV8_REG34_ADDR A:&base_addr+0x88220c
y.create.l HWIO_RPMH_VRM_HEADROOM_VOTE_DRV8_REG35_ADDR A:&base_addr+0x88230c
y.create.l HWIO_RPMH_VRM_HEADROOM_VOTE_DRV8_REG36_ADDR A:&base_addr+0x88240c
y.create.l HWIO_RPMH_VRM_HEADROOM_VOTE_DRV8_REG37_ADDR A:&base_addr+0x88250c
y.create.l HWIO_RPMH_VRM_HEADROOM_VOTE_DRV8_REG38_ADDR A:&base_addr+0x88260c
y.create.l HWIO_RPMH_VRM_HEADROOM_VOTE_DRV8_REG39_ADDR A:&base_addr+0x88270c
y.create.l HWIO_RPMH_VRM_HEADROOM_VOTE_DRV8_REG40_ADDR A:&base_addr+0x88280c
y.create.l HWIO_RPMH_VRM_HEADROOM_VOTE_DRV8_REG41_ADDR A:&base_addr+0x88290c
y.create.l HWIO_RPMH_VRM_HEADROOM_VOTE_DRV8_REG42_ADDR A:&base_addr+0x882a0c
y.create.l HWIO_RPMH_VRM_HEADROOM_VOTE_DRV8_REG43_ADDR A:&base_addr+0x882b0c
y.create.l HWIO_RPMH_VRM_HEADROOM_VOTE_DRV8_REG44_ADDR A:&base_addr+0x882c0c
y.create.l HWIO_RPMH_VRM_HEADROOM_VOTE_DRV8_REG45_ADDR A:&base_addr+0x882d0c
y.create.l HWIO_RPMH_VRM_HEADROOM_VOTE_DRV9_REG0_ADDR A:&base_addr+0x89000c
y.create.l HWIO_RPMH_VRM_HEADROOM_VOTE_DRV9_REG1_ADDR A:&base_addr+0x89010c
y.create.l HWIO_RPMH_VRM_HEADROOM_VOTE_DRV9_REG2_ADDR A:&base_addr+0x89020c
y.create.l HWIO_RPMH_VRM_HEADROOM_VOTE_DRV9_REG3_ADDR A:&base_addr+0x89030c
y.create.l HWIO_RPMH_VRM_HEADROOM_VOTE_DRV9_REG4_ADDR A:&base_addr+0x89040c
y.create.l HWIO_RPMH_VRM_HEADROOM_VOTE_DRV9_REG5_ADDR A:&base_addr+0x89050c
y.create.l HWIO_RPMH_VRM_HEADROOM_VOTE_DRV9_REG6_ADDR A:&base_addr+0x89060c
y.create.l HWIO_RPMH_VRM_HEADROOM_VOTE_DRV9_REG7_ADDR A:&base_addr+0x89070c
y.create.l HWIO_RPMH_VRM_HEADROOM_VOTE_DRV9_REG8_ADDR A:&base_addr+0x89080c
y.create.l HWIO_RPMH_VRM_HEADROOM_VOTE_DRV9_REG9_ADDR A:&base_addr+0x89090c
y.create.l HWIO_RPMH_VRM_HEADROOM_VOTE_DRV9_REG10_ADDR A:&base_addr+0x890a0c
y.create.l HWIO_RPMH_VRM_HEADROOM_VOTE_DRV9_REG11_ADDR A:&base_addr+0x890b0c
y.create.l HWIO_RPMH_VRM_HEADROOM_VOTE_DRV9_REG12_ADDR A:&base_addr+0x890c0c
y.create.l HWIO_RPMH_VRM_HEADROOM_VOTE_DRV9_REG13_ADDR A:&base_addr+0x890d0c
y.create.l HWIO_RPMH_VRM_HEADROOM_VOTE_DRV9_REG14_ADDR A:&base_addr+0x890e0c
y.create.l HWIO_RPMH_VRM_HEADROOM_VOTE_DRV9_REG15_ADDR A:&base_addr+0x890f0c
y.create.l HWIO_RPMH_VRM_HEADROOM_VOTE_DRV9_REG16_ADDR A:&base_addr+0x89100c
y.create.l HWIO_RPMH_VRM_HEADROOM_VOTE_DRV9_REG17_ADDR A:&base_addr+0x89110c
y.create.l HWIO_RPMH_VRM_HEADROOM_VOTE_DRV9_REG18_ADDR A:&base_addr+0x89120c
y.create.l HWIO_RPMH_VRM_HEADROOM_VOTE_DRV9_REG19_ADDR A:&base_addr+0x89130c
y.create.l HWIO_RPMH_VRM_HEADROOM_VOTE_DRV9_REG20_ADDR A:&base_addr+0x89140c
y.create.l HWIO_RPMH_VRM_HEADROOM_VOTE_DRV9_REG21_ADDR A:&base_addr+0x89150c
y.create.l HWIO_RPMH_VRM_HEADROOM_VOTE_DRV9_REG22_ADDR A:&base_addr+0x89160c
y.create.l HWIO_RPMH_VRM_HEADROOM_VOTE_DRV9_REG23_ADDR A:&base_addr+0x89170c
y.create.l HWIO_RPMH_VRM_HEADROOM_VOTE_DRV9_REG24_ADDR A:&base_addr+0x89180c
y.create.l HWIO_RPMH_VRM_HEADROOM_VOTE_DRV9_REG25_ADDR A:&base_addr+0x89190c
y.create.l HWIO_RPMH_VRM_HEADROOM_VOTE_DRV9_REG26_ADDR A:&base_addr+0x891a0c
y.create.l HWIO_RPMH_VRM_HEADROOM_VOTE_DRV9_REG27_ADDR A:&base_addr+0x891b0c
y.create.l HWIO_RPMH_VRM_HEADROOM_VOTE_DRV9_REG28_ADDR A:&base_addr+0x891c0c
y.create.l HWIO_RPMH_VRM_HEADROOM_VOTE_DRV9_REG29_ADDR A:&base_addr+0x891d0c
y.create.l HWIO_RPMH_VRM_HEADROOM_VOTE_DRV9_REG30_ADDR A:&base_addr+0x891e0c
y.create.l HWIO_RPMH_VRM_HEADROOM_VOTE_DRV9_REG31_ADDR A:&base_addr+0x891f0c
y.create.l HWIO_RPMH_VRM_HEADROOM_VOTE_DRV9_REG32_ADDR A:&base_addr+0x89200c
y.create.l HWIO_RPMH_VRM_HEADROOM_VOTE_DRV9_REG33_ADDR A:&base_addr+0x89210c
y.create.l HWIO_RPMH_VRM_HEADROOM_VOTE_DRV9_REG34_ADDR A:&base_addr+0x89220c
y.create.l HWIO_RPMH_VRM_HEADROOM_VOTE_DRV9_REG35_ADDR A:&base_addr+0x89230c
y.create.l HWIO_RPMH_VRM_HEADROOM_VOTE_DRV9_REG36_ADDR A:&base_addr+0x89240c
y.create.l HWIO_RPMH_VRM_HEADROOM_VOTE_DRV9_REG37_ADDR A:&base_addr+0x89250c
y.create.l HWIO_RPMH_VRM_HEADROOM_VOTE_DRV9_REG38_ADDR A:&base_addr+0x89260c
y.create.l HWIO_RPMH_VRM_HEADROOM_VOTE_DRV9_REG39_ADDR A:&base_addr+0x89270c
y.create.l HWIO_RPMH_VRM_HEADROOM_VOTE_DRV9_REG40_ADDR A:&base_addr+0x89280c
y.create.l HWIO_RPMH_VRM_HEADROOM_VOTE_DRV9_REG41_ADDR A:&base_addr+0x89290c
y.create.l HWIO_RPMH_VRM_HEADROOM_VOTE_DRV9_REG42_ADDR A:&base_addr+0x892a0c
y.create.l HWIO_RPMH_VRM_HEADROOM_VOTE_DRV9_REG43_ADDR A:&base_addr+0x892b0c
y.create.l HWIO_RPMH_VRM_HEADROOM_VOTE_DRV9_REG44_ADDR A:&base_addr+0x892c0c
y.create.l HWIO_RPMH_VRM_HEADROOM_VOTE_DRV9_REG45_ADDR A:&base_addr+0x892d0c
y.create.l HWIO_RPMH_VRM_HEADROOM_VOTE_DRV10_REG0_ADDR A:&base_addr+0x8a000c
y.create.l HWIO_RPMH_VRM_HEADROOM_VOTE_DRV10_REG1_ADDR A:&base_addr+0x8a010c
y.create.l HWIO_RPMH_VRM_HEADROOM_VOTE_DRV10_REG2_ADDR A:&base_addr+0x8a020c
y.create.l HWIO_RPMH_VRM_HEADROOM_VOTE_DRV10_REG3_ADDR A:&base_addr+0x8a030c
y.create.l HWIO_RPMH_VRM_HEADROOM_VOTE_DRV10_REG4_ADDR A:&base_addr+0x8a040c
y.create.l HWIO_RPMH_VRM_HEADROOM_VOTE_DRV10_REG5_ADDR A:&base_addr+0x8a050c
y.create.l HWIO_RPMH_VRM_HEADROOM_VOTE_DRV10_REG6_ADDR A:&base_addr+0x8a060c
y.create.l HWIO_RPMH_VRM_HEADROOM_VOTE_DRV10_REG7_ADDR A:&base_addr+0x8a070c
y.create.l HWIO_RPMH_VRM_HEADROOM_VOTE_DRV10_REG8_ADDR A:&base_addr+0x8a080c
y.create.l HWIO_RPMH_VRM_HEADROOM_VOTE_DRV10_REG9_ADDR A:&base_addr+0x8a090c
y.create.l HWIO_RPMH_VRM_HEADROOM_VOTE_DRV10_REG10_ADDR A:&base_addr+0x8a0a0c
y.create.l HWIO_RPMH_VRM_HEADROOM_VOTE_DRV10_REG11_ADDR A:&base_addr+0x8a0b0c
y.create.l HWIO_RPMH_VRM_HEADROOM_VOTE_DRV10_REG12_ADDR A:&base_addr+0x8a0c0c
y.create.l HWIO_RPMH_VRM_HEADROOM_VOTE_DRV10_REG13_ADDR A:&base_addr+0x8a0d0c
y.create.l HWIO_RPMH_VRM_HEADROOM_VOTE_DRV10_REG14_ADDR A:&base_addr+0x8a0e0c
y.create.l HWIO_RPMH_VRM_HEADROOM_VOTE_DRV10_REG15_ADDR A:&base_addr+0x8a0f0c
y.create.l HWIO_RPMH_VRM_HEADROOM_VOTE_DRV10_REG16_ADDR A:&base_addr+0x8a100c
y.create.l HWIO_RPMH_VRM_HEADROOM_VOTE_DRV10_REG17_ADDR A:&base_addr+0x8a110c
y.create.l HWIO_RPMH_VRM_HEADROOM_VOTE_DRV10_REG18_ADDR A:&base_addr+0x8a120c
y.create.l HWIO_RPMH_VRM_HEADROOM_VOTE_DRV10_REG19_ADDR A:&base_addr+0x8a130c
y.create.l HWIO_RPMH_VRM_HEADROOM_VOTE_DRV10_REG20_ADDR A:&base_addr+0x8a140c
y.create.l HWIO_RPMH_VRM_HEADROOM_VOTE_DRV10_REG21_ADDR A:&base_addr+0x8a150c
y.create.l HWIO_RPMH_VRM_HEADROOM_VOTE_DRV10_REG22_ADDR A:&base_addr+0x8a160c
y.create.l HWIO_RPMH_VRM_HEADROOM_VOTE_DRV10_REG23_ADDR A:&base_addr+0x8a170c
y.create.l HWIO_RPMH_VRM_HEADROOM_VOTE_DRV10_REG24_ADDR A:&base_addr+0x8a180c
y.create.l HWIO_RPMH_VRM_HEADROOM_VOTE_DRV10_REG25_ADDR A:&base_addr+0x8a190c
y.create.l HWIO_RPMH_VRM_HEADROOM_VOTE_DRV10_REG26_ADDR A:&base_addr+0x8a1a0c
y.create.l HWIO_RPMH_VRM_HEADROOM_VOTE_DRV10_REG27_ADDR A:&base_addr+0x8a1b0c
y.create.l HWIO_RPMH_VRM_HEADROOM_VOTE_DRV10_REG28_ADDR A:&base_addr+0x8a1c0c
y.create.l HWIO_RPMH_VRM_HEADROOM_VOTE_DRV10_REG29_ADDR A:&base_addr+0x8a1d0c
y.create.l HWIO_RPMH_VRM_HEADROOM_VOTE_DRV10_REG30_ADDR A:&base_addr+0x8a1e0c
y.create.l HWIO_RPMH_VRM_HEADROOM_VOTE_DRV10_REG31_ADDR A:&base_addr+0x8a1f0c
y.create.l HWIO_RPMH_VRM_HEADROOM_VOTE_DRV10_REG32_ADDR A:&base_addr+0x8a200c
y.create.l HWIO_RPMH_VRM_HEADROOM_VOTE_DRV10_REG33_ADDR A:&base_addr+0x8a210c
y.create.l HWIO_RPMH_VRM_HEADROOM_VOTE_DRV10_REG34_ADDR A:&base_addr+0x8a220c
y.create.l HWIO_RPMH_VRM_HEADROOM_VOTE_DRV10_REG35_ADDR A:&base_addr+0x8a230c
y.create.l HWIO_RPMH_VRM_HEADROOM_VOTE_DRV10_REG36_ADDR A:&base_addr+0x8a240c
y.create.l HWIO_RPMH_VRM_HEADROOM_VOTE_DRV10_REG37_ADDR A:&base_addr+0x8a250c
y.create.l HWIO_RPMH_VRM_HEADROOM_VOTE_DRV10_REG38_ADDR A:&base_addr+0x8a260c
y.create.l HWIO_RPMH_VRM_HEADROOM_VOTE_DRV10_REG39_ADDR A:&base_addr+0x8a270c
y.create.l HWIO_RPMH_VRM_HEADROOM_VOTE_DRV10_REG40_ADDR A:&base_addr+0x8a280c
y.create.l HWIO_RPMH_VRM_HEADROOM_VOTE_DRV10_REG41_ADDR A:&base_addr+0x8a290c
y.create.l HWIO_RPMH_VRM_HEADROOM_VOTE_DRV10_REG42_ADDR A:&base_addr+0x8a2a0c
y.create.l HWIO_RPMH_VRM_HEADROOM_VOTE_DRV10_REG43_ADDR A:&base_addr+0x8a2b0c
y.create.l HWIO_RPMH_VRM_HEADROOM_VOTE_DRV10_REG44_ADDR A:&base_addr+0x8a2c0c
y.create.l HWIO_RPMH_VRM_HEADROOM_VOTE_DRV10_REG45_ADDR A:&base_addr+0x8a2d0c
y.create.l HWIO_RPMH_VRM_HEADROOM_VOTE_DRV11_REG0_ADDR A:&base_addr+0x8b000c
y.create.l HWIO_RPMH_VRM_HEADROOM_VOTE_DRV11_REG1_ADDR A:&base_addr+0x8b010c
y.create.l HWIO_RPMH_VRM_HEADROOM_VOTE_DRV11_REG2_ADDR A:&base_addr+0x8b020c
y.create.l HWIO_RPMH_VRM_HEADROOM_VOTE_DRV11_REG3_ADDR A:&base_addr+0x8b030c
y.create.l HWIO_RPMH_VRM_HEADROOM_VOTE_DRV11_REG4_ADDR A:&base_addr+0x8b040c
y.create.l HWIO_RPMH_VRM_HEADROOM_VOTE_DRV11_REG5_ADDR A:&base_addr+0x8b050c
y.create.l HWIO_RPMH_VRM_HEADROOM_VOTE_DRV11_REG6_ADDR A:&base_addr+0x8b060c
y.create.l HWIO_RPMH_VRM_HEADROOM_VOTE_DRV11_REG7_ADDR A:&base_addr+0x8b070c
y.create.l HWIO_RPMH_VRM_HEADROOM_VOTE_DRV11_REG8_ADDR A:&base_addr+0x8b080c
y.create.l HWIO_RPMH_VRM_HEADROOM_VOTE_DRV11_REG9_ADDR A:&base_addr+0x8b090c
y.create.l HWIO_RPMH_VRM_HEADROOM_VOTE_DRV11_REG10_ADDR A:&base_addr+0x8b0a0c
y.create.l HWIO_RPMH_VRM_HEADROOM_VOTE_DRV11_REG11_ADDR A:&base_addr+0x8b0b0c
y.create.l HWIO_RPMH_VRM_HEADROOM_VOTE_DRV11_REG12_ADDR A:&base_addr+0x8b0c0c
y.create.l HWIO_RPMH_VRM_HEADROOM_VOTE_DRV11_REG13_ADDR A:&base_addr+0x8b0d0c
y.create.l HWIO_RPMH_VRM_HEADROOM_VOTE_DRV11_REG14_ADDR A:&base_addr+0x8b0e0c
y.create.l HWIO_RPMH_VRM_HEADROOM_VOTE_DRV11_REG15_ADDR A:&base_addr+0x8b0f0c
y.create.l HWIO_RPMH_VRM_HEADROOM_VOTE_DRV11_REG16_ADDR A:&base_addr+0x8b100c
y.create.l HWIO_RPMH_VRM_HEADROOM_VOTE_DRV11_REG17_ADDR A:&base_addr+0x8b110c
y.create.l HWIO_RPMH_VRM_HEADROOM_VOTE_DRV11_REG18_ADDR A:&base_addr+0x8b120c
y.create.l HWIO_RPMH_VRM_HEADROOM_VOTE_DRV11_REG19_ADDR A:&base_addr+0x8b130c
y.create.l HWIO_RPMH_VRM_HEADROOM_VOTE_DRV11_REG20_ADDR A:&base_addr+0x8b140c
y.create.l HWIO_RPMH_VRM_HEADROOM_VOTE_DRV11_REG21_ADDR A:&base_addr+0x8b150c
y.create.l HWIO_RPMH_VRM_HEADROOM_VOTE_DRV11_REG22_ADDR A:&base_addr+0x8b160c
y.create.l HWIO_RPMH_VRM_HEADROOM_VOTE_DRV11_REG23_ADDR A:&base_addr+0x8b170c
y.create.l HWIO_RPMH_VRM_HEADROOM_VOTE_DRV11_REG24_ADDR A:&base_addr+0x8b180c
y.create.l HWIO_RPMH_VRM_HEADROOM_VOTE_DRV11_REG25_ADDR A:&base_addr+0x8b190c
y.create.l HWIO_RPMH_VRM_HEADROOM_VOTE_DRV11_REG26_ADDR A:&base_addr+0x8b1a0c
y.create.l HWIO_RPMH_VRM_HEADROOM_VOTE_DRV11_REG27_ADDR A:&base_addr+0x8b1b0c
y.create.l HWIO_RPMH_VRM_HEADROOM_VOTE_DRV11_REG28_ADDR A:&base_addr+0x8b1c0c
y.create.l HWIO_RPMH_VRM_HEADROOM_VOTE_DRV11_REG29_ADDR A:&base_addr+0x8b1d0c
y.create.l HWIO_RPMH_VRM_HEADROOM_VOTE_DRV11_REG30_ADDR A:&base_addr+0x8b1e0c
y.create.l HWIO_RPMH_VRM_HEADROOM_VOTE_DRV11_REG31_ADDR A:&base_addr+0x8b1f0c
y.create.l HWIO_RPMH_VRM_HEADROOM_VOTE_DRV11_REG32_ADDR A:&base_addr+0x8b200c
y.create.l HWIO_RPMH_VRM_HEADROOM_VOTE_DRV11_REG33_ADDR A:&base_addr+0x8b210c
y.create.l HWIO_RPMH_VRM_HEADROOM_VOTE_DRV11_REG34_ADDR A:&base_addr+0x8b220c
y.create.l HWIO_RPMH_VRM_HEADROOM_VOTE_DRV11_REG35_ADDR A:&base_addr+0x8b230c
y.create.l HWIO_RPMH_VRM_HEADROOM_VOTE_DRV11_REG36_ADDR A:&base_addr+0x8b240c
y.create.l HWIO_RPMH_VRM_HEADROOM_VOTE_DRV11_REG37_ADDR A:&base_addr+0x8b250c
y.create.l HWIO_RPMH_VRM_HEADROOM_VOTE_DRV11_REG38_ADDR A:&base_addr+0x8b260c
y.create.l HWIO_RPMH_VRM_HEADROOM_VOTE_DRV11_REG39_ADDR A:&base_addr+0x8b270c
y.create.l HWIO_RPMH_VRM_HEADROOM_VOTE_DRV11_REG40_ADDR A:&base_addr+0x8b280c
y.create.l HWIO_RPMH_VRM_HEADROOM_VOTE_DRV11_REG41_ADDR A:&base_addr+0x8b290c
y.create.l HWIO_RPMH_VRM_HEADROOM_VOTE_DRV11_REG42_ADDR A:&base_addr+0x8b2a0c
y.create.l HWIO_RPMH_VRM_HEADROOM_VOTE_DRV11_REG43_ADDR A:&base_addr+0x8b2b0c
y.create.l HWIO_RPMH_VRM_HEADROOM_VOTE_DRV11_REG44_ADDR A:&base_addr+0x8b2c0c
y.create.l HWIO_RPMH_VRM_HEADROOM_VOTE_DRV11_REG45_ADDR A:&base_addr+0x8b2d0c
y.create.l HWIO_RPMH_VRM_HEADROOM_VOTE_DRV12_REG0_ADDR A:&base_addr+0x8c000c
y.create.l HWIO_RPMH_VRM_HEADROOM_VOTE_DRV12_REG1_ADDR A:&base_addr+0x8c010c
y.create.l HWIO_RPMH_VRM_HEADROOM_VOTE_DRV12_REG2_ADDR A:&base_addr+0x8c020c
y.create.l HWIO_RPMH_VRM_HEADROOM_VOTE_DRV12_REG3_ADDR A:&base_addr+0x8c030c
y.create.l HWIO_RPMH_VRM_HEADROOM_VOTE_DRV12_REG4_ADDR A:&base_addr+0x8c040c
y.create.l HWIO_RPMH_VRM_HEADROOM_VOTE_DRV12_REG5_ADDR A:&base_addr+0x8c050c
y.create.l HWIO_RPMH_VRM_HEADROOM_VOTE_DRV12_REG6_ADDR A:&base_addr+0x8c060c
y.create.l HWIO_RPMH_VRM_HEADROOM_VOTE_DRV12_REG7_ADDR A:&base_addr+0x8c070c
y.create.l HWIO_RPMH_VRM_HEADROOM_VOTE_DRV12_REG8_ADDR A:&base_addr+0x8c080c
y.create.l HWIO_RPMH_VRM_HEADROOM_VOTE_DRV12_REG9_ADDR A:&base_addr+0x8c090c
y.create.l HWIO_RPMH_VRM_HEADROOM_VOTE_DRV12_REG10_ADDR A:&base_addr+0x8c0a0c
y.create.l HWIO_RPMH_VRM_HEADROOM_VOTE_DRV12_REG11_ADDR A:&base_addr+0x8c0b0c
y.create.l HWIO_RPMH_VRM_HEADROOM_VOTE_DRV12_REG12_ADDR A:&base_addr+0x8c0c0c
y.create.l HWIO_RPMH_VRM_HEADROOM_VOTE_DRV12_REG13_ADDR A:&base_addr+0x8c0d0c
y.create.l HWIO_RPMH_VRM_HEADROOM_VOTE_DRV12_REG14_ADDR A:&base_addr+0x8c0e0c
y.create.l HWIO_RPMH_VRM_HEADROOM_VOTE_DRV12_REG15_ADDR A:&base_addr+0x8c0f0c
y.create.l HWIO_RPMH_VRM_HEADROOM_VOTE_DRV12_REG16_ADDR A:&base_addr+0x8c100c
y.create.l HWIO_RPMH_VRM_HEADROOM_VOTE_DRV12_REG17_ADDR A:&base_addr+0x8c110c
y.create.l HWIO_RPMH_VRM_HEADROOM_VOTE_DRV12_REG18_ADDR A:&base_addr+0x8c120c
y.create.l HWIO_RPMH_VRM_HEADROOM_VOTE_DRV12_REG19_ADDR A:&base_addr+0x8c130c
y.create.l HWIO_RPMH_VRM_HEADROOM_VOTE_DRV12_REG20_ADDR A:&base_addr+0x8c140c
y.create.l HWIO_RPMH_VRM_HEADROOM_VOTE_DRV12_REG21_ADDR A:&base_addr+0x8c150c
y.create.l HWIO_RPMH_VRM_HEADROOM_VOTE_DRV12_REG22_ADDR A:&base_addr+0x8c160c
y.create.l HWIO_RPMH_VRM_HEADROOM_VOTE_DRV12_REG23_ADDR A:&base_addr+0x8c170c
y.create.l HWIO_RPMH_VRM_HEADROOM_VOTE_DRV12_REG24_ADDR A:&base_addr+0x8c180c
y.create.l HWIO_RPMH_VRM_HEADROOM_VOTE_DRV12_REG25_ADDR A:&base_addr+0x8c190c
y.create.l HWIO_RPMH_VRM_HEADROOM_VOTE_DRV12_REG26_ADDR A:&base_addr+0x8c1a0c
y.create.l HWIO_RPMH_VRM_HEADROOM_VOTE_DRV12_REG27_ADDR A:&base_addr+0x8c1b0c
y.create.l HWIO_RPMH_VRM_HEADROOM_VOTE_DRV12_REG28_ADDR A:&base_addr+0x8c1c0c
y.create.l HWIO_RPMH_VRM_HEADROOM_VOTE_DRV12_REG29_ADDR A:&base_addr+0x8c1d0c
y.create.l HWIO_RPMH_VRM_HEADROOM_VOTE_DRV12_REG30_ADDR A:&base_addr+0x8c1e0c
y.create.l HWIO_RPMH_VRM_HEADROOM_VOTE_DRV12_REG31_ADDR A:&base_addr+0x8c1f0c
y.create.l HWIO_RPMH_VRM_HEADROOM_VOTE_DRV12_REG32_ADDR A:&base_addr+0x8c200c
y.create.l HWIO_RPMH_VRM_HEADROOM_VOTE_DRV12_REG33_ADDR A:&base_addr+0x8c210c
y.create.l HWIO_RPMH_VRM_HEADROOM_VOTE_DRV12_REG34_ADDR A:&base_addr+0x8c220c
y.create.l HWIO_RPMH_VRM_HEADROOM_VOTE_DRV12_REG35_ADDR A:&base_addr+0x8c230c
y.create.l HWIO_RPMH_VRM_HEADROOM_VOTE_DRV12_REG36_ADDR A:&base_addr+0x8c240c
y.create.l HWIO_RPMH_VRM_HEADROOM_VOTE_DRV12_REG37_ADDR A:&base_addr+0x8c250c
y.create.l HWIO_RPMH_VRM_HEADROOM_VOTE_DRV12_REG38_ADDR A:&base_addr+0x8c260c
y.create.l HWIO_RPMH_VRM_HEADROOM_VOTE_DRV12_REG39_ADDR A:&base_addr+0x8c270c
y.create.l HWIO_RPMH_VRM_HEADROOM_VOTE_DRV12_REG40_ADDR A:&base_addr+0x8c280c
y.create.l HWIO_RPMH_VRM_HEADROOM_VOTE_DRV12_REG41_ADDR A:&base_addr+0x8c290c
y.create.l HWIO_RPMH_VRM_HEADROOM_VOTE_DRV12_REG42_ADDR A:&base_addr+0x8c2a0c
y.create.l HWIO_RPMH_VRM_HEADROOM_VOTE_DRV12_REG43_ADDR A:&base_addr+0x8c2b0c
y.create.l HWIO_RPMH_VRM_HEADROOM_VOTE_DRV12_REG44_ADDR A:&base_addr+0x8c2c0c
y.create.l HWIO_RPMH_VRM_HEADROOM_VOTE_DRV12_REG45_ADDR A:&base_addr+0x8c2d0c
y.create.l HWIO_RPMH_VRM_HEADROOM_VOTE_DRV13_REG0_ADDR A:&base_addr+0x8d000c
y.create.l HWIO_RPMH_VRM_HEADROOM_VOTE_DRV13_REG1_ADDR A:&base_addr+0x8d010c
y.create.l HWIO_RPMH_VRM_HEADROOM_VOTE_DRV13_REG2_ADDR A:&base_addr+0x8d020c
y.create.l HWIO_RPMH_VRM_HEADROOM_VOTE_DRV13_REG3_ADDR A:&base_addr+0x8d030c
y.create.l HWIO_RPMH_VRM_HEADROOM_VOTE_DRV13_REG4_ADDR A:&base_addr+0x8d040c
y.create.l HWIO_RPMH_VRM_HEADROOM_VOTE_DRV13_REG5_ADDR A:&base_addr+0x8d050c
y.create.l HWIO_RPMH_VRM_HEADROOM_VOTE_DRV13_REG6_ADDR A:&base_addr+0x8d060c
y.create.l HWIO_RPMH_VRM_HEADROOM_VOTE_DRV13_REG7_ADDR A:&base_addr+0x8d070c
y.create.l HWIO_RPMH_VRM_HEADROOM_VOTE_DRV13_REG8_ADDR A:&base_addr+0x8d080c
y.create.l HWIO_RPMH_VRM_HEADROOM_VOTE_DRV13_REG9_ADDR A:&base_addr+0x8d090c
y.create.l HWIO_RPMH_VRM_HEADROOM_VOTE_DRV13_REG10_ADDR A:&base_addr+0x8d0a0c
y.create.l HWIO_RPMH_VRM_HEADROOM_VOTE_DRV13_REG11_ADDR A:&base_addr+0x8d0b0c
y.create.l HWIO_RPMH_VRM_HEADROOM_VOTE_DRV13_REG12_ADDR A:&base_addr+0x8d0c0c
y.create.l HWIO_RPMH_VRM_HEADROOM_VOTE_DRV13_REG13_ADDR A:&base_addr+0x8d0d0c
y.create.l HWIO_RPMH_VRM_HEADROOM_VOTE_DRV13_REG14_ADDR A:&base_addr+0x8d0e0c
y.create.l HWIO_RPMH_VRM_HEADROOM_VOTE_DRV13_REG15_ADDR A:&base_addr+0x8d0f0c
y.create.l HWIO_RPMH_VRM_HEADROOM_VOTE_DRV13_REG16_ADDR A:&base_addr+0x8d100c
y.create.l HWIO_RPMH_VRM_HEADROOM_VOTE_DRV13_REG17_ADDR A:&base_addr+0x8d110c
y.create.l HWIO_RPMH_VRM_HEADROOM_VOTE_DRV13_REG18_ADDR A:&base_addr+0x8d120c
y.create.l HWIO_RPMH_VRM_HEADROOM_VOTE_DRV13_REG19_ADDR A:&base_addr+0x8d130c
y.create.l HWIO_RPMH_VRM_HEADROOM_VOTE_DRV13_REG20_ADDR A:&base_addr+0x8d140c
y.create.l HWIO_RPMH_VRM_HEADROOM_VOTE_DRV13_REG21_ADDR A:&base_addr+0x8d150c
y.create.l HWIO_RPMH_VRM_HEADROOM_VOTE_DRV13_REG22_ADDR A:&base_addr+0x8d160c
y.create.l HWIO_RPMH_VRM_HEADROOM_VOTE_DRV13_REG23_ADDR A:&base_addr+0x8d170c
y.create.l HWIO_RPMH_VRM_HEADROOM_VOTE_DRV13_REG24_ADDR A:&base_addr+0x8d180c
y.create.l HWIO_RPMH_VRM_HEADROOM_VOTE_DRV13_REG25_ADDR A:&base_addr+0x8d190c
y.create.l HWIO_RPMH_VRM_HEADROOM_VOTE_DRV13_REG26_ADDR A:&base_addr+0x8d1a0c
y.create.l HWIO_RPMH_VRM_HEADROOM_VOTE_DRV13_REG27_ADDR A:&base_addr+0x8d1b0c
y.create.l HWIO_RPMH_VRM_HEADROOM_VOTE_DRV13_REG28_ADDR A:&base_addr+0x8d1c0c
y.create.l HWIO_RPMH_VRM_HEADROOM_VOTE_DRV13_REG29_ADDR A:&base_addr+0x8d1d0c
y.create.l HWIO_RPMH_VRM_HEADROOM_VOTE_DRV13_REG30_ADDR A:&base_addr+0x8d1e0c
y.create.l HWIO_RPMH_VRM_HEADROOM_VOTE_DRV13_REG31_ADDR A:&base_addr+0x8d1f0c
y.create.l HWIO_RPMH_VRM_HEADROOM_VOTE_DRV13_REG32_ADDR A:&base_addr+0x8d200c
y.create.l HWIO_RPMH_VRM_HEADROOM_VOTE_DRV13_REG33_ADDR A:&base_addr+0x8d210c
y.create.l HWIO_RPMH_VRM_HEADROOM_VOTE_DRV13_REG34_ADDR A:&base_addr+0x8d220c
y.create.l HWIO_RPMH_VRM_HEADROOM_VOTE_DRV13_REG35_ADDR A:&base_addr+0x8d230c
y.create.l HWIO_RPMH_VRM_HEADROOM_VOTE_DRV13_REG36_ADDR A:&base_addr+0x8d240c
y.create.l HWIO_RPMH_VRM_HEADROOM_VOTE_DRV13_REG37_ADDR A:&base_addr+0x8d250c
y.create.l HWIO_RPMH_VRM_HEADROOM_VOTE_DRV13_REG38_ADDR A:&base_addr+0x8d260c
y.create.l HWIO_RPMH_VRM_HEADROOM_VOTE_DRV13_REG39_ADDR A:&base_addr+0x8d270c
y.create.l HWIO_RPMH_VRM_HEADROOM_VOTE_DRV13_REG40_ADDR A:&base_addr+0x8d280c
y.create.l HWIO_RPMH_VRM_HEADROOM_VOTE_DRV13_REG41_ADDR A:&base_addr+0x8d290c
y.create.l HWIO_RPMH_VRM_HEADROOM_VOTE_DRV13_REG42_ADDR A:&base_addr+0x8d2a0c
y.create.l HWIO_RPMH_VRM_HEADROOM_VOTE_DRV13_REG43_ADDR A:&base_addr+0x8d2b0c
y.create.l HWIO_RPMH_VRM_HEADROOM_VOTE_DRV13_REG44_ADDR A:&base_addr+0x8d2c0c
y.create.l HWIO_RPMH_VRM_HEADROOM_VOTE_DRV13_REG45_ADDR A:&base_addr+0x8d2d0c
y.create.l HWIO_RPMH_VRM_HEADROOM_VOTE_DRV14_REG0_ADDR A:&base_addr+0x8e000c
y.create.l HWIO_RPMH_VRM_HEADROOM_VOTE_DRV14_REG1_ADDR A:&base_addr+0x8e010c
y.create.l HWIO_RPMH_VRM_HEADROOM_VOTE_DRV14_REG2_ADDR A:&base_addr+0x8e020c
y.create.l HWIO_RPMH_VRM_HEADROOM_VOTE_DRV14_REG3_ADDR A:&base_addr+0x8e030c
y.create.l HWIO_RPMH_VRM_HEADROOM_VOTE_DRV14_REG4_ADDR A:&base_addr+0x8e040c
y.create.l HWIO_RPMH_VRM_HEADROOM_VOTE_DRV14_REG5_ADDR A:&base_addr+0x8e050c
y.create.l HWIO_RPMH_VRM_HEADROOM_VOTE_DRV14_REG6_ADDR A:&base_addr+0x8e060c
y.create.l HWIO_RPMH_VRM_HEADROOM_VOTE_DRV14_REG7_ADDR A:&base_addr+0x8e070c
y.create.l HWIO_RPMH_VRM_HEADROOM_VOTE_DRV14_REG8_ADDR A:&base_addr+0x8e080c
y.create.l HWIO_RPMH_VRM_HEADROOM_VOTE_DRV14_REG9_ADDR A:&base_addr+0x8e090c
y.create.l HWIO_RPMH_VRM_HEADROOM_VOTE_DRV14_REG10_ADDR A:&base_addr+0x8e0a0c
y.create.l HWIO_RPMH_VRM_HEADROOM_VOTE_DRV14_REG11_ADDR A:&base_addr+0x8e0b0c
y.create.l HWIO_RPMH_VRM_HEADROOM_VOTE_DRV14_REG12_ADDR A:&base_addr+0x8e0c0c
y.create.l HWIO_RPMH_VRM_HEADROOM_VOTE_DRV14_REG13_ADDR A:&base_addr+0x8e0d0c
y.create.l HWIO_RPMH_VRM_HEADROOM_VOTE_DRV14_REG14_ADDR A:&base_addr+0x8e0e0c
y.create.l HWIO_RPMH_VRM_HEADROOM_VOTE_DRV14_REG15_ADDR A:&base_addr+0x8e0f0c
y.create.l HWIO_RPMH_VRM_HEADROOM_VOTE_DRV14_REG16_ADDR A:&base_addr+0x8e100c
y.create.l HWIO_RPMH_VRM_HEADROOM_VOTE_DRV14_REG17_ADDR A:&base_addr+0x8e110c
y.create.l HWIO_RPMH_VRM_HEADROOM_VOTE_DRV14_REG18_ADDR A:&base_addr+0x8e120c
y.create.l HWIO_RPMH_VRM_HEADROOM_VOTE_DRV14_REG19_ADDR A:&base_addr+0x8e130c
y.create.l HWIO_RPMH_VRM_HEADROOM_VOTE_DRV14_REG20_ADDR A:&base_addr+0x8e140c
y.create.l HWIO_RPMH_VRM_HEADROOM_VOTE_DRV14_REG21_ADDR A:&base_addr+0x8e150c
y.create.l HWIO_RPMH_VRM_HEADROOM_VOTE_DRV14_REG22_ADDR A:&base_addr+0x8e160c
y.create.l HWIO_RPMH_VRM_HEADROOM_VOTE_DRV14_REG23_ADDR A:&base_addr+0x8e170c
y.create.l HWIO_RPMH_VRM_HEADROOM_VOTE_DRV14_REG24_ADDR A:&base_addr+0x8e180c
y.create.l HWIO_RPMH_VRM_HEADROOM_VOTE_DRV14_REG25_ADDR A:&base_addr+0x8e190c
y.create.l HWIO_RPMH_VRM_HEADROOM_VOTE_DRV14_REG26_ADDR A:&base_addr+0x8e1a0c
y.create.l HWIO_RPMH_VRM_HEADROOM_VOTE_DRV14_REG27_ADDR A:&base_addr+0x8e1b0c
y.create.l HWIO_RPMH_VRM_HEADROOM_VOTE_DRV14_REG28_ADDR A:&base_addr+0x8e1c0c
y.create.l HWIO_RPMH_VRM_HEADROOM_VOTE_DRV14_REG29_ADDR A:&base_addr+0x8e1d0c
y.create.l HWIO_RPMH_VRM_HEADROOM_VOTE_DRV14_REG30_ADDR A:&base_addr+0x8e1e0c
y.create.l HWIO_RPMH_VRM_HEADROOM_VOTE_DRV14_REG31_ADDR A:&base_addr+0x8e1f0c
y.create.l HWIO_RPMH_VRM_HEADROOM_VOTE_DRV14_REG32_ADDR A:&base_addr+0x8e200c
y.create.l HWIO_RPMH_VRM_HEADROOM_VOTE_DRV14_REG33_ADDR A:&base_addr+0x8e210c
y.create.l HWIO_RPMH_VRM_HEADROOM_VOTE_DRV14_REG34_ADDR A:&base_addr+0x8e220c
y.create.l HWIO_RPMH_VRM_HEADROOM_VOTE_DRV14_REG35_ADDR A:&base_addr+0x8e230c
y.create.l HWIO_RPMH_VRM_HEADROOM_VOTE_DRV14_REG36_ADDR A:&base_addr+0x8e240c
y.create.l HWIO_RPMH_VRM_HEADROOM_VOTE_DRV14_REG37_ADDR A:&base_addr+0x8e250c
y.create.l HWIO_RPMH_VRM_HEADROOM_VOTE_DRV14_REG38_ADDR A:&base_addr+0x8e260c
y.create.l HWIO_RPMH_VRM_HEADROOM_VOTE_DRV14_REG39_ADDR A:&base_addr+0x8e270c
y.create.l HWIO_RPMH_VRM_HEADROOM_VOTE_DRV14_REG40_ADDR A:&base_addr+0x8e280c
y.create.l HWIO_RPMH_VRM_HEADROOM_VOTE_DRV14_REG41_ADDR A:&base_addr+0x8e290c
y.create.l HWIO_RPMH_VRM_HEADROOM_VOTE_DRV14_REG42_ADDR A:&base_addr+0x8e2a0c
y.create.l HWIO_RPMH_VRM_HEADROOM_VOTE_DRV14_REG43_ADDR A:&base_addr+0x8e2b0c
y.create.l HWIO_RPMH_VRM_HEADROOM_VOTE_DRV14_REG44_ADDR A:&base_addr+0x8e2c0c
y.create.l HWIO_RPMH_VRM_HEADROOM_VOTE_DRV14_REG45_ADDR A:&base_addr+0x8e2d0c
y.create.l HWIO_RPMH_VRM_ENABLE_VOTE_DRV0_XOB0_ADDR A:&base_addr+0x80c004
y.create.l HWIO_RPMH_VRM_ENABLE_VOTE_DRV0_XOB1_ADDR A:&base_addr+0x80c104
y.create.l HWIO_RPMH_VRM_ENABLE_VOTE_DRV0_XOB2_ADDR A:&base_addr+0x80c204
y.create.l HWIO_RPMH_VRM_ENABLE_VOTE_DRV0_XOB3_ADDR A:&base_addr+0x80c304
y.create.l HWIO_RPMH_VRM_ENABLE_VOTE_DRV0_XOB4_ADDR A:&base_addr+0x80c404
y.create.l HWIO_RPMH_VRM_ENABLE_VOTE_DRV0_XOB5_ADDR A:&base_addr+0x80c504
y.create.l HWIO_RPMH_VRM_ENABLE_VOTE_DRV0_XOB6_ADDR A:&base_addr+0x80c604
y.create.l HWIO_RPMH_VRM_ENABLE_VOTE_DRV0_XOB7_ADDR A:&base_addr+0x80c704
y.create.l HWIO_RPMH_VRM_ENABLE_VOTE_DRV1_XOB0_ADDR A:&base_addr+0x81c004
y.create.l HWIO_RPMH_VRM_ENABLE_VOTE_DRV1_XOB1_ADDR A:&base_addr+0x81c104
y.create.l HWIO_RPMH_VRM_ENABLE_VOTE_DRV1_XOB2_ADDR A:&base_addr+0x81c204
y.create.l HWIO_RPMH_VRM_ENABLE_VOTE_DRV1_XOB3_ADDR A:&base_addr+0x81c304
y.create.l HWIO_RPMH_VRM_ENABLE_VOTE_DRV1_XOB4_ADDR A:&base_addr+0x81c404
y.create.l HWIO_RPMH_VRM_ENABLE_VOTE_DRV1_XOB5_ADDR A:&base_addr+0x81c504
y.create.l HWIO_RPMH_VRM_ENABLE_VOTE_DRV1_XOB6_ADDR A:&base_addr+0x81c604
y.create.l HWIO_RPMH_VRM_ENABLE_VOTE_DRV1_XOB7_ADDR A:&base_addr+0x81c704
y.create.l HWIO_RPMH_VRM_ENABLE_VOTE_DRV2_XOB0_ADDR A:&base_addr+0x82c004
y.create.l HWIO_RPMH_VRM_ENABLE_VOTE_DRV2_XOB1_ADDR A:&base_addr+0x82c104
y.create.l HWIO_RPMH_VRM_ENABLE_VOTE_DRV2_XOB2_ADDR A:&base_addr+0x82c204
y.create.l HWIO_RPMH_VRM_ENABLE_VOTE_DRV2_XOB3_ADDR A:&base_addr+0x82c304
y.create.l HWIO_RPMH_VRM_ENABLE_VOTE_DRV2_XOB4_ADDR A:&base_addr+0x82c404
y.create.l HWIO_RPMH_VRM_ENABLE_VOTE_DRV2_XOB5_ADDR A:&base_addr+0x82c504
y.create.l HWIO_RPMH_VRM_ENABLE_VOTE_DRV2_XOB6_ADDR A:&base_addr+0x82c604
y.create.l HWIO_RPMH_VRM_ENABLE_VOTE_DRV2_XOB7_ADDR A:&base_addr+0x82c704
y.create.l HWIO_RPMH_VRM_ENABLE_VOTE_DRV3_XOB0_ADDR A:&base_addr+0x83c004
y.create.l HWIO_RPMH_VRM_ENABLE_VOTE_DRV3_XOB1_ADDR A:&base_addr+0x83c104
y.create.l HWIO_RPMH_VRM_ENABLE_VOTE_DRV3_XOB2_ADDR A:&base_addr+0x83c204
y.create.l HWIO_RPMH_VRM_ENABLE_VOTE_DRV3_XOB3_ADDR A:&base_addr+0x83c304
y.create.l HWIO_RPMH_VRM_ENABLE_VOTE_DRV3_XOB4_ADDR A:&base_addr+0x83c404
y.create.l HWIO_RPMH_VRM_ENABLE_VOTE_DRV3_XOB5_ADDR A:&base_addr+0x83c504
y.create.l HWIO_RPMH_VRM_ENABLE_VOTE_DRV3_XOB6_ADDR A:&base_addr+0x83c604
y.create.l HWIO_RPMH_VRM_ENABLE_VOTE_DRV3_XOB7_ADDR A:&base_addr+0x83c704
y.create.l HWIO_RPMH_VRM_ENABLE_VOTE_DRV4_XOB0_ADDR A:&base_addr+0x84c004
y.create.l HWIO_RPMH_VRM_ENABLE_VOTE_DRV4_XOB1_ADDR A:&base_addr+0x84c104
y.create.l HWIO_RPMH_VRM_ENABLE_VOTE_DRV4_XOB2_ADDR A:&base_addr+0x84c204
y.create.l HWIO_RPMH_VRM_ENABLE_VOTE_DRV4_XOB3_ADDR A:&base_addr+0x84c304
y.create.l HWIO_RPMH_VRM_ENABLE_VOTE_DRV4_XOB4_ADDR A:&base_addr+0x84c404
y.create.l HWIO_RPMH_VRM_ENABLE_VOTE_DRV4_XOB5_ADDR A:&base_addr+0x84c504
y.create.l HWIO_RPMH_VRM_ENABLE_VOTE_DRV4_XOB6_ADDR A:&base_addr+0x84c604
y.create.l HWIO_RPMH_VRM_ENABLE_VOTE_DRV4_XOB7_ADDR A:&base_addr+0x84c704
y.create.l HWIO_RPMH_VRM_ENABLE_VOTE_DRV5_XOB0_ADDR A:&base_addr+0x85c004
y.create.l HWIO_RPMH_VRM_ENABLE_VOTE_DRV5_XOB1_ADDR A:&base_addr+0x85c104
y.create.l HWIO_RPMH_VRM_ENABLE_VOTE_DRV5_XOB2_ADDR A:&base_addr+0x85c204
y.create.l HWIO_RPMH_VRM_ENABLE_VOTE_DRV5_XOB3_ADDR A:&base_addr+0x85c304
y.create.l HWIO_RPMH_VRM_ENABLE_VOTE_DRV5_XOB4_ADDR A:&base_addr+0x85c404
y.create.l HWIO_RPMH_VRM_ENABLE_VOTE_DRV5_XOB5_ADDR A:&base_addr+0x85c504
y.create.l HWIO_RPMH_VRM_ENABLE_VOTE_DRV5_XOB6_ADDR A:&base_addr+0x85c604
y.create.l HWIO_RPMH_VRM_ENABLE_VOTE_DRV5_XOB7_ADDR A:&base_addr+0x85c704
y.create.l HWIO_RPMH_VRM_ENABLE_VOTE_DRV6_XOB0_ADDR A:&base_addr+0x86c004
y.create.l HWIO_RPMH_VRM_ENABLE_VOTE_DRV6_XOB1_ADDR A:&base_addr+0x86c104
y.create.l HWIO_RPMH_VRM_ENABLE_VOTE_DRV6_XOB2_ADDR A:&base_addr+0x86c204
y.create.l HWIO_RPMH_VRM_ENABLE_VOTE_DRV6_XOB3_ADDR A:&base_addr+0x86c304
y.create.l HWIO_RPMH_VRM_ENABLE_VOTE_DRV6_XOB4_ADDR A:&base_addr+0x86c404
y.create.l HWIO_RPMH_VRM_ENABLE_VOTE_DRV6_XOB5_ADDR A:&base_addr+0x86c504
y.create.l HWIO_RPMH_VRM_ENABLE_VOTE_DRV6_XOB6_ADDR A:&base_addr+0x86c604
y.create.l HWIO_RPMH_VRM_ENABLE_VOTE_DRV6_XOB7_ADDR A:&base_addr+0x86c704
y.create.l HWIO_RPMH_VRM_ENABLE_VOTE_DRV7_XOB0_ADDR A:&base_addr+0x87c004
y.create.l HWIO_RPMH_VRM_ENABLE_VOTE_DRV7_XOB1_ADDR A:&base_addr+0x87c104
y.create.l HWIO_RPMH_VRM_ENABLE_VOTE_DRV7_XOB2_ADDR A:&base_addr+0x87c204
y.create.l HWIO_RPMH_VRM_ENABLE_VOTE_DRV7_XOB3_ADDR A:&base_addr+0x87c304
y.create.l HWIO_RPMH_VRM_ENABLE_VOTE_DRV7_XOB4_ADDR A:&base_addr+0x87c404
y.create.l HWIO_RPMH_VRM_ENABLE_VOTE_DRV7_XOB5_ADDR A:&base_addr+0x87c504
y.create.l HWIO_RPMH_VRM_ENABLE_VOTE_DRV7_XOB6_ADDR A:&base_addr+0x87c604
y.create.l HWIO_RPMH_VRM_ENABLE_VOTE_DRV7_XOB7_ADDR A:&base_addr+0x87c704
y.create.l HWIO_RPMH_VRM_ENABLE_VOTE_DRV8_XOB0_ADDR A:&base_addr+0x88c004
y.create.l HWIO_RPMH_VRM_ENABLE_VOTE_DRV8_XOB1_ADDR A:&base_addr+0x88c104
y.create.l HWIO_RPMH_VRM_ENABLE_VOTE_DRV8_XOB2_ADDR A:&base_addr+0x88c204
y.create.l HWIO_RPMH_VRM_ENABLE_VOTE_DRV8_XOB3_ADDR A:&base_addr+0x88c304
y.create.l HWIO_RPMH_VRM_ENABLE_VOTE_DRV8_XOB4_ADDR A:&base_addr+0x88c404
y.create.l HWIO_RPMH_VRM_ENABLE_VOTE_DRV8_XOB5_ADDR A:&base_addr+0x88c504
y.create.l HWIO_RPMH_VRM_ENABLE_VOTE_DRV8_XOB6_ADDR A:&base_addr+0x88c604
y.create.l HWIO_RPMH_VRM_ENABLE_VOTE_DRV8_XOB7_ADDR A:&base_addr+0x88c704
y.create.l HWIO_RPMH_VRM_ENABLE_VOTE_DRV9_XOB0_ADDR A:&base_addr+0x89c004
y.create.l HWIO_RPMH_VRM_ENABLE_VOTE_DRV9_XOB1_ADDR A:&base_addr+0x89c104
y.create.l HWIO_RPMH_VRM_ENABLE_VOTE_DRV9_XOB2_ADDR A:&base_addr+0x89c204
y.create.l HWIO_RPMH_VRM_ENABLE_VOTE_DRV9_XOB3_ADDR A:&base_addr+0x89c304
y.create.l HWIO_RPMH_VRM_ENABLE_VOTE_DRV9_XOB4_ADDR A:&base_addr+0x89c404
y.create.l HWIO_RPMH_VRM_ENABLE_VOTE_DRV9_XOB5_ADDR A:&base_addr+0x89c504
y.create.l HWIO_RPMH_VRM_ENABLE_VOTE_DRV9_XOB6_ADDR A:&base_addr+0x89c604
y.create.l HWIO_RPMH_VRM_ENABLE_VOTE_DRV9_XOB7_ADDR A:&base_addr+0x89c704
y.create.l HWIO_RPMH_VRM_ENABLE_VOTE_DRV10_XOB0_ADDR A:&base_addr+0x8ac004
y.create.l HWIO_RPMH_VRM_ENABLE_VOTE_DRV10_XOB1_ADDR A:&base_addr+0x8ac104
y.create.l HWIO_RPMH_VRM_ENABLE_VOTE_DRV10_XOB2_ADDR A:&base_addr+0x8ac204
y.create.l HWIO_RPMH_VRM_ENABLE_VOTE_DRV10_XOB3_ADDR A:&base_addr+0x8ac304
y.create.l HWIO_RPMH_VRM_ENABLE_VOTE_DRV10_XOB4_ADDR A:&base_addr+0x8ac404
y.create.l HWIO_RPMH_VRM_ENABLE_VOTE_DRV10_XOB5_ADDR A:&base_addr+0x8ac504
y.create.l HWIO_RPMH_VRM_ENABLE_VOTE_DRV10_XOB6_ADDR A:&base_addr+0x8ac604
y.create.l HWIO_RPMH_VRM_ENABLE_VOTE_DRV10_XOB7_ADDR A:&base_addr+0x8ac704
y.create.l HWIO_RPMH_VRM_ENABLE_VOTE_DRV11_XOB0_ADDR A:&base_addr+0x8bc004
y.create.l HWIO_RPMH_VRM_ENABLE_VOTE_DRV11_XOB1_ADDR A:&base_addr+0x8bc104
y.create.l HWIO_RPMH_VRM_ENABLE_VOTE_DRV11_XOB2_ADDR A:&base_addr+0x8bc204
y.create.l HWIO_RPMH_VRM_ENABLE_VOTE_DRV11_XOB3_ADDR A:&base_addr+0x8bc304
y.create.l HWIO_RPMH_VRM_ENABLE_VOTE_DRV11_XOB4_ADDR A:&base_addr+0x8bc404
y.create.l HWIO_RPMH_VRM_ENABLE_VOTE_DRV11_XOB5_ADDR A:&base_addr+0x8bc504
y.create.l HWIO_RPMH_VRM_ENABLE_VOTE_DRV11_XOB6_ADDR A:&base_addr+0x8bc604
y.create.l HWIO_RPMH_VRM_ENABLE_VOTE_DRV11_XOB7_ADDR A:&base_addr+0x8bc704
y.create.l HWIO_RPMH_VRM_ENABLE_VOTE_DRV12_XOB0_ADDR A:&base_addr+0x8cc004
y.create.l HWIO_RPMH_VRM_ENABLE_VOTE_DRV12_XOB1_ADDR A:&base_addr+0x8cc104
y.create.l HWIO_RPMH_VRM_ENABLE_VOTE_DRV12_XOB2_ADDR A:&base_addr+0x8cc204
y.create.l HWIO_RPMH_VRM_ENABLE_VOTE_DRV12_XOB3_ADDR A:&base_addr+0x8cc304
y.create.l HWIO_RPMH_VRM_ENABLE_VOTE_DRV12_XOB4_ADDR A:&base_addr+0x8cc404
y.create.l HWIO_RPMH_VRM_ENABLE_VOTE_DRV12_XOB5_ADDR A:&base_addr+0x8cc504
y.create.l HWIO_RPMH_VRM_ENABLE_VOTE_DRV12_XOB6_ADDR A:&base_addr+0x8cc604
y.create.l HWIO_RPMH_VRM_ENABLE_VOTE_DRV12_XOB7_ADDR A:&base_addr+0x8cc704
y.create.l HWIO_RPMH_VRM_ENABLE_VOTE_DRV13_XOB0_ADDR A:&base_addr+0x8dc004
y.create.l HWIO_RPMH_VRM_ENABLE_VOTE_DRV13_XOB1_ADDR A:&base_addr+0x8dc104
y.create.l HWIO_RPMH_VRM_ENABLE_VOTE_DRV13_XOB2_ADDR A:&base_addr+0x8dc204
y.create.l HWIO_RPMH_VRM_ENABLE_VOTE_DRV13_XOB3_ADDR A:&base_addr+0x8dc304
y.create.l HWIO_RPMH_VRM_ENABLE_VOTE_DRV13_XOB4_ADDR A:&base_addr+0x8dc404
y.create.l HWIO_RPMH_VRM_ENABLE_VOTE_DRV13_XOB5_ADDR A:&base_addr+0x8dc504
y.create.l HWIO_RPMH_VRM_ENABLE_VOTE_DRV13_XOB6_ADDR A:&base_addr+0x8dc604
y.create.l HWIO_RPMH_VRM_ENABLE_VOTE_DRV13_XOB7_ADDR A:&base_addr+0x8dc704
y.create.l HWIO_RPMH_VRM_ENABLE_VOTE_DRV14_XOB0_ADDR A:&base_addr+0x8ec004
y.create.l HWIO_RPMH_VRM_ENABLE_VOTE_DRV14_XOB1_ADDR A:&base_addr+0x8ec104
y.create.l HWIO_RPMH_VRM_ENABLE_VOTE_DRV14_XOB2_ADDR A:&base_addr+0x8ec204
y.create.l HWIO_RPMH_VRM_ENABLE_VOTE_DRV14_XOB3_ADDR A:&base_addr+0x8ec304
y.create.l HWIO_RPMH_VRM_ENABLE_VOTE_DRV14_XOB4_ADDR A:&base_addr+0x8ec404
y.create.l HWIO_RPMH_VRM_ENABLE_VOTE_DRV14_XOB5_ADDR A:&base_addr+0x8ec504
y.create.l HWIO_RPMH_VRM_ENABLE_VOTE_DRV14_XOB6_ADDR A:&base_addr+0x8ec604
y.create.l HWIO_RPMH_VRM_ENABLE_VOTE_DRV14_XOB7_ADDR A:&base_addr+0x8ec704
y.create.l HWIO_RPMH_VRM_ENABLE_VOTE_DRV0_XO0_ADDR A:&base_addr+0x80d804
y.create.l HWIO_RPMH_VRM_ENABLE_VOTE_DRV1_XO0_ADDR A:&base_addr+0x81d804
y.create.l HWIO_RPMH_VRM_ENABLE_VOTE_DRV2_XO0_ADDR A:&base_addr+0x82d804
y.create.l HWIO_RPMH_VRM_ENABLE_VOTE_DRV3_XO0_ADDR A:&base_addr+0x83d804
y.create.l HWIO_RPMH_VRM_ENABLE_VOTE_DRV4_XO0_ADDR A:&base_addr+0x84d804
y.create.l HWIO_RPMH_VRM_ENABLE_VOTE_DRV5_XO0_ADDR A:&base_addr+0x85d804
y.create.l HWIO_RPMH_VRM_ENABLE_VOTE_DRV6_XO0_ADDR A:&base_addr+0x86d804
y.create.l HWIO_RPMH_VRM_ENABLE_VOTE_DRV7_XO0_ADDR A:&base_addr+0x87d804
y.create.l HWIO_RPMH_VRM_ENABLE_VOTE_DRV8_XO0_ADDR A:&base_addr+0x88d804
y.create.l HWIO_RPMH_VRM_ENABLE_VOTE_DRV9_XO0_ADDR A:&base_addr+0x89d804
y.create.l HWIO_RPMH_VRM_ENABLE_VOTE_DRV10_XO0_ADDR A:&base_addr+0x8ad804
y.create.l HWIO_RPMH_VRM_ENABLE_VOTE_DRV11_XO0_ADDR A:&base_addr+0x8bd804
y.create.l HWIO_RPMH_VRM_ENABLE_VOTE_DRV12_XO0_ADDR A:&base_addr+0x8cd804
y.create.l HWIO_RPMH_VRM_ENABLE_VOTE_DRV13_XO0_ADDR A:&base_addr+0x8dd804
y.create.l HWIO_RPMH_VRM_ENABLE_VOTE_DRV14_XO0_ADDR A:&base_addr+0x8ed804
y.create.l HWIO_RPMH_VRM_VOLTAGE_CRS_DRV0_REG0_ADDR A:&base_addr+0x800020
y.create.l HWIO_RPMH_VRM_VOLTAGE_CRS_DRV0_REG1_ADDR A:&base_addr+0x800120
y.create.l HWIO_RPMH_VRM_VOLTAGE_CRS_DRV0_REG2_ADDR A:&base_addr+0x800220
y.create.l HWIO_RPMH_VRM_VOLTAGE_CRS_DRV0_REG3_ADDR A:&base_addr+0x800320
y.create.l HWIO_RPMH_VRM_VOLTAGE_CRS_DRV0_REG4_ADDR A:&base_addr+0x800420
y.create.l HWIO_RPMH_VRM_VOLTAGE_CRS_DRV0_REG5_ADDR A:&base_addr+0x800520
y.create.l HWIO_RPMH_VRM_VOLTAGE_CRS_DRV0_REG6_ADDR A:&base_addr+0x800620
y.create.l HWIO_RPMH_VRM_VOLTAGE_CRS_DRV0_REG7_ADDR A:&base_addr+0x800720
y.create.l HWIO_RPMH_VRM_VOLTAGE_CRS_DRV0_REG8_ADDR A:&base_addr+0x800820
y.create.l HWIO_RPMH_VRM_VOLTAGE_CRS_DRV0_REG9_ADDR A:&base_addr+0x800920
y.create.l HWIO_RPMH_VRM_VOLTAGE_CRS_DRV0_REG10_ADDR A:&base_addr+0x800a20
y.create.l HWIO_RPMH_VRM_VOLTAGE_CRS_DRV0_REG11_ADDR A:&base_addr+0x800b20
y.create.l HWIO_RPMH_VRM_VOLTAGE_CRS_DRV0_REG12_ADDR A:&base_addr+0x800c20
y.create.l HWIO_RPMH_VRM_VOLTAGE_CRS_DRV0_REG13_ADDR A:&base_addr+0x800d20
y.create.l HWIO_RPMH_VRM_VOLTAGE_CRS_DRV0_REG14_ADDR A:&base_addr+0x800e20
y.create.l HWIO_RPMH_VRM_VOLTAGE_CRS_DRV0_REG15_ADDR A:&base_addr+0x800f20
y.create.l HWIO_RPMH_VRM_VOLTAGE_CRS_DRV0_REG16_ADDR A:&base_addr+0x801020
y.create.l HWIO_RPMH_VRM_VOLTAGE_CRS_DRV0_REG17_ADDR A:&base_addr+0x801120
y.create.l HWIO_RPMH_VRM_VOLTAGE_CRS_DRV0_REG18_ADDR A:&base_addr+0x801220
y.create.l HWIO_RPMH_VRM_VOLTAGE_CRS_DRV0_REG19_ADDR A:&base_addr+0x801320
y.create.l HWIO_RPMH_VRM_VOLTAGE_CRS_DRV0_REG20_ADDR A:&base_addr+0x801420
y.create.l HWIO_RPMH_VRM_VOLTAGE_CRS_DRV0_REG21_ADDR A:&base_addr+0x801520
y.create.l HWIO_RPMH_VRM_VOLTAGE_CRS_DRV0_REG22_ADDR A:&base_addr+0x801620
y.create.l HWIO_RPMH_VRM_VOLTAGE_CRS_DRV0_REG23_ADDR A:&base_addr+0x801720
y.create.l HWIO_RPMH_VRM_VOLTAGE_CRS_DRV0_REG24_ADDR A:&base_addr+0x801820
y.create.l HWIO_RPMH_VRM_VOLTAGE_CRS_DRV0_REG25_ADDR A:&base_addr+0x801920
y.create.l HWIO_RPMH_VRM_VOLTAGE_CRS_DRV0_REG26_ADDR A:&base_addr+0x801a20
y.create.l HWIO_RPMH_VRM_VOLTAGE_CRS_DRV0_REG27_ADDR A:&base_addr+0x801b20
y.create.l HWIO_RPMH_VRM_VOLTAGE_CRS_DRV0_REG28_ADDR A:&base_addr+0x801c20
y.create.l HWIO_RPMH_VRM_VOLTAGE_CRS_DRV0_REG29_ADDR A:&base_addr+0x801d20
y.create.l HWIO_RPMH_VRM_VOLTAGE_CRS_DRV0_REG30_ADDR A:&base_addr+0x801e20
y.create.l HWIO_RPMH_VRM_VOLTAGE_CRS_DRV0_REG31_ADDR A:&base_addr+0x801f20
y.create.l HWIO_RPMH_VRM_VOLTAGE_CRS_DRV0_REG32_ADDR A:&base_addr+0x802020
y.create.l HWIO_RPMH_VRM_VOLTAGE_CRS_DRV0_REG33_ADDR A:&base_addr+0x802120
y.create.l HWIO_RPMH_VRM_VOLTAGE_CRS_DRV0_REG34_ADDR A:&base_addr+0x802220
y.create.l HWIO_RPMH_VRM_VOLTAGE_CRS_DRV0_REG35_ADDR A:&base_addr+0x802320
y.create.l HWIO_RPMH_VRM_VOLTAGE_CRS_DRV0_REG36_ADDR A:&base_addr+0x802420
y.create.l HWIO_RPMH_VRM_VOLTAGE_CRS_DRV0_REG37_ADDR A:&base_addr+0x802520
y.create.l HWIO_RPMH_VRM_VOLTAGE_CRS_DRV0_REG38_ADDR A:&base_addr+0x802620
y.create.l HWIO_RPMH_VRM_VOLTAGE_CRS_DRV0_REG39_ADDR A:&base_addr+0x802720
y.create.l HWIO_RPMH_VRM_VOLTAGE_CRS_DRV0_REG40_ADDR A:&base_addr+0x802820
y.create.l HWIO_RPMH_VRM_VOLTAGE_CRS_DRV0_REG41_ADDR A:&base_addr+0x802920
y.create.l HWIO_RPMH_VRM_VOLTAGE_CRS_DRV0_REG42_ADDR A:&base_addr+0x802a20
y.create.l HWIO_RPMH_VRM_VOLTAGE_CRS_DRV0_REG43_ADDR A:&base_addr+0x802b20
y.create.l HWIO_RPMH_VRM_VOLTAGE_CRS_DRV0_REG44_ADDR A:&base_addr+0x802c20
y.create.l HWIO_RPMH_VRM_VOLTAGE_CRS_DRV0_REG45_ADDR A:&base_addr+0x802d20
y.create.l HWIO_RPMH_VRM_VOLTAGE_CRS_DRV1_REG0_ADDR A:&base_addr+0x810020
y.create.l HWIO_RPMH_VRM_VOLTAGE_CRS_DRV1_REG1_ADDR A:&base_addr+0x810120
y.create.l HWIO_RPMH_VRM_VOLTAGE_CRS_DRV1_REG2_ADDR A:&base_addr+0x810220
y.create.l HWIO_RPMH_VRM_VOLTAGE_CRS_DRV1_REG3_ADDR A:&base_addr+0x810320
y.create.l HWIO_RPMH_VRM_VOLTAGE_CRS_DRV1_REG4_ADDR A:&base_addr+0x810420
y.create.l HWIO_RPMH_VRM_VOLTAGE_CRS_DRV1_REG5_ADDR A:&base_addr+0x810520
y.create.l HWIO_RPMH_VRM_VOLTAGE_CRS_DRV1_REG6_ADDR A:&base_addr+0x810620
y.create.l HWIO_RPMH_VRM_VOLTAGE_CRS_DRV1_REG7_ADDR A:&base_addr+0x810720
y.create.l HWIO_RPMH_VRM_VOLTAGE_CRS_DRV1_REG8_ADDR A:&base_addr+0x810820
y.create.l HWIO_RPMH_VRM_VOLTAGE_CRS_DRV1_REG9_ADDR A:&base_addr+0x810920
y.create.l HWIO_RPMH_VRM_VOLTAGE_CRS_DRV1_REG10_ADDR A:&base_addr+0x810a20
y.create.l HWIO_RPMH_VRM_VOLTAGE_CRS_DRV1_REG11_ADDR A:&base_addr+0x810b20
y.create.l HWIO_RPMH_VRM_VOLTAGE_CRS_DRV1_REG12_ADDR A:&base_addr+0x810c20
y.create.l HWIO_RPMH_VRM_VOLTAGE_CRS_DRV1_REG13_ADDR A:&base_addr+0x810d20
y.create.l HWIO_RPMH_VRM_VOLTAGE_CRS_DRV1_REG14_ADDR A:&base_addr+0x810e20
y.create.l HWIO_RPMH_VRM_VOLTAGE_CRS_DRV1_REG15_ADDR A:&base_addr+0x810f20
y.create.l HWIO_RPMH_VRM_VOLTAGE_CRS_DRV1_REG16_ADDR A:&base_addr+0x811020
y.create.l HWIO_RPMH_VRM_VOLTAGE_CRS_DRV1_REG17_ADDR A:&base_addr+0x811120
y.create.l HWIO_RPMH_VRM_VOLTAGE_CRS_DRV1_REG18_ADDR A:&base_addr+0x811220
y.create.l HWIO_RPMH_VRM_VOLTAGE_CRS_DRV1_REG19_ADDR A:&base_addr+0x811320
y.create.l HWIO_RPMH_VRM_VOLTAGE_CRS_DRV1_REG20_ADDR A:&base_addr+0x811420
y.create.l HWIO_RPMH_VRM_VOLTAGE_CRS_DRV1_REG21_ADDR A:&base_addr+0x811520
y.create.l HWIO_RPMH_VRM_VOLTAGE_CRS_DRV1_REG22_ADDR A:&base_addr+0x811620
y.create.l HWIO_RPMH_VRM_VOLTAGE_CRS_DRV1_REG23_ADDR A:&base_addr+0x811720
y.create.l HWIO_RPMH_VRM_VOLTAGE_CRS_DRV1_REG24_ADDR A:&base_addr+0x811820
y.create.l HWIO_RPMH_VRM_VOLTAGE_CRS_DRV1_REG25_ADDR A:&base_addr+0x811920
y.create.l HWIO_RPMH_VRM_VOLTAGE_CRS_DRV1_REG26_ADDR A:&base_addr+0x811a20
y.create.l HWIO_RPMH_VRM_VOLTAGE_CRS_DRV1_REG27_ADDR A:&base_addr+0x811b20
y.create.l HWIO_RPMH_VRM_VOLTAGE_CRS_DRV1_REG28_ADDR A:&base_addr+0x811c20
y.create.l HWIO_RPMH_VRM_VOLTAGE_CRS_DRV1_REG29_ADDR A:&base_addr+0x811d20
y.create.l HWIO_RPMH_VRM_VOLTAGE_CRS_DRV1_REG30_ADDR A:&base_addr+0x811e20
y.create.l HWIO_RPMH_VRM_VOLTAGE_CRS_DRV1_REG31_ADDR A:&base_addr+0x811f20
y.create.l HWIO_RPMH_VRM_VOLTAGE_CRS_DRV1_REG32_ADDR A:&base_addr+0x812020
y.create.l HWIO_RPMH_VRM_VOLTAGE_CRS_DRV1_REG33_ADDR A:&base_addr+0x812120
y.create.l HWIO_RPMH_VRM_VOLTAGE_CRS_DRV1_REG34_ADDR A:&base_addr+0x812220
y.create.l HWIO_RPMH_VRM_VOLTAGE_CRS_DRV1_REG35_ADDR A:&base_addr+0x812320
y.create.l HWIO_RPMH_VRM_VOLTAGE_CRS_DRV1_REG36_ADDR A:&base_addr+0x812420
y.create.l HWIO_RPMH_VRM_VOLTAGE_CRS_DRV1_REG37_ADDR A:&base_addr+0x812520
y.create.l HWIO_RPMH_VRM_VOLTAGE_CRS_DRV1_REG38_ADDR A:&base_addr+0x812620
y.create.l HWIO_RPMH_VRM_VOLTAGE_CRS_DRV1_REG39_ADDR A:&base_addr+0x812720
y.create.l HWIO_RPMH_VRM_VOLTAGE_CRS_DRV1_REG40_ADDR A:&base_addr+0x812820
y.create.l HWIO_RPMH_VRM_VOLTAGE_CRS_DRV1_REG41_ADDR A:&base_addr+0x812920
y.create.l HWIO_RPMH_VRM_VOLTAGE_CRS_DRV1_REG42_ADDR A:&base_addr+0x812a20
y.create.l HWIO_RPMH_VRM_VOLTAGE_CRS_DRV1_REG43_ADDR A:&base_addr+0x812b20
y.create.l HWIO_RPMH_VRM_VOLTAGE_CRS_DRV1_REG44_ADDR A:&base_addr+0x812c20
y.create.l HWIO_RPMH_VRM_VOLTAGE_CRS_DRV1_REG45_ADDR A:&base_addr+0x812d20
y.create.l HWIO_RPMH_VRM_VOLTAGE_CRS_DRV2_REG0_ADDR A:&base_addr+0x820020
y.create.l HWIO_RPMH_VRM_VOLTAGE_CRS_DRV2_REG1_ADDR A:&base_addr+0x820120
y.create.l HWIO_RPMH_VRM_VOLTAGE_CRS_DRV2_REG2_ADDR A:&base_addr+0x820220
y.create.l HWIO_RPMH_VRM_VOLTAGE_CRS_DRV2_REG3_ADDR A:&base_addr+0x820320
y.create.l HWIO_RPMH_VRM_VOLTAGE_CRS_DRV2_REG4_ADDR A:&base_addr+0x820420
y.create.l HWIO_RPMH_VRM_VOLTAGE_CRS_DRV2_REG5_ADDR A:&base_addr+0x820520
y.create.l HWIO_RPMH_VRM_VOLTAGE_CRS_DRV2_REG6_ADDR A:&base_addr+0x820620
y.create.l HWIO_RPMH_VRM_VOLTAGE_CRS_DRV2_REG7_ADDR A:&base_addr+0x820720
y.create.l HWIO_RPMH_VRM_VOLTAGE_CRS_DRV2_REG8_ADDR A:&base_addr+0x820820
y.create.l HWIO_RPMH_VRM_VOLTAGE_CRS_DRV2_REG9_ADDR A:&base_addr+0x820920
y.create.l HWIO_RPMH_VRM_VOLTAGE_CRS_DRV2_REG10_ADDR A:&base_addr+0x820a20
y.create.l HWIO_RPMH_VRM_VOLTAGE_CRS_DRV2_REG11_ADDR A:&base_addr+0x820b20
y.create.l HWIO_RPMH_VRM_VOLTAGE_CRS_DRV2_REG12_ADDR A:&base_addr+0x820c20
y.create.l HWIO_RPMH_VRM_VOLTAGE_CRS_DRV2_REG13_ADDR A:&base_addr+0x820d20
y.create.l HWIO_RPMH_VRM_VOLTAGE_CRS_DRV2_REG14_ADDR A:&base_addr+0x820e20
y.create.l HWIO_RPMH_VRM_VOLTAGE_CRS_DRV2_REG15_ADDR A:&base_addr+0x820f20
y.create.l HWIO_RPMH_VRM_VOLTAGE_CRS_DRV2_REG16_ADDR A:&base_addr+0x821020
y.create.l HWIO_RPMH_VRM_VOLTAGE_CRS_DRV2_REG17_ADDR A:&base_addr+0x821120
y.create.l HWIO_RPMH_VRM_VOLTAGE_CRS_DRV2_REG18_ADDR A:&base_addr+0x821220
y.create.l HWIO_RPMH_VRM_VOLTAGE_CRS_DRV2_REG19_ADDR A:&base_addr+0x821320
y.create.l HWIO_RPMH_VRM_VOLTAGE_CRS_DRV2_REG20_ADDR A:&base_addr+0x821420
y.create.l HWIO_RPMH_VRM_VOLTAGE_CRS_DRV2_REG21_ADDR A:&base_addr+0x821520
y.create.l HWIO_RPMH_VRM_VOLTAGE_CRS_DRV2_REG22_ADDR A:&base_addr+0x821620
y.create.l HWIO_RPMH_VRM_VOLTAGE_CRS_DRV2_REG23_ADDR A:&base_addr+0x821720
y.create.l HWIO_RPMH_VRM_VOLTAGE_CRS_DRV2_REG24_ADDR A:&base_addr+0x821820
y.create.l HWIO_RPMH_VRM_VOLTAGE_CRS_DRV2_REG25_ADDR A:&base_addr+0x821920
y.create.l HWIO_RPMH_VRM_VOLTAGE_CRS_DRV2_REG26_ADDR A:&base_addr+0x821a20
y.create.l HWIO_RPMH_VRM_VOLTAGE_CRS_DRV2_REG27_ADDR A:&base_addr+0x821b20
y.create.l HWIO_RPMH_VRM_VOLTAGE_CRS_DRV2_REG28_ADDR A:&base_addr+0x821c20
y.create.l HWIO_RPMH_VRM_VOLTAGE_CRS_DRV2_REG29_ADDR A:&base_addr+0x821d20
y.create.l HWIO_RPMH_VRM_VOLTAGE_CRS_DRV2_REG30_ADDR A:&base_addr+0x821e20
y.create.l HWIO_RPMH_VRM_VOLTAGE_CRS_DRV2_REG31_ADDR A:&base_addr+0x821f20
y.create.l HWIO_RPMH_VRM_VOLTAGE_CRS_DRV2_REG32_ADDR A:&base_addr+0x822020
y.create.l HWIO_RPMH_VRM_VOLTAGE_CRS_DRV2_REG33_ADDR A:&base_addr+0x822120
y.create.l HWIO_RPMH_VRM_VOLTAGE_CRS_DRV2_REG34_ADDR A:&base_addr+0x822220
y.create.l HWIO_RPMH_VRM_VOLTAGE_CRS_DRV2_REG35_ADDR A:&base_addr+0x822320
y.create.l HWIO_RPMH_VRM_VOLTAGE_CRS_DRV2_REG36_ADDR A:&base_addr+0x822420
y.create.l HWIO_RPMH_VRM_VOLTAGE_CRS_DRV2_REG37_ADDR A:&base_addr+0x822520
y.create.l HWIO_RPMH_VRM_VOLTAGE_CRS_DRV2_REG38_ADDR A:&base_addr+0x822620
y.create.l HWIO_RPMH_VRM_VOLTAGE_CRS_DRV2_REG39_ADDR A:&base_addr+0x822720
y.create.l HWIO_RPMH_VRM_VOLTAGE_CRS_DRV2_REG40_ADDR A:&base_addr+0x822820
y.create.l HWIO_RPMH_VRM_VOLTAGE_CRS_DRV2_REG41_ADDR A:&base_addr+0x822920
y.create.l HWIO_RPMH_VRM_VOLTAGE_CRS_DRV2_REG42_ADDR A:&base_addr+0x822a20
y.create.l HWIO_RPMH_VRM_VOLTAGE_CRS_DRV2_REG43_ADDR A:&base_addr+0x822b20
y.create.l HWIO_RPMH_VRM_VOLTAGE_CRS_DRV2_REG44_ADDR A:&base_addr+0x822c20
y.create.l HWIO_RPMH_VRM_VOLTAGE_CRS_DRV2_REG45_ADDR A:&base_addr+0x822d20
y.create.l HWIO_RPMH_VRM_VOLTAGE_CRS_DRV3_REG0_ADDR A:&base_addr+0x830020
y.create.l HWIO_RPMH_VRM_VOLTAGE_CRS_DRV3_REG1_ADDR A:&base_addr+0x830120
y.create.l HWIO_RPMH_VRM_VOLTAGE_CRS_DRV3_REG2_ADDR A:&base_addr+0x830220
y.create.l HWIO_RPMH_VRM_VOLTAGE_CRS_DRV3_REG3_ADDR A:&base_addr+0x830320
y.create.l HWIO_RPMH_VRM_VOLTAGE_CRS_DRV3_REG4_ADDR A:&base_addr+0x830420
y.create.l HWIO_RPMH_VRM_VOLTAGE_CRS_DRV3_REG5_ADDR A:&base_addr+0x830520
y.create.l HWIO_RPMH_VRM_VOLTAGE_CRS_DRV3_REG6_ADDR A:&base_addr+0x830620
y.create.l HWIO_RPMH_VRM_VOLTAGE_CRS_DRV3_REG7_ADDR A:&base_addr+0x830720
y.create.l HWIO_RPMH_VRM_VOLTAGE_CRS_DRV3_REG8_ADDR A:&base_addr+0x830820
y.create.l HWIO_RPMH_VRM_VOLTAGE_CRS_DRV3_REG9_ADDR A:&base_addr+0x830920
y.create.l HWIO_RPMH_VRM_VOLTAGE_CRS_DRV3_REG10_ADDR A:&base_addr+0x830a20
y.create.l HWIO_RPMH_VRM_VOLTAGE_CRS_DRV3_REG11_ADDR A:&base_addr+0x830b20
y.create.l HWIO_RPMH_VRM_VOLTAGE_CRS_DRV3_REG12_ADDR A:&base_addr+0x830c20
y.create.l HWIO_RPMH_VRM_VOLTAGE_CRS_DRV3_REG13_ADDR A:&base_addr+0x830d20
y.create.l HWIO_RPMH_VRM_VOLTAGE_CRS_DRV3_REG14_ADDR A:&base_addr+0x830e20
y.create.l HWIO_RPMH_VRM_VOLTAGE_CRS_DRV3_REG15_ADDR A:&base_addr+0x830f20
y.create.l HWIO_RPMH_VRM_VOLTAGE_CRS_DRV3_REG16_ADDR A:&base_addr+0x831020
y.create.l HWIO_RPMH_VRM_VOLTAGE_CRS_DRV3_REG17_ADDR A:&base_addr+0x831120
y.create.l HWIO_RPMH_VRM_VOLTAGE_CRS_DRV3_REG18_ADDR A:&base_addr+0x831220
y.create.l HWIO_RPMH_VRM_VOLTAGE_CRS_DRV3_REG19_ADDR A:&base_addr+0x831320
y.create.l HWIO_RPMH_VRM_VOLTAGE_CRS_DRV3_REG20_ADDR A:&base_addr+0x831420
y.create.l HWIO_RPMH_VRM_VOLTAGE_CRS_DRV3_REG21_ADDR A:&base_addr+0x831520
y.create.l HWIO_RPMH_VRM_VOLTAGE_CRS_DRV3_REG22_ADDR A:&base_addr+0x831620
y.create.l HWIO_RPMH_VRM_VOLTAGE_CRS_DRV3_REG23_ADDR A:&base_addr+0x831720
y.create.l HWIO_RPMH_VRM_VOLTAGE_CRS_DRV3_REG24_ADDR A:&base_addr+0x831820
y.create.l HWIO_RPMH_VRM_VOLTAGE_CRS_DRV3_REG25_ADDR A:&base_addr+0x831920
y.create.l HWIO_RPMH_VRM_VOLTAGE_CRS_DRV3_REG26_ADDR A:&base_addr+0x831a20
y.create.l HWIO_RPMH_VRM_VOLTAGE_CRS_DRV3_REG27_ADDR A:&base_addr+0x831b20
y.create.l HWIO_RPMH_VRM_VOLTAGE_CRS_DRV3_REG28_ADDR A:&base_addr+0x831c20
y.create.l HWIO_RPMH_VRM_VOLTAGE_CRS_DRV3_REG29_ADDR A:&base_addr+0x831d20
y.create.l HWIO_RPMH_VRM_VOLTAGE_CRS_DRV3_REG30_ADDR A:&base_addr+0x831e20
y.create.l HWIO_RPMH_VRM_VOLTAGE_CRS_DRV3_REG31_ADDR A:&base_addr+0x831f20
y.create.l HWIO_RPMH_VRM_VOLTAGE_CRS_DRV3_REG32_ADDR A:&base_addr+0x832020
y.create.l HWIO_RPMH_VRM_VOLTAGE_CRS_DRV3_REG33_ADDR A:&base_addr+0x832120
y.create.l HWIO_RPMH_VRM_VOLTAGE_CRS_DRV3_REG34_ADDR A:&base_addr+0x832220
y.create.l HWIO_RPMH_VRM_VOLTAGE_CRS_DRV3_REG35_ADDR A:&base_addr+0x832320
y.create.l HWIO_RPMH_VRM_VOLTAGE_CRS_DRV3_REG36_ADDR A:&base_addr+0x832420
y.create.l HWIO_RPMH_VRM_VOLTAGE_CRS_DRV3_REG37_ADDR A:&base_addr+0x832520
y.create.l HWIO_RPMH_VRM_VOLTAGE_CRS_DRV3_REG38_ADDR A:&base_addr+0x832620
y.create.l HWIO_RPMH_VRM_VOLTAGE_CRS_DRV3_REG39_ADDR A:&base_addr+0x832720
y.create.l HWIO_RPMH_VRM_VOLTAGE_CRS_DRV3_REG40_ADDR A:&base_addr+0x832820
y.create.l HWIO_RPMH_VRM_VOLTAGE_CRS_DRV3_REG41_ADDR A:&base_addr+0x832920
y.create.l HWIO_RPMH_VRM_VOLTAGE_CRS_DRV3_REG42_ADDR A:&base_addr+0x832a20
y.create.l HWIO_RPMH_VRM_VOLTAGE_CRS_DRV3_REG43_ADDR A:&base_addr+0x832b20
y.create.l HWIO_RPMH_VRM_VOLTAGE_CRS_DRV3_REG44_ADDR A:&base_addr+0x832c20
y.create.l HWIO_RPMH_VRM_VOLTAGE_CRS_DRV3_REG45_ADDR A:&base_addr+0x832d20
y.create.l HWIO_RPMH_VRM_VOLTAGE_CRS_DRV4_REG0_ADDR A:&base_addr+0x840020
y.create.l HWIO_RPMH_VRM_VOLTAGE_CRS_DRV4_REG1_ADDR A:&base_addr+0x840120
y.create.l HWIO_RPMH_VRM_VOLTAGE_CRS_DRV4_REG2_ADDR A:&base_addr+0x840220
y.create.l HWIO_RPMH_VRM_VOLTAGE_CRS_DRV4_REG3_ADDR A:&base_addr+0x840320
y.create.l HWIO_RPMH_VRM_VOLTAGE_CRS_DRV4_REG4_ADDR A:&base_addr+0x840420
y.create.l HWIO_RPMH_VRM_VOLTAGE_CRS_DRV4_REG5_ADDR A:&base_addr+0x840520
y.create.l HWIO_RPMH_VRM_VOLTAGE_CRS_DRV4_REG6_ADDR A:&base_addr+0x840620
y.create.l HWIO_RPMH_VRM_VOLTAGE_CRS_DRV4_REG7_ADDR A:&base_addr+0x840720
y.create.l HWIO_RPMH_VRM_VOLTAGE_CRS_DRV4_REG8_ADDR A:&base_addr+0x840820
y.create.l HWIO_RPMH_VRM_VOLTAGE_CRS_DRV4_REG9_ADDR A:&base_addr+0x840920
y.create.l HWIO_RPMH_VRM_VOLTAGE_CRS_DRV4_REG10_ADDR A:&base_addr+0x840a20
y.create.l HWIO_RPMH_VRM_VOLTAGE_CRS_DRV4_REG11_ADDR A:&base_addr+0x840b20
y.create.l HWIO_RPMH_VRM_VOLTAGE_CRS_DRV4_REG12_ADDR A:&base_addr+0x840c20
y.create.l HWIO_RPMH_VRM_VOLTAGE_CRS_DRV4_REG13_ADDR A:&base_addr+0x840d20
y.create.l HWIO_RPMH_VRM_VOLTAGE_CRS_DRV4_REG14_ADDR A:&base_addr+0x840e20
y.create.l HWIO_RPMH_VRM_VOLTAGE_CRS_DRV4_REG15_ADDR A:&base_addr+0x840f20
y.create.l HWIO_RPMH_VRM_VOLTAGE_CRS_DRV4_REG16_ADDR A:&base_addr+0x841020
y.create.l HWIO_RPMH_VRM_VOLTAGE_CRS_DRV4_REG17_ADDR A:&base_addr+0x841120
y.create.l HWIO_RPMH_VRM_VOLTAGE_CRS_DRV4_REG18_ADDR A:&base_addr+0x841220
y.create.l HWIO_RPMH_VRM_VOLTAGE_CRS_DRV4_REG19_ADDR A:&base_addr+0x841320
y.create.l HWIO_RPMH_VRM_VOLTAGE_CRS_DRV4_REG20_ADDR A:&base_addr+0x841420
y.create.l HWIO_RPMH_VRM_VOLTAGE_CRS_DRV4_REG21_ADDR A:&base_addr+0x841520
y.create.l HWIO_RPMH_VRM_VOLTAGE_CRS_DRV4_REG22_ADDR A:&base_addr+0x841620
y.create.l HWIO_RPMH_VRM_VOLTAGE_CRS_DRV4_REG23_ADDR A:&base_addr+0x841720
y.create.l HWIO_RPMH_VRM_VOLTAGE_CRS_DRV4_REG24_ADDR A:&base_addr+0x841820
y.create.l HWIO_RPMH_VRM_VOLTAGE_CRS_DRV4_REG25_ADDR A:&base_addr+0x841920
y.create.l HWIO_RPMH_VRM_VOLTAGE_CRS_DRV4_REG26_ADDR A:&base_addr+0x841a20
y.create.l HWIO_RPMH_VRM_VOLTAGE_CRS_DRV4_REG27_ADDR A:&base_addr+0x841b20
y.create.l HWIO_RPMH_VRM_VOLTAGE_CRS_DRV4_REG28_ADDR A:&base_addr+0x841c20
y.create.l HWIO_RPMH_VRM_VOLTAGE_CRS_DRV4_REG29_ADDR A:&base_addr+0x841d20
y.create.l HWIO_RPMH_VRM_VOLTAGE_CRS_DRV4_REG30_ADDR A:&base_addr+0x841e20
y.create.l HWIO_RPMH_VRM_VOLTAGE_CRS_DRV4_REG31_ADDR A:&base_addr+0x841f20
y.create.l HWIO_RPMH_VRM_VOLTAGE_CRS_DRV4_REG32_ADDR A:&base_addr+0x842020
y.create.l HWIO_RPMH_VRM_VOLTAGE_CRS_DRV4_REG33_ADDR A:&base_addr+0x842120
y.create.l HWIO_RPMH_VRM_VOLTAGE_CRS_DRV4_REG34_ADDR A:&base_addr+0x842220
y.create.l HWIO_RPMH_VRM_VOLTAGE_CRS_DRV4_REG35_ADDR A:&base_addr+0x842320
y.create.l HWIO_RPMH_VRM_VOLTAGE_CRS_DRV4_REG36_ADDR A:&base_addr+0x842420
y.create.l HWIO_RPMH_VRM_VOLTAGE_CRS_DRV4_REG37_ADDR A:&base_addr+0x842520
y.create.l HWIO_RPMH_VRM_VOLTAGE_CRS_DRV4_REG38_ADDR A:&base_addr+0x842620
y.create.l HWIO_RPMH_VRM_VOLTAGE_CRS_DRV4_REG39_ADDR A:&base_addr+0x842720
y.create.l HWIO_RPMH_VRM_VOLTAGE_CRS_DRV4_REG40_ADDR A:&base_addr+0x842820
y.create.l HWIO_RPMH_VRM_VOLTAGE_CRS_DRV4_REG41_ADDR A:&base_addr+0x842920
y.create.l HWIO_RPMH_VRM_VOLTAGE_CRS_DRV4_REG42_ADDR A:&base_addr+0x842a20
y.create.l HWIO_RPMH_VRM_VOLTAGE_CRS_DRV4_REG43_ADDR A:&base_addr+0x842b20
y.create.l HWIO_RPMH_VRM_VOLTAGE_CRS_DRV4_REG44_ADDR A:&base_addr+0x842c20
y.create.l HWIO_RPMH_VRM_VOLTAGE_CRS_DRV4_REG45_ADDR A:&base_addr+0x842d20
y.create.l HWIO_RPMH_VRM_VOLTAGE_CRS_DRV5_REG0_ADDR A:&base_addr+0x850020
y.create.l HWIO_RPMH_VRM_VOLTAGE_CRS_DRV5_REG1_ADDR A:&base_addr+0x850120
y.create.l HWIO_RPMH_VRM_VOLTAGE_CRS_DRV5_REG2_ADDR A:&base_addr+0x850220
y.create.l HWIO_RPMH_VRM_VOLTAGE_CRS_DRV5_REG3_ADDR A:&base_addr+0x850320
y.create.l HWIO_RPMH_VRM_VOLTAGE_CRS_DRV5_REG4_ADDR A:&base_addr+0x850420
y.create.l HWIO_RPMH_VRM_VOLTAGE_CRS_DRV5_REG5_ADDR A:&base_addr+0x850520
y.create.l HWIO_RPMH_VRM_VOLTAGE_CRS_DRV5_REG6_ADDR A:&base_addr+0x850620
y.create.l HWIO_RPMH_VRM_VOLTAGE_CRS_DRV5_REG7_ADDR A:&base_addr+0x850720
y.create.l HWIO_RPMH_VRM_VOLTAGE_CRS_DRV5_REG8_ADDR A:&base_addr+0x850820
y.create.l HWIO_RPMH_VRM_VOLTAGE_CRS_DRV5_REG9_ADDR A:&base_addr+0x850920
y.create.l HWIO_RPMH_VRM_VOLTAGE_CRS_DRV5_REG10_ADDR A:&base_addr+0x850a20
y.create.l HWIO_RPMH_VRM_VOLTAGE_CRS_DRV5_REG11_ADDR A:&base_addr+0x850b20
y.create.l HWIO_RPMH_VRM_VOLTAGE_CRS_DRV5_REG12_ADDR A:&base_addr+0x850c20
y.create.l HWIO_RPMH_VRM_VOLTAGE_CRS_DRV5_REG13_ADDR A:&base_addr+0x850d20
y.create.l HWIO_RPMH_VRM_VOLTAGE_CRS_DRV5_REG14_ADDR A:&base_addr+0x850e20
y.create.l HWIO_RPMH_VRM_VOLTAGE_CRS_DRV5_REG15_ADDR A:&base_addr+0x850f20
y.create.l HWIO_RPMH_VRM_VOLTAGE_CRS_DRV5_REG16_ADDR A:&base_addr+0x851020
y.create.l HWIO_RPMH_VRM_VOLTAGE_CRS_DRV5_REG17_ADDR A:&base_addr+0x851120
y.create.l HWIO_RPMH_VRM_VOLTAGE_CRS_DRV5_REG18_ADDR A:&base_addr+0x851220
y.create.l HWIO_RPMH_VRM_VOLTAGE_CRS_DRV5_REG19_ADDR A:&base_addr+0x851320
y.create.l HWIO_RPMH_VRM_VOLTAGE_CRS_DRV5_REG20_ADDR A:&base_addr+0x851420
y.create.l HWIO_RPMH_VRM_VOLTAGE_CRS_DRV5_REG21_ADDR A:&base_addr+0x851520
y.create.l HWIO_RPMH_VRM_VOLTAGE_CRS_DRV5_REG22_ADDR A:&base_addr+0x851620
y.create.l HWIO_RPMH_VRM_VOLTAGE_CRS_DRV5_REG23_ADDR A:&base_addr+0x851720
y.create.l HWIO_RPMH_VRM_VOLTAGE_CRS_DRV5_REG24_ADDR A:&base_addr+0x851820
y.create.l HWIO_RPMH_VRM_VOLTAGE_CRS_DRV5_REG25_ADDR A:&base_addr+0x851920
y.create.l HWIO_RPMH_VRM_VOLTAGE_CRS_DRV5_REG26_ADDR A:&base_addr+0x851a20
y.create.l HWIO_RPMH_VRM_VOLTAGE_CRS_DRV5_REG27_ADDR A:&base_addr+0x851b20
y.create.l HWIO_RPMH_VRM_VOLTAGE_CRS_DRV5_REG28_ADDR A:&base_addr+0x851c20
y.create.l HWIO_RPMH_VRM_VOLTAGE_CRS_DRV5_REG29_ADDR A:&base_addr+0x851d20
y.create.l HWIO_RPMH_VRM_VOLTAGE_CRS_DRV5_REG30_ADDR A:&base_addr+0x851e20
y.create.l HWIO_RPMH_VRM_VOLTAGE_CRS_DRV5_REG31_ADDR A:&base_addr+0x851f20
y.create.l HWIO_RPMH_VRM_VOLTAGE_CRS_DRV5_REG32_ADDR A:&base_addr+0x852020
y.create.l HWIO_RPMH_VRM_VOLTAGE_CRS_DRV5_REG33_ADDR A:&base_addr+0x852120
y.create.l HWIO_RPMH_VRM_VOLTAGE_CRS_DRV5_REG34_ADDR A:&base_addr+0x852220
y.create.l HWIO_RPMH_VRM_VOLTAGE_CRS_DRV5_REG35_ADDR A:&base_addr+0x852320
y.create.l HWIO_RPMH_VRM_VOLTAGE_CRS_DRV5_REG36_ADDR A:&base_addr+0x852420
y.create.l HWIO_RPMH_VRM_VOLTAGE_CRS_DRV5_REG37_ADDR A:&base_addr+0x852520
y.create.l HWIO_RPMH_VRM_VOLTAGE_CRS_DRV5_REG38_ADDR A:&base_addr+0x852620
y.create.l HWIO_RPMH_VRM_VOLTAGE_CRS_DRV5_REG39_ADDR A:&base_addr+0x852720
y.create.l HWIO_RPMH_VRM_VOLTAGE_CRS_DRV5_REG40_ADDR A:&base_addr+0x852820
y.create.l HWIO_RPMH_VRM_VOLTAGE_CRS_DRV5_REG41_ADDR A:&base_addr+0x852920
y.create.l HWIO_RPMH_VRM_VOLTAGE_CRS_DRV5_REG42_ADDR A:&base_addr+0x852a20
y.create.l HWIO_RPMH_VRM_VOLTAGE_CRS_DRV5_REG43_ADDR A:&base_addr+0x852b20
y.create.l HWIO_RPMH_VRM_VOLTAGE_CRS_DRV5_REG44_ADDR A:&base_addr+0x852c20
y.create.l HWIO_RPMH_VRM_VOLTAGE_CRS_DRV5_REG45_ADDR A:&base_addr+0x852d20
y.create.l HWIO_RPMH_VRM_VOLTAGE_CRS_DRV6_REG0_ADDR A:&base_addr+0x860020
y.create.l HWIO_RPMH_VRM_VOLTAGE_CRS_DRV6_REG1_ADDR A:&base_addr+0x860120
y.create.l HWIO_RPMH_VRM_VOLTAGE_CRS_DRV6_REG2_ADDR A:&base_addr+0x860220
y.create.l HWIO_RPMH_VRM_VOLTAGE_CRS_DRV6_REG3_ADDR A:&base_addr+0x860320
y.create.l HWIO_RPMH_VRM_VOLTAGE_CRS_DRV6_REG4_ADDR A:&base_addr+0x860420
y.create.l HWIO_RPMH_VRM_VOLTAGE_CRS_DRV6_REG5_ADDR A:&base_addr+0x860520
y.create.l HWIO_RPMH_VRM_VOLTAGE_CRS_DRV6_REG6_ADDR A:&base_addr+0x860620
y.create.l HWIO_RPMH_VRM_VOLTAGE_CRS_DRV6_REG7_ADDR A:&base_addr+0x860720
y.create.l HWIO_RPMH_VRM_VOLTAGE_CRS_DRV6_REG8_ADDR A:&base_addr+0x860820
y.create.l HWIO_RPMH_VRM_VOLTAGE_CRS_DRV6_REG9_ADDR A:&base_addr+0x860920
y.create.l HWIO_RPMH_VRM_VOLTAGE_CRS_DRV6_REG10_ADDR A:&base_addr+0x860a20
y.create.l HWIO_RPMH_VRM_VOLTAGE_CRS_DRV6_REG11_ADDR A:&base_addr+0x860b20
y.create.l HWIO_RPMH_VRM_VOLTAGE_CRS_DRV6_REG12_ADDR A:&base_addr+0x860c20
y.create.l HWIO_RPMH_VRM_VOLTAGE_CRS_DRV6_REG13_ADDR A:&base_addr+0x860d20
y.create.l HWIO_RPMH_VRM_VOLTAGE_CRS_DRV6_REG14_ADDR A:&base_addr+0x860e20
y.create.l HWIO_RPMH_VRM_VOLTAGE_CRS_DRV6_REG15_ADDR A:&base_addr+0x860f20
y.create.l HWIO_RPMH_VRM_VOLTAGE_CRS_DRV6_REG16_ADDR A:&base_addr+0x861020
y.create.l HWIO_RPMH_VRM_VOLTAGE_CRS_DRV6_REG17_ADDR A:&base_addr+0x861120
y.create.l HWIO_RPMH_VRM_VOLTAGE_CRS_DRV6_REG18_ADDR A:&base_addr+0x861220
y.create.l HWIO_RPMH_VRM_VOLTAGE_CRS_DRV6_REG19_ADDR A:&base_addr+0x861320
y.create.l HWIO_RPMH_VRM_VOLTAGE_CRS_DRV6_REG20_ADDR A:&base_addr+0x861420
y.create.l HWIO_RPMH_VRM_VOLTAGE_CRS_DRV6_REG21_ADDR A:&base_addr+0x861520
y.create.l HWIO_RPMH_VRM_VOLTAGE_CRS_DRV6_REG22_ADDR A:&base_addr+0x861620
y.create.l HWIO_RPMH_VRM_VOLTAGE_CRS_DRV6_REG23_ADDR A:&base_addr+0x861720
y.create.l HWIO_RPMH_VRM_VOLTAGE_CRS_DRV6_REG24_ADDR A:&base_addr+0x861820
y.create.l HWIO_RPMH_VRM_VOLTAGE_CRS_DRV6_REG25_ADDR A:&base_addr+0x861920
y.create.l HWIO_RPMH_VRM_VOLTAGE_CRS_DRV6_REG26_ADDR A:&base_addr+0x861a20
y.create.l HWIO_RPMH_VRM_VOLTAGE_CRS_DRV6_REG27_ADDR A:&base_addr+0x861b20
y.create.l HWIO_RPMH_VRM_VOLTAGE_CRS_DRV6_REG28_ADDR A:&base_addr+0x861c20
y.create.l HWIO_RPMH_VRM_VOLTAGE_CRS_DRV6_REG29_ADDR A:&base_addr+0x861d20
y.create.l HWIO_RPMH_VRM_VOLTAGE_CRS_DRV6_REG30_ADDR A:&base_addr+0x861e20
y.create.l HWIO_RPMH_VRM_VOLTAGE_CRS_DRV6_REG31_ADDR A:&base_addr+0x861f20
y.create.l HWIO_RPMH_VRM_VOLTAGE_CRS_DRV6_REG32_ADDR A:&base_addr+0x862020
y.create.l HWIO_RPMH_VRM_VOLTAGE_CRS_DRV6_REG33_ADDR A:&base_addr+0x862120
y.create.l HWIO_RPMH_VRM_VOLTAGE_CRS_DRV6_REG34_ADDR A:&base_addr+0x862220
y.create.l HWIO_RPMH_VRM_VOLTAGE_CRS_DRV6_REG35_ADDR A:&base_addr+0x862320
y.create.l HWIO_RPMH_VRM_VOLTAGE_CRS_DRV6_REG36_ADDR A:&base_addr+0x862420
y.create.l HWIO_RPMH_VRM_VOLTAGE_CRS_DRV6_REG37_ADDR A:&base_addr+0x862520
y.create.l HWIO_RPMH_VRM_VOLTAGE_CRS_DRV6_REG38_ADDR A:&base_addr+0x862620
y.create.l HWIO_RPMH_VRM_VOLTAGE_CRS_DRV6_REG39_ADDR A:&base_addr+0x862720
y.create.l HWIO_RPMH_VRM_VOLTAGE_CRS_DRV6_REG40_ADDR A:&base_addr+0x862820
y.create.l HWIO_RPMH_VRM_VOLTAGE_CRS_DRV6_REG41_ADDR A:&base_addr+0x862920
y.create.l HWIO_RPMH_VRM_VOLTAGE_CRS_DRV6_REG42_ADDR A:&base_addr+0x862a20
y.create.l HWIO_RPMH_VRM_VOLTAGE_CRS_DRV6_REG43_ADDR A:&base_addr+0x862b20
y.create.l HWIO_RPMH_VRM_VOLTAGE_CRS_DRV6_REG44_ADDR A:&base_addr+0x862c20
y.create.l HWIO_RPMH_VRM_VOLTAGE_CRS_DRV6_REG45_ADDR A:&base_addr+0x862d20
y.create.l HWIO_RPMH_VRM_VOLTAGE_CRS_DRV7_REG0_ADDR A:&base_addr+0x870020
y.create.l HWIO_RPMH_VRM_VOLTAGE_CRS_DRV7_REG1_ADDR A:&base_addr+0x870120
y.create.l HWIO_RPMH_VRM_VOLTAGE_CRS_DRV7_REG2_ADDR A:&base_addr+0x870220
y.create.l HWIO_RPMH_VRM_VOLTAGE_CRS_DRV7_REG3_ADDR A:&base_addr+0x870320
y.create.l HWIO_RPMH_VRM_VOLTAGE_CRS_DRV7_REG4_ADDR A:&base_addr+0x870420
y.create.l HWIO_RPMH_VRM_VOLTAGE_CRS_DRV7_REG5_ADDR A:&base_addr+0x870520
y.create.l HWIO_RPMH_VRM_VOLTAGE_CRS_DRV7_REG6_ADDR A:&base_addr+0x870620
y.create.l HWIO_RPMH_VRM_VOLTAGE_CRS_DRV7_REG7_ADDR A:&base_addr+0x870720
y.create.l HWIO_RPMH_VRM_VOLTAGE_CRS_DRV7_REG8_ADDR A:&base_addr+0x870820
y.create.l HWIO_RPMH_VRM_VOLTAGE_CRS_DRV7_REG9_ADDR A:&base_addr+0x870920
y.create.l HWIO_RPMH_VRM_VOLTAGE_CRS_DRV7_REG10_ADDR A:&base_addr+0x870a20
y.create.l HWIO_RPMH_VRM_VOLTAGE_CRS_DRV7_REG11_ADDR A:&base_addr+0x870b20
y.create.l HWIO_RPMH_VRM_VOLTAGE_CRS_DRV7_REG12_ADDR A:&base_addr+0x870c20
y.create.l HWIO_RPMH_VRM_VOLTAGE_CRS_DRV7_REG13_ADDR A:&base_addr+0x870d20
y.create.l HWIO_RPMH_VRM_VOLTAGE_CRS_DRV7_REG14_ADDR A:&base_addr+0x870e20
y.create.l HWIO_RPMH_VRM_VOLTAGE_CRS_DRV7_REG15_ADDR A:&base_addr+0x870f20
y.create.l HWIO_RPMH_VRM_VOLTAGE_CRS_DRV7_REG16_ADDR A:&base_addr+0x871020
y.create.l HWIO_RPMH_VRM_VOLTAGE_CRS_DRV7_REG17_ADDR A:&base_addr+0x871120
y.create.l HWIO_RPMH_VRM_VOLTAGE_CRS_DRV7_REG18_ADDR A:&base_addr+0x871220
y.create.l HWIO_RPMH_VRM_VOLTAGE_CRS_DRV7_REG19_ADDR A:&base_addr+0x871320
y.create.l HWIO_RPMH_VRM_VOLTAGE_CRS_DRV7_REG20_ADDR A:&base_addr+0x871420
y.create.l HWIO_RPMH_VRM_VOLTAGE_CRS_DRV7_REG21_ADDR A:&base_addr+0x871520
y.create.l HWIO_RPMH_VRM_VOLTAGE_CRS_DRV7_REG22_ADDR A:&base_addr+0x871620
y.create.l HWIO_RPMH_VRM_VOLTAGE_CRS_DRV7_REG23_ADDR A:&base_addr+0x871720
y.create.l HWIO_RPMH_VRM_VOLTAGE_CRS_DRV7_REG24_ADDR A:&base_addr+0x871820
y.create.l HWIO_RPMH_VRM_VOLTAGE_CRS_DRV7_REG25_ADDR A:&base_addr+0x871920
y.create.l HWIO_RPMH_VRM_VOLTAGE_CRS_DRV7_REG26_ADDR A:&base_addr+0x871a20
y.create.l HWIO_RPMH_VRM_VOLTAGE_CRS_DRV7_REG27_ADDR A:&base_addr+0x871b20
y.create.l HWIO_RPMH_VRM_VOLTAGE_CRS_DRV7_REG28_ADDR A:&base_addr+0x871c20
y.create.l HWIO_RPMH_VRM_VOLTAGE_CRS_DRV7_REG29_ADDR A:&base_addr+0x871d20
y.create.l HWIO_RPMH_VRM_VOLTAGE_CRS_DRV7_REG30_ADDR A:&base_addr+0x871e20
y.create.l HWIO_RPMH_VRM_VOLTAGE_CRS_DRV7_REG31_ADDR A:&base_addr+0x871f20
y.create.l HWIO_RPMH_VRM_VOLTAGE_CRS_DRV7_REG32_ADDR A:&base_addr+0x872020
y.create.l HWIO_RPMH_VRM_VOLTAGE_CRS_DRV7_REG33_ADDR A:&base_addr+0x872120
y.create.l HWIO_RPMH_VRM_VOLTAGE_CRS_DRV7_REG34_ADDR A:&base_addr+0x872220
y.create.l HWIO_RPMH_VRM_VOLTAGE_CRS_DRV7_REG35_ADDR A:&base_addr+0x872320
y.create.l HWIO_RPMH_VRM_VOLTAGE_CRS_DRV7_REG36_ADDR A:&base_addr+0x872420
y.create.l HWIO_RPMH_VRM_VOLTAGE_CRS_DRV7_REG37_ADDR A:&base_addr+0x872520
y.create.l HWIO_RPMH_VRM_VOLTAGE_CRS_DRV7_REG38_ADDR A:&base_addr+0x872620
y.create.l HWIO_RPMH_VRM_VOLTAGE_CRS_DRV7_REG39_ADDR A:&base_addr+0x872720
y.create.l HWIO_RPMH_VRM_VOLTAGE_CRS_DRV7_REG40_ADDR A:&base_addr+0x872820
y.create.l HWIO_RPMH_VRM_VOLTAGE_CRS_DRV7_REG41_ADDR A:&base_addr+0x872920
y.create.l HWIO_RPMH_VRM_VOLTAGE_CRS_DRV7_REG42_ADDR A:&base_addr+0x872a20
y.create.l HWIO_RPMH_VRM_VOLTAGE_CRS_DRV7_REG43_ADDR A:&base_addr+0x872b20
y.create.l HWIO_RPMH_VRM_VOLTAGE_CRS_DRV7_REG44_ADDR A:&base_addr+0x872c20
y.create.l HWIO_RPMH_VRM_VOLTAGE_CRS_DRV7_REG45_ADDR A:&base_addr+0x872d20
y.create.l HWIO_RPMH_VRM_VOLTAGE_CRS_DRV8_REG0_ADDR A:&base_addr+0x880020
y.create.l HWIO_RPMH_VRM_VOLTAGE_CRS_DRV8_REG1_ADDR A:&base_addr+0x880120
y.create.l HWIO_RPMH_VRM_VOLTAGE_CRS_DRV8_REG2_ADDR A:&base_addr+0x880220
y.create.l HWIO_RPMH_VRM_VOLTAGE_CRS_DRV8_REG3_ADDR A:&base_addr+0x880320
y.create.l HWIO_RPMH_VRM_VOLTAGE_CRS_DRV8_REG4_ADDR A:&base_addr+0x880420
y.create.l HWIO_RPMH_VRM_VOLTAGE_CRS_DRV8_REG5_ADDR A:&base_addr+0x880520
y.create.l HWIO_RPMH_VRM_VOLTAGE_CRS_DRV8_REG6_ADDR A:&base_addr+0x880620
y.create.l HWIO_RPMH_VRM_VOLTAGE_CRS_DRV8_REG7_ADDR A:&base_addr+0x880720
y.create.l HWIO_RPMH_VRM_VOLTAGE_CRS_DRV8_REG8_ADDR A:&base_addr+0x880820
y.create.l HWIO_RPMH_VRM_VOLTAGE_CRS_DRV8_REG9_ADDR A:&base_addr+0x880920
y.create.l HWIO_RPMH_VRM_VOLTAGE_CRS_DRV8_REG10_ADDR A:&base_addr+0x880a20
y.create.l HWIO_RPMH_VRM_VOLTAGE_CRS_DRV8_REG11_ADDR A:&base_addr+0x880b20
y.create.l HWIO_RPMH_VRM_VOLTAGE_CRS_DRV8_REG12_ADDR A:&base_addr+0x880c20
y.create.l HWIO_RPMH_VRM_VOLTAGE_CRS_DRV8_REG13_ADDR A:&base_addr+0x880d20
y.create.l HWIO_RPMH_VRM_VOLTAGE_CRS_DRV8_REG14_ADDR A:&base_addr+0x880e20
y.create.l HWIO_RPMH_VRM_VOLTAGE_CRS_DRV8_REG15_ADDR A:&base_addr+0x880f20
y.create.l HWIO_RPMH_VRM_VOLTAGE_CRS_DRV8_REG16_ADDR A:&base_addr+0x881020
y.create.l HWIO_RPMH_VRM_VOLTAGE_CRS_DRV8_REG17_ADDR A:&base_addr+0x881120
y.create.l HWIO_RPMH_VRM_VOLTAGE_CRS_DRV8_REG18_ADDR A:&base_addr+0x881220
y.create.l HWIO_RPMH_VRM_VOLTAGE_CRS_DRV8_REG19_ADDR A:&base_addr+0x881320
y.create.l HWIO_RPMH_VRM_VOLTAGE_CRS_DRV8_REG20_ADDR A:&base_addr+0x881420
y.create.l HWIO_RPMH_VRM_VOLTAGE_CRS_DRV8_REG21_ADDR A:&base_addr+0x881520
y.create.l HWIO_RPMH_VRM_VOLTAGE_CRS_DRV8_REG22_ADDR A:&base_addr+0x881620
y.create.l HWIO_RPMH_VRM_VOLTAGE_CRS_DRV8_REG23_ADDR A:&base_addr+0x881720
y.create.l HWIO_RPMH_VRM_VOLTAGE_CRS_DRV8_REG24_ADDR A:&base_addr+0x881820
y.create.l HWIO_RPMH_VRM_VOLTAGE_CRS_DRV8_REG25_ADDR A:&base_addr+0x881920
y.create.l HWIO_RPMH_VRM_VOLTAGE_CRS_DRV8_REG26_ADDR A:&base_addr+0x881a20
y.create.l HWIO_RPMH_VRM_VOLTAGE_CRS_DRV8_REG27_ADDR A:&base_addr+0x881b20
y.create.l HWIO_RPMH_VRM_VOLTAGE_CRS_DRV8_REG28_ADDR A:&base_addr+0x881c20
y.create.l HWIO_RPMH_VRM_VOLTAGE_CRS_DRV8_REG29_ADDR A:&base_addr+0x881d20
y.create.l HWIO_RPMH_VRM_VOLTAGE_CRS_DRV8_REG30_ADDR A:&base_addr+0x881e20
y.create.l HWIO_RPMH_VRM_VOLTAGE_CRS_DRV8_REG31_ADDR A:&base_addr+0x881f20
y.create.l HWIO_RPMH_VRM_VOLTAGE_CRS_DRV8_REG32_ADDR A:&base_addr+0x882020
y.create.l HWIO_RPMH_VRM_VOLTAGE_CRS_DRV8_REG33_ADDR A:&base_addr+0x882120
y.create.l HWIO_RPMH_VRM_VOLTAGE_CRS_DRV8_REG34_ADDR A:&base_addr+0x882220
y.create.l HWIO_RPMH_VRM_VOLTAGE_CRS_DRV8_REG35_ADDR A:&base_addr+0x882320
y.create.l HWIO_RPMH_VRM_VOLTAGE_CRS_DRV8_REG36_ADDR A:&base_addr+0x882420
y.create.l HWIO_RPMH_VRM_VOLTAGE_CRS_DRV8_REG37_ADDR A:&base_addr+0x882520
y.create.l HWIO_RPMH_VRM_VOLTAGE_CRS_DRV8_REG38_ADDR A:&base_addr+0x882620
y.create.l HWIO_RPMH_VRM_VOLTAGE_CRS_DRV8_REG39_ADDR A:&base_addr+0x882720
y.create.l HWIO_RPMH_VRM_VOLTAGE_CRS_DRV8_REG40_ADDR A:&base_addr+0x882820
y.create.l HWIO_RPMH_VRM_VOLTAGE_CRS_DRV8_REG41_ADDR A:&base_addr+0x882920
y.create.l HWIO_RPMH_VRM_VOLTAGE_CRS_DRV8_REG42_ADDR A:&base_addr+0x882a20
y.create.l HWIO_RPMH_VRM_VOLTAGE_CRS_DRV8_REG43_ADDR A:&base_addr+0x882b20
y.create.l HWIO_RPMH_VRM_VOLTAGE_CRS_DRV8_REG44_ADDR A:&base_addr+0x882c20
y.create.l HWIO_RPMH_VRM_VOLTAGE_CRS_DRV8_REG45_ADDR A:&base_addr+0x882d20
y.create.l HWIO_RPMH_VRM_VOLTAGE_CRS_DRV9_REG0_ADDR A:&base_addr+0x890020
y.create.l HWIO_RPMH_VRM_VOLTAGE_CRS_DRV9_REG1_ADDR A:&base_addr+0x890120
y.create.l HWIO_RPMH_VRM_VOLTAGE_CRS_DRV9_REG2_ADDR A:&base_addr+0x890220
y.create.l HWIO_RPMH_VRM_VOLTAGE_CRS_DRV9_REG3_ADDR A:&base_addr+0x890320
y.create.l HWIO_RPMH_VRM_VOLTAGE_CRS_DRV9_REG4_ADDR A:&base_addr+0x890420
y.create.l HWIO_RPMH_VRM_VOLTAGE_CRS_DRV9_REG5_ADDR A:&base_addr+0x890520
y.create.l HWIO_RPMH_VRM_VOLTAGE_CRS_DRV9_REG6_ADDR A:&base_addr+0x890620
y.create.l HWIO_RPMH_VRM_VOLTAGE_CRS_DRV9_REG7_ADDR A:&base_addr+0x890720
y.create.l HWIO_RPMH_VRM_VOLTAGE_CRS_DRV9_REG8_ADDR A:&base_addr+0x890820
y.create.l HWIO_RPMH_VRM_VOLTAGE_CRS_DRV9_REG9_ADDR A:&base_addr+0x890920
y.create.l HWIO_RPMH_VRM_VOLTAGE_CRS_DRV9_REG10_ADDR A:&base_addr+0x890a20
y.create.l HWIO_RPMH_VRM_VOLTAGE_CRS_DRV9_REG11_ADDR A:&base_addr+0x890b20
y.create.l HWIO_RPMH_VRM_VOLTAGE_CRS_DRV9_REG12_ADDR A:&base_addr+0x890c20
y.create.l HWIO_RPMH_VRM_VOLTAGE_CRS_DRV9_REG13_ADDR A:&base_addr+0x890d20
y.create.l HWIO_RPMH_VRM_VOLTAGE_CRS_DRV9_REG14_ADDR A:&base_addr+0x890e20
y.create.l HWIO_RPMH_VRM_VOLTAGE_CRS_DRV9_REG15_ADDR A:&base_addr+0x890f20
y.create.l HWIO_RPMH_VRM_VOLTAGE_CRS_DRV9_REG16_ADDR A:&base_addr+0x891020
y.create.l HWIO_RPMH_VRM_VOLTAGE_CRS_DRV9_REG17_ADDR A:&base_addr+0x891120
y.create.l HWIO_RPMH_VRM_VOLTAGE_CRS_DRV9_REG18_ADDR A:&base_addr+0x891220
y.create.l HWIO_RPMH_VRM_VOLTAGE_CRS_DRV9_REG19_ADDR A:&base_addr+0x891320
y.create.l HWIO_RPMH_VRM_VOLTAGE_CRS_DRV9_REG20_ADDR A:&base_addr+0x891420
y.create.l HWIO_RPMH_VRM_VOLTAGE_CRS_DRV9_REG21_ADDR A:&base_addr+0x891520
y.create.l HWIO_RPMH_VRM_VOLTAGE_CRS_DRV9_REG22_ADDR A:&base_addr+0x891620
y.create.l HWIO_RPMH_VRM_VOLTAGE_CRS_DRV9_REG23_ADDR A:&base_addr+0x891720
y.create.l HWIO_RPMH_VRM_VOLTAGE_CRS_DRV9_REG24_ADDR A:&base_addr+0x891820
y.create.l HWIO_RPMH_VRM_VOLTAGE_CRS_DRV9_REG25_ADDR A:&base_addr+0x891920
y.create.l HWIO_RPMH_VRM_VOLTAGE_CRS_DRV9_REG26_ADDR A:&base_addr+0x891a20
y.create.l HWIO_RPMH_VRM_VOLTAGE_CRS_DRV9_REG27_ADDR A:&base_addr+0x891b20
y.create.l HWIO_RPMH_VRM_VOLTAGE_CRS_DRV9_REG28_ADDR A:&base_addr+0x891c20
y.create.l HWIO_RPMH_VRM_VOLTAGE_CRS_DRV9_REG29_ADDR A:&base_addr+0x891d20
y.create.l HWIO_RPMH_VRM_VOLTAGE_CRS_DRV9_REG30_ADDR A:&base_addr+0x891e20
y.create.l HWIO_RPMH_VRM_VOLTAGE_CRS_DRV9_REG31_ADDR A:&base_addr+0x891f20
y.create.l HWIO_RPMH_VRM_VOLTAGE_CRS_DRV9_REG32_ADDR A:&base_addr+0x892020
y.create.l HWIO_RPMH_VRM_VOLTAGE_CRS_DRV9_REG33_ADDR A:&base_addr+0x892120
y.create.l HWIO_RPMH_VRM_VOLTAGE_CRS_DRV9_REG34_ADDR A:&base_addr+0x892220
y.create.l HWIO_RPMH_VRM_VOLTAGE_CRS_DRV9_REG35_ADDR A:&base_addr+0x892320
y.create.l HWIO_RPMH_VRM_VOLTAGE_CRS_DRV9_REG36_ADDR A:&base_addr+0x892420
y.create.l HWIO_RPMH_VRM_VOLTAGE_CRS_DRV9_REG37_ADDR A:&base_addr+0x892520
y.create.l HWIO_RPMH_VRM_VOLTAGE_CRS_DRV9_REG38_ADDR A:&base_addr+0x892620
y.create.l HWIO_RPMH_VRM_VOLTAGE_CRS_DRV9_REG39_ADDR A:&base_addr+0x892720
y.create.l HWIO_RPMH_VRM_VOLTAGE_CRS_DRV9_REG40_ADDR A:&base_addr+0x892820
y.create.l HWIO_RPMH_VRM_VOLTAGE_CRS_DRV9_REG41_ADDR A:&base_addr+0x892920
y.create.l HWIO_RPMH_VRM_VOLTAGE_CRS_DRV9_REG42_ADDR A:&base_addr+0x892a20
y.create.l HWIO_RPMH_VRM_VOLTAGE_CRS_DRV9_REG43_ADDR A:&base_addr+0x892b20
y.create.l HWIO_RPMH_VRM_VOLTAGE_CRS_DRV9_REG44_ADDR A:&base_addr+0x892c20
y.create.l HWIO_RPMH_VRM_VOLTAGE_CRS_DRV9_REG45_ADDR A:&base_addr+0x892d20
y.create.l HWIO_RPMH_VRM_VOLTAGE_CRS_DRV10_REG0_ADDR A:&base_addr+0x8a0020
y.create.l HWIO_RPMH_VRM_VOLTAGE_CRS_DRV10_REG1_ADDR A:&base_addr+0x8a0120
y.create.l HWIO_RPMH_VRM_VOLTAGE_CRS_DRV10_REG2_ADDR A:&base_addr+0x8a0220
y.create.l HWIO_RPMH_VRM_VOLTAGE_CRS_DRV10_REG3_ADDR A:&base_addr+0x8a0320
y.create.l HWIO_RPMH_VRM_VOLTAGE_CRS_DRV10_REG4_ADDR A:&base_addr+0x8a0420
y.create.l HWIO_RPMH_VRM_VOLTAGE_CRS_DRV10_REG5_ADDR A:&base_addr+0x8a0520
y.create.l HWIO_RPMH_VRM_VOLTAGE_CRS_DRV10_REG6_ADDR A:&base_addr+0x8a0620
y.create.l HWIO_RPMH_VRM_VOLTAGE_CRS_DRV10_REG7_ADDR A:&base_addr+0x8a0720
y.create.l HWIO_RPMH_VRM_VOLTAGE_CRS_DRV10_REG8_ADDR A:&base_addr+0x8a0820
y.create.l HWIO_RPMH_VRM_VOLTAGE_CRS_DRV10_REG9_ADDR A:&base_addr+0x8a0920
y.create.l HWIO_RPMH_VRM_VOLTAGE_CRS_DRV10_REG10_ADDR A:&base_addr+0x8a0a20
y.create.l HWIO_RPMH_VRM_VOLTAGE_CRS_DRV10_REG11_ADDR A:&base_addr+0x8a0b20
y.create.l HWIO_RPMH_VRM_VOLTAGE_CRS_DRV10_REG12_ADDR A:&base_addr+0x8a0c20
y.create.l HWIO_RPMH_VRM_VOLTAGE_CRS_DRV10_REG13_ADDR A:&base_addr+0x8a0d20
y.create.l HWIO_RPMH_VRM_VOLTAGE_CRS_DRV10_REG14_ADDR A:&base_addr+0x8a0e20
y.create.l HWIO_RPMH_VRM_VOLTAGE_CRS_DRV10_REG15_ADDR A:&base_addr+0x8a0f20
y.create.l HWIO_RPMH_VRM_VOLTAGE_CRS_DRV10_REG16_ADDR A:&base_addr+0x8a1020
y.create.l HWIO_RPMH_VRM_VOLTAGE_CRS_DRV10_REG17_ADDR A:&base_addr+0x8a1120
y.create.l HWIO_RPMH_VRM_VOLTAGE_CRS_DRV10_REG18_ADDR A:&base_addr+0x8a1220
y.create.l HWIO_RPMH_VRM_VOLTAGE_CRS_DRV10_REG19_ADDR A:&base_addr+0x8a1320
y.create.l HWIO_RPMH_VRM_VOLTAGE_CRS_DRV10_REG20_ADDR A:&base_addr+0x8a1420
y.create.l HWIO_RPMH_VRM_VOLTAGE_CRS_DRV10_REG21_ADDR A:&base_addr+0x8a1520
y.create.l HWIO_RPMH_VRM_VOLTAGE_CRS_DRV10_REG22_ADDR A:&base_addr+0x8a1620
y.create.l HWIO_RPMH_VRM_VOLTAGE_CRS_DRV10_REG23_ADDR A:&base_addr+0x8a1720
y.create.l HWIO_RPMH_VRM_VOLTAGE_CRS_DRV10_REG24_ADDR A:&base_addr+0x8a1820
y.create.l HWIO_RPMH_VRM_VOLTAGE_CRS_DRV10_REG25_ADDR A:&base_addr+0x8a1920
y.create.l HWIO_RPMH_VRM_VOLTAGE_CRS_DRV10_REG26_ADDR A:&base_addr+0x8a1a20
y.create.l HWIO_RPMH_VRM_VOLTAGE_CRS_DRV10_REG27_ADDR A:&base_addr+0x8a1b20
y.create.l HWIO_RPMH_VRM_VOLTAGE_CRS_DRV10_REG28_ADDR A:&base_addr+0x8a1c20
y.create.l HWIO_RPMH_VRM_VOLTAGE_CRS_DRV10_REG29_ADDR A:&base_addr+0x8a1d20
y.create.l HWIO_RPMH_VRM_VOLTAGE_CRS_DRV10_REG30_ADDR A:&base_addr+0x8a1e20
y.create.l HWIO_RPMH_VRM_VOLTAGE_CRS_DRV10_REG31_ADDR A:&base_addr+0x8a1f20
y.create.l HWIO_RPMH_VRM_VOLTAGE_CRS_DRV10_REG32_ADDR A:&base_addr+0x8a2020
y.create.l HWIO_RPMH_VRM_VOLTAGE_CRS_DRV10_REG33_ADDR A:&base_addr+0x8a2120
y.create.l HWIO_RPMH_VRM_VOLTAGE_CRS_DRV10_REG34_ADDR A:&base_addr+0x8a2220
y.create.l HWIO_RPMH_VRM_VOLTAGE_CRS_DRV10_REG35_ADDR A:&base_addr+0x8a2320
y.create.l HWIO_RPMH_VRM_VOLTAGE_CRS_DRV10_REG36_ADDR A:&base_addr+0x8a2420
y.create.l HWIO_RPMH_VRM_VOLTAGE_CRS_DRV10_REG37_ADDR A:&base_addr+0x8a2520
y.create.l HWIO_RPMH_VRM_VOLTAGE_CRS_DRV10_REG38_ADDR A:&base_addr+0x8a2620
y.create.l HWIO_RPMH_VRM_VOLTAGE_CRS_DRV10_REG39_ADDR A:&base_addr+0x8a2720
y.create.l HWIO_RPMH_VRM_VOLTAGE_CRS_DRV10_REG40_ADDR A:&base_addr+0x8a2820
y.create.l HWIO_RPMH_VRM_VOLTAGE_CRS_DRV10_REG41_ADDR A:&base_addr+0x8a2920
y.create.l HWIO_RPMH_VRM_VOLTAGE_CRS_DRV10_REG42_ADDR A:&base_addr+0x8a2a20
y.create.l HWIO_RPMH_VRM_VOLTAGE_CRS_DRV10_REG43_ADDR A:&base_addr+0x8a2b20
y.create.l HWIO_RPMH_VRM_VOLTAGE_CRS_DRV10_REG44_ADDR A:&base_addr+0x8a2c20
y.create.l HWIO_RPMH_VRM_VOLTAGE_CRS_DRV10_REG45_ADDR A:&base_addr+0x8a2d20
y.create.l HWIO_RPMH_VRM_VOLTAGE_CRS_DRV11_REG0_ADDR A:&base_addr+0x8b0020
y.create.l HWIO_RPMH_VRM_VOLTAGE_CRS_DRV11_REG1_ADDR A:&base_addr+0x8b0120
y.create.l HWIO_RPMH_VRM_VOLTAGE_CRS_DRV11_REG2_ADDR A:&base_addr+0x8b0220
y.create.l HWIO_RPMH_VRM_VOLTAGE_CRS_DRV11_REG3_ADDR A:&base_addr+0x8b0320
y.create.l HWIO_RPMH_VRM_VOLTAGE_CRS_DRV11_REG4_ADDR A:&base_addr+0x8b0420
y.create.l HWIO_RPMH_VRM_VOLTAGE_CRS_DRV11_REG5_ADDR A:&base_addr+0x8b0520
y.create.l HWIO_RPMH_VRM_VOLTAGE_CRS_DRV11_REG6_ADDR A:&base_addr+0x8b0620
y.create.l HWIO_RPMH_VRM_VOLTAGE_CRS_DRV11_REG7_ADDR A:&base_addr+0x8b0720
y.create.l HWIO_RPMH_VRM_VOLTAGE_CRS_DRV11_REG8_ADDR A:&base_addr+0x8b0820
y.create.l HWIO_RPMH_VRM_VOLTAGE_CRS_DRV11_REG9_ADDR A:&base_addr+0x8b0920
y.create.l HWIO_RPMH_VRM_VOLTAGE_CRS_DRV11_REG10_ADDR A:&base_addr+0x8b0a20
y.create.l HWIO_RPMH_VRM_VOLTAGE_CRS_DRV11_REG11_ADDR A:&base_addr+0x8b0b20
y.create.l HWIO_RPMH_VRM_VOLTAGE_CRS_DRV11_REG12_ADDR A:&base_addr+0x8b0c20
y.create.l HWIO_RPMH_VRM_VOLTAGE_CRS_DRV11_REG13_ADDR A:&base_addr+0x8b0d20
y.create.l HWIO_RPMH_VRM_VOLTAGE_CRS_DRV11_REG14_ADDR A:&base_addr+0x8b0e20
y.create.l HWIO_RPMH_VRM_VOLTAGE_CRS_DRV11_REG15_ADDR A:&base_addr+0x8b0f20
y.create.l HWIO_RPMH_VRM_VOLTAGE_CRS_DRV11_REG16_ADDR A:&base_addr+0x8b1020
y.create.l HWIO_RPMH_VRM_VOLTAGE_CRS_DRV11_REG17_ADDR A:&base_addr+0x8b1120
y.create.l HWIO_RPMH_VRM_VOLTAGE_CRS_DRV11_REG18_ADDR A:&base_addr+0x8b1220
y.create.l HWIO_RPMH_VRM_VOLTAGE_CRS_DRV11_REG19_ADDR A:&base_addr+0x8b1320
y.create.l HWIO_RPMH_VRM_VOLTAGE_CRS_DRV11_REG20_ADDR A:&base_addr+0x8b1420
y.create.l HWIO_RPMH_VRM_VOLTAGE_CRS_DRV11_REG21_ADDR A:&base_addr+0x8b1520
y.create.l HWIO_RPMH_VRM_VOLTAGE_CRS_DRV11_REG22_ADDR A:&base_addr+0x8b1620
y.create.l HWIO_RPMH_VRM_VOLTAGE_CRS_DRV11_REG23_ADDR A:&base_addr+0x8b1720
y.create.l HWIO_RPMH_VRM_VOLTAGE_CRS_DRV11_REG24_ADDR A:&base_addr+0x8b1820
y.create.l HWIO_RPMH_VRM_VOLTAGE_CRS_DRV11_REG25_ADDR A:&base_addr+0x8b1920
y.create.l HWIO_RPMH_VRM_VOLTAGE_CRS_DRV11_REG26_ADDR A:&base_addr+0x8b1a20
y.create.l HWIO_RPMH_VRM_VOLTAGE_CRS_DRV11_REG27_ADDR A:&base_addr+0x8b1b20
y.create.l HWIO_RPMH_VRM_VOLTAGE_CRS_DRV11_REG28_ADDR A:&base_addr+0x8b1c20
y.create.l HWIO_RPMH_VRM_VOLTAGE_CRS_DRV11_REG29_ADDR A:&base_addr+0x8b1d20
y.create.l HWIO_RPMH_VRM_VOLTAGE_CRS_DRV11_REG30_ADDR A:&base_addr+0x8b1e20
y.create.l HWIO_RPMH_VRM_VOLTAGE_CRS_DRV11_REG31_ADDR A:&base_addr+0x8b1f20
y.create.l HWIO_RPMH_VRM_VOLTAGE_CRS_DRV11_REG32_ADDR A:&base_addr+0x8b2020
y.create.l HWIO_RPMH_VRM_VOLTAGE_CRS_DRV11_REG33_ADDR A:&base_addr+0x8b2120
y.create.l HWIO_RPMH_VRM_VOLTAGE_CRS_DRV11_REG34_ADDR A:&base_addr+0x8b2220
y.create.l HWIO_RPMH_VRM_VOLTAGE_CRS_DRV11_REG35_ADDR A:&base_addr+0x8b2320
y.create.l HWIO_RPMH_VRM_VOLTAGE_CRS_DRV11_REG36_ADDR A:&base_addr+0x8b2420
y.create.l HWIO_RPMH_VRM_VOLTAGE_CRS_DRV11_REG37_ADDR A:&base_addr+0x8b2520
y.create.l HWIO_RPMH_VRM_VOLTAGE_CRS_DRV11_REG38_ADDR A:&base_addr+0x8b2620
y.create.l HWIO_RPMH_VRM_VOLTAGE_CRS_DRV11_REG39_ADDR A:&base_addr+0x8b2720
y.create.l HWIO_RPMH_VRM_VOLTAGE_CRS_DRV11_REG40_ADDR A:&base_addr+0x8b2820
y.create.l HWIO_RPMH_VRM_VOLTAGE_CRS_DRV11_REG41_ADDR A:&base_addr+0x8b2920
y.create.l HWIO_RPMH_VRM_VOLTAGE_CRS_DRV11_REG42_ADDR A:&base_addr+0x8b2a20
y.create.l HWIO_RPMH_VRM_VOLTAGE_CRS_DRV11_REG43_ADDR A:&base_addr+0x8b2b20
y.create.l HWIO_RPMH_VRM_VOLTAGE_CRS_DRV11_REG44_ADDR A:&base_addr+0x8b2c20
y.create.l HWIO_RPMH_VRM_VOLTAGE_CRS_DRV11_REG45_ADDR A:&base_addr+0x8b2d20
y.create.l HWIO_RPMH_VRM_VOLTAGE_CRS_DRV12_REG0_ADDR A:&base_addr+0x8c0020
y.create.l HWIO_RPMH_VRM_VOLTAGE_CRS_DRV12_REG1_ADDR A:&base_addr+0x8c0120
y.create.l HWIO_RPMH_VRM_VOLTAGE_CRS_DRV12_REG2_ADDR A:&base_addr+0x8c0220
y.create.l HWIO_RPMH_VRM_VOLTAGE_CRS_DRV12_REG3_ADDR A:&base_addr+0x8c0320
y.create.l HWIO_RPMH_VRM_VOLTAGE_CRS_DRV12_REG4_ADDR A:&base_addr+0x8c0420
y.create.l HWIO_RPMH_VRM_VOLTAGE_CRS_DRV12_REG5_ADDR A:&base_addr+0x8c0520
y.create.l HWIO_RPMH_VRM_VOLTAGE_CRS_DRV12_REG6_ADDR A:&base_addr+0x8c0620
y.create.l HWIO_RPMH_VRM_VOLTAGE_CRS_DRV12_REG7_ADDR A:&base_addr+0x8c0720
y.create.l HWIO_RPMH_VRM_VOLTAGE_CRS_DRV12_REG8_ADDR A:&base_addr+0x8c0820
y.create.l HWIO_RPMH_VRM_VOLTAGE_CRS_DRV12_REG9_ADDR A:&base_addr+0x8c0920
y.create.l HWIO_RPMH_VRM_VOLTAGE_CRS_DRV12_REG10_ADDR A:&base_addr+0x8c0a20
y.create.l HWIO_RPMH_VRM_VOLTAGE_CRS_DRV12_REG11_ADDR A:&base_addr+0x8c0b20
y.create.l HWIO_RPMH_VRM_VOLTAGE_CRS_DRV12_REG12_ADDR A:&base_addr+0x8c0c20
y.create.l HWIO_RPMH_VRM_VOLTAGE_CRS_DRV12_REG13_ADDR A:&base_addr+0x8c0d20
y.create.l HWIO_RPMH_VRM_VOLTAGE_CRS_DRV12_REG14_ADDR A:&base_addr+0x8c0e20
y.create.l HWIO_RPMH_VRM_VOLTAGE_CRS_DRV12_REG15_ADDR A:&base_addr+0x8c0f20
y.create.l HWIO_RPMH_VRM_VOLTAGE_CRS_DRV12_REG16_ADDR A:&base_addr+0x8c1020
y.create.l HWIO_RPMH_VRM_VOLTAGE_CRS_DRV12_REG17_ADDR A:&base_addr+0x8c1120
y.create.l HWIO_RPMH_VRM_VOLTAGE_CRS_DRV12_REG18_ADDR A:&base_addr+0x8c1220
y.create.l HWIO_RPMH_VRM_VOLTAGE_CRS_DRV12_REG19_ADDR A:&base_addr+0x8c1320
y.create.l HWIO_RPMH_VRM_VOLTAGE_CRS_DRV12_REG20_ADDR A:&base_addr+0x8c1420
y.create.l HWIO_RPMH_VRM_VOLTAGE_CRS_DRV12_REG21_ADDR A:&base_addr+0x8c1520
y.create.l HWIO_RPMH_VRM_VOLTAGE_CRS_DRV12_REG22_ADDR A:&base_addr+0x8c1620
y.create.l HWIO_RPMH_VRM_VOLTAGE_CRS_DRV12_REG23_ADDR A:&base_addr+0x8c1720
y.create.l HWIO_RPMH_VRM_VOLTAGE_CRS_DRV12_REG24_ADDR A:&base_addr+0x8c1820
y.create.l HWIO_RPMH_VRM_VOLTAGE_CRS_DRV12_REG25_ADDR A:&base_addr+0x8c1920
y.create.l HWIO_RPMH_VRM_VOLTAGE_CRS_DRV12_REG26_ADDR A:&base_addr+0x8c1a20
y.create.l HWIO_RPMH_VRM_VOLTAGE_CRS_DRV12_REG27_ADDR A:&base_addr+0x8c1b20
y.create.l HWIO_RPMH_VRM_VOLTAGE_CRS_DRV12_REG28_ADDR A:&base_addr+0x8c1c20
y.create.l HWIO_RPMH_VRM_VOLTAGE_CRS_DRV12_REG29_ADDR A:&base_addr+0x8c1d20
y.create.l HWIO_RPMH_VRM_VOLTAGE_CRS_DRV12_REG30_ADDR A:&base_addr+0x8c1e20
y.create.l HWIO_RPMH_VRM_VOLTAGE_CRS_DRV12_REG31_ADDR A:&base_addr+0x8c1f20
y.create.l HWIO_RPMH_VRM_VOLTAGE_CRS_DRV12_REG32_ADDR A:&base_addr+0x8c2020
y.create.l HWIO_RPMH_VRM_VOLTAGE_CRS_DRV12_REG33_ADDR A:&base_addr+0x8c2120
y.create.l HWIO_RPMH_VRM_VOLTAGE_CRS_DRV12_REG34_ADDR A:&base_addr+0x8c2220
y.create.l HWIO_RPMH_VRM_VOLTAGE_CRS_DRV12_REG35_ADDR A:&base_addr+0x8c2320
y.create.l HWIO_RPMH_VRM_VOLTAGE_CRS_DRV12_REG36_ADDR A:&base_addr+0x8c2420
y.create.l HWIO_RPMH_VRM_VOLTAGE_CRS_DRV12_REG37_ADDR A:&base_addr+0x8c2520
y.create.l HWIO_RPMH_VRM_VOLTAGE_CRS_DRV12_REG38_ADDR A:&base_addr+0x8c2620
y.create.l HWIO_RPMH_VRM_VOLTAGE_CRS_DRV12_REG39_ADDR A:&base_addr+0x8c2720
y.create.l HWIO_RPMH_VRM_VOLTAGE_CRS_DRV12_REG40_ADDR A:&base_addr+0x8c2820
y.create.l HWIO_RPMH_VRM_VOLTAGE_CRS_DRV12_REG41_ADDR A:&base_addr+0x8c2920
y.create.l HWIO_RPMH_VRM_VOLTAGE_CRS_DRV12_REG42_ADDR A:&base_addr+0x8c2a20
y.create.l HWIO_RPMH_VRM_VOLTAGE_CRS_DRV12_REG43_ADDR A:&base_addr+0x8c2b20
y.create.l HWIO_RPMH_VRM_VOLTAGE_CRS_DRV12_REG44_ADDR A:&base_addr+0x8c2c20
y.create.l HWIO_RPMH_VRM_VOLTAGE_CRS_DRV12_REG45_ADDR A:&base_addr+0x8c2d20
y.create.l HWIO_RPMH_VRM_VOLTAGE_CRS_DRV13_REG0_ADDR A:&base_addr+0x8d0020
y.create.l HWIO_RPMH_VRM_VOLTAGE_CRS_DRV13_REG1_ADDR A:&base_addr+0x8d0120
y.create.l HWIO_RPMH_VRM_VOLTAGE_CRS_DRV13_REG2_ADDR A:&base_addr+0x8d0220
y.create.l HWIO_RPMH_VRM_VOLTAGE_CRS_DRV13_REG3_ADDR A:&base_addr+0x8d0320
y.create.l HWIO_RPMH_VRM_VOLTAGE_CRS_DRV13_REG4_ADDR A:&base_addr+0x8d0420
y.create.l HWIO_RPMH_VRM_VOLTAGE_CRS_DRV13_REG5_ADDR A:&base_addr+0x8d0520
y.create.l HWIO_RPMH_VRM_VOLTAGE_CRS_DRV13_REG6_ADDR A:&base_addr+0x8d0620
y.create.l HWIO_RPMH_VRM_VOLTAGE_CRS_DRV13_REG7_ADDR A:&base_addr+0x8d0720
y.create.l HWIO_RPMH_VRM_VOLTAGE_CRS_DRV13_REG8_ADDR A:&base_addr+0x8d0820
y.create.l HWIO_RPMH_VRM_VOLTAGE_CRS_DRV13_REG9_ADDR A:&base_addr+0x8d0920
y.create.l HWIO_RPMH_VRM_VOLTAGE_CRS_DRV13_REG10_ADDR A:&base_addr+0x8d0a20
y.create.l HWIO_RPMH_VRM_VOLTAGE_CRS_DRV13_REG11_ADDR A:&base_addr+0x8d0b20
y.create.l HWIO_RPMH_VRM_VOLTAGE_CRS_DRV13_REG12_ADDR A:&base_addr+0x8d0c20
y.create.l HWIO_RPMH_VRM_VOLTAGE_CRS_DRV13_REG13_ADDR A:&base_addr+0x8d0d20
y.create.l HWIO_RPMH_VRM_VOLTAGE_CRS_DRV13_REG14_ADDR A:&base_addr+0x8d0e20
y.create.l HWIO_RPMH_VRM_VOLTAGE_CRS_DRV13_REG15_ADDR A:&base_addr+0x8d0f20
y.create.l HWIO_RPMH_VRM_VOLTAGE_CRS_DRV13_REG16_ADDR A:&base_addr+0x8d1020
y.create.l HWIO_RPMH_VRM_VOLTAGE_CRS_DRV13_REG17_ADDR A:&base_addr+0x8d1120
y.create.l HWIO_RPMH_VRM_VOLTAGE_CRS_DRV13_REG18_ADDR A:&base_addr+0x8d1220
y.create.l HWIO_RPMH_VRM_VOLTAGE_CRS_DRV13_REG19_ADDR A:&base_addr+0x8d1320
y.create.l HWIO_RPMH_VRM_VOLTAGE_CRS_DRV13_REG20_ADDR A:&base_addr+0x8d1420
y.create.l HWIO_RPMH_VRM_VOLTAGE_CRS_DRV13_REG21_ADDR A:&base_addr+0x8d1520
y.create.l HWIO_RPMH_VRM_VOLTAGE_CRS_DRV13_REG22_ADDR A:&base_addr+0x8d1620
y.create.l HWIO_RPMH_VRM_VOLTAGE_CRS_DRV13_REG23_ADDR A:&base_addr+0x8d1720
y.create.l HWIO_RPMH_VRM_VOLTAGE_CRS_DRV13_REG24_ADDR A:&base_addr+0x8d1820
y.create.l HWIO_RPMH_VRM_VOLTAGE_CRS_DRV13_REG25_ADDR A:&base_addr+0x8d1920
y.create.l HWIO_RPMH_VRM_VOLTAGE_CRS_DRV13_REG26_ADDR A:&base_addr+0x8d1a20
y.create.l HWIO_RPMH_VRM_VOLTAGE_CRS_DRV13_REG27_ADDR A:&base_addr+0x8d1b20
y.create.l HWIO_RPMH_VRM_VOLTAGE_CRS_DRV13_REG28_ADDR A:&base_addr+0x8d1c20
y.create.l HWIO_RPMH_VRM_VOLTAGE_CRS_DRV13_REG29_ADDR A:&base_addr+0x8d1d20
y.create.l HWIO_RPMH_VRM_VOLTAGE_CRS_DRV13_REG30_ADDR A:&base_addr+0x8d1e20
y.create.l HWIO_RPMH_VRM_VOLTAGE_CRS_DRV13_REG31_ADDR A:&base_addr+0x8d1f20
y.create.l HWIO_RPMH_VRM_VOLTAGE_CRS_DRV13_REG32_ADDR A:&base_addr+0x8d2020
y.create.l HWIO_RPMH_VRM_VOLTAGE_CRS_DRV13_REG33_ADDR A:&base_addr+0x8d2120
y.create.l HWIO_RPMH_VRM_VOLTAGE_CRS_DRV13_REG34_ADDR A:&base_addr+0x8d2220
y.create.l HWIO_RPMH_VRM_VOLTAGE_CRS_DRV13_REG35_ADDR A:&base_addr+0x8d2320
y.create.l HWIO_RPMH_VRM_VOLTAGE_CRS_DRV13_REG36_ADDR A:&base_addr+0x8d2420
y.create.l HWIO_RPMH_VRM_VOLTAGE_CRS_DRV13_REG37_ADDR A:&base_addr+0x8d2520
y.create.l HWIO_RPMH_VRM_VOLTAGE_CRS_DRV13_REG38_ADDR A:&base_addr+0x8d2620
y.create.l HWIO_RPMH_VRM_VOLTAGE_CRS_DRV13_REG39_ADDR A:&base_addr+0x8d2720
y.create.l HWIO_RPMH_VRM_VOLTAGE_CRS_DRV13_REG40_ADDR A:&base_addr+0x8d2820
y.create.l HWIO_RPMH_VRM_VOLTAGE_CRS_DRV13_REG41_ADDR A:&base_addr+0x8d2920
y.create.l HWIO_RPMH_VRM_VOLTAGE_CRS_DRV13_REG42_ADDR A:&base_addr+0x8d2a20
y.create.l HWIO_RPMH_VRM_VOLTAGE_CRS_DRV13_REG43_ADDR A:&base_addr+0x8d2b20
y.create.l HWIO_RPMH_VRM_VOLTAGE_CRS_DRV13_REG44_ADDR A:&base_addr+0x8d2c20
y.create.l HWIO_RPMH_VRM_VOLTAGE_CRS_DRV13_REG45_ADDR A:&base_addr+0x8d2d20
y.create.l HWIO_RPMH_VRM_VOLTAGE_CRS_DRV14_REG0_ADDR A:&base_addr+0x8e0020
y.create.l HWIO_RPMH_VRM_VOLTAGE_CRS_DRV14_REG1_ADDR A:&base_addr+0x8e0120
y.create.l HWIO_RPMH_VRM_VOLTAGE_CRS_DRV14_REG2_ADDR A:&base_addr+0x8e0220
y.create.l HWIO_RPMH_VRM_VOLTAGE_CRS_DRV14_REG3_ADDR A:&base_addr+0x8e0320
y.create.l HWIO_RPMH_VRM_VOLTAGE_CRS_DRV14_REG4_ADDR A:&base_addr+0x8e0420
y.create.l HWIO_RPMH_VRM_VOLTAGE_CRS_DRV14_REG5_ADDR A:&base_addr+0x8e0520
y.create.l HWIO_RPMH_VRM_VOLTAGE_CRS_DRV14_REG6_ADDR A:&base_addr+0x8e0620
y.create.l HWIO_RPMH_VRM_VOLTAGE_CRS_DRV14_REG7_ADDR A:&base_addr+0x8e0720
y.create.l HWIO_RPMH_VRM_VOLTAGE_CRS_DRV14_REG8_ADDR A:&base_addr+0x8e0820
y.create.l HWIO_RPMH_VRM_VOLTAGE_CRS_DRV14_REG9_ADDR A:&base_addr+0x8e0920
y.create.l HWIO_RPMH_VRM_VOLTAGE_CRS_DRV14_REG10_ADDR A:&base_addr+0x8e0a20
y.create.l HWIO_RPMH_VRM_VOLTAGE_CRS_DRV14_REG11_ADDR A:&base_addr+0x8e0b20
y.create.l HWIO_RPMH_VRM_VOLTAGE_CRS_DRV14_REG12_ADDR A:&base_addr+0x8e0c20
y.create.l HWIO_RPMH_VRM_VOLTAGE_CRS_DRV14_REG13_ADDR A:&base_addr+0x8e0d20
y.create.l HWIO_RPMH_VRM_VOLTAGE_CRS_DRV14_REG14_ADDR A:&base_addr+0x8e0e20
y.create.l HWIO_RPMH_VRM_VOLTAGE_CRS_DRV14_REG15_ADDR A:&base_addr+0x8e0f20
y.create.l HWIO_RPMH_VRM_VOLTAGE_CRS_DRV14_REG16_ADDR A:&base_addr+0x8e1020
y.create.l HWIO_RPMH_VRM_VOLTAGE_CRS_DRV14_REG17_ADDR A:&base_addr+0x8e1120
y.create.l HWIO_RPMH_VRM_VOLTAGE_CRS_DRV14_REG18_ADDR A:&base_addr+0x8e1220
y.create.l HWIO_RPMH_VRM_VOLTAGE_CRS_DRV14_REG19_ADDR A:&base_addr+0x8e1320
y.create.l HWIO_RPMH_VRM_VOLTAGE_CRS_DRV14_REG20_ADDR A:&base_addr+0x8e1420
y.create.l HWIO_RPMH_VRM_VOLTAGE_CRS_DRV14_REG21_ADDR A:&base_addr+0x8e1520
y.create.l HWIO_RPMH_VRM_VOLTAGE_CRS_DRV14_REG22_ADDR A:&base_addr+0x8e1620
y.create.l HWIO_RPMH_VRM_VOLTAGE_CRS_DRV14_REG23_ADDR A:&base_addr+0x8e1720
y.create.l HWIO_RPMH_VRM_VOLTAGE_CRS_DRV14_REG24_ADDR A:&base_addr+0x8e1820
y.create.l HWIO_RPMH_VRM_VOLTAGE_CRS_DRV14_REG25_ADDR A:&base_addr+0x8e1920
y.create.l HWIO_RPMH_VRM_VOLTAGE_CRS_DRV14_REG26_ADDR A:&base_addr+0x8e1a20
y.create.l HWIO_RPMH_VRM_VOLTAGE_CRS_DRV14_REG27_ADDR A:&base_addr+0x8e1b20
y.create.l HWIO_RPMH_VRM_VOLTAGE_CRS_DRV14_REG28_ADDR A:&base_addr+0x8e1c20
y.create.l HWIO_RPMH_VRM_VOLTAGE_CRS_DRV14_REG29_ADDR A:&base_addr+0x8e1d20
y.create.l HWIO_RPMH_VRM_VOLTAGE_CRS_DRV14_REG30_ADDR A:&base_addr+0x8e1e20
y.create.l HWIO_RPMH_VRM_VOLTAGE_CRS_DRV14_REG31_ADDR A:&base_addr+0x8e1f20
y.create.l HWIO_RPMH_VRM_VOLTAGE_CRS_DRV14_REG32_ADDR A:&base_addr+0x8e2020
y.create.l HWIO_RPMH_VRM_VOLTAGE_CRS_DRV14_REG33_ADDR A:&base_addr+0x8e2120
y.create.l HWIO_RPMH_VRM_VOLTAGE_CRS_DRV14_REG34_ADDR A:&base_addr+0x8e2220
y.create.l HWIO_RPMH_VRM_VOLTAGE_CRS_DRV14_REG35_ADDR A:&base_addr+0x8e2320
y.create.l HWIO_RPMH_VRM_VOLTAGE_CRS_DRV14_REG36_ADDR A:&base_addr+0x8e2420
y.create.l HWIO_RPMH_VRM_VOLTAGE_CRS_DRV14_REG37_ADDR A:&base_addr+0x8e2520
y.create.l HWIO_RPMH_VRM_VOLTAGE_CRS_DRV14_REG38_ADDR A:&base_addr+0x8e2620
y.create.l HWIO_RPMH_VRM_VOLTAGE_CRS_DRV14_REG39_ADDR A:&base_addr+0x8e2720
y.create.l HWIO_RPMH_VRM_VOLTAGE_CRS_DRV14_REG40_ADDR A:&base_addr+0x8e2820
y.create.l HWIO_RPMH_VRM_VOLTAGE_CRS_DRV14_REG41_ADDR A:&base_addr+0x8e2920
y.create.l HWIO_RPMH_VRM_VOLTAGE_CRS_DRV14_REG42_ADDR A:&base_addr+0x8e2a20
y.create.l HWIO_RPMH_VRM_VOLTAGE_CRS_DRV14_REG43_ADDR A:&base_addr+0x8e2b20
y.create.l HWIO_RPMH_VRM_VOLTAGE_CRS_DRV14_REG44_ADDR A:&base_addr+0x8e2c20
y.create.l HWIO_RPMH_VRM_VOLTAGE_CRS_DRV14_REG45_ADDR A:&base_addr+0x8e2d20
y.create.l HWIO_RPMH_VRM_ENABLE_CRS_DRV0_REG0_ADDR A:&base_addr+0x800024
y.create.l HWIO_RPMH_VRM_ENABLE_CRS_DRV0_REG1_ADDR A:&base_addr+0x800124
y.create.l HWIO_RPMH_VRM_ENABLE_CRS_DRV0_REG2_ADDR A:&base_addr+0x800224
y.create.l HWIO_RPMH_VRM_ENABLE_CRS_DRV0_REG3_ADDR A:&base_addr+0x800324
y.create.l HWIO_RPMH_VRM_ENABLE_CRS_DRV0_REG4_ADDR A:&base_addr+0x800424
y.create.l HWIO_RPMH_VRM_ENABLE_CRS_DRV0_REG5_ADDR A:&base_addr+0x800524
y.create.l HWIO_RPMH_VRM_ENABLE_CRS_DRV0_REG6_ADDR A:&base_addr+0x800624
y.create.l HWIO_RPMH_VRM_ENABLE_CRS_DRV0_REG7_ADDR A:&base_addr+0x800724
y.create.l HWIO_RPMH_VRM_ENABLE_CRS_DRV0_REG8_ADDR A:&base_addr+0x800824
y.create.l HWIO_RPMH_VRM_ENABLE_CRS_DRV0_REG9_ADDR A:&base_addr+0x800924
y.create.l HWIO_RPMH_VRM_ENABLE_CRS_DRV0_REG10_ADDR A:&base_addr+0x800a24
y.create.l HWIO_RPMH_VRM_ENABLE_CRS_DRV0_REG11_ADDR A:&base_addr+0x800b24
y.create.l HWIO_RPMH_VRM_ENABLE_CRS_DRV0_REG12_ADDR A:&base_addr+0x800c24
y.create.l HWIO_RPMH_VRM_ENABLE_CRS_DRV0_REG13_ADDR A:&base_addr+0x800d24
y.create.l HWIO_RPMH_VRM_ENABLE_CRS_DRV0_REG14_ADDR A:&base_addr+0x800e24
y.create.l HWIO_RPMH_VRM_ENABLE_CRS_DRV0_REG15_ADDR A:&base_addr+0x800f24
y.create.l HWIO_RPMH_VRM_ENABLE_CRS_DRV0_REG16_ADDR A:&base_addr+0x801024
y.create.l HWIO_RPMH_VRM_ENABLE_CRS_DRV0_REG17_ADDR A:&base_addr+0x801124
y.create.l HWIO_RPMH_VRM_ENABLE_CRS_DRV0_REG18_ADDR A:&base_addr+0x801224
y.create.l HWIO_RPMH_VRM_ENABLE_CRS_DRV0_REG19_ADDR A:&base_addr+0x801324
y.create.l HWIO_RPMH_VRM_ENABLE_CRS_DRV0_REG20_ADDR A:&base_addr+0x801424
y.create.l HWIO_RPMH_VRM_ENABLE_CRS_DRV0_REG21_ADDR A:&base_addr+0x801524
y.create.l HWIO_RPMH_VRM_ENABLE_CRS_DRV0_REG22_ADDR A:&base_addr+0x801624
y.create.l HWIO_RPMH_VRM_ENABLE_CRS_DRV0_REG23_ADDR A:&base_addr+0x801724
y.create.l HWIO_RPMH_VRM_ENABLE_CRS_DRV0_REG24_ADDR A:&base_addr+0x801824
y.create.l HWIO_RPMH_VRM_ENABLE_CRS_DRV0_REG25_ADDR A:&base_addr+0x801924
y.create.l HWIO_RPMH_VRM_ENABLE_CRS_DRV0_REG26_ADDR A:&base_addr+0x801a24
y.create.l HWIO_RPMH_VRM_ENABLE_CRS_DRV0_REG27_ADDR A:&base_addr+0x801b24
y.create.l HWIO_RPMH_VRM_ENABLE_CRS_DRV0_REG28_ADDR A:&base_addr+0x801c24
y.create.l HWIO_RPMH_VRM_ENABLE_CRS_DRV0_REG29_ADDR A:&base_addr+0x801d24
y.create.l HWIO_RPMH_VRM_ENABLE_CRS_DRV0_REG30_ADDR A:&base_addr+0x801e24
y.create.l HWIO_RPMH_VRM_ENABLE_CRS_DRV0_REG31_ADDR A:&base_addr+0x801f24
y.create.l HWIO_RPMH_VRM_ENABLE_CRS_DRV0_REG32_ADDR A:&base_addr+0x802024
y.create.l HWIO_RPMH_VRM_ENABLE_CRS_DRV0_REG33_ADDR A:&base_addr+0x802124
y.create.l HWIO_RPMH_VRM_ENABLE_CRS_DRV0_REG34_ADDR A:&base_addr+0x802224
y.create.l HWIO_RPMH_VRM_ENABLE_CRS_DRV0_REG35_ADDR A:&base_addr+0x802324
y.create.l HWIO_RPMH_VRM_ENABLE_CRS_DRV0_REG36_ADDR A:&base_addr+0x802424
y.create.l HWIO_RPMH_VRM_ENABLE_CRS_DRV0_REG37_ADDR A:&base_addr+0x802524
y.create.l HWIO_RPMH_VRM_ENABLE_CRS_DRV0_REG38_ADDR A:&base_addr+0x802624
y.create.l HWIO_RPMH_VRM_ENABLE_CRS_DRV0_REG39_ADDR A:&base_addr+0x802724
y.create.l HWIO_RPMH_VRM_ENABLE_CRS_DRV0_REG40_ADDR A:&base_addr+0x802824
y.create.l HWIO_RPMH_VRM_ENABLE_CRS_DRV0_REG41_ADDR A:&base_addr+0x802924
y.create.l HWIO_RPMH_VRM_ENABLE_CRS_DRV0_REG42_ADDR A:&base_addr+0x802a24
y.create.l HWIO_RPMH_VRM_ENABLE_CRS_DRV0_REG43_ADDR A:&base_addr+0x802b24
y.create.l HWIO_RPMH_VRM_ENABLE_CRS_DRV0_REG44_ADDR A:&base_addr+0x802c24
y.create.l HWIO_RPMH_VRM_ENABLE_CRS_DRV0_REG45_ADDR A:&base_addr+0x802d24
y.create.l HWIO_RPMH_VRM_ENABLE_CRS_DRV1_REG0_ADDR A:&base_addr+0x810024
y.create.l HWIO_RPMH_VRM_ENABLE_CRS_DRV1_REG1_ADDR A:&base_addr+0x810124
y.create.l HWIO_RPMH_VRM_ENABLE_CRS_DRV1_REG2_ADDR A:&base_addr+0x810224
y.create.l HWIO_RPMH_VRM_ENABLE_CRS_DRV1_REG3_ADDR A:&base_addr+0x810324
y.create.l HWIO_RPMH_VRM_ENABLE_CRS_DRV1_REG4_ADDR A:&base_addr+0x810424
y.create.l HWIO_RPMH_VRM_ENABLE_CRS_DRV1_REG5_ADDR A:&base_addr+0x810524
y.create.l HWIO_RPMH_VRM_ENABLE_CRS_DRV1_REG6_ADDR A:&base_addr+0x810624
y.create.l HWIO_RPMH_VRM_ENABLE_CRS_DRV1_REG7_ADDR A:&base_addr+0x810724
y.create.l HWIO_RPMH_VRM_ENABLE_CRS_DRV1_REG8_ADDR A:&base_addr+0x810824
y.create.l HWIO_RPMH_VRM_ENABLE_CRS_DRV1_REG9_ADDR A:&base_addr+0x810924
y.create.l HWIO_RPMH_VRM_ENABLE_CRS_DRV1_REG10_ADDR A:&base_addr+0x810a24
y.create.l HWIO_RPMH_VRM_ENABLE_CRS_DRV1_REG11_ADDR A:&base_addr+0x810b24
y.create.l HWIO_RPMH_VRM_ENABLE_CRS_DRV1_REG12_ADDR A:&base_addr+0x810c24
y.create.l HWIO_RPMH_VRM_ENABLE_CRS_DRV1_REG13_ADDR A:&base_addr+0x810d24
y.create.l HWIO_RPMH_VRM_ENABLE_CRS_DRV1_REG14_ADDR A:&base_addr+0x810e24
y.create.l HWIO_RPMH_VRM_ENABLE_CRS_DRV1_REG15_ADDR A:&base_addr+0x810f24
y.create.l HWIO_RPMH_VRM_ENABLE_CRS_DRV1_REG16_ADDR A:&base_addr+0x811024
y.create.l HWIO_RPMH_VRM_ENABLE_CRS_DRV1_REG17_ADDR A:&base_addr+0x811124
y.create.l HWIO_RPMH_VRM_ENABLE_CRS_DRV1_REG18_ADDR A:&base_addr+0x811224
y.create.l HWIO_RPMH_VRM_ENABLE_CRS_DRV1_REG19_ADDR A:&base_addr+0x811324
y.create.l HWIO_RPMH_VRM_ENABLE_CRS_DRV1_REG20_ADDR A:&base_addr+0x811424
y.create.l HWIO_RPMH_VRM_ENABLE_CRS_DRV1_REG21_ADDR A:&base_addr+0x811524
y.create.l HWIO_RPMH_VRM_ENABLE_CRS_DRV1_REG22_ADDR A:&base_addr+0x811624
y.create.l HWIO_RPMH_VRM_ENABLE_CRS_DRV1_REG23_ADDR A:&base_addr+0x811724
y.create.l HWIO_RPMH_VRM_ENABLE_CRS_DRV1_REG24_ADDR A:&base_addr+0x811824
y.create.l HWIO_RPMH_VRM_ENABLE_CRS_DRV1_REG25_ADDR A:&base_addr+0x811924
y.create.l HWIO_RPMH_VRM_ENABLE_CRS_DRV1_REG26_ADDR A:&base_addr+0x811a24
y.create.l HWIO_RPMH_VRM_ENABLE_CRS_DRV1_REG27_ADDR A:&base_addr+0x811b24
y.create.l HWIO_RPMH_VRM_ENABLE_CRS_DRV1_REG28_ADDR A:&base_addr+0x811c24
y.create.l HWIO_RPMH_VRM_ENABLE_CRS_DRV1_REG29_ADDR A:&base_addr+0x811d24
y.create.l HWIO_RPMH_VRM_ENABLE_CRS_DRV1_REG30_ADDR A:&base_addr+0x811e24
y.create.l HWIO_RPMH_VRM_ENABLE_CRS_DRV1_REG31_ADDR A:&base_addr+0x811f24
y.create.l HWIO_RPMH_VRM_ENABLE_CRS_DRV1_REG32_ADDR A:&base_addr+0x812024
y.create.l HWIO_RPMH_VRM_ENABLE_CRS_DRV1_REG33_ADDR A:&base_addr+0x812124
y.create.l HWIO_RPMH_VRM_ENABLE_CRS_DRV1_REG34_ADDR A:&base_addr+0x812224
y.create.l HWIO_RPMH_VRM_ENABLE_CRS_DRV1_REG35_ADDR A:&base_addr+0x812324
y.create.l HWIO_RPMH_VRM_ENABLE_CRS_DRV1_REG36_ADDR A:&base_addr+0x812424
y.create.l HWIO_RPMH_VRM_ENABLE_CRS_DRV1_REG37_ADDR A:&base_addr+0x812524
y.create.l HWIO_RPMH_VRM_ENABLE_CRS_DRV1_REG38_ADDR A:&base_addr+0x812624
y.create.l HWIO_RPMH_VRM_ENABLE_CRS_DRV1_REG39_ADDR A:&base_addr+0x812724
y.create.l HWIO_RPMH_VRM_ENABLE_CRS_DRV1_REG40_ADDR A:&base_addr+0x812824
y.create.l HWIO_RPMH_VRM_ENABLE_CRS_DRV1_REG41_ADDR A:&base_addr+0x812924
y.create.l HWIO_RPMH_VRM_ENABLE_CRS_DRV1_REG42_ADDR A:&base_addr+0x812a24
y.create.l HWIO_RPMH_VRM_ENABLE_CRS_DRV1_REG43_ADDR A:&base_addr+0x812b24
y.create.l HWIO_RPMH_VRM_ENABLE_CRS_DRV1_REG44_ADDR A:&base_addr+0x812c24
y.create.l HWIO_RPMH_VRM_ENABLE_CRS_DRV1_REG45_ADDR A:&base_addr+0x812d24
y.create.l HWIO_RPMH_VRM_ENABLE_CRS_DRV2_REG0_ADDR A:&base_addr+0x820024
y.create.l HWIO_RPMH_VRM_ENABLE_CRS_DRV2_REG1_ADDR A:&base_addr+0x820124
y.create.l HWIO_RPMH_VRM_ENABLE_CRS_DRV2_REG2_ADDR A:&base_addr+0x820224
y.create.l HWIO_RPMH_VRM_ENABLE_CRS_DRV2_REG3_ADDR A:&base_addr+0x820324
y.create.l HWIO_RPMH_VRM_ENABLE_CRS_DRV2_REG4_ADDR A:&base_addr+0x820424
y.create.l HWIO_RPMH_VRM_ENABLE_CRS_DRV2_REG5_ADDR A:&base_addr+0x820524
y.create.l HWIO_RPMH_VRM_ENABLE_CRS_DRV2_REG6_ADDR A:&base_addr+0x820624
y.create.l HWIO_RPMH_VRM_ENABLE_CRS_DRV2_REG7_ADDR A:&base_addr+0x820724
y.create.l HWIO_RPMH_VRM_ENABLE_CRS_DRV2_REG8_ADDR A:&base_addr+0x820824
y.create.l HWIO_RPMH_VRM_ENABLE_CRS_DRV2_REG9_ADDR A:&base_addr+0x820924
y.create.l HWIO_RPMH_VRM_ENABLE_CRS_DRV2_REG10_ADDR A:&base_addr+0x820a24
y.create.l HWIO_RPMH_VRM_ENABLE_CRS_DRV2_REG11_ADDR A:&base_addr+0x820b24
y.create.l HWIO_RPMH_VRM_ENABLE_CRS_DRV2_REG12_ADDR A:&base_addr+0x820c24
y.create.l HWIO_RPMH_VRM_ENABLE_CRS_DRV2_REG13_ADDR A:&base_addr+0x820d24
y.create.l HWIO_RPMH_VRM_ENABLE_CRS_DRV2_REG14_ADDR A:&base_addr+0x820e24
y.create.l HWIO_RPMH_VRM_ENABLE_CRS_DRV2_REG15_ADDR A:&base_addr+0x820f24
y.create.l HWIO_RPMH_VRM_ENABLE_CRS_DRV2_REG16_ADDR A:&base_addr+0x821024
y.create.l HWIO_RPMH_VRM_ENABLE_CRS_DRV2_REG17_ADDR A:&base_addr+0x821124
y.create.l HWIO_RPMH_VRM_ENABLE_CRS_DRV2_REG18_ADDR A:&base_addr+0x821224
y.create.l HWIO_RPMH_VRM_ENABLE_CRS_DRV2_REG19_ADDR A:&base_addr+0x821324
y.create.l HWIO_RPMH_VRM_ENABLE_CRS_DRV2_REG20_ADDR A:&base_addr+0x821424
y.create.l HWIO_RPMH_VRM_ENABLE_CRS_DRV2_REG21_ADDR A:&base_addr+0x821524
y.create.l HWIO_RPMH_VRM_ENABLE_CRS_DRV2_REG22_ADDR A:&base_addr+0x821624
y.create.l HWIO_RPMH_VRM_ENABLE_CRS_DRV2_REG23_ADDR A:&base_addr+0x821724
y.create.l HWIO_RPMH_VRM_ENABLE_CRS_DRV2_REG24_ADDR A:&base_addr+0x821824
y.create.l HWIO_RPMH_VRM_ENABLE_CRS_DRV2_REG25_ADDR A:&base_addr+0x821924
y.create.l HWIO_RPMH_VRM_ENABLE_CRS_DRV2_REG26_ADDR A:&base_addr+0x821a24
y.create.l HWIO_RPMH_VRM_ENABLE_CRS_DRV2_REG27_ADDR A:&base_addr+0x821b24
y.create.l HWIO_RPMH_VRM_ENABLE_CRS_DRV2_REG28_ADDR A:&base_addr+0x821c24
y.create.l HWIO_RPMH_VRM_ENABLE_CRS_DRV2_REG29_ADDR A:&base_addr+0x821d24
y.create.l HWIO_RPMH_VRM_ENABLE_CRS_DRV2_REG30_ADDR A:&base_addr+0x821e24
y.create.l HWIO_RPMH_VRM_ENABLE_CRS_DRV2_REG31_ADDR A:&base_addr+0x821f24
y.create.l HWIO_RPMH_VRM_ENABLE_CRS_DRV2_REG32_ADDR A:&base_addr+0x822024
y.create.l HWIO_RPMH_VRM_ENABLE_CRS_DRV2_REG33_ADDR A:&base_addr+0x822124
y.create.l HWIO_RPMH_VRM_ENABLE_CRS_DRV2_REG34_ADDR A:&base_addr+0x822224
y.create.l HWIO_RPMH_VRM_ENABLE_CRS_DRV2_REG35_ADDR A:&base_addr+0x822324
y.create.l HWIO_RPMH_VRM_ENABLE_CRS_DRV2_REG36_ADDR A:&base_addr+0x822424
y.create.l HWIO_RPMH_VRM_ENABLE_CRS_DRV2_REG37_ADDR A:&base_addr+0x822524
y.create.l HWIO_RPMH_VRM_ENABLE_CRS_DRV2_REG38_ADDR A:&base_addr+0x822624
y.create.l HWIO_RPMH_VRM_ENABLE_CRS_DRV2_REG39_ADDR A:&base_addr+0x822724
y.create.l HWIO_RPMH_VRM_ENABLE_CRS_DRV2_REG40_ADDR A:&base_addr+0x822824
y.create.l HWIO_RPMH_VRM_ENABLE_CRS_DRV2_REG41_ADDR A:&base_addr+0x822924
y.create.l HWIO_RPMH_VRM_ENABLE_CRS_DRV2_REG42_ADDR A:&base_addr+0x822a24
y.create.l HWIO_RPMH_VRM_ENABLE_CRS_DRV2_REG43_ADDR A:&base_addr+0x822b24
y.create.l HWIO_RPMH_VRM_ENABLE_CRS_DRV2_REG44_ADDR A:&base_addr+0x822c24
y.create.l HWIO_RPMH_VRM_ENABLE_CRS_DRV2_REG45_ADDR A:&base_addr+0x822d24
y.create.l HWIO_RPMH_VRM_ENABLE_CRS_DRV3_REG0_ADDR A:&base_addr+0x830024
y.create.l HWIO_RPMH_VRM_ENABLE_CRS_DRV3_REG1_ADDR A:&base_addr+0x830124
y.create.l HWIO_RPMH_VRM_ENABLE_CRS_DRV3_REG2_ADDR A:&base_addr+0x830224
y.create.l HWIO_RPMH_VRM_ENABLE_CRS_DRV3_REG3_ADDR A:&base_addr+0x830324
y.create.l HWIO_RPMH_VRM_ENABLE_CRS_DRV3_REG4_ADDR A:&base_addr+0x830424
y.create.l HWIO_RPMH_VRM_ENABLE_CRS_DRV3_REG5_ADDR A:&base_addr+0x830524
y.create.l HWIO_RPMH_VRM_ENABLE_CRS_DRV3_REG6_ADDR A:&base_addr+0x830624
y.create.l HWIO_RPMH_VRM_ENABLE_CRS_DRV3_REG7_ADDR A:&base_addr+0x830724
y.create.l HWIO_RPMH_VRM_ENABLE_CRS_DRV3_REG8_ADDR A:&base_addr+0x830824
y.create.l HWIO_RPMH_VRM_ENABLE_CRS_DRV3_REG9_ADDR A:&base_addr+0x830924
y.create.l HWIO_RPMH_VRM_ENABLE_CRS_DRV3_REG10_ADDR A:&base_addr+0x830a24
y.create.l HWIO_RPMH_VRM_ENABLE_CRS_DRV3_REG11_ADDR A:&base_addr+0x830b24
y.create.l HWIO_RPMH_VRM_ENABLE_CRS_DRV3_REG12_ADDR A:&base_addr+0x830c24
y.create.l HWIO_RPMH_VRM_ENABLE_CRS_DRV3_REG13_ADDR A:&base_addr+0x830d24
y.create.l HWIO_RPMH_VRM_ENABLE_CRS_DRV3_REG14_ADDR A:&base_addr+0x830e24
y.create.l HWIO_RPMH_VRM_ENABLE_CRS_DRV3_REG15_ADDR A:&base_addr+0x830f24
y.create.l HWIO_RPMH_VRM_ENABLE_CRS_DRV3_REG16_ADDR A:&base_addr+0x831024
y.create.l HWIO_RPMH_VRM_ENABLE_CRS_DRV3_REG17_ADDR A:&base_addr+0x831124
y.create.l HWIO_RPMH_VRM_ENABLE_CRS_DRV3_REG18_ADDR A:&base_addr+0x831224
y.create.l HWIO_RPMH_VRM_ENABLE_CRS_DRV3_REG19_ADDR A:&base_addr+0x831324
y.create.l HWIO_RPMH_VRM_ENABLE_CRS_DRV3_REG20_ADDR A:&base_addr+0x831424
y.create.l HWIO_RPMH_VRM_ENABLE_CRS_DRV3_REG21_ADDR A:&base_addr+0x831524
y.create.l HWIO_RPMH_VRM_ENABLE_CRS_DRV3_REG22_ADDR A:&base_addr+0x831624
y.create.l HWIO_RPMH_VRM_ENABLE_CRS_DRV3_REG23_ADDR A:&base_addr+0x831724
y.create.l HWIO_RPMH_VRM_ENABLE_CRS_DRV3_REG24_ADDR A:&base_addr+0x831824
y.create.l HWIO_RPMH_VRM_ENABLE_CRS_DRV3_REG25_ADDR A:&base_addr+0x831924
y.create.l HWIO_RPMH_VRM_ENABLE_CRS_DRV3_REG26_ADDR A:&base_addr+0x831a24
y.create.l HWIO_RPMH_VRM_ENABLE_CRS_DRV3_REG27_ADDR A:&base_addr+0x831b24
y.create.l HWIO_RPMH_VRM_ENABLE_CRS_DRV3_REG28_ADDR A:&base_addr+0x831c24
y.create.l HWIO_RPMH_VRM_ENABLE_CRS_DRV3_REG29_ADDR A:&base_addr+0x831d24
y.create.l HWIO_RPMH_VRM_ENABLE_CRS_DRV3_REG30_ADDR A:&base_addr+0x831e24
y.create.l HWIO_RPMH_VRM_ENABLE_CRS_DRV3_REG31_ADDR A:&base_addr+0x831f24
y.create.l HWIO_RPMH_VRM_ENABLE_CRS_DRV3_REG32_ADDR A:&base_addr+0x832024
y.create.l HWIO_RPMH_VRM_ENABLE_CRS_DRV3_REG33_ADDR A:&base_addr+0x832124
y.create.l HWIO_RPMH_VRM_ENABLE_CRS_DRV3_REG34_ADDR A:&base_addr+0x832224
y.create.l HWIO_RPMH_VRM_ENABLE_CRS_DRV3_REG35_ADDR A:&base_addr+0x832324
y.create.l HWIO_RPMH_VRM_ENABLE_CRS_DRV3_REG36_ADDR A:&base_addr+0x832424
y.create.l HWIO_RPMH_VRM_ENABLE_CRS_DRV3_REG37_ADDR A:&base_addr+0x832524
y.create.l HWIO_RPMH_VRM_ENABLE_CRS_DRV3_REG38_ADDR A:&base_addr+0x832624
y.create.l HWIO_RPMH_VRM_ENABLE_CRS_DRV3_REG39_ADDR A:&base_addr+0x832724
y.create.l HWIO_RPMH_VRM_ENABLE_CRS_DRV3_REG40_ADDR A:&base_addr+0x832824
y.create.l HWIO_RPMH_VRM_ENABLE_CRS_DRV3_REG41_ADDR A:&base_addr+0x832924
y.create.l HWIO_RPMH_VRM_ENABLE_CRS_DRV3_REG42_ADDR A:&base_addr+0x832a24
y.create.l HWIO_RPMH_VRM_ENABLE_CRS_DRV3_REG43_ADDR A:&base_addr+0x832b24
y.create.l HWIO_RPMH_VRM_ENABLE_CRS_DRV3_REG44_ADDR A:&base_addr+0x832c24
y.create.l HWIO_RPMH_VRM_ENABLE_CRS_DRV3_REG45_ADDR A:&base_addr+0x832d24
y.create.l HWIO_RPMH_VRM_ENABLE_CRS_DRV4_REG0_ADDR A:&base_addr+0x840024
y.create.l HWIO_RPMH_VRM_ENABLE_CRS_DRV4_REG1_ADDR A:&base_addr+0x840124
y.create.l HWIO_RPMH_VRM_ENABLE_CRS_DRV4_REG2_ADDR A:&base_addr+0x840224
y.create.l HWIO_RPMH_VRM_ENABLE_CRS_DRV4_REG3_ADDR A:&base_addr+0x840324
y.create.l HWIO_RPMH_VRM_ENABLE_CRS_DRV4_REG4_ADDR A:&base_addr+0x840424
y.create.l HWIO_RPMH_VRM_ENABLE_CRS_DRV4_REG5_ADDR A:&base_addr+0x840524
y.create.l HWIO_RPMH_VRM_ENABLE_CRS_DRV4_REG6_ADDR A:&base_addr+0x840624
y.create.l HWIO_RPMH_VRM_ENABLE_CRS_DRV4_REG7_ADDR A:&base_addr+0x840724
y.create.l HWIO_RPMH_VRM_ENABLE_CRS_DRV4_REG8_ADDR A:&base_addr+0x840824
y.create.l HWIO_RPMH_VRM_ENABLE_CRS_DRV4_REG9_ADDR A:&base_addr+0x840924
y.create.l HWIO_RPMH_VRM_ENABLE_CRS_DRV4_REG10_ADDR A:&base_addr+0x840a24
y.create.l HWIO_RPMH_VRM_ENABLE_CRS_DRV4_REG11_ADDR A:&base_addr+0x840b24
y.create.l HWIO_RPMH_VRM_ENABLE_CRS_DRV4_REG12_ADDR A:&base_addr+0x840c24
y.create.l HWIO_RPMH_VRM_ENABLE_CRS_DRV4_REG13_ADDR A:&base_addr+0x840d24
y.create.l HWIO_RPMH_VRM_ENABLE_CRS_DRV4_REG14_ADDR A:&base_addr+0x840e24
y.create.l HWIO_RPMH_VRM_ENABLE_CRS_DRV4_REG15_ADDR A:&base_addr+0x840f24
y.create.l HWIO_RPMH_VRM_ENABLE_CRS_DRV4_REG16_ADDR A:&base_addr+0x841024
y.create.l HWIO_RPMH_VRM_ENABLE_CRS_DRV4_REG17_ADDR A:&base_addr+0x841124
y.create.l HWIO_RPMH_VRM_ENABLE_CRS_DRV4_REG18_ADDR A:&base_addr+0x841224
y.create.l HWIO_RPMH_VRM_ENABLE_CRS_DRV4_REG19_ADDR A:&base_addr+0x841324
y.create.l HWIO_RPMH_VRM_ENABLE_CRS_DRV4_REG20_ADDR A:&base_addr+0x841424
y.create.l HWIO_RPMH_VRM_ENABLE_CRS_DRV4_REG21_ADDR A:&base_addr+0x841524
y.create.l HWIO_RPMH_VRM_ENABLE_CRS_DRV4_REG22_ADDR A:&base_addr+0x841624
y.create.l HWIO_RPMH_VRM_ENABLE_CRS_DRV4_REG23_ADDR A:&base_addr+0x841724
y.create.l HWIO_RPMH_VRM_ENABLE_CRS_DRV4_REG24_ADDR A:&base_addr+0x841824
y.create.l HWIO_RPMH_VRM_ENABLE_CRS_DRV4_REG25_ADDR A:&base_addr+0x841924
y.create.l HWIO_RPMH_VRM_ENABLE_CRS_DRV4_REG26_ADDR A:&base_addr+0x841a24
y.create.l HWIO_RPMH_VRM_ENABLE_CRS_DRV4_REG27_ADDR A:&base_addr+0x841b24
y.create.l HWIO_RPMH_VRM_ENABLE_CRS_DRV4_REG28_ADDR A:&base_addr+0x841c24
y.create.l HWIO_RPMH_VRM_ENABLE_CRS_DRV4_REG29_ADDR A:&base_addr+0x841d24
y.create.l HWIO_RPMH_VRM_ENABLE_CRS_DRV4_REG30_ADDR A:&base_addr+0x841e24
y.create.l HWIO_RPMH_VRM_ENABLE_CRS_DRV4_REG31_ADDR A:&base_addr+0x841f24
y.create.l HWIO_RPMH_VRM_ENABLE_CRS_DRV4_REG32_ADDR A:&base_addr+0x842024
y.create.l HWIO_RPMH_VRM_ENABLE_CRS_DRV4_REG33_ADDR A:&base_addr+0x842124
y.create.l HWIO_RPMH_VRM_ENABLE_CRS_DRV4_REG34_ADDR A:&base_addr+0x842224
y.create.l HWIO_RPMH_VRM_ENABLE_CRS_DRV4_REG35_ADDR A:&base_addr+0x842324
y.create.l HWIO_RPMH_VRM_ENABLE_CRS_DRV4_REG36_ADDR A:&base_addr+0x842424
y.create.l HWIO_RPMH_VRM_ENABLE_CRS_DRV4_REG37_ADDR A:&base_addr+0x842524
y.create.l HWIO_RPMH_VRM_ENABLE_CRS_DRV4_REG38_ADDR A:&base_addr+0x842624
y.create.l HWIO_RPMH_VRM_ENABLE_CRS_DRV4_REG39_ADDR A:&base_addr+0x842724
y.create.l HWIO_RPMH_VRM_ENABLE_CRS_DRV4_REG40_ADDR A:&base_addr+0x842824
y.create.l HWIO_RPMH_VRM_ENABLE_CRS_DRV4_REG41_ADDR A:&base_addr+0x842924
y.create.l HWIO_RPMH_VRM_ENABLE_CRS_DRV4_REG42_ADDR A:&base_addr+0x842a24
y.create.l HWIO_RPMH_VRM_ENABLE_CRS_DRV4_REG43_ADDR A:&base_addr+0x842b24
y.create.l HWIO_RPMH_VRM_ENABLE_CRS_DRV4_REG44_ADDR A:&base_addr+0x842c24
y.create.l HWIO_RPMH_VRM_ENABLE_CRS_DRV4_REG45_ADDR A:&base_addr+0x842d24
y.create.l HWIO_RPMH_VRM_ENABLE_CRS_DRV5_REG0_ADDR A:&base_addr+0x850024
y.create.l HWIO_RPMH_VRM_ENABLE_CRS_DRV5_REG1_ADDR A:&base_addr+0x850124
y.create.l HWIO_RPMH_VRM_ENABLE_CRS_DRV5_REG2_ADDR A:&base_addr+0x850224
y.create.l HWIO_RPMH_VRM_ENABLE_CRS_DRV5_REG3_ADDR A:&base_addr+0x850324
y.create.l HWIO_RPMH_VRM_ENABLE_CRS_DRV5_REG4_ADDR A:&base_addr+0x850424
y.create.l HWIO_RPMH_VRM_ENABLE_CRS_DRV5_REG5_ADDR A:&base_addr+0x850524
y.create.l HWIO_RPMH_VRM_ENABLE_CRS_DRV5_REG6_ADDR A:&base_addr+0x850624
y.create.l HWIO_RPMH_VRM_ENABLE_CRS_DRV5_REG7_ADDR A:&base_addr+0x850724
y.create.l HWIO_RPMH_VRM_ENABLE_CRS_DRV5_REG8_ADDR A:&base_addr+0x850824
y.create.l HWIO_RPMH_VRM_ENABLE_CRS_DRV5_REG9_ADDR A:&base_addr+0x850924
y.create.l HWIO_RPMH_VRM_ENABLE_CRS_DRV5_REG10_ADDR A:&base_addr+0x850a24
y.create.l HWIO_RPMH_VRM_ENABLE_CRS_DRV5_REG11_ADDR A:&base_addr+0x850b24
y.create.l HWIO_RPMH_VRM_ENABLE_CRS_DRV5_REG12_ADDR A:&base_addr+0x850c24
y.create.l HWIO_RPMH_VRM_ENABLE_CRS_DRV5_REG13_ADDR A:&base_addr+0x850d24
y.create.l HWIO_RPMH_VRM_ENABLE_CRS_DRV5_REG14_ADDR A:&base_addr+0x850e24
y.create.l HWIO_RPMH_VRM_ENABLE_CRS_DRV5_REG15_ADDR A:&base_addr+0x850f24
y.create.l HWIO_RPMH_VRM_ENABLE_CRS_DRV5_REG16_ADDR A:&base_addr+0x851024
y.create.l HWIO_RPMH_VRM_ENABLE_CRS_DRV5_REG17_ADDR A:&base_addr+0x851124
y.create.l HWIO_RPMH_VRM_ENABLE_CRS_DRV5_REG18_ADDR A:&base_addr+0x851224
y.create.l HWIO_RPMH_VRM_ENABLE_CRS_DRV5_REG19_ADDR A:&base_addr+0x851324
y.create.l HWIO_RPMH_VRM_ENABLE_CRS_DRV5_REG20_ADDR A:&base_addr+0x851424
y.create.l HWIO_RPMH_VRM_ENABLE_CRS_DRV5_REG21_ADDR A:&base_addr+0x851524
y.create.l HWIO_RPMH_VRM_ENABLE_CRS_DRV5_REG22_ADDR A:&base_addr+0x851624
y.create.l HWIO_RPMH_VRM_ENABLE_CRS_DRV5_REG23_ADDR A:&base_addr+0x851724
y.create.l HWIO_RPMH_VRM_ENABLE_CRS_DRV5_REG24_ADDR A:&base_addr+0x851824
y.create.l HWIO_RPMH_VRM_ENABLE_CRS_DRV5_REG25_ADDR A:&base_addr+0x851924
y.create.l HWIO_RPMH_VRM_ENABLE_CRS_DRV5_REG26_ADDR A:&base_addr+0x851a24
y.create.l HWIO_RPMH_VRM_ENABLE_CRS_DRV5_REG27_ADDR A:&base_addr+0x851b24
y.create.l HWIO_RPMH_VRM_ENABLE_CRS_DRV5_REG28_ADDR A:&base_addr+0x851c24
y.create.l HWIO_RPMH_VRM_ENABLE_CRS_DRV5_REG29_ADDR A:&base_addr+0x851d24
y.create.l HWIO_RPMH_VRM_ENABLE_CRS_DRV5_REG30_ADDR A:&base_addr+0x851e24
y.create.l HWIO_RPMH_VRM_ENABLE_CRS_DRV5_REG31_ADDR A:&base_addr+0x851f24
y.create.l HWIO_RPMH_VRM_ENABLE_CRS_DRV5_REG32_ADDR A:&base_addr+0x852024
y.create.l HWIO_RPMH_VRM_ENABLE_CRS_DRV5_REG33_ADDR A:&base_addr+0x852124
y.create.l HWIO_RPMH_VRM_ENABLE_CRS_DRV5_REG34_ADDR A:&base_addr+0x852224
y.create.l HWIO_RPMH_VRM_ENABLE_CRS_DRV5_REG35_ADDR A:&base_addr+0x852324
y.create.l HWIO_RPMH_VRM_ENABLE_CRS_DRV5_REG36_ADDR A:&base_addr+0x852424
y.create.l HWIO_RPMH_VRM_ENABLE_CRS_DRV5_REG37_ADDR A:&base_addr+0x852524
y.create.l HWIO_RPMH_VRM_ENABLE_CRS_DRV5_REG38_ADDR A:&base_addr+0x852624
y.create.l HWIO_RPMH_VRM_ENABLE_CRS_DRV5_REG39_ADDR A:&base_addr+0x852724
y.create.l HWIO_RPMH_VRM_ENABLE_CRS_DRV5_REG40_ADDR A:&base_addr+0x852824
y.create.l HWIO_RPMH_VRM_ENABLE_CRS_DRV5_REG41_ADDR A:&base_addr+0x852924
y.create.l HWIO_RPMH_VRM_ENABLE_CRS_DRV5_REG42_ADDR A:&base_addr+0x852a24
y.create.l HWIO_RPMH_VRM_ENABLE_CRS_DRV5_REG43_ADDR A:&base_addr+0x852b24
y.create.l HWIO_RPMH_VRM_ENABLE_CRS_DRV5_REG44_ADDR A:&base_addr+0x852c24
y.create.l HWIO_RPMH_VRM_ENABLE_CRS_DRV5_REG45_ADDR A:&base_addr+0x852d24
y.create.l HWIO_RPMH_VRM_ENABLE_CRS_DRV6_REG0_ADDR A:&base_addr+0x860024
y.create.l HWIO_RPMH_VRM_ENABLE_CRS_DRV6_REG1_ADDR A:&base_addr+0x860124
y.create.l HWIO_RPMH_VRM_ENABLE_CRS_DRV6_REG2_ADDR A:&base_addr+0x860224
y.create.l HWIO_RPMH_VRM_ENABLE_CRS_DRV6_REG3_ADDR A:&base_addr+0x860324
y.create.l HWIO_RPMH_VRM_ENABLE_CRS_DRV6_REG4_ADDR A:&base_addr+0x860424
y.create.l HWIO_RPMH_VRM_ENABLE_CRS_DRV6_REG5_ADDR A:&base_addr+0x860524
y.create.l HWIO_RPMH_VRM_ENABLE_CRS_DRV6_REG6_ADDR A:&base_addr+0x860624
y.create.l HWIO_RPMH_VRM_ENABLE_CRS_DRV6_REG7_ADDR A:&base_addr+0x860724
y.create.l HWIO_RPMH_VRM_ENABLE_CRS_DRV6_REG8_ADDR A:&base_addr+0x860824
y.create.l HWIO_RPMH_VRM_ENABLE_CRS_DRV6_REG9_ADDR A:&base_addr+0x860924
y.create.l HWIO_RPMH_VRM_ENABLE_CRS_DRV6_REG10_ADDR A:&base_addr+0x860a24
y.create.l HWIO_RPMH_VRM_ENABLE_CRS_DRV6_REG11_ADDR A:&base_addr+0x860b24
y.create.l HWIO_RPMH_VRM_ENABLE_CRS_DRV6_REG12_ADDR A:&base_addr+0x860c24
y.create.l HWIO_RPMH_VRM_ENABLE_CRS_DRV6_REG13_ADDR A:&base_addr+0x860d24
y.create.l HWIO_RPMH_VRM_ENABLE_CRS_DRV6_REG14_ADDR A:&base_addr+0x860e24
y.create.l HWIO_RPMH_VRM_ENABLE_CRS_DRV6_REG15_ADDR A:&base_addr+0x860f24
y.create.l HWIO_RPMH_VRM_ENABLE_CRS_DRV6_REG16_ADDR A:&base_addr+0x861024
y.create.l HWIO_RPMH_VRM_ENABLE_CRS_DRV6_REG17_ADDR A:&base_addr+0x861124
y.create.l HWIO_RPMH_VRM_ENABLE_CRS_DRV6_REG18_ADDR A:&base_addr+0x861224
y.create.l HWIO_RPMH_VRM_ENABLE_CRS_DRV6_REG19_ADDR A:&base_addr+0x861324
y.create.l HWIO_RPMH_VRM_ENABLE_CRS_DRV6_REG20_ADDR A:&base_addr+0x861424
y.create.l HWIO_RPMH_VRM_ENABLE_CRS_DRV6_REG21_ADDR A:&base_addr+0x861524
y.create.l HWIO_RPMH_VRM_ENABLE_CRS_DRV6_REG22_ADDR A:&base_addr+0x861624
y.create.l HWIO_RPMH_VRM_ENABLE_CRS_DRV6_REG23_ADDR A:&base_addr+0x861724
y.create.l HWIO_RPMH_VRM_ENABLE_CRS_DRV6_REG24_ADDR A:&base_addr+0x861824
y.create.l HWIO_RPMH_VRM_ENABLE_CRS_DRV6_REG25_ADDR A:&base_addr+0x861924
y.create.l HWIO_RPMH_VRM_ENABLE_CRS_DRV6_REG26_ADDR A:&base_addr+0x861a24
y.create.l HWIO_RPMH_VRM_ENABLE_CRS_DRV6_REG27_ADDR A:&base_addr+0x861b24
y.create.l HWIO_RPMH_VRM_ENABLE_CRS_DRV6_REG28_ADDR A:&base_addr+0x861c24
y.create.l HWIO_RPMH_VRM_ENABLE_CRS_DRV6_REG29_ADDR A:&base_addr+0x861d24
y.create.l HWIO_RPMH_VRM_ENABLE_CRS_DRV6_REG30_ADDR A:&base_addr+0x861e24
y.create.l HWIO_RPMH_VRM_ENABLE_CRS_DRV6_REG31_ADDR A:&base_addr+0x861f24
y.create.l HWIO_RPMH_VRM_ENABLE_CRS_DRV6_REG32_ADDR A:&base_addr+0x862024
y.create.l HWIO_RPMH_VRM_ENABLE_CRS_DRV6_REG33_ADDR A:&base_addr+0x862124
y.create.l HWIO_RPMH_VRM_ENABLE_CRS_DRV6_REG34_ADDR A:&base_addr+0x862224
y.create.l HWIO_RPMH_VRM_ENABLE_CRS_DRV6_REG35_ADDR A:&base_addr+0x862324
y.create.l HWIO_RPMH_VRM_ENABLE_CRS_DRV6_REG36_ADDR A:&base_addr+0x862424
y.create.l HWIO_RPMH_VRM_ENABLE_CRS_DRV6_REG37_ADDR A:&base_addr+0x862524
y.create.l HWIO_RPMH_VRM_ENABLE_CRS_DRV6_REG38_ADDR A:&base_addr+0x862624
y.create.l HWIO_RPMH_VRM_ENABLE_CRS_DRV6_REG39_ADDR A:&base_addr+0x862724
y.create.l HWIO_RPMH_VRM_ENABLE_CRS_DRV6_REG40_ADDR A:&base_addr+0x862824
y.create.l HWIO_RPMH_VRM_ENABLE_CRS_DRV6_REG41_ADDR A:&base_addr+0x862924
y.create.l HWIO_RPMH_VRM_ENABLE_CRS_DRV6_REG42_ADDR A:&base_addr+0x862a24
y.create.l HWIO_RPMH_VRM_ENABLE_CRS_DRV6_REG43_ADDR A:&base_addr+0x862b24
y.create.l HWIO_RPMH_VRM_ENABLE_CRS_DRV6_REG44_ADDR A:&base_addr+0x862c24
y.create.l HWIO_RPMH_VRM_ENABLE_CRS_DRV6_REG45_ADDR A:&base_addr+0x862d24
y.create.l HWIO_RPMH_VRM_ENABLE_CRS_DRV7_REG0_ADDR A:&base_addr+0x870024
y.create.l HWIO_RPMH_VRM_ENABLE_CRS_DRV7_REG1_ADDR A:&base_addr+0x870124
y.create.l HWIO_RPMH_VRM_ENABLE_CRS_DRV7_REG2_ADDR A:&base_addr+0x870224
y.create.l HWIO_RPMH_VRM_ENABLE_CRS_DRV7_REG3_ADDR A:&base_addr+0x870324
y.create.l HWIO_RPMH_VRM_ENABLE_CRS_DRV7_REG4_ADDR A:&base_addr+0x870424
y.create.l HWIO_RPMH_VRM_ENABLE_CRS_DRV7_REG5_ADDR A:&base_addr+0x870524
y.create.l HWIO_RPMH_VRM_ENABLE_CRS_DRV7_REG6_ADDR A:&base_addr+0x870624
y.create.l HWIO_RPMH_VRM_ENABLE_CRS_DRV7_REG7_ADDR A:&base_addr+0x870724
y.create.l HWIO_RPMH_VRM_ENABLE_CRS_DRV7_REG8_ADDR A:&base_addr+0x870824
y.create.l HWIO_RPMH_VRM_ENABLE_CRS_DRV7_REG9_ADDR A:&base_addr+0x870924
y.create.l HWIO_RPMH_VRM_ENABLE_CRS_DRV7_REG10_ADDR A:&base_addr+0x870a24
y.create.l HWIO_RPMH_VRM_ENABLE_CRS_DRV7_REG11_ADDR A:&base_addr+0x870b24
y.create.l HWIO_RPMH_VRM_ENABLE_CRS_DRV7_REG12_ADDR A:&base_addr+0x870c24
y.create.l HWIO_RPMH_VRM_ENABLE_CRS_DRV7_REG13_ADDR A:&base_addr+0x870d24
y.create.l HWIO_RPMH_VRM_ENABLE_CRS_DRV7_REG14_ADDR A:&base_addr+0x870e24
y.create.l HWIO_RPMH_VRM_ENABLE_CRS_DRV7_REG15_ADDR A:&base_addr+0x870f24
y.create.l HWIO_RPMH_VRM_ENABLE_CRS_DRV7_REG16_ADDR A:&base_addr+0x871024
y.create.l HWIO_RPMH_VRM_ENABLE_CRS_DRV7_REG17_ADDR A:&base_addr+0x871124
y.create.l HWIO_RPMH_VRM_ENABLE_CRS_DRV7_REG18_ADDR A:&base_addr+0x871224
y.create.l HWIO_RPMH_VRM_ENABLE_CRS_DRV7_REG19_ADDR A:&base_addr+0x871324
y.create.l HWIO_RPMH_VRM_ENABLE_CRS_DRV7_REG20_ADDR A:&base_addr+0x871424
y.create.l HWIO_RPMH_VRM_ENABLE_CRS_DRV7_REG21_ADDR A:&base_addr+0x871524
y.create.l HWIO_RPMH_VRM_ENABLE_CRS_DRV7_REG22_ADDR A:&base_addr+0x871624
y.create.l HWIO_RPMH_VRM_ENABLE_CRS_DRV7_REG23_ADDR A:&base_addr+0x871724
y.create.l HWIO_RPMH_VRM_ENABLE_CRS_DRV7_REG24_ADDR A:&base_addr+0x871824
y.create.l HWIO_RPMH_VRM_ENABLE_CRS_DRV7_REG25_ADDR A:&base_addr+0x871924
y.create.l HWIO_RPMH_VRM_ENABLE_CRS_DRV7_REG26_ADDR A:&base_addr+0x871a24
y.create.l HWIO_RPMH_VRM_ENABLE_CRS_DRV7_REG27_ADDR A:&base_addr+0x871b24
y.create.l HWIO_RPMH_VRM_ENABLE_CRS_DRV7_REG28_ADDR A:&base_addr+0x871c24
y.create.l HWIO_RPMH_VRM_ENABLE_CRS_DRV7_REG29_ADDR A:&base_addr+0x871d24
y.create.l HWIO_RPMH_VRM_ENABLE_CRS_DRV7_REG30_ADDR A:&base_addr+0x871e24
y.create.l HWIO_RPMH_VRM_ENABLE_CRS_DRV7_REG31_ADDR A:&base_addr+0x871f24
y.create.l HWIO_RPMH_VRM_ENABLE_CRS_DRV7_REG32_ADDR A:&base_addr+0x872024
y.create.l HWIO_RPMH_VRM_ENABLE_CRS_DRV7_REG33_ADDR A:&base_addr+0x872124
y.create.l HWIO_RPMH_VRM_ENABLE_CRS_DRV7_REG34_ADDR A:&base_addr+0x872224
y.create.l HWIO_RPMH_VRM_ENABLE_CRS_DRV7_REG35_ADDR A:&base_addr+0x872324
y.create.l HWIO_RPMH_VRM_ENABLE_CRS_DRV7_REG36_ADDR A:&base_addr+0x872424
y.create.l HWIO_RPMH_VRM_ENABLE_CRS_DRV7_REG37_ADDR A:&base_addr+0x872524
y.create.l HWIO_RPMH_VRM_ENABLE_CRS_DRV7_REG38_ADDR A:&base_addr+0x872624
y.create.l HWIO_RPMH_VRM_ENABLE_CRS_DRV7_REG39_ADDR A:&base_addr+0x872724
y.create.l HWIO_RPMH_VRM_ENABLE_CRS_DRV7_REG40_ADDR A:&base_addr+0x872824
y.create.l HWIO_RPMH_VRM_ENABLE_CRS_DRV7_REG41_ADDR A:&base_addr+0x872924
y.create.l HWIO_RPMH_VRM_ENABLE_CRS_DRV7_REG42_ADDR A:&base_addr+0x872a24
y.create.l HWIO_RPMH_VRM_ENABLE_CRS_DRV7_REG43_ADDR A:&base_addr+0x872b24
y.create.l HWIO_RPMH_VRM_ENABLE_CRS_DRV7_REG44_ADDR A:&base_addr+0x872c24
y.create.l HWIO_RPMH_VRM_ENABLE_CRS_DRV7_REG45_ADDR A:&base_addr+0x872d24
y.create.l HWIO_RPMH_VRM_ENABLE_CRS_DRV8_REG0_ADDR A:&base_addr+0x880024
y.create.l HWIO_RPMH_VRM_ENABLE_CRS_DRV8_REG1_ADDR A:&base_addr+0x880124
y.create.l HWIO_RPMH_VRM_ENABLE_CRS_DRV8_REG2_ADDR A:&base_addr+0x880224
y.create.l HWIO_RPMH_VRM_ENABLE_CRS_DRV8_REG3_ADDR A:&base_addr+0x880324
y.create.l HWIO_RPMH_VRM_ENABLE_CRS_DRV8_REG4_ADDR A:&base_addr+0x880424
y.create.l HWIO_RPMH_VRM_ENABLE_CRS_DRV8_REG5_ADDR A:&base_addr+0x880524
y.create.l HWIO_RPMH_VRM_ENABLE_CRS_DRV8_REG6_ADDR A:&base_addr+0x880624
y.create.l HWIO_RPMH_VRM_ENABLE_CRS_DRV8_REG7_ADDR A:&base_addr+0x880724
y.create.l HWIO_RPMH_VRM_ENABLE_CRS_DRV8_REG8_ADDR A:&base_addr+0x880824
y.create.l HWIO_RPMH_VRM_ENABLE_CRS_DRV8_REG9_ADDR A:&base_addr+0x880924
y.create.l HWIO_RPMH_VRM_ENABLE_CRS_DRV8_REG10_ADDR A:&base_addr+0x880a24
y.create.l HWIO_RPMH_VRM_ENABLE_CRS_DRV8_REG11_ADDR A:&base_addr+0x880b24
y.create.l HWIO_RPMH_VRM_ENABLE_CRS_DRV8_REG12_ADDR A:&base_addr+0x880c24
y.create.l HWIO_RPMH_VRM_ENABLE_CRS_DRV8_REG13_ADDR A:&base_addr+0x880d24
y.create.l HWIO_RPMH_VRM_ENABLE_CRS_DRV8_REG14_ADDR A:&base_addr+0x880e24
y.create.l HWIO_RPMH_VRM_ENABLE_CRS_DRV8_REG15_ADDR A:&base_addr+0x880f24
y.create.l HWIO_RPMH_VRM_ENABLE_CRS_DRV8_REG16_ADDR A:&base_addr+0x881024
y.create.l HWIO_RPMH_VRM_ENABLE_CRS_DRV8_REG17_ADDR A:&base_addr+0x881124
y.create.l HWIO_RPMH_VRM_ENABLE_CRS_DRV8_REG18_ADDR A:&base_addr+0x881224
y.create.l HWIO_RPMH_VRM_ENABLE_CRS_DRV8_REG19_ADDR A:&base_addr+0x881324
y.create.l HWIO_RPMH_VRM_ENABLE_CRS_DRV8_REG20_ADDR A:&base_addr+0x881424
y.create.l HWIO_RPMH_VRM_ENABLE_CRS_DRV8_REG21_ADDR A:&base_addr+0x881524
y.create.l HWIO_RPMH_VRM_ENABLE_CRS_DRV8_REG22_ADDR A:&base_addr+0x881624
y.create.l HWIO_RPMH_VRM_ENABLE_CRS_DRV8_REG23_ADDR A:&base_addr+0x881724
y.create.l HWIO_RPMH_VRM_ENABLE_CRS_DRV8_REG24_ADDR A:&base_addr+0x881824
y.create.l HWIO_RPMH_VRM_ENABLE_CRS_DRV8_REG25_ADDR A:&base_addr+0x881924
y.create.l HWIO_RPMH_VRM_ENABLE_CRS_DRV8_REG26_ADDR A:&base_addr+0x881a24
y.create.l HWIO_RPMH_VRM_ENABLE_CRS_DRV8_REG27_ADDR A:&base_addr+0x881b24
y.create.l HWIO_RPMH_VRM_ENABLE_CRS_DRV8_REG28_ADDR A:&base_addr+0x881c24
y.create.l HWIO_RPMH_VRM_ENABLE_CRS_DRV8_REG29_ADDR A:&base_addr+0x881d24
y.create.l HWIO_RPMH_VRM_ENABLE_CRS_DRV8_REG30_ADDR A:&base_addr+0x881e24
y.create.l HWIO_RPMH_VRM_ENABLE_CRS_DRV8_REG31_ADDR A:&base_addr+0x881f24
y.create.l HWIO_RPMH_VRM_ENABLE_CRS_DRV8_REG32_ADDR A:&base_addr+0x882024
y.create.l HWIO_RPMH_VRM_ENABLE_CRS_DRV8_REG33_ADDR A:&base_addr+0x882124
y.create.l HWIO_RPMH_VRM_ENABLE_CRS_DRV8_REG34_ADDR A:&base_addr+0x882224
y.create.l HWIO_RPMH_VRM_ENABLE_CRS_DRV8_REG35_ADDR A:&base_addr+0x882324
y.create.l HWIO_RPMH_VRM_ENABLE_CRS_DRV8_REG36_ADDR A:&base_addr+0x882424
y.create.l HWIO_RPMH_VRM_ENABLE_CRS_DRV8_REG37_ADDR A:&base_addr+0x882524
y.create.l HWIO_RPMH_VRM_ENABLE_CRS_DRV8_REG38_ADDR A:&base_addr+0x882624
y.create.l HWIO_RPMH_VRM_ENABLE_CRS_DRV8_REG39_ADDR A:&base_addr+0x882724
y.create.l HWIO_RPMH_VRM_ENABLE_CRS_DRV8_REG40_ADDR A:&base_addr+0x882824
y.create.l HWIO_RPMH_VRM_ENABLE_CRS_DRV8_REG41_ADDR A:&base_addr+0x882924
y.create.l HWIO_RPMH_VRM_ENABLE_CRS_DRV8_REG42_ADDR A:&base_addr+0x882a24
y.create.l HWIO_RPMH_VRM_ENABLE_CRS_DRV8_REG43_ADDR A:&base_addr+0x882b24
y.create.l HWIO_RPMH_VRM_ENABLE_CRS_DRV8_REG44_ADDR A:&base_addr+0x882c24
y.create.l HWIO_RPMH_VRM_ENABLE_CRS_DRV8_REG45_ADDR A:&base_addr+0x882d24
y.create.l HWIO_RPMH_VRM_ENABLE_CRS_DRV9_REG0_ADDR A:&base_addr+0x890024
y.create.l HWIO_RPMH_VRM_ENABLE_CRS_DRV9_REG1_ADDR A:&base_addr+0x890124
y.create.l HWIO_RPMH_VRM_ENABLE_CRS_DRV9_REG2_ADDR A:&base_addr+0x890224
y.create.l HWIO_RPMH_VRM_ENABLE_CRS_DRV9_REG3_ADDR A:&base_addr+0x890324
y.create.l HWIO_RPMH_VRM_ENABLE_CRS_DRV9_REG4_ADDR A:&base_addr+0x890424
y.create.l HWIO_RPMH_VRM_ENABLE_CRS_DRV9_REG5_ADDR A:&base_addr+0x890524
y.create.l HWIO_RPMH_VRM_ENABLE_CRS_DRV9_REG6_ADDR A:&base_addr+0x890624
y.create.l HWIO_RPMH_VRM_ENABLE_CRS_DRV9_REG7_ADDR A:&base_addr+0x890724
y.create.l HWIO_RPMH_VRM_ENABLE_CRS_DRV9_REG8_ADDR A:&base_addr+0x890824
y.create.l HWIO_RPMH_VRM_ENABLE_CRS_DRV9_REG9_ADDR A:&base_addr+0x890924
y.create.l HWIO_RPMH_VRM_ENABLE_CRS_DRV9_REG10_ADDR A:&base_addr+0x890a24
y.create.l HWIO_RPMH_VRM_ENABLE_CRS_DRV9_REG11_ADDR A:&base_addr+0x890b24
y.create.l HWIO_RPMH_VRM_ENABLE_CRS_DRV9_REG12_ADDR A:&base_addr+0x890c24
y.create.l HWIO_RPMH_VRM_ENABLE_CRS_DRV9_REG13_ADDR A:&base_addr+0x890d24
y.create.l HWIO_RPMH_VRM_ENABLE_CRS_DRV9_REG14_ADDR A:&base_addr+0x890e24
y.create.l HWIO_RPMH_VRM_ENABLE_CRS_DRV9_REG15_ADDR A:&base_addr+0x890f24
y.create.l HWIO_RPMH_VRM_ENABLE_CRS_DRV9_REG16_ADDR A:&base_addr+0x891024
y.create.l HWIO_RPMH_VRM_ENABLE_CRS_DRV9_REG17_ADDR A:&base_addr+0x891124
y.create.l HWIO_RPMH_VRM_ENABLE_CRS_DRV9_REG18_ADDR A:&base_addr+0x891224
y.create.l HWIO_RPMH_VRM_ENABLE_CRS_DRV9_REG19_ADDR A:&base_addr+0x891324
y.create.l HWIO_RPMH_VRM_ENABLE_CRS_DRV9_REG20_ADDR A:&base_addr+0x891424
y.create.l HWIO_RPMH_VRM_ENABLE_CRS_DRV9_REG21_ADDR A:&base_addr+0x891524
y.create.l HWIO_RPMH_VRM_ENABLE_CRS_DRV9_REG22_ADDR A:&base_addr+0x891624
y.create.l HWIO_RPMH_VRM_ENABLE_CRS_DRV9_REG23_ADDR A:&base_addr+0x891724
y.create.l HWIO_RPMH_VRM_ENABLE_CRS_DRV9_REG24_ADDR A:&base_addr+0x891824
y.create.l HWIO_RPMH_VRM_ENABLE_CRS_DRV9_REG25_ADDR A:&base_addr+0x891924
y.create.l HWIO_RPMH_VRM_ENABLE_CRS_DRV9_REG26_ADDR A:&base_addr+0x891a24
y.create.l HWIO_RPMH_VRM_ENABLE_CRS_DRV9_REG27_ADDR A:&base_addr+0x891b24
y.create.l HWIO_RPMH_VRM_ENABLE_CRS_DRV9_REG28_ADDR A:&base_addr+0x891c24
y.create.l HWIO_RPMH_VRM_ENABLE_CRS_DRV9_REG29_ADDR A:&base_addr+0x891d24
y.create.l HWIO_RPMH_VRM_ENABLE_CRS_DRV9_REG30_ADDR A:&base_addr+0x891e24
y.create.l HWIO_RPMH_VRM_ENABLE_CRS_DRV9_REG31_ADDR A:&base_addr+0x891f24
y.create.l HWIO_RPMH_VRM_ENABLE_CRS_DRV9_REG32_ADDR A:&base_addr+0x892024
y.create.l HWIO_RPMH_VRM_ENABLE_CRS_DRV9_REG33_ADDR A:&base_addr+0x892124
y.create.l HWIO_RPMH_VRM_ENABLE_CRS_DRV9_REG34_ADDR A:&base_addr+0x892224
y.create.l HWIO_RPMH_VRM_ENABLE_CRS_DRV9_REG35_ADDR A:&base_addr+0x892324
y.create.l HWIO_RPMH_VRM_ENABLE_CRS_DRV9_REG36_ADDR A:&base_addr+0x892424
y.create.l HWIO_RPMH_VRM_ENABLE_CRS_DRV9_REG37_ADDR A:&base_addr+0x892524
y.create.l HWIO_RPMH_VRM_ENABLE_CRS_DRV9_REG38_ADDR A:&base_addr+0x892624
y.create.l HWIO_RPMH_VRM_ENABLE_CRS_DRV9_REG39_ADDR A:&base_addr+0x892724
y.create.l HWIO_RPMH_VRM_ENABLE_CRS_DRV9_REG40_ADDR A:&base_addr+0x892824
y.create.l HWIO_RPMH_VRM_ENABLE_CRS_DRV9_REG41_ADDR A:&base_addr+0x892924
y.create.l HWIO_RPMH_VRM_ENABLE_CRS_DRV9_REG42_ADDR A:&base_addr+0x892a24
y.create.l HWIO_RPMH_VRM_ENABLE_CRS_DRV9_REG43_ADDR A:&base_addr+0x892b24
y.create.l HWIO_RPMH_VRM_ENABLE_CRS_DRV9_REG44_ADDR A:&base_addr+0x892c24
y.create.l HWIO_RPMH_VRM_ENABLE_CRS_DRV9_REG45_ADDR A:&base_addr+0x892d24
y.create.l HWIO_RPMH_VRM_ENABLE_CRS_DRV10_REG0_ADDR A:&base_addr+0x8a0024
y.create.l HWIO_RPMH_VRM_ENABLE_CRS_DRV10_REG1_ADDR A:&base_addr+0x8a0124
y.create.l HWIO_RPMH_VRM_ENABLE_CRS_DRV10_REG2_ADDR A:&base_addr+0x8a0224
y.create.l HWIO_RPMH_VRM_ENABLE_CRS_DRV10_REG3_ADDR A:&base_addr+0x8a0324
y.create.l HWIO_RPMH_VRM_ENABLE_CRS_DRV10_REG4_ADDR A:&base_addr+0x8a0424
y.create.l HWIO_RPMH_VRM_ENABLE_CRS_DRV10_REG5_ADDR A:&base_addr+0x8a0524
y.create.l HWIO_RPMH_VRM_ENABLE_CRS_DRV10_REG6_ADDR A:&base_addr+0x8a0624
y.create.l HWIO_RPMH_VRM_ENABLE_CRS_DRV10_REG7_ADDR A:&base_addr+0x8a0724
y.create.l HWIO_RPMH_VRM_ENABLE_CRS_DRV10_REG8_ADDR A:&base_addr+0x8a0824
y.create.l HWIO_RPMH_VRM_ENABLE_CRS_DRV10_REG9_ADDR A:&base_addr+0x8a0924
y.create.l HWIO_RPMH_VRM_ENABLE_CRS_DRV10_REG10_ADDR A:&base_addr+0x8a0a24
y.create.l HWIO_RPMH_VRM_ENABLE_CRS_DRV10_REG11_ADDR A:&base_addr+0x8a0b24
y.create.l HWIO_RPMH_VRM_ENABLE_CRS_DRV10_REG12_ADDR A:&base_addr+0x8a0c24
y.create.l HWIO_RPMH_VRM_ENABLE_CRS_DRV10_REG13_ADDR A:&base_addr+0x8a0d24
y.create.l HWIO_RPMH_VRM_ENABLE_CRS_DRV10_REG14_ADDR A:&base_addr+0x8a0e24
y.create.l HWIO_RPMH_VRM_ENABLE_CRS_DRV10_REG15_ADDR A:&base_addr+0x8a0f24
y.create.l HWIO_RPMH_VRM_ENABLE_CRS_DRV10_REG16_ADDR A:&base_addr+0x8a1024
y.create.l HWIO_RPMH_VRM_ENABLE_CRS_DRV10_REG17_ADDR A:&base_addr+0x8a1124
y.create.l HWIO_RPMH_VRM_ENABLE_CRS_DRV10_REG18_ADDR A:&base_addr+0x8a1224
y.create.l HWIO_RPMH_VRM_ENABLE_CRS_DRV10_REG19_ADDR A:&base_addr+0x8a1324
y.create.l HWIO_RPMH_VRM_ENABLE_CRS_DRV10_REG20_ADDR A:&base_addr+0x8a1424
y.create.l HWIO_RPMH_VRM_ENABLE_CRS_DRV10_REG21_ADDR A:&base_addr+0x8a1524
y.create.l HWIO_RPMH_VRM_ENABLE_CRS_DRV10_REG22_ADDR A:&base_addr+0x8a1624
y.create.l HWIO_RPMH_VRM_ENABLE_CRS_DRV10_REG23_ADDR A:&base_addr+0x8a1724
y.create.l HWIO_RPMH_VRM_ENABLE_CRS_DRV10_REG24_ADDR A:&base_addr+0x8a1824
y.create.l HWIO_RPMH_VRM_ENABLE_CRS_DRV10_REG25_ADDR A:&base_addr+0x8a1924
y.create.l HWIO_RPMH_VRM_ENABLE_CRS_DRV10_REG26_ADDR A:&base_addr+0x8a1a24
y.create.l HWIO_RPMH_VRM_ENABLE_CRS_DRV10_REG27_ADDR A:&base_addr+0x8a1b24
y.create.l HWIO_RPMH_VRM_ENABLE_CRS_DRV10_REG28_ADDR A:&base_addr+0x8a1c24
y.create.l HWIO_RPMH_VRM_ENABLE_CRS_DRV10_REG29_ADDR A:&base_addr+0x8a1d24
y.create.l HWIO_RPMH_VRM_ENABLE_CRS_DRV10_REG30_ADDR A:&base_addr+0x8a1e24
y.create.l HWIO_RPMH_VRM_ENABLE_CRS_DRV10_REG31_ADDR A:&base_addr+0x8a1f24
y.create.l HWIO_RPMH_VRM_ENABLE_CRS_DRV10_REG32_ADDR A:&base_addr+0x8a2024
y.create.l HWIO_RPMH_VRM_ENABLE_CRS_DRV10_REG33_ADDR A:&base_addr+0x8a2124
y.create.l HWIO_RPMH_VRM_ENABLE_CRS_DRV10_REG34_ADDR A:&base_addr+0x8a2224
y.create.l HWIO_RPMH_VRM_ENABLE_CRS_DRV10_REG35_ADDR A:&base_addr+0x8a2324
y.create.l HWIO_RPMH_VRM_ENABLE_CRS_DRV10_REG36_ADDR A:&base_addr+0x8a2424
y.create.l HWIO_RPMH_VRM_ENABLE_CRS_DRV10_REG37_ADDR A:&base_addr+0x8a2524
y.create.l HWIO_RPMH_VRM_ENABLE_CRS_DRV10_REG38_ADDR A:&base_addr+0x8a2624
y.create.l HWIO_RPMH_VRM_ENABLE_CRS_DRV10_REG39_ADDR A:&base_addr+0x8a2724
y.create.l HWIO_RPMH_VRM_ENABLE_CRS_DRV10_REG40_ADDR A:&base_addr+0x8a2824
y.create.l HWIO_RPMH_VRM_ENABLE_CRS_DRV10_REG41_ADDR A:&base_addr+0x8a2924
y.create.l HWIO_RPMH_VRM_ENABLE_CRS_DRV10_REG42_ADDR A:&base_addr+0x8a2a24
y.create.l HWIO_RPMH_VRM_ENABLE_CRS_DRV10_REG43_ADDR A:&base_addr+0x8a2b24
y.create.l HWIO_RPMH_VRM_ENABLE_CRS_DRV10_REG44_ADDR A:&base_addr+0x8a2c24
y.create.l HWIO_RPMH_VRM_ENABLE_CRS_DRV10_REG45_ADDR A:&base_addr+0x8a2d24
y.create.l HWIO_RPMH_VRM_ENABLE_CRS_DRV11_REG0_ADDR A:&base_addr+0x8b0024
y.create.l HWIO_RPMH_VRM_ENABLE_CRS_DRV11_REG1_ADDR A:&base_addr+0x8b0124
y.create.l HWIO_RPMH_VRM_ENABLE_CRS_DRV11_REG2_ADDR A:&base_addr+0x8b0224
y.create.l HWIO_RPMH_VRM_ENABLE_CRS_DRV11_REG3_ADDR A:&base_addr+0x8b0324
y.create.l HWIO_RPMH_VRM_ENABLE_CRS_DRV11_REG4_ADDR A:&base_addr+0x8b0424
y.create.l HWIO_RPMH_VRM_ENABLE_CRS_DRV11_REG5_ADDR A:&base_addr+0x8b0524
y.create.l HWIO_RPMH_VRM_ENABLE_CRS_DRV11_REG6_ADDR A:&base_addr+0x8b0624
y.create.l HWIO_RPMH_VRM_ENABLE_CRS_DRV11_REG7_ADDR A:&base_addr+0x8b0724
y.create.l HWIO_RPMH_VRM_ENABLE_CRS_DRV11_REG8_ADDR A:&base_addr+0x8b0824
y.create.l HWIO_RPMH_VRM_ENABLE_CRS_DRV11_REG9_ADDR A:&base_addr+0x8b0924
y.create.l HWIO_RPMH_VRM_ENABLE_CRS_DRV11_REG10_ADDR A:&base_addr+0x8b0a24
y.create.l HWIO_RPMH_VRM_ENABLE_CRS_DRV11_REG11_ADDR A:&base_addr+0x8b0b24
y.create.l HWIO_RPMH_VRM_ENABLE_CRS_DRV11_REG12_ADDR A:&base_addr+0x8b0c24
y.create.l HWIO_RPMH_VRM_ENABLE_CRS_DRV11_REG13_ADDR A:&base_addr+0x8b0d24
y.create.l HWIO_RPMH_VRM_ENABLE_CRS_DRV11_REG14_ADDR A:&base_addr+0x8b0e24
y.create.l HWIO_RPMH_VRM_ENABLE_CRS_DRV11_REG15_ADDR A:&base_addr+0x8b0f24
y.create.l HWIO_RPMH_VRM_ENABLE_CRS_DRV11_REG16_ADDR A:&base_addr+0x8b1024
y.create.l HWIO_RPMH_VRM_ENABLE_CRS_DRV11_REG17_ADDR A:&base_addr+0x8b1124
y.create.l HWIO_RPMH_VRM_ENABLE_CRS_DRV11_REG18_ADDR A:&base_addr+0x8b1224
y.create.l HWIO_RPMH_VRM_ENABLE_CRS_DRV11_REG19_ADDR A:&base_addr+0x8b1324
y.create.l HWIO_RPMH_VRM_ENABLE_CRS_DRV11_REG20_ADDR A:&base_addr+0x8b1424
y.create.l HWIO_RPMH_VRM_ENABLE_CRS_DRV11_REG21_ADDR A:&base_addr+0x8b1524
y.create.l HWIO_RPMH_VRM_ENABLE_CRS_DRV11_REG22_ADDR A:&base_addr+0x8b1624
y.create.l HWIO_RPMH_VRM_ENABLE_CRS_DRV11_REG23_ADDR A:&base_addr+0x8b1724
y.create.l HWIO_RPMH_VRM_ENABLE_CRS_DRV11_REG24_ADDR A:&base_addr+0x8b1824
y.create.l HWIO_RPMH_VRM_ENABLE_CRS_DRV11_REG25_ADDR A:&base_addr+0x8b1924
y.create.l HWIO_RPMH_VRM_ENABLE_CRS_DRV11_REG26_ADDR A:&base_addr+0x8b1a24
y.create.l HWIO_RPMH_VRM_ENABLE_CRS_DRV11_REG27_ADDR A:&base_addr+0x8b1b24
y.create.l HWIO_RPMH_VRM_ENABLE_CRS_DRV11_REG28_ADDR A:&base_addr+0x8b1c24
y.create.l HWIO_RPMH_VRM_ENABLE_CRS_DRV11_REG29_ADDR A:&base_addr+0x8b1d24
y.create.l HWIO_RPMH_VRM_ENABLE_CRS_DRV11_REG30_ADDR A:&base_addr+0x8b1e24
y.create.l HWIO_RPMH_VRM_ENABLE_CRS_DRV11_REG31_ADDR A:&base_addr+0x8b1f24
y.create.l HWIO_RPMH_VRM_ENABLE_CRS_DRV11_REG32_ADDR A:&base_addr+0x8b2024
y.create.l HWIO_RPMH_VRM_ENABLE_CRS_DRV11_REG33_ADDR A:&base_addr+0x8b2124
y.create.l HWIO_RPMH_VRM_ENABLE_CRS_DRV11_REG34_ADDR A:&base_addr+0x8b2224
y.create.l HWIO_RPMH_VRM_ENABLE_CRS_DRV11_REG35_ADDR A:&base_addr+0x8b2324
y.create.l HWIO_RPMH_VRM_ENABLE_CRS_DRV11_REG36_ADDR A:&base_addr+0x8b2424
y.create.l HWIO_RPMH_VRM_ENABLE_CRS_DRV11_REG37_ADDR A:&base_addr+0x8b2524
y.create.l HWIO_RPMH_VRM_ENABLE_CRS_DRV11_REG38_ADDR A:&base_addr+0x8b2624
y.create.l HWIO_RPMH_VRM_ENABLE_CRS_DRV11_REG39_ADDR A:&base_addr+0x8b2724
y.create.l HWIO_RPMH_VRM_ENABLE_CRS_DRV11_REG40_ADDR A:&base_addr+0x8b2824
y.create.l HWIO_RPMH_VRM_ENABLE_CRS_DRV11_REG41_ADDR A:&base_addr+0x8b2924
y.create.l HWIO_RPMH_VRM_ENABLE_CRS_DRV11_REG42_ADDR A:&base_addr+0x8b2a24
y.create.l HWIO_RPMH_VRM_ENABLE_CRS_DRV11_REG43_ADDR A:&base_addr+0x8b2b24
y.create.l HWIO_RPMH_VRM_ENABLE_CRS_DRV11_REG44_ADDR A:&base_addr+0x8b2c24
y.create.l HWIO_RPMH_VRM_ENABLE_CRS_DRV11_REG45_ADDR A:&base_addr+0x8b2d24
y.create.l HWIO_RPMH_VRM_ENABLE_CRS_DRV12_REG0_ADDR A:&base_addr+0x8c0024
y.create.l HWIO_RPMH_VRM_ENABLE_CRS_DRV12_REG1_ADDR A:&base_addr+0x8c0124
y.create.l HWIO_RPMH_VRM_ENABLE_CRS_DRV12_REG2_ADDR A:&base_addr+0x8c0224
y.create.l HWIO_RPMH_VRM_ENABLE_CRS_DRV12_REG3_ADDR A:&base_addr+0x8c0324
y.create.l HWIO_RPMH_VRM_ENABLE_CRS_DRV12_REG4_ADDR A:&base_addr+0x8c0424
y.create.l HWIO_RPMH_VRM_ENABLE_CRS_DRV12_REG5_ADDR A:&base_addr+0x8c0524
y.create.l HWIO_RPMH_VRM_ENABLE_CRS_DRV12_REG6_ADDR A:&base_addr+0x8c0624
y.create.l HWIO_RPMH_VRM_ENABLE_CRS_DRV12_REG7_ADDR A:&base_addr+0x8c0724
y.create.l HWIO_RPMH_VRM_ENABLE_CRS_DRV12_REG8_ADDR A:&base_addr+0x8c0824
y.create.l HWIO_RPMH_VRM_ENABLE_CRS_DRV12_REG9_ADDR A:&base_addr+0x8c0924
y.create.l HWIO_RPMH_VRM_ENABLE_CRS_DRV12_REG10_ADDR A:&base_addr+0x8c0a24
y.create.l HWIO_RPMH_VRM_ENABLE_CRS_DRV12_REG11_ADDR A:&base_addr+0x8c0b24
y.create.l HWIO_RPMH_VRM_ENABLE_CRS_DRV12_REG12_ADDR A:&base_addr+0x8c0c24
y.create.l HWIO_RPMH_VRM_ENABLE_CRS_DRV12_REG13_ADDR A:&base_addr+0x8c0d24
y.create.l HWIO_RPMH_VRM_ENABLE_CRS_DRV12_REG14_ADDR A:&base_addr+0x8c0e24
y.create.l HWIO_RPMH_VRM_ENABLE_CRS_DRV12_REG15_ADDR A:&base_addr+0x8c0f24
y.create.l HWIO_RPMH_VRM_ENABLE_CRS_DRV12_REG16_ADDR A:&base_addr+0x8c1024
y.create.l HWIO_RPMH_VRM_ENABLE_CRS_DRV12_REG17_ADDR A:&base_addr+0x8c1124
y.create.l HWIO_RPMH_VRM_ENABLE_CRS_DRV12_REG18_ADDR A:&base_addr+0x8c1224
y.create.l HWIO_RPMH_VRM_ENABLE_CRS_DRV12_REG19_ADDR A:&base_addr+0x8c1324
y.create.l HWIO_RPMH_VRM_ENABLE_CRS_DRV12_REG20_ADDR A:&base_addr+0x8c1424
y.create.l HWIO_RPMH_VRM_ENABLE_CRS_DRV12_REG21_ADDR A:&base_addr+0x8c1524
y.create.l HWIO_RPMH_VRM_ENABLE_CRS_DRV12_REG22_ADDR A:&base_addr+0x8c1624
y.create.l HWIO_RPMH_VRM_ENABLE_CRS_DRV12_REG23_ADDR A:&base_addr+0x8c1724
y.create.l HWIO_RPMH_VRM_ENABLE_CRS_DRV12_REG24_ADDR A:&base_addr+0x8c1824
y.create.l HWIO_RPMH_VRM_ENABLE_CRS_DRV12_REG25_ADDR A:&base_addr+0x8c1924
y.create.l HWIO_RPMH_VRM_ENABLE_CRS_DRV12_REG26_ADDR A:&base_addr+0x8c1a24
y.create.l HWIO_RPMH_VRM_ENABLE_CRS_DRV12_REG27_ADDR A:&base_addr+0x8c1b24
y.create.l HWIO_RPMH_VRM_ENABLE_CRS_DRV12_REG28_ADDR A:&base_addr+0x8c1c24
y.create.l HWIO_RPMH_VRM_ENABLE_CRS_DRV12_REG29_ADDR A:&base_addr+0x8c1d24
y.create.l HWIO_RPMH_VRM_ENABLE_CRS_DRV12_REG30_ADDR A:&base_addr+0x8c1e24
y.create.l HWIO_RPMH_VRM_ENABLE_CRS_DRV12_REG31_ADDR A:&base_addr+0x8c1f24
y.create.l HWIO_RPMH_VRM_ENABLE_CRS_DRV12_REG32_ADDR A:&base_addr+0x8c2024
y.create.l HWIO_RPMH_VRM_ENABLE_CRS_DRV12_REG33_ADDR A:&base_addr+0x8c2124
y.create.l HWIO_RPMH_VRM_ENABLE_CRS_DRV12_REG34_ADDR A:&base_addr+0x8c2224
y.create.l HWIO_RPMH_VRM_ENABLE_CRS_DRV12_REG35_ADDR A:&base_addr+0x8c2324
y.create.l HWIO_RPMH_VRM_ENABLE_CRS_DRV12_REG36_ADDR A:&base_addr+0x8c2424
y.create.l HWIO_RPMH_VRM_ENABLE_CRS_DRV12_REG37_ADDR A:&base_addr+0x8c2524
y.create.l HWIO_RPMH_VRM_ENABLE_CRS_DRV12_REG38_ADDR A:&base_addr+0x8c2624
y.create.l HWIO_RPMH_VRM_ENABLE_CRS_DRV12_REG39_ADDR A:&base_addr+0x8c2724
y.create.l HWIO_RPMH_VRM_ENABLE_CRS_DRV12_REG40_ADDR A:&base_addr+0x8c2824
y.create.l HWIO_RPMH_VRM_ENABLE_CRS_DRV12_REG41_ADDR A:&base_addr+0x8c2924
y.create.l HWIO_RPMH_VRM_ENABLE_CRS_DRV12_REG42_ADDR A:&base_addr+0x8c2a24
y.create.l HWIO_RPMH_VRM_ENABLE_CRS_DRV12_REG43_ADDR A:&base_addr+0x8c2b24
y.create.l HWIO_RPMH_VRM_ENABLE_CRS_DRV12_REG44_ADDR A:&base_addr+0x8c2c24
y.create.l HWIO_RPMH_VRM_ENABLE_CRS_DRV12_REG45_ADDR A:&base_addr+0x8c2d24
y.create.l HWIO_RPMH_VRM_ENABLE_CRS_DRV13_REG0_ADDR A:&base_addr+0x8d0024
y.create.l HWIO_RPMH_VRM_ENABLE_CRS_DRV13_REG1_ADDR A:&base_addr+0x8d0124
y.create.l HWIO_RPMH_VRM_ENABLE_CRS_DRV13_REG2_ADDR A:&base_addr+0x8d0224
y.create.l HWIO_RPMH_VRM_ENABLE_CRS_DRV13_REG3_ADDR A:&base_addr+0x8d0324
y.create.l HWIO_RPMH_VRM_ENABLE_CRS_DRV13_REG4_ADDR A:&base_addr+0x8d0424
y.create.l HWIO_RPMH_VRM_ENABLE_CRS_DRV13_REG5_ADDR A:&base_addr+0x8d0524
y.create.l HWIO_RPMH_VRM_ENABLE_CRS_DRV13_REG6_ADDR A:&base_addr+0x8d0624
y.create.l HWIO_RPMH_VRM_ENABLE_CRS_DRV13_REG7_ADDR A:&base_addr+0x8d0724
y.create.l HWIO_RPMH_VRM_ENABLE_CRS_DRV13_REG8_ADDR A:&base_addr+0x8d0824
y.create.l HWIO_RPMH_VRM_ENABLE_CRS_DRV13_REG9_ADDR A:&base_addr+0x8d0924
y.create.l HWIO_RPMH_VRM_ENABLE_CRS_DRV13_REG10_ADDR A:&base_addr+0x8d0a24
y.create.l HWIO_RPMH_VRM_ENABLE_CRS_DRV13_REG11_ADDR A:&base_addr+0x8d0b24
y.create.l HWIO_RPMH_VRM_ENABLE_CRS_DRV13_REG12_ADDR A:&base_addr+0x8d0c24
y.create.l HWIO_RPMH_VRM_ENABLE_CRS_DRV13_REG13_ADDR A:&base_addr+0x8d0d24
y.create.l HWIO_RPMH_VRM_ENABLE_CRS_DRV13_REG14_ADDR A:&base_addr+0x8d0e24
y.create.l HWIO_RPMH_VRM_ENABLE_CRS_DRV13_REG15_ADDR A:&base_addr+0x8d0f24
y.create.l HWIO_RPMH_VRM_ENABLE_CRS_DRV13_REG16_ADDR A:&base_addr+0x8d1024
y.create.l HWIO_RPMH_VRM_ENABLE_CRS_DRV13_REG17_ADDR A:&base_addr+0x8d1124
y.create.l HWIO_RPMH_VRM_ENABLE_CRS_DRV13_REG18_ADDR A:&base_addr+0x8d1224
y.create.l HWIO_RPMH_VRM_ENABLE_CRS_DRV13_REG19_ADDR A:&base_addr+0x8d1324
y.create.l HWIO_RPMH_VRM_ENABLE_CRS_DRV13_REG20_ADDR A:&base_addr+0x8d1424
y.create.l HWIO_RPMH_VRM_ENABLE_CRS_DRV13_REG21_ADDR A:&base_addr+0x8d1524
y.create.l HWIO_RPMH_VRM_ENABLE_CRS_DRV13_REG22_ADDR A:&base_addr+0x8d1624
y.create.l HWIO_RPMH_VRM_ENABLE_CRS_DRV13_REG23_ADDR A:&base_addr+0x8d1724
y.create.l HWIO_RPMH_VRM_ENABLE_CRS_DRV13_REG24_ADDR A:&base_addr+0x8d1824
y.create.l HWIO_RPMH_VRM_ENABLE_CRS_DRV13_REG25_ADDR A:&base_addr+0x8d1924
y.create.l HWIO_RPMH_VRM_ENABLE_CRS_DRV13_REG26_ADDR A:&base_addr+0x8d1a24
y.create.l HWIO_RPMH_VRM_ENABLE_CRS_DRV13_REG27_ADDR A:&base_addr+0x8d1b24
y.create.l HWIO_RPMH_VRM_ENABLE_CRS_DRV13_REG28_ADDR A:&base_addr+0x8d1c24
y.create.l HWIO_RPMH_VRM_ENABLE_CRS_DRV13_REG29_ADDR A:&base_addr+0x8d1d24
y.create.l HWIO_RPMH_VRM_ENABLE_CRS_DRV13_REG30_ADDR A:&base_addr+0x8d1e24
y.create.l HWIO_RPMH_VRM_ENABLE_CRS_DRV13_REG31_ADDR A:&base_addr+0x8d1f24
y.create.l HWIO_RPMH_VRM_ENABLE_CRS_DRV13_REG32_ADDR A:&base_addr+0x8d2024
y.create.l HWIO_RPMH_VRM_ENABLE_CRS_DRV13_REG33_ADDR A:&base_addr+0x8d2124
y.create.l HWIO_RPMH_VRM_ENABLE_CRS_DRV13_REG34_ADDR A:&base_addr+0x8d2224
y.create.l HWIO_RPMH_VRM_ENABLE_CRS_DRV13_REG35_ADDR A:&base_addr+0x8d2324
y.create.l HWIO_RPMH_VRM_ENABLE_CRS_DRV13_REG36_ADDR A:&base_addr+0x8d2424
y.create.l HWIO_RPMH_VRM_ENABLE_CRS_DRV13_REG37_ADDR A:&base_addr+0x8d2524
y.create.l HWIO_RPMH_VRM_ENABLE_CRS_DRV13_REG38_ADDR A:&base_addr+0x8d2624
y.create.l HWIO_RPMH_VRM_ENABLE_CRS_DRV13_REG39_ADDR A:&base_addr+0x8d2724
y.create.l HWIO_RPMH_VRM_ENABLE_CRS_DRV13_REG40_ADDR A:&base_addr+0x8d2824
y.create.l HWIO_RPMH_VRM_ENABLE_CRS_DRV13_REG41_ADDR A:&base_addr+0x8d2924
y.create.l HWIO_RPMH_VRM_ENABLE_CRS_DRV13_REG42_ADDR A:&base_addr+0x8d2a24
y.create.l HWIO_RPMH_VRM_ENABLE_CRS_DRV13_REG43_ADDR A:&base_addr+0x8d2b24
y.create.l HWIO_RPMH_VRM_ENABLE_CRS_DRV13_REG44_ADDR A:&base_addr+0x8d2c24
y.create.l HWIO_RPMH_VRM_ENABLE_CRS_DRV13_REG45_ADDR A:&base_addr+0x8d2d24
y.create.l HWIO_RPMH_VRM_ENABLE_CRS_DRV14_REG0_ADDR A:&base_addr+0x8e0024
y.create.l HWIO_RPMH_VRM_ENABLE_CRS_DRV14_REG1_ADDR A:&base_addr+0x8e0124
y.create.l HWIO_RPMH_VRM_ENABLE_CRS_DRV14_REG2_ADDR A:&base_addr+0x8e0224
y.create.l HWIO_RPMH_VRM_ENABLE_CRS_DRV14_REG3_ADDR A:&base_addr+0x8e0324
y.create.l HWIO_RPMH_VRM_ENABLE_CRS_DRV14_REG4_ADDR A:&base_addr+0x8e0424
y.create.l HWIO_RPMH_VRM_ENABLE_CRS_DRV14_REG5_ADDR A:&base_addr+0x8e0524
y.create.l HWIO_RPMH_VRM_ENABLE_CRS_DRV14_REG6_ADDR A:&base_addr+0x8e0624
y.create.l HWIO_RPMH_VRM_ENABLE_CRS_DRV14_REG7_ADDR A:&base_addr+0x8e0724
y.create.l HWIO_RPMH_VRM_ENABLE_CRS_DRV14_REG8_ADDR A:&base_addr+0x8e0824
y.create.l HWIO_RPMH_VRM_ENABLE_CRS_DRV14_REG9_ADDR A:&base_addr+0x8e0924
y.create.l HWIO_RPMH_VRM_ENABLE_CRS_DRV14_REG10_ADDR A:&base_addr+0x8e0a24
y.create.l HWIO_RPMH_VRM_ENABLE_CRS_DRV14_REG11_ADDR A:&base_addr+0x8e0b24
y.create.l HWIO_RPMH_VRM_ENABLE_CRS_DRV14_REG12_ADDR A:&base_addr+0x8e0c24
y.create.l HWIO_RPMH_VRM_ENABLE_CRS_DRV14_REG13_ADDR A:&base_addr+0x8e0d24
y.create.l HWIO_RPMH_VRM_ENABLE_CRS_DRV14_REG14_ADDR A:&base_addr+0x8e0e24
y.create.l HWIO_RPMH_VRM_ENABLE_CRS_DRV14_REG15_ADDR A:&base_addr+0x8e0f24
y.create.l HWIO_RPMH_VRM_ENABLE_CRS_DRV14_REG16_ADDR A:&base_addr+0x8e1024
y.create.l HWIO_RPMH_VRM_ENABLE_CRS_DRV14_REG17_ADDR A:&base_addr+0x8e1124
y.create.l HWIO_RPMH_VRM_ENABLE_CRS_DRV14_REG18_ADDR A:&base_addr+0x8e1224
y.create.l HWIO_RPMH_VRM_ENABLE_CRS_DRV14_REG19_ADDR A:&base_addr+0x8e1324
y.create.l HWIO_RPMH_VRM_ENABLE_CRS_DRV14_REG20_ADDR A:&base_addr+0x8e1424
y.create.l HWIO_RPMH_VRM_ENABLE_CRS_DRV14_REG21_ADDR A:&base_addr+0x8e1524
y.create.l HWIO_RPMH_VRM_ENABLE_CRS_DRV14_REG22_ADDR A:&base_addr+0x8e1624
y.create.l HWIO_RPMH_VRM_ENABLE_CRS_DRV14_REG23_ADDR A:&base_addr+0x8e1724
y.create.l HWIO_RPMH_VRM_ENABLE_CRS_DRV14_REG24_ADDR A:&base_addr+0x8e1824
y.create.l HWIO_RPMH_VRM_ENABLE_CRS_DRV14_REG25_ADDR A:&base_addr+0x8e1924
y.create.l HWIO_RPMH_VRM_ENABLE_CRS_DRV14_REG26_ADDR A:&base_addr+0x8e1a24
y.create.l HWIO_RPMH_VRM_ENABLE_CRS_DRV14_REG27_ADDR A:&base_addr+0x8e1b24
y.create.l HWIO_RPMH_VRM_ENABLE_CRS_DRV14_REG28_ADDR A:&base_addr+0x8e1c24
y.create.l HWIO_RPMH_VRM_ENABLE_CRS_DRV14_REG29_ADDR A:&base_addr+0x8e1d24
y.create.l HWIO_RPMH_VRM_ENABLE_CRS_DRV14_REG30_ADDR A:&base_addr+0x8e1e24
y.create.l HWIO_RPMH_VRM_ENABLE_CRS_DRV14_REG31_ADDR A:&base_addr+0x8e1f24
y.create.l HWIO_RPMH_VRM_ENABLE_CRS_DRV14_REG32_ADDR A:&base_addr+0x8e2024
y.create.l HWIO_RPMH_VRM_ENABLE_CRS_DRV14_REG33_ADDR A:&base_addr+0x8e2124
y.create.l HWIO_RPMH_VRM_ENABLE_CRS_DRV14_REG34_ADDR A:&base_addr+0x8e2224
y.create.l HWIO_RPMH_VRM_ENABLE_CRS_DRV14_REG35_ADDR A:&base_addr+0x8e2324
y.create.l HWIO_RPMH_VRM_ENABLE_CRS_DRV14_REG36_ADDR A:&base_addr+0x8e2424
y.create.l HWIO_RPMH_VRM_ENABLE_CRS_DRV14_REG37_ADDR A:&base_addr+0x8e2524
y.create.l HWIO_RPMH_VRM_ENABLE_CRS_DRV14_REG38_ADDR A:&base_addr+0x8e2624
y.create.l HWIO_RPMH_VRM_ENABLE_CRS_DRV14_REG39_ADDR A:&base_addr+0x8e2724
y.create.l HWIO_RPMH_VRM_ENABLE_CRS_DRV14_REG40_ADDR A:&base_addr+0x8e2824
y.create.l HWIO_RPMH_VRM_ENABLE_CRS_DRV14_REG41_ADDR A:&base_addr+0x8e2924
y.create.l HWIO_RPMH_VRM_ENABLE_CRS_DRV14_REG42_ADDR A:&base_addr+0x8e2a24
y.create.l HWIO_RPMH_VRM_ENABLE_CRS_DRV14_REG43_ADDR A:&base_addr+0x8e2b24
y.create.l HWIO_RPMH_VRM_ENABLE_CRS_DRV14_REG44_ADDR A:&base_addr+0x8e2c24
y.create.l HWIO_RPMH_VRM_ENABLE_CRS_DRV14_REG45_ADDR A:&base_addr+0x8e2d24
y.create.l HWIO_RPMH_VRM_MODE_CRS_DRV0_REG0_ADDR A:&base_addr+0x800028
y.create.l HWIO_RPMH_VRM_MODE_CRS_DRV0_REG1_ADDR A:&base_addr+0x800128
y.create.l HWIO_RPMH_VRM_MODE_CRS_DRV0_REG2_ADDR A:&base_addr+0x800228
y.create.l HWIO_RPMH_VRM_MODE_CRS_DRV0_REG3_ADDR A:&base_addr+0x800328
y.create.l HWIO_RPMH_VRM_MODE_CRS_DRV0_REG4_ADDR A:&base_addr+0x800428
y.create.l HWIO_RPMH_VRM_MODE_CRS_DRV0_REG5_ADDR A:&base_addr+0x800528
y.create.l HWIO_RPMH_VRM_MODE_CRS_DRV0_REG6_ADDR A:&base_addr+0x800628
y.create.l HWIO_RPMH_VRM_MODE_CRS_DRV0_REG7_ADDR A:&base_addr+0x800728
y.create.l HWIO_RPMH_VRM_MODE_CRS_DRV0_REG8_ADDR A:&base_addr+0x800828
y.create.l HWIO_RPMH_VRM_MODE_CRS_DRV0_REG9_ADDR A:&base_addr+0x800928
y.create.l HWIO_RPMH_VRM_MODE_CRS_DRV0_REG10_ADDR A:&base_addr+0x800a28
y.create.l HWIO_RPMH_VRM_MODE_CRS_DRV0_REG11_ADDR A:&base_addr+0x800b28
y.create.l HWIO_RPMH_VRM_MODE_CRS_DRV0_REG12_ADDR A:&base_addr+0x800c28
y.create.l HWIO_RPMH_VRM_MODE_CRS_DRV0_REG13_ADDR A:&base_addr+0x800d28
y.create.l HWIO_RPMH_VRM_MODE_CRS_DRV0_REG14_ADDR A:&base_addr+0x800e28
y.create.l HWIO_RPMH_VRM_MODE_CRS_DRV0_REG15_ADDR A:&base_addr+0x800f28
y.create.l HWIO_RPMH_VRM_MODE_CRS_DRV0_REG16_ADDR A:&base_addr+0x801028
y.create.l HWIO_RPMH_VRM_MODE_CRS_DRV0_REG17_ADDR A:&base_addr+0x801128
y.create.l HWIO_RPMH_VRM_MODE_CRS_DRV0_REG18_ADDR A:&base_addr+0x801228
y.create.l HWIO_RPMH_VRM_MODE_CRS_DRV0_REG19_ADDR A:&base_addr+0x801328
y.create.l HWIO_RPMH_VRM_MODE_CRS_DRV0_REG20_ADDR A:&base_addr+0x801428
y.create.l HWIO_RPMH_VRM_MODE_CRS_DRV0_REG21_ADDR A:&base_addr+0x801528
y.create.l HWIO_RPMH_VRM_MODE_CRS_DRV0_REG22_ADDR A:&base_addr+0x801628
y.create.l HWIO_RPMH_VRM_MODE_CRS_DRV0_REG23_ADDR A:&base_addr+0x801728
y.create.l HWIO_RPMH_VRM_MODE_CRS_DRV0_REG24_ADDR A:&base_addr+0x801828
y.create.l HWIO_RPMH_VRM_MODE_CRS_DRV0_REG25_ADDR A:&base_addr+0x801928
y.create.l HWIO_RPMH_VRM_MODE_CRS_DRV0_REG26_ADDR A:&base_addr+0x801a28
y.create.l HWIO_RPMH_VRM_MODE_CRS_DRV0_REG27_ADDR A:&base_addr+0x801b28
y.create.l HWIO_RPMH_VRM_MODE_CRS_DRV0_REG28_ADDR A:&base_addr+0x801c28
y.create.l HWIO_RPMH_VRM_MODE_CRS_DRV0_REG29_ADDR A:&base_addr+0x801d28
y.create.l HWIO_RPMH_VRM_MODE_CRS_DRV0_REG30_ADDR A:&base_addr+0x801e28
y.create.l HWIO_RPMH_VRM_MODE_CRS_DRV0_REG31_ADDR A:&base_addr+0x801f28
y.create.l HWIO_RPMH_VRM_MODE_CRS_DRV0_REG32_ADDR A:&base_addr+0x802028
y.create.l HWIO_RPMH_VRM_MODE_CRS_DRV0_REG33_ADDR A:&base_addr+0x802128
y.create.l HWIO_RPMH_VRM_MODE_CRS_DRV0_REG34_ADDR A:&base_addr+0x802228
y.create.l HWIO_RPMH_VRM_MODE_CRS_DRV0_REG35_ADDR A:&base_addr+0x802328
y.create.l HWIO_RPMH_VRM_MODE_CRS_DRV0_REG36_ADDR A:&base_addr+0x802428
y.create.l HWIO_RPMH_VRM_MODE_CRS_DRV0_REG37_ADDR A:&base_addr+0x802528
y.create.l HWIO_RPMH_VRM_MODE_CRS_DRV0_REG38_ADDR A:&base_addr+0x802628
y.create.l HWIO_RPMH_VRM_MODE_CRS_DRV0_REG39_ADDR A:&base_addr+0x802728
y.create.l HWIO_RPMH_VRM_MODE_CRS_DRV0_REG40_ADDR A:&base_addr+0x802828
y.create.l HWIO_RPMH_VRM_MODE_CRS_DRV0_REG41_ADDR A:&base_addr+0x802928
y.create.l HWIO_RPMH_VRM_MODE_CRS_DRV0_REG42_ADDR A:&base_addr+0x802a28
y.create.l HWIO_RPMH_VRM_MODE_CRS_DRV0_REG43_ADDR A:&base_addr+0x802b28
y.create.l HWIO_RPMH_VRM_MODE_CRS_DRV0_REG44_ADDR A:&base_addr+0x802c28
y.create.l HWIO_RPMH_VRM_MODE_CRS_DRV0_REG45_ADDR A:&base_addr+0x802d28
y.create.l HWIO_RPMH_VRM_MODE_CRS_DRV1_REG0_ADDR A:&base_addr+0x810028
y.create.l HWIO_RPMH_VRM_MODE_CRS_DRV1_REG1_ADDR A:&base_addr+0x810128
y.create.l HWIO_RPMH_VRM_MODE_CRS_DRV1_REG2_ADDR A:&base_addr+0x810228
y.create.l HWIO_RPMH_VRM_MODE_CRS_DRV1_REG3_ADDR A:&base_addr+0x810328
y.create.l HWIO_RPMH_VRM_MODE_CRS_DRV1_REG4_ADDR A:&base_addr+0x810428
y.create.l HWIO_RPMH_VRM_MODE_CRS_DRV1_REG5_ADDR A:&base_addr+0x810528
y.create.l HWIO_RPMH_VRM_MODE_CRS_DRV1_REG6_ADDR A:&base_addr+0x810628
y.create.l HWIO_RPMH_VRM_MODE_CRS_DRV1_REG7_ADDR A:&base_addr+0x810728
y.create.l HWIO_RPMH_VRM_MODE_CRS_DRV1_REG8_ADDR A:&base_addr+0x810828
y.create.l HWIO_RPMH_VRM_MODE_CRS_DRV1_REG9_ADDR A:&base_addr+0x810928
y.create.l HWIO_RPMH_VRM_MODE_CRS_DRV1_REG10_ADDR A:&base_addr+0x810a28
y.create.l HWIO_RPMH_VRM_MODE_CRS_DRV1_REG11_ADDR A:&base_addr+0x810b28
y.create.l HWIO_RPMH_VRM_MODE_CRS_DRV1_REG12_ADDR A:&base_addr+0x810c28
y.create.l HWIO_RPMH_VRM_MODE_CRS_DRV1_REG13_ADDR A:&base_addr+0x810d28
y.create.l HWIO_RPMH_VRM_MODE_CRS_DRV1_REG14_ADDR A:&base_addr+0x810e28
y.create.l HWIO_RPMH_VRM_MODE_CRS_DRV1_REG15_ADDR A:&base_addr+0x810f28
y.create.l HWIO_RPMH_VRM_MODE_CRS_DRV1_REG16_ADDR A:&base_addr+0x811028
y.create.l HWIO_RPMH_VRM_MODE_CRS_DRV1_REG17_ADDR A:&base_addr+0x811128
y.create.l HWIO_RPMH_VRM_MODE_CRS_DRV1_REG18_ADDR A:&base_addr+0x811228
y.create.l HWIO_RPMH_VRM_MODE_CRS_DRV1_REG19_ADDR A:&base_addr+0x811328
y.create.l HWIO_RPMH_VRM_MODE_CRS_DRV1_REG20_ADDR A:&base_addr+0x811428
y.create.l HWIO_RPMH_VRM_MODE_CRS_DRV1_REG21_ADDR A:&base_addr+0x811528
y.create.l HWIO_RPMH_VRM_MODE_CRS_DRV1_REG22_ADDR A:&base_addr+0x811628
y.create.l HWIO_RPMH_VRM_MODE_CRS_DRV1_REG23_ADDR A:&base_addr+0x811728
y.create.l HWIO_RPMH_VRM_MODE_CRS_DRV1_REG24_ADDR A:&base_addr+0x811828
y.create.l HWIO_RPMH_VRM_MODE_CRS_DRV1_REG25_ADDR A:&base_addr+0x811928
y.create.l HWIO_RPMH_VRM_MODE_CRS_DRV1_REG26_ADDR A:&base_addr+0x811a28
y.create.l HWIO_RPMH_VRM_MODE_CRS_DRV1_REG27_ADDR A:&base_addr+0x811b28
y.create.l HWIO_RPMH_VRM_MODE_CRS_DRV1_REG28_ADDR A:&base_addr+0x811c28
y.create.l HWIO_RPMH_VRM_MODE_CRS_DRV1_REG29_ADDR A:&base_addr+0x811d28
y.create.l HWIO_RPMH_VRM_MODE_CRS_DRV1_REG30_ADDR A:&base_addr+0x811e28
y.create.l HWIO_RPMH_VRM_MODE_CRS_DRV1_REG31_ADDR A:&base_addr+0x811f28
y.create.l HWIO_RPMH_VRM_MODE_CRS_DRV1_REG32_ADDR A:&base_addr+0x812028
y.create.l HWIO_RPMH_VRM_MODE_CRS_DRV1_REG33_ADDR A:&base_addr+0x812128
y.create.l HWIO_RPMH_VRM_MODE_CRS_DRV1_REG34_ADDR A:&base_addr+0x812228
y.create.l HWIO_RPMH_VRM_MODE_CRS_DRV1_REG35_ADDR A:&base_addr+0x812328
y.create.l HWIO_RPMH_VRM_MODE_CRS_DRV1_REG36_ADDR A:&base_addr+0x812428
y.create.l HWIO_RPMH_VRM_MODE_CRS_DRV1_REG37_ADDR A:&base_addr+0x812528
y.create.l HWIO_RPMH_VRM_MODE_CRS_DRV1_REG38_ADDR A:&base_addr+0x812628
y.create.l HWIO_RPMH_VRM_MODE_CRS_DRV1_REG39_ADDR A:&base_addr+0x812728
y.create.l HWIO_RPMH_VRM_MODE_CRS_DRV1_REG40_ADDR A:&base_addr+0x812828
y.create.l HWIO_RPMH_VRM_MODE_CRS_DRV1_REG41_ADDR A:&base_addr+0x812928
y.create.l HWIO_RPMH_VRM_MODE_CRS_DRV1_REG42_ADDR A:&base_addr+0x812a28
y.create.l HWIO_RPMH_VRM_MODE_CRS_DRV1_REG43_ADDR A:&base_addr+0x812b28
y.create.l HWIO_RPMH_VRM_MODE_CRS_DRV1_REG44_ADDR A:&base_addr+0x812c28
y.create.l HWIO_RPMH_VRM_MODE_CRS_DRV1_REG45_ADDR A:&base_addr+0x812d28
y.create.l HWIO_RPMH_VRM_MODE_CRS_DRV2_REG0_ADDR A:&base_addr+0x820028
y.create.l HWIO_RPMH_VRM_MODE_CRS_DRV2_REG1_ADDR A:&base_addr+0x820128
y.create.l HWIO_RPMH_VRM_MODE_CRS_DRV2_REG2_ADDR A:&base_addr+0x820228
y.create.l HWIO_RPMH_VRM_MODE_CRS_DRV2_REG3_ADDR A:&base_addr+0x820328
y.create.l HWIO_RPMH_VRM_MODE_CRS_DRV2_REG4_ADDR A:&base_addr+0x820428
y.create.l HWIO_RPMH_VRM_MODE_CRS_DRV2_REG5_ADDR A:&base_addr+0x820528
y.create.l HWIO_RPMH_VRM_MODE_CRS_DRV2_REG6_ADDR A:&base_addr+0x820628
y.create.l HWIO_RPMH_VRM_MODE_CRS_DRV2_REG7_ADDR A:&base_addr+0x820728
y.create.l HWIO_RPMH_VRM_MODE_CRS_DRV2_REG8_ADDR A:&base_addr+0x820828
y.create.l HWIO_RPMH_VRM_MODE_CRS_DRV2_REG9_ADDR A:&base_addr+0x820928
y.create.l HWIO_RPMH_VRM_MODE_CRS_DRV2_REG10_ADDR A:&base_addr+0x820a28
y.create.l HWIO_RPMH_VRM_MODE_CRS_DRV2_REG11_ADDR A:&base_addr+0x820b28
y.create.l HWIO_RPMH_VRM_MODE_CRS_DRV2_REG12_ADDR A:&base_addr+0x820c28
y.create.l HWIO_RPMH_VRM_MODE_CRS_DRV2_REG13_ADDR A:&base_addr+0x820d28
y.create.l HWIO_RPMH_VRM_MODE_CRS_DRV2_REG14_ADDR A:&base_addr+0x820e28
y.create.l HWIO_RPMH_VRM_MODE_CRS_DRV2_REG15_ADDR A:&base_addr+0x820f28
y.create.l HWIO_RPMH_VRM_MODE_CRS_DRV2_REG16_ADDR A:&base_addr+0x821028
y.create.l HWIO_RPMH_VRM_MODE_CRS_DRV2_REG17_ADDR A:&base_addr+0x821128
y.create.l HWIO_RPMH_VRM_MODE_CRS_DRV2_REG18_ADDR A:&base_addr+0x821228
y.create.l HWIO_RPMH_VRM_MODE_CRS_DRV2_REG19_ADDR A:&base_addr+0x821328
y.create.l HWIO_RPMH_VRM_MODE_CRS_DRV2_REG20_ADDR A:&base_addr+0x821428
y.create.l HWIO_RPMH_VRM_MODE_CRS_DRV2_REG21_ADDR A:&base_addr+0x821528
y.create.l HWIO_RPMH_VRM_MODE_CRS_DRV2_REG22_ADDR A:&base_addr+0x821628
y.create.l HWIO_RPMH_VRM_MODE_CRS_DRV2_REG23_ADDR A:&base_addr+0x821728
y.create.l HWIO_RPMH_VRM_MODE_CRS_DRV2_REG24_ADDR A:&base_addr+0x821828
y.create.l HWIO_RPMH_VRM_MODE_CRS_DRV2_REG25_ADDR A:&base_addr+0x821928
y.create.l HWIO_RPMH_VRM_MODE_CRS_DRV2_REG26_ADDR A:&base_addr+0x821a28
y.create.l HWIO_RPMH_VRM_MODE_CRS_DRV2_REG27_ADDR A:&base_addr+0x821b28
y.create.l HWIO_RPMH_VRM_MODE_CRS_DRV2_REG28_ADDR A:&base_addr+0x821c28
y.create.l HWIO_RPMH_VRM_MODE_CRS_DRV2_REG29_ADDR A:&base_addr+0x821d28
y.create.l HWIO_RPMH_VRM_MODE_CRS_DRV2_REG30_ADDR A:&base_addr+0x821e28
y.create.l HWIO_RPMH_VRM_MODE_CRS_DRV2_REG31_ADDR A:&base_addr+0x821f28
y.create.l HWIO_RPMH_VRM_MODE_CRS_DRV2_REG32_ADDR A:&base_addr+0x822028
y.create.l HWIO_RPMH_VRM_MODE_CRS_DRV2_REG33_ADDR A:&base_addr+0x822128
y.create.l HWIO_RPMH_VRM_MODE_CRS_DRV2_REG34_ADDR A:&base_addr+0x822228
y.create.l HWIO_RPMH_VRM_MODE_CRS_DRV2_REG35_ADDR A:&base_addr+0x822328
y.create.l HWIO_RPMH_VRM_MODE_CRS_DRV2_REG36_ADDR A:&base_addr+0x822428
y.create.l HWIO_RPMH_VRM_MODE_CRS_DRV2_REG37_ADDR A:&base_addr+0x822528
y.create.l HWIO_RPMH_VRM_MODE_CRS_DRV2_REG38_ADDR A:&base_addr+0x822628
y.create.l HWIO_RPMH_VRM_MODE_CRS_DRV2_REG39_ADDR A:&base_addr+0x822728
y.create.l HWIO_RPMH_VRM_MODE_CRS_DRV2_REG40_ADDR A:&base_addr+0x822828
y.create.l HWIO_RPMH_VRM_MODE_CRS_DRV2_REG41_ADDR A:&base_addr+0x822928
y.create.l HWIO_RPMH_VRM_MODE_CRS_DRV2_REG42_ADDR A:&base_addr+0x822a28
y.create.l HWIO_RPMH_VRM_MODE_CRS_DRV2_REG43_ADDR A:&base_addr+0x822b28
y.create.l HWIO_RPMH_VRM_MODE_CRS_DRV2_REG44_ADDR A:&base_addr+0x822c28
y.create.l HWIO_RPMH_VRM_MODE_CRS_DRV2_REG45_ADDR A:&base_addr+0x822d28
y.create.l HWIO_RPMH_VRM_MODE_CRS_DRV3_REG0_ADDR A:&base_addr+0x830028
y.create.l HWIO_RPMH_VRM_MODE_CRS_DRV3_REG1_ADDR A:&base_addr+0x830128
y.create.l HWIO_RPMH_VRM_MODE_CRS_DRV3_REG2_ADDR A:&base_addr+0x830228
y.create.l HWIO_RPMH_VRM_MODE_CRS_DRV3_REG3_ADDR A:&base_addr+0x830328
y.create.l HWIO_RPMH_VRM_MODE_CRS_DRV3_REG4_ADDR A:&base_addr+0x830428
y.create.l HWIO_RPMH_VRM_MODE_CRS_DRV3_REG5_ADDR A:&base_addr+0x830528
y.create.l HWIO_RPMH_VRM_MODE_CRS_DRV3_REG6_ADDR A:&base_addr+0x830628
y.create.l HWIO_RPMH_VRM_MODE_CRS_DRV3_REG7_ADDR A:&base_addr+0x830728
y.create.l HWIO_RPMH_VRM_MODE_CRS_DRV3_REG8_ADDR A:&base_addr+0x830828
y.create.l HWIO_RPMH_VRM_MODE_CRS_DRV3_REG9_ADDR A:&base_addr+0x830928
y.create.l HWIO_RPMH_VRM_MODE_CRS_DRV3_REG10_ADDR A:&base_addr+0x830a28
y.create.l HWIO_RPMH_VRM_MODE_CRS_DRV3_REG11_ADDR A:&base_addr+0x830b28
y.create.l HWIO_RPMH_VRM_MODE_CRS_DRV3_REG12_ADDR A:&base_addr+0x830c28
y.create.l HWIO_RPMH_VRM_MODE_CRS_DRV3_REG13_ADDR A:&base_addr+0x830d28
y.create.l HWIO_RPMH_VRM_MODE_CRS_DRV3_REG14_ADDR A:&base_addr+0x830e28
y.create.l HWIO_RPMH_VRM_MODE_CRS_DRV3_REG15_ADDR A:&base_addr+0x830f28
y.create.l HWIO_RPMH_VRM_MODE_CRS_DRV3_REG16_ADDR A:&base_addr+0x831028
y.create.l HWIO_RPMH_VRM_MODE_CRS_DRV3_REG17_ADDR A:&base_addr+0x831128
y.create.l HWIO_RPMH_VRM_MODE_CRS_DRV3_REG18_ADDR A:&base_addr+0x831228
y.create.l HWIO_RPMH_VRM_MODE_CRS_DRV3_REG19_ADDR A:&base_addr+0x831328
y.create.l HWIO_RPMH_VRM_MODE_CRS_DRV3_REG20_ADDR A:&base_addr+0x831428
y.create.l HWIO_RPMH_VRM_MODE_CRS_DRV3_REG21_ADDR A:&base_addr+0x831528
y.create.l HWIO_RPMH_VRM_MODE_CRS_DRV3_REG22_ADDR A:&base_addr+0x831628
y.create.l HWIO_RPMH_VRM_MODE_CRS_DRV3_REG23_ADDR A:&base_addr+0x831728
y.create.l HWIO_RPMH_VRM_MODE_CRS_DRV3_REG24_ADDR A:&base_addr+0x831828
y.create.l HWIO_RPMH_VRM_MODE_CRS_DRV3_REG25_ADDR A:&base_addr+0x831928
y.create.l HWIO_RPMH_VRM_MODE_CRS_DRV3_REG26_ADDR A:&base_addr+0x831a28
y.create.l HWIO_RPMH_VRM_MODE_CRS_DRV3_REG27_ADDR A:&base_addr+0x831b28
y.create.l HWIO_RPMH_VRM_MODE_CRS_DRV3_REG28_ADDR A:&base_addr+0x831c28
y.create.l HWIO_RPMH_VRM_MODE_CRS_DRV3_REG29_ADDR A:&base_addr+0x831d28
y.create.l HWIO_RPMH_VRM_MODE_CRS_DRV3_REG30_ADDR A:&base_addr+0x831e28
y.create.l HWIO_RPMH_VRM_MODE_CRS_DRV3_REG31_ADDR A:&base_addr+0x831f28
y.create.l HWIO_RPMH_VRM_MODE_CRS_DRV3_REG32_ADDR A:&base_addr+0x832028
y.create.l HWIO_RPMH_VRM_MODE_CRS_DRV3_REG33_ADDR A:&base_addr+0x832128
y.create.l HWIO_RPMH_VRM_MODE_CRS_DRV3_REG34_ADDR A:&base_addr+0x832228
y.create.l HWIO_RPMH_VRM_MODE_CRS_DRV3_REG35_ADDR A:&base_addr+0x832328
y.create.l HWIO_RPMH_VRM_MODE_CRS_DRV3_REG36_ADDR A:&base_addr+0x832428
y.create.l HWIO_RPMH_VRM_MODE_CRS_DRV3_REG37_ADDR A:&base_addr+0x832528
y.create.l HWIO_RPMH_VRM_MODE_CRS_DRV3_REG38_ADDR A:&base_addr+0x832628
y.create.l HWIO_RPMH_VRM_MODE_CRS_DRV3_REG39_ADDR A:&base_addr+0x832728
y.create.l HWIO_RPMH_VRM_MODE_CRS_DRV3_REG40_ADDR A:&base_addr+0x832828
y.create.l HWIO_RPMH_VRM_MODE_CRS_DRV3_REG41_ADDR A:&base_addr+0x832928
y.create.l HWIO_RPMH_VRM_MODE_CRS_DRV3_REG42_ADDR A:&base_addr+0x832a28
y.create.l HWIO_RPMH_VRM_MODE_CRS_DRV3_REG43_ADDR A:&base_addr+0x832b28
y.create.l HWIO_RPMH_VRM_MODE_CRS_DRV3_REG44_ADDR A:&base_addr+0x832c28
y.create.l HWIO_RPMH_VRM_MODE_CRS_DRV3_REG45_ADDR A:&base_addr+0x832d28
y.create.l HWIO_RPMH_VRM_MODE_CRS_DRV4_REG0_ADDR A:&base_addr+0x840028
y.create.l HWIO_RPMH_VRM_MODE_CRS_DRV4_REG1_ADDR A:&base_addr+0x840128
y.create.l HWIO_RPMH_VRM_MODE_CRS_DRV4_REG2_ADDR A:&base_addr+0x840228
y.create.l HWIO_RPMH_VRM_MODE_CRS_DRV4_REG3_ADDR A:&base_addr+0x840328
y.create.l HWIO_RPMH_VRM_MODE_CRS_DRV4_REG4_ADDR A:&base_addr+0x840428
y.create.l HWIO_RPMH_VRM_MODE_CRS_DRV4_REG5_ADDR A:&base_addr+0x840528
y.create.l HWIO_RPMH_VRM_MODE_CRS_DRV4_REG6_ADDR A:&base_addr+0x840628
y.create.l HWIO_RPMH_VRM_MODE_CRS_DRV4_REG7_ADDR A:&base_addr+0x840728
y.create.l HWIO_RPMH_VRM_MODE_CRS_DRV4_REG8_ADDR A:&base_addr+0x840828
y.create.l HWIO_RPMH_VRM_MODE_CRS_DRV4_REG9_ADDR A:&base_addr+0x840928
y.create.l HWIO_RPMH_VRM_MODE_CRS_DRV4_REG10_ADDR A:&base_addr+0x840a28
y.create.l HWIO_RPMH_VRM_MODE_CRS_DRV4_REG11_ADDR A:&base_addr+0x840b28
y.create.l HWIO_RPMH_VRM_MODE_CRS_DRV4_REG12_ADDR A:&base_addr+0x840c28
y.create.l HWIO_RPMH_VRM_MODE_CRS_DRV4_REG13_ADDR A:&base_addr+0x840d28
y.create.l HWIO_RPMH_VRM_MODE_CRS_DRV4_REG14_ADDR A:&base_addr+0x840e28
y.create.l HWIO_RPMH_VRM_MODE_CRS_DRV4_REG15_ADDR A:&base_addr+0x840f28
y.create.l HWIO_RPMH_VRM_MODE_CRS_DRV4_REG16_ADDR A:&base_addr+0x841028
y.create.l HWIO_RPMH_VRM_MODE_CRS_DRV4_REG17_ADDR A:&base_addr+0x841128
y.create.l HWIO_RPMH_VRM_MODE_CRS_DRV4_REG18_ADDR A:&base_addr+0x841228
y.create.l HWIO_RPMH_VRM_MODE_CRS_DRV4_REG19_ADDR A:&base_addr+0x841328
y.create.l HWIO_RPMH_VRM_MODE_CRS_DRV4_REG20_ADDR A:&base_addr+0x841428
y.create.l HWIO_RPMH_VRM_MODE_CRS_DRV4_REG21_ADDR A:&base_addr+0x841528
y.create.l HWIO_RPMH_VRM_MODE_CRS_DRV4_REG22_ADDR A:&base_addr+0x841628
y.create.l HWIO_RPMH_VRM_MODE_CRS_DRV4_REG23_ADDR A:&base_addr+0x841728
y.create.l HWIO_RPMH_VRM_MODE_CRS_DRV4_REG24_ADDR A:&base_addr+0x841828
y.create.l HWIO_RPMH_VRM_MODE_CRS_DRV4_REG25_ADDR A:&base_addr+0x841928
y.create.l HWIO_RPMH_VRM_MODE_CRS_DRV4_REG26_ADDR A:&base_addr+0x841a28
y.create.l HWIO_RPMH_VRM_MODE_CRS_DRV4_REG27_ADDR A:&base_addr+0x841b28
y.create.l HWIO_RPMH_VRM_MODE_CRS_DRV4_REG28_ADDR A:&base_addr+0x841c28
y.create.l HWIO_RPMH_VRM_MODE_CRS_DRV4_REG29_ADDR A:&base_addr+0x841d28
y.create.l HWIO_RPMH_VRM_MODE_CRS_DRV4_REG30_ADDR A:&base_addr+0x841e28
y.create.l HWIO_RPMH_VRM_MODE_CRS_DRV4_REG31_ADDR A:&base_addr+0x841f28
y.create.l HWIO_RPMH_VRM_MODE_CRS_DRV4_REG32_ADDR A:&base_addr+0x842028
y.create.l HWIO_RPMH_VRM_MODE_CRS_DRV4_REG33_ADDR A:&base_addr+0x842128
y.create.l HWIO_RPMH_VRM_MODE_CRS_DRV4_REG34_ADDR A:&base_addr+0x842228
y.create.l HWIO_RPMH_VRM_MODE_CRS_DRV4_REG35_ADDR A:&base_addr+0x842328
y.create.l HWIO_RPMH_VRM_MODE_CRS_DRV4_REG36_ADDR A:&base_addr+0x842428
y.create.l HWIO_RPMH_VRM_MODE_CRS_DRV4_REG37_ADDR A:&base_addr+0x842528
y.create.l HWIO_RPMH_VRM_MODE_CRS_DRV4_REG38_ADDR A:&base_addr+0x842628
y.create.l HWIO_RPMH_VRM_MODE_CRS_DRV4_REG39_ADDR A:&base_addr+0x842728
y.create.l HWIO_RPMH_VRM_MODE_CRS_DRV4_REG40_ADDR A:&base_addr+0x842828
y.create.l HWIO_RPMH_VRM_MODE_CRS_DRV4_REG41_ADDR A:&base_addr+0x842928
y.create.l HWIO_RPMH_VRM_MODE_CRS_DRV4_REG42_ADDR A:&base_addr+0x842a28
y.create.l HWIO_RPMH_VRM_MODE_CRS_DRV4_REG43_ADDR A:&base_addr+0x842b28
y.create.l HWIO_RPMH_VRM_MODE_CRS_DRV4_REG44_ADDR A:&base_addr+0x842c28
y.create.l HWIO_RPMH_VRM_MODE_CRS_DRV4_REG45_ADDR A:&base_addr+0x842d28
y.create.l HWIO_RPMH_VRM_MODE_CRS_DRV5_REG0_ADDR A:&base_addr+0x850028
y.create.l HWIO_RPMH_VRM_MODE_CRS_DRV5_REG1_ADDR A:&base_addr+0x850128
y.create.l HWIO_RPMH_VRM_MODE_CRS_DRV5_REG2_ADDR A:&base_addr+0x850228
y.create.l HWIO_RPMH_VRM_MODE_CRS_DRV5_REG3_ADDR A:&base_addr+0x850328
y.create.l HWIO_RPMH_VRM_MODE_CRS_DRV5_REG4_ADDR A:&base_addr+0x850428
y.create.l HWIO_RPMH_VRM_MODE_CRS_DRV5_REG5_ADDR A:&base_addr+0x850528
y.create.l HWIO_RPMH_VRM_MODE_CRS_DRV5_REG6_ADDR A:&base_addr+0x850628
y.create.l HWIO_RPMH_VRM_MODE_CRS_DRV5_REG7_ADDR A:&base_addr+0x850728
y.create.l HWIO_RPMH_VRM_MODE_CRS_DRV5_REG8_ADDR A:&base_addr+0x850828
y.create.l HWIO_RPMH_VRM_MODE_CRS_DRV5_REG9_ADDR A:&base_addr+0x850928
y.create.l HWIO_RPMH_VRM_MODE_CRS_DRV5_REG10_ADDR A:&base_addr+0x850a28
y.create.l HWIO_RPMH_VRM_MODE_CRS_DRV5_REG11_ADDR A:&base_addr+0x850b28
y.create.l HWIO_RPMH_VRM_MODE_CRS_DRV5_REG12_ADDR A:&base_addr+0x850c28
y.create.l HWIO_RPMH_VRM_MODE_CRS_DRV5_REG13_ADDR A:&base_addr+0x850d28
y.create.l HWIO_RPMH_VRM_MODE_CRS_DRV5_REG14_ADDR A:&base_addr+0x850e28
y.create.l HWIO_RPMH_VRM_MODE_CRS_DRV5_REG15_ADDR A:&base_addr+0x850f28
y.create.l HWIO_RPMH_VRM_MODE_CRS_DRV5_REG16_ADDR A:&base_addr+0x851028
y.create.l HWIO_RPMH_VRM_MODE_CRS_DRV5_REG17_ADDR A:&base_addr+0x851128
y.create.l HWIO_RPMH_VRM_MODE_CRS_DRV5_REG18_ADDR A:&base_addr+0x851228
y.create.l HWIO_RPMH_VRM_MODE_CRS_DRV5_REG19_ADDR A:&base_addr+0x851328
y.create.l HWIO_RPMH_VRM_MODE_CRS_DRV5_REG20_ADDR A:&base_addr+0x851428
y.create.l HWIO_RPMH_VRM_MODE_CRS_DRV5_REG21_ADDR A:&base_addr+0x851528
y.create.l HWIO_RPMH_VRM_MODE_CRS_DRV5_REG22_ADDR A:&base_addr+0x851628
y.create.l HWIO_RPMH_VRM_MODE_CRS_DRV5_REG23_ADDR A:&base_addr+0x851728
y.create.l HWIO_RPMH_VRM_MODE_CRS_DRV5_REG24_ADDR A:&base_addr+0x851828
y.create.l HWIO_RPMH_VRM_MODE_CRS_DRV5_REG25_ADDR A:&base_addr+0x851928
y.create.l HWIO_RPMH_VRM_MODE_CRS_DRV5_REG26_ADDR A:&base_addr+0x851a28
y.create.l HWIO_RPMH_VRM_MODE_CRS_DRV5_REG27_ADDR A:&base_addr+0x851b28
y.create.l HWIO_RPMH_VRM_MODE_CRS_DRV5_REG28_ADDR A:&base_addr+0x851c28
y.create.l HWIO_RPMH_VRM_MODE_CRS_DRV5_REG29_ADDR A:&base_addr+0x851d28
y.create.l HWIO_RPMH_VRM_MODE_CRS_DRV5_REG30_ADDR A:&base_addr+0x851e28
y.create.l HWIO_RPMH_VRM_MODE_CRS_DRV5_REG31_ADDR A:&base_addr+0x851f28
y.create.l HWIO_RPMH_VRM_MODE_CRS_DRV5_REG32_ADDR A:&base_addr+0x852028
y.create.l HWIO_RPMH_VRM_MODE_CRS_DRV5_REG33_ADDR A:&base_addr+0x852128
y.create.l HWIO_RPMH_VRM_MODE_CRS_DRV5_REG34_ADDR A:&base_addr+0x852228
y.create.l HWIO_RPMH_VRM_MODE_CRS_DRV5_REG35_ADDR A:&base_addr+0x852328
y.create.l HWIO_RPMH_VRM_MODE_CRS_DRV5_REG36_ADDR A:&base_addr+0x852428
y.create.l HWIO_RPMH_VRM_MODE_CRS_DRV5_REG37_ADDR A:&base_addr+0x852528
y.create.l HWIO_RPMH_VRM_MODE_CRS_DRV5_REG38_ADDR A:&base_addr+0x852628
y.create.l HWIO_RPMH_VRM_MODE_CRS_DRV5_REG39_ADDR A:&base_addr+0x852728
y.create.l HWIO_RPMH_VRM_MODE_CRS_DRV5_REG40_ADDR A:&base_addr+0x852828
y.create.l HWIO_RPMH_VRM_MODE_CRS_DRV5_REG41_ADDR A:&base_addr+0x852928
y.create.l HWIO_RPMH_VRM_MODE_CRS_DRV5_REG42_ADDR A:&base_addr+0x852a28
y.create.l HWIO_RPMH_VRM_MODE_CRS_DRV5_REG43_ADDR A:&base_addr+0x852b28
y.create.l HWIO_RPMH_VRM_MODE_CRS_DRV5_REG44_ADDR A:&base_addr+0x852c28
y.create.l HWIO_RPMH_VRM_MODE_CRS_DRV5_REG45_ADDR A:&base_addr+0x852d28
y.create.l HWIO_RPMH_VRM_MODE_CRS_DRV6_REG0_ADDR A:&base_addr+0x860028
y.create.l HWIO_RPMH_VRM_MODE_CRS_DRV6_REG1_ADDR A:&base_addr+0x860128
y.create.l HWIO_RPMH_VRM_MODE_CRS_DRV6_REG2_ADDR A:&base_addr+0x860228
y.create.l HWIO_RPMH_VRM_MODE_CRS_DRV6_REG3_ADDR A:&base_addr+0x860328
y.create.l HWIO_RPMH_VRM_MODE_CRS_DRV6_REG4_ADDR A:&base_addr+0x860428
y.create.l HWIO_RPMH_VRM_MODE_CRS_DRV6_REG5_ADDR A:&base_addr+0x860528
y.create.l HWIO_RPMH_VRM_MODE_CRS_DRV6_REG6_ADDR A:&base_addr+0x860628
y.create.l HWIO_RPMH_VRM_MODE_CRS_DRV6_REG7_ADDR A:&base_addr+0x860728
y.create.l HWIO_RPMH_VRM_MODE_CRS_DRV6_REG8_ADDR A:&base_addr+0x860828
y.create.l HWIO_RPMH_VRM_MODE_CRS_DRV6_REG9_ADDR A:&base_addr+0x860928
y.create.l HWIO_RPMH_VRM_MODE_CRS_DRV6_REG10_ADDR A:&base_addr+0x860a28
y.create.l HWIO_RPMH_VRM_MODE_CRS_DRV6_REG11_ADDR A:&base_addr+0x860b28
y.create.l HWIO_RPMH_VRM_MODE_CRS_DRV6_REG12_ADDR A:&base_addr+0x860c28
y.create.l HWIO_RPMH_VRM_MODE_CRS_DRV6_REG13_ADDR A:&base_addr+0x860d28
y.create.l HWIO_RPMH_VRM_MODE_CRS_DRV6_REG14_ADDR A:&base_addr+0x860e28
y.create.l HWIO_RPMH_VRM_MODE_CRS_DRV6_REG15_ADDR A:&base_addr+0x860f28
y.create.l HWIO_RPMH_VRM_MODE_CRS_DRV6_REG16_ADDR A:&base_addr+0x861028
y.create.l HWIO_RPMH_VRM_MODE_CRS_DRV6_REG17_ADDR A:&base_addr+0x861128
y.create.l HWIO_RPMH_VRM_MODE_CRS_DRV6_REG18_ADDR A:&base_addr+0x861228
y.create.l HWIO_RPMH_VRM_MODE_CRS_DRV6_REG19_ADDR A:&base_addr+0x861328
y.create.l HWIO_RPMH_VRM_MODE_CRS_DRV6_REG20_ADDR A:&base_addr+0x861428
y.create.l HWIO_RPMH_VRM_MODE_CRS_DRV6_REG21_ADDR A:&base_addr+0x861528
y.create.l HWIO_RPMH_VRM_MODE_CRS_DRV6_REG22_ADDR A:&base_addr+0x861628
y.create.l HWIO_RPMH_VRM_MODE_CRS_DRV6_REG23_ADDR A:&base_addr+0x861728
y.create.l HWIO_RPMH_VRM_MODE_CRS_DRV6_REG24_ADDR A:&base_addr+0x861828
y.create.l HWIO_RPMH_VRM_MODE_CRS_DRV6_REG25_ADDR A:&base_addr+0x861928
y.create.l HWIO_RPMH_VRM_MODE_CRS_DRV6_REG26_ADDR A:&base_addr+0x861a28
y.create.l HWIO_RPMH_VRM_MODE_CRS_DRV6_REG27_ADDR A:&base_addr+0x861b28
y.create.l HWIO_RPMH_VRM_MODE_CRS_DRV6_REG28_ADDR A:&base_addr+0x861c28
y.create.l HWIO_RPMH_VRM_MODE_CRS_DRV6_REG29_ADDR A:&base_addr+0x861d28
y.create.l HWIO_RPMH_VRM_MODE_CRS_DRV6_REG30_ADDR A:&base_addr+0x861e28
y.create.l HWIO_RPMH_VRM_MODE_CRS_DRV6_REG31_ADDR A:&base_addr+0x861f28
y.create.l HWIO_RPMH_VRM_MODE_CRS_DRV6_REG32_ADDR A:&base_addr+0x862028
y.create.l HWIO_RPMH_VRM_MODE_CRS_DRV6_REG33_ADDR A:&base_addr+0x862128
y.create.l HWIO_RPMH_VRM_MODE_CRS_DRV6_REG34_ADDR A:&base_addr+0x862228
y.create.l HWIO_RPMH_VRM_MODE_CRS_DRV6_REG35_ADDR A:&base_addr+0x862328
y.create.l HWIO_RPMH_VRM_MODE_CRS_DRV6_REG36_ADDR A:&base_addr+0x862428
y.create.l HWIO_RPMH_VRM_MODE_CRS_DRV6_REG37_ADDR A:&base_addr+0x862528
y.create.l HWIO_RPMH_VRM_MODE_CRS_DRV6_REG38_ADDR A:&base_addr+0x862628
y.create.l HWIO_RPMH_VRM_MODE_CRS_DRV6_REG39_ADDR A:&base_addr+0x862728
y.create.l HWIO_RPMH_VRM_MODE_CRS_DRV6_REG40_ADDR A:&base_addr+0x862828
y.create.l HWIO_RPMH_VRM_MODE_CRS_DRV6_REG41_ADDR A:&base_addr+0x862928
y.create.l HWIO_RPMH_VRM_MODE_CRS_DRV6_REG42_ADDR A:&base_addr+0x862a28
y.create.l HWIO_RPMH_VRM_MODE_CRS_DRV6_REG43_ADDR A:&base_addr+0x862b28
y.create.l HWIO_RPMH_VRM_MODE_CRS_DRV6_REG44_ADDR A:&base_addr+0x862c28
y.create.l HWIO_RPMH_VRM_MODE_CRS_DRV6_REG45_ADDR A:&base_addr+0x862d28
y.create.l HWIO_RPMH_VRM_MODE_CRS_DRV7_REG0_ADDR A:&base_addr+0x870028
y.create.l HWIO_RPMH_VRM_MODE_CRS_DRV7_REG1_ADDR A:&base_addr+0x870128
y.create.l HWIO_RPMH_VRM_MODE_CRS_DRV7_REG2_ADDR A:&base_addr+0x870228
y.create.l HWIO_RPMH_VRM_MODE_CRS_DRV7_REG3_ADDR A:&base_addr+0x870328
y.create.l HWIO_RPMH_VRM_MODE_CRS_DRV7_REG4_ADDR A:&base_addr+0x870428
y.create.l HWIO_RPMH_VRM_MODE_CRS_DRV7_REG5_ADDR A:&base_addr+0x870528
y.create.l HWIO_RPMH_VRM_MODE_CRS_DRV7_REG6_ADDR A:&base_addr+0x870628
y.create.l HWIO_RPMH_VRM_MODE_CRS_DRV7_REG7_ADDR A:&base_addr+0x870728
y.create.l HWIO_RPMH_VRM_MODE_CRS_DRV7_REG8_ADDR A:&base_addr+0x870828
y.create.l HWIO_RPMH_VRM_MODE_CRS_DRV7_REG9_ADDR A:&base_addr+0x870928
y.create.l HWIO_RPMH_VRM_MODE_CRS_DRV7_REG10_ADDR A:&base_addr+0x870a28
y.create.l HWIO_RPMH_VRM_MODE_CRS_DRV7_REG11_ADDR A:&base_addr+0x870b28
y.create.l HWIO_RPMH_VRM_MODE_CRS_DRV7_REG12_ADDR A:&base_addr+0x870c28
y.create.l HWIO_RPMH_VRM_MODE_CRS_DRV7_REG13_ADDR A:&base_addr+0x870d28
y.create.l HWIO_RPMH_VRM_MODE_CRS_DRV7_REG14_ADDR A:&base_addr+0x870e28
y.create.l HWIO_RPMH_VRM_MODE_CRS_DRV7_REG15_ADDR A:&base_addr+0x870f28
y.create.l HWIO_RPMH_VRM_MODE_CRS_DRV7_REG16_ADDR A:&base_addr+0x871028
y.create.l HWIO_RPMH_VRM_MODE_CRS_DRV7_REG17_ADDR A:&base_addr+0x871128
y.create.l HWIO_RPMH_VRM_MODE_CRS_DRV7_REG18_ADDR A:&base_addr+0x871228
y.create.l HWIO_RPMH_VRM_MODE_CRS_DRV7_REG19_ADDR A:&base_addr+0x871328
y.create.l HWIO_RPMH_VRM_MODE_CRS_DRV7_REG20_ADDR A:&base_addr+0x871428
y.create.l HWIO_RPMH_VRM_MODE_CRS_DRV7_REG21_ADDR A:&base_addr+0x871528
y.create.l HWIO_RPMH_VRM_MODE_CRS_DRV7_REG22_ADDR A:&base_addr+0x871628
y.create.l HWIO_RPMH_VRM_MODE_CRS_DRV7_REG23_ADDR A:&base_addr+0x871728
y.create.l HWIO_RPMH_VRM_MODE_CRS_DRV7_REG24_ADDR A:&base_addr+0x871828
y.create.l HWIO_RPMH_VRM_MODE_CRS_DRV7_REG25_ADDR A:&base_addr+0x871928
y.create.l HWIO_RPMH_VRM_MODE_CRS_DRV7_REG26_ADDR A:&base_addr+0x871a28
y.create.l HWIO_RPMH_VRM_MODE_CRS_DRV7_REG27_ADDR A:&base_addr+0x871b28
y.create.l HWIO_RPMH_VRM_MODE_CRS_DRV7_REG28_ADDR A:&base_addr+0x871c28
y.create.l HWIO_RPMH_VRM_MODE_CRS_DRV7_REG29_ADDR A:&base_addr+0x871d28
y.create.l HWIO_RPMH_VRM_MODE_CRS_DRV7_REG30_ADDR A:&base_addr+0x871e28
y.create.l HWIO_RPMH_VRM_MODE_CRS_DRV7_REG31_ADDR A:&base_addr+0x871f28
y.create.l HWIO_RPMH_VRM_MODE_CRS_DRV7_REG32_ADDR A:&base_addr+0x872028
y.create.l HWIO_RPMH_VRM_MODE_CRS_DRV7_REG33_ADDR A:&base_addr+0x872128
y.create.l HWIO_RPMH_VRM_MODE_CRS_DRV7_REG34_ADDR A:&base_addr+0x872228
y.create.l HWIO_RPMH_VRM_MODE_CRS_DRV7_REG35_ADDR A:&base_addr+0x872328
y.create.l HWIO_RPMH_VRM_MODE_CRS_DRV7_REG36_ADDR A:&base_addr+0x872428
y.create.l HWIO_RPMH_VRM_MODE_CRS_DRV7_REG37_ADDR A:&base_addr+0x872528
y.create.l HWIO_RPMH_VRM_MODE_CRS_DRV7_REG38_ADDR A:&base_addr+0x872628
y.create.l HWIO_RPMH_VRM_MODE_CRS_DRV7_REG39_ADDR A:&base_addr+0x872728
y.create.l HWIO_RPMH_VRM_MODE_CRS_DRV7_REG40_ADDR A:&base_addr+0x872828
y.create.l HWIO_RPMH_VRM_MODE_CRS_DRV7_REG41_ADDR A:&base_addr+0x872928
y.create.l HWIO_RPMH_VRM_MODE_CRS_DRV7_REG42_ADDR A:&base_addr+0x872a28
y.create.l HWIO_RPMH_VRM_MODE_CRS_DRV7_REG43_ADDR A:&base_addr+0x872b28
y.create.l HWIO_RPMH_VRM_MODE_CRS_DRV7_REG44_ADDR A:&base_addr+0x872c28
y.create.l HWIO_RPMH_VRM_MODE_CRS_DRV7_REG45_ADDR A:&base_addr+0x872d28
y.create.l HWIO_RPMH_VRM_MODE_CRS_DRV8_REG0_ADDR A:&base_addr+0x880028
y.create.l HWIO_RPMH_VRM_MODE_CRS_DRV8_REG1_ADDR A:&base_addr+0x880128
y.create.l HWIO_RPMH_VRM_MODE_CRS_DRV8_REG2_ADDR A:&base_addr+0x880228
y.create.l HWIO_RPMH_VRM_MODE_CRS_DRV8_REG3_ADDR A:&base_addr+0x880328
y.create.l HWIO_RPMH_VRM_MODE_CRS_DRV8_REG4_ADDR A:&base_addr+0x880428
y.create.l HWIO_RPMH_VRM_MODE_CRS_DRV8_REG5_ADDR A:&base_addr+0x880528
y.create.l HWIO_RPMH_VRM_MODE_CRS_DRV8_REG6_ADDR A:&base_addr+0x880628
y.create.l HWIO_RPMH_VRM_MODE_CRS_DRV8_REG7_ADDR A:&base_addr+0x880728
y.create.l HWIO_RPMH_VRM_MODE_CRS_DRV8_REG8_ADDR A:&base_addr+0x880828
y.create.l HWIO_RPMH_VRM_MODE_CRS_DRV8_REG9_ADDR A:&base_addr+0x880928
y.create.l HWIO_RPMH_VRM_MODE_CRS_DRV8_REG10_ADDR A:&base_addr+0x880a28
y.create.l HWIO_RPMH_VRM_MODE_CRS_DRV8_REG11_ADDR A:&base_addr+0x880b28
y.create.l HWIO_RPMH_VRM_MODE_CRS_DRV8_REG12_ADDR A:&base_addr+0x880c28
y.create.l HWIO_RPMH_VRM_MODE_CRS_DRV8_REG13_ADDR A:&base_addr+0x880d28
y.create.l HWIO_RPMH_VRM_MODE_CRS_DRV8_REG14_ADDR A:&base_addr+0x880e28
y.create.l HWIO_RPMH_VRM_MODE_CRS_DRV8_REG15_ADDR A:&base_addr+0x880f28
y.create.l HWIO_RPMH_VRM_MODE_CRS_DRV8_REG16_ADDR A:&base_addr+0x881028
y.create.l HWIO_RPMH_VRM_MODE_CRS_DRV8_REG17_ADDR A:&base_addr+0x881128
y.create.l HWIO_RPMH_VRM_MODE_CRS_DRV8_REG18_ADDR A:&base_addr+0x881228
y.create.l HWIO_RPMH_VRM_MODE_CRS_DRV8_REG19_ADDR A:&base_addr+0x881328
y.create.l HWIO_RPMH_VRM_MODE_CRS_DRV8_REG20_ADDR A:&base_addr+0x881428
y.create.l HWIO_RPMH_VRM_MODE_CRS_DRV8_REG21_ADDR A:&base_addr+0x881528
y.create.l HWIO_RPMH_VRM_MODE_CRS_DRV8_REG22_ADDR A:&base_addr+0x881628
y.create.l HWIO_RPMH_VRM_MODE_CRS_DRV8_REG23_ADDR A:&base_addr+0x881728
y.create.l HWIO_RPMH_VRM_MODE_CRS_DRV8_REG24_ADDR A:&base_addr+0x881828
y.create.l HWIO_RPMH_VRM_MODE_CRS_DRV8_REG25_ADDR A:&base_addr+0x881928
y.create.l HWIO_RPMH_VRM_MODE_CRS_DRV8_REG26_ADDR A:&base_addr+0x881a28
y.create.l HWIO_RPMH_VRM_MODE_CRS_DRV8_REG27_ADDR A:&base_addr+0x881b28
y.create.l HWIO_RPMH_VRM_MODE_CRS_DRV8_REG28_ADDR A:&base_addr+0x881c28
y.create.l HWIO_RPMH_VRM_MODE_CRS_DRV8_REG29_ADDR A:&base_addr+0x881d28
y.create.l HWIO_RPMH_VRM_MODE_CRS_DRV8_REG30_ADDR A:&base_addr+0x881e28
y.create.l HWIO_RPMH_VRM_MODE_CRS_DRV8_REG31_ADDR A:&base_addr+0x881f28
y.create.l HWIO_RPMH_VRM_MODE_CRS_DRV8_REG32_ADDR A:&base_addr+0x882028
y.create.l HWIO_RPMH_VRM_MODE_CRS_DRV8_REG33_ADDR A:&base_addr+0x882128
y.create.l HWIO_RPMH_VRM_MODE_CRS_DRV8_REG34_ADDR A:&base_addr+0x882228
y.create.l HWIO_RPMH_VRM_MODE_CRS_DRV8_REG35_ADDR A:&base_addr+0x882328
y.create.l HWIO_RPMH_VRM_MODE_CRS_DRV8_REG36_ADDR A:&base_addr+0x882428
y.create.l HWIO_RPMH_VRM_MODE_CRS_DRV8_REG37_ADDR A:&base_addr+0x882528
y.create.l HWIO_RPMH_VRM_MODE_CRS_DRV8_REG38_ADDR A:&base_addr+0x882628
y.create.l HWIO_RPMH_VRM_MODE_CRS_DRV8_REG39_ADDR A:&base_addr+0x882728
y.create.l HWIO_RPMH_VRM_MODE_CRS_DRV8_REG40_ADDR A:&base_addr+0x882828
y.create.l HWIO_RPMH_VRM_MODE_CRS_DRV8_REG41_ADDR A:&base_addr+0x882928
y.create.l HWIO_RPMH_VRM_MODE_CRS_DRV8_REG42_ADDR A:&base_addr+0x882a28
y.create.l HWIO_RPMH_VRM_MODE_CRS_DRV8_REG43_ADDR A:&base_addr+0x882b28
y.create.l HWIO_RPMH_VRM_MODE_CRS_DRV8_REG44_ADDR A:&base_addr+0x882c28
y.create.l HWIO_RPMH_VRM_MODE_CRS_DRV8_REG45_ADDR A:&base_addr+0x882d28
y.create.l HWIO_RPMH_VRM_MODE_CRS_DRV9_REG0_ADDR A:&base_addr+0x890028
y.create.l HWIO_RPMH_VRM_MODE_CRS_DRV9_REG1_ADDR A:&base_addr+0x890128
y.create.l HWIO_RPMH_VRM_MODE_CRS_DRV9_REG2_ADDR A:&base_addr+0x890228
y.create.l HWIO_RPMH_VRM_MODE_CRS_DRV9_REG3_ADDR A:&base_addr+0x890328
y.create.l HWIO_RPMH_VRM_MODE_CRS_DRV9_REG4_ADDR A:&base_addr+0x890428
y.create.l HWIO_RPMH_VRM_MODE_CRS_DRV9_REG5_ADDR A:&base_addr+0x890528
y.create.l HWIO_RPMH_VRM_MODE_CRS_DRV9_REG6_ADDR A:&base_addr+0x890628
y.create.l HWIO_RPMH_VRM_MODE_CRS_DRV9_REG7_ADDR A:&base_addr+0x890728
y.create.l HWIO_RPMH_VRM_MODE_CRS_DRV9_REG8_ADDR A:&base_addr+0x890828
y.create.l HWIO_RPMH_VRM_MODE_CRS_DRV9_REG9_ADDR A:&base_addr+0x890928
y.create.l HWIO_RPMH_VRM_MODE_CRS_DRV9_REG10_ADDR A:&base_addr+0x890a28
y.create.l HWIO_RPMH_VRM_MODE_CRS_DRV9_REG11_ADDR A:&base_addr+0x890b28
y.create.l HWIO_RPMH_VRM_MODE_CRS_DRV9_REG12_ADDR A:&base_addr+0x890c28
y.create.l HWIO_RPMH_VRM_MODE_CRS_DRV9_REG13_ADDR A:&base_addr+0x890d28
y.create.l HWIO_RPMH_VRM_MODE_CRS_DRV9_REG14_ADDR A:&base_addr+0x890e28
y.create.l HWIO_RPMH_VRM_MODE_CRS_DRV9_REG15_ADDR A:&base_addr+0x890f28
y.create.l HWIO_RPMH_VRM_MODE_CRS_DRV9_REG16_ADDR A:&base_addr+0x891028
y.create.l HWIO_RPMH_VRM_MODE_CRS_DRV9_REG17_ADDR A:&base_addr+0x891128
y.create.l HWIO_RPMH_VRM_MODE_CRS_DRV9_REG18_ADDR A:&base_addr+0x891228
y.create.l HWIO_RPMH_VRM_MODE_CRS_DRV9_REG19_ADDR A:&base_addr+0x891328
y.create.l HWIO_RPMH_VRM_MODE_CRS_DRV9_REG20_ADDR A:&base_addr+0x891428
y.create.l HWIO_RPMH_VRM_MODE_CRS_DRV9_REG21_ADDR A:&base_addr+0x891528
y.create.l HWIO_RPMH_VRM_MODE_CRS_DRV9_REG22_ADDR A:&base_addr+0x891628
y.create.l HWIO_RPMH_VRM_MODE_CRS_DRV9_REG23_ADDR A:&base_addr+0x891728
y.create.l HWIO_RPMH_VRM_MODE_CRS_DRV9_REG24_ADDR A:&base_addr+0x891828
y.create.l HWIO_RPMH_VRM_MODE_CRS_DRV9_REG25_ADDR A:&base_addr+0x891928
y.create.l HWIO_RPMH_VRM_MODE_CRS_DRV9_REG26_ADDR A:&base_addr+0x891a28
y.create.l HWIO_RPMH_VRM_MODE_CRS_DRV9_REG27_ADDR A:&base_addr+0x891b28
y.create.l HWIO_RPMH_VRM_MODE_CRS_DRV9_REG28_ADDR A:&base_addr+0x891c28
y.create.l HWIO_RPMH_VRM_MODE_CRS_DRV9_REG29_ADDR A:&base_addr+0x891d28
y.create.l HWIO_RPMH_VRM_MODE_CRS_DRV9_REG30_ADDR A:&base_addr+0x891e28
y.create.l HWIO_RPMH_VRM_MODE_CRS_DRV9_REG31_ADDR A:&base_addr+0x891f28
y.create.l HWIO_RPMH_VRM_MODE_CRS_DRV9_REG32_ADDR A:&base_addr+0x892028
y.create.l HWIO_RPMH_VRM_MODE_CRS_DRV9_REG33_ADDR A:&base_addr+0x892128
y.create.l HWIO_RPMH_VRM_MODE_CRS_DRV9_REG34_ADDR A:&base_addr+0x892228
y.create.l HWIO_RPMH_VRM_MODE_CRS_DRV9_REG35_ADDR A:&base_addr+0x892328
y.create.l HWIO_RPMH_VRM_MODE_CRS_DRV9_REG36_ADDR A:&base_addr+0x892428
y.create.l HWIO_RPMH_VRM_MODE_CRS_DRV9_REG37_ADDR A:&base_addr+0x892528
y.create.l HWIO_RPMH_VRM_MODE_CRS_DRV9_REG38_ADDR A:&base_addr+0x892628
y.create.l HWIO_RPMH_VRM_MODE_CRS_DRV9_REG39_ADDR A:&base_addr+0x892728
y.create.l HWIO_RPMH_VRM_MODE_CRS_DRV9_REG40_ADDR A:&base_addr+0x892828
y.create.l HWIO_RPMH_VRM_MODE_CRS_DRV9_REG41_ADDR A:&base_addr+0x892928
y.create.l HWIO_RPMH_VRM_MODE_CRS_DRV9_REG42_ADDR A:&base_addr+0x892a28
y.create.l HWIO_RPMH_VRM_MODE_CRS_DRV9_REG43_ADDR A:&base_addr+0x892b28
y.create.l HWIO_RPMH_VRM_MODE_CRS_DRV9_REG44_ADDR A:&base_addr+0x892c28
y.create.l HWIO_RPMH_VRM_MODE_CRS_DRV9_REG45_ADDR A:&base_addr+0x892d28
y.create.l HWIO_RPMH_VRM_MODE_CRS_DRV10_REG0_ADDR A:&base_addr+0x8a0028
y.create.l HWIO_RPMH_VRM_MODE_CRS_DRV10_REG1_ADDR A:&base_addr+0x8a0128
y.create.l HWIO_RPMH_VRM_MODE_CRS_DRV10_REG2_ADDR A:&base_addr+0x8a0228
y.create.l HWIO_RPMH_VRM_MODE_CRS_DRV10_REG3_ADDR A:&base_addr+0x8a0328
y.create.l HWIO_RPMH_VRM_MODE_CRS_DRV10_REG4_ADDR A:&base_addr+0x8a0428
y.create.l HWIO_RPMH_VRM_MODE_CRS_DRV10_REG5_ADDR A:&base_addr+0x8a0528
y.create.l HWIO_RPMH_VRM_MODE_CRS_DRV10_REG6_ADDR A:&base_addr+0x8a0628
y.create.l HWIO_RPMH_VRM_MODE_CRS_DRV10_REG7_ADDR A:&base_addr+0x8a0728
y.create.l HWIO_RPMH_VRM_MODE_CRS_DRV10_REG8_ADDR A:&base_addr+0x8a0828
y.create.l HWIO_RPMH_VRM_MODE_CRS_DRV10_REG9_ADDR A:&base_addr+0x8a0928
y.create.l HWIO_RPMH_VRM_MODE_CRS_DRV10_REG10_ADDR A:&base_addr+0x8a0a28
y.create.l HWIO_RPMH_VRM_MODE_CRS_DRV10_REG11_ADDR A:&base_addr+0x8a0b28
y.create.l HWIO_RPMH_VRM_MODE_CRS_DRV10_REG12_ADDR A:&base_addr+0x8a0c28
y.create.l HWIO_RPMH_VRM_MODE_CRS_DRV10_REG13_ADDR A:&base_addr+0x8a0d28
y.create.l HWIO_RPMH_VRM_MODE_CRS_DRV10_REG14_ADDR A:&base_addr+0x8a0e28
y.create.l HWIO_RPMH_VRM_MODE_CRS_DRV10_REG15_ADDR A:&base_addr+0x8a0f28
y.create.l HWIO_RPMH_VRM_MODE_CRS_DRV10_REG16_ADDR A:&base_addr+0x8a1028
y.create.l HWIO_RPMH_VRM_MODE_CRS_DRV10_REG17_ADDR A:&base_addr+0x8a1128
y.create.l HWIO_RPMH_VRM_MODE_CRS_DRV10_REG18_ADDR A:&base_addr+0x8a1228
y.create.l HWIO_RPMH_VRM_MODE_CRS_DRV10_REG19_ADDR A:&base_addr+0x8a1328
y.create.l HWIO_RPMH_VRM_MODE_CRS_DRV10_REG20_ADDR A:&base_addr+0x8a1428
y.create.l HWIO_RPMH_VRM_MODE_CRS_DRV10_REG21_ADDR A:&base_addr+0x8a1528
y.create.l HWIO_RPMH_VRM_MODE_CRS_DRV10_REG22_ADDR A:&base_addr+0x8a1628
y.create.l HWIO_RPMH_VRM_MODE_CRS_DRV10_REG23_ADDR A:&base_addr+0x8a1728
y.create.l HWIO_RPMH_VRM_MODE_CRS_DRV10_REG24_ADDR A:&base_addr+0x8a1828
y.create.l HWIO_RPMH_VRM_MODE_CRS_DRV10_REG25_ADDR A:&base_addr+0x8a1928
y.create.l HWIO_RPMH_VRM_MODE_CRS_DRV10_REG26_ADDR A:&base_addr+0x8a1a28
y.create.l HWIO_RPMH_VRM_MODE_CRS_DRV10_REG27_ADDR A:&base_addr+0x8a1b28
y.create.l HWIO_RPMH_VRM_MODE_CRS_DRV10_REG28_ADDR A:&base_addr+0x8a1c28
y.create.l HWIO_RPMH_VRM_MODE_CRS_DRV10_REG29_ADDR A:&base_addr+0x8a1d28
y.create.l HWIO_RPMH_VRM_MODE_CRS_DRV10_REG30_ADDR A:&base_addr+0x8a1e28
y.create.l HWIO_RPMH_VRM_MODE_CRS_DRV10_REG31_ADDR A:&base_addr+0x8a1f28
y.create.l HWIO_RPMH_VRM_MODE_CRS_DRV10_REG32_ADDR A:&base_addr+0x8a2028
y.create.l HWIO_RPMH_VRM_MODE_CRS_DRV10_REG33_ADDR A:&base_addr+0x8a2128
y.create.l HWIO_RPMH_VRM_MODE_CRS_DRV10_REG34_ADDR A:&base_addr+0x8a2228
y.create.l HWIO_RPMH_VRM_MODE_CRS_DRV10_REG35_ADDR A:&base_addr+0x8a2328
y.create.l HWIO_RPMH_VRM_MODE_CRS_DRV10_REG36_ADDR A:&base_addr+0x8a2428
y.create.l HWIO_RPMH_VRM_MODE_CRS_DRV10_REG37_ADDR A:&base_addr+0x8a2528
y.create.l HWIO_RPMH_VRM_MODE_CRS_DRV10_REG38_ADDR A:&base_addr+0x8a2628
y.create.l HWIO_RPMH_VRM_MODE_CRS_DRV10_REG39_ADDR A:&base_addr+0x8a2728
y.create.l HWIO_RPMH_VRM_MODE_CRS_DRV10_REG40_ADDR A:&base_addr+0x8a2828
y.create.l HWIO_RPMH_VRM_MODE_CRS_DRV10_REG41_ADDR A:&base_addr+0x8a2928
y.create.l HWIO_RPMH_VRM_MODE_CRS_DRV10_REG42_ADDR A:&base_addr+0x8a2a28
y.create.l HWIO_RPMH_VRM_MODE_CRS_DRV10_REG43_ADDR A:&base_addr+0x8a2b28
y.create.l HWIO_RPMH_VRM_MODE_CRS_DRV10_REG44_ADDR A:&base_addr+0x8a2c28
y.create.l HWIO_RPMH_VRM_MODE_CRS_DRV10_REG45_ADDR A:&base_addr+0x8a2d28
y.create.l HWIO_RPMH_VRM_MODE_CRS_DRV11_REG0_ADDR A:&base_addr+0x8b0028
y.create.l HWIO_RPMH_VRM_MODE_CRS_DRV11_REG1_ADDR A:&base_addr+0x8b0128
y.create.l HWIO_RPMH_VRM_MODE_CRS_DRV11_REG2_ADDR A:&base_addr+0x8b0228
y.create.l HWIO_RPMH_VRM_MODE_CRS_DRV11_REG3_ADDR A:&base_addr+0x8b0328
y.create.l HWIO_RPMH_VRM_MODE_CRS_DRV11_REG4_ADDR A:&base_addr+0x8b0428
y.create.l HWIO_RPMH_VRM_MODE_CRS_DRV11_REG5_ADDR A:&base_addr+0x8b0528
y.create.l HWIO_RPMH_VRM_MODE_CRS_DRV11_REG6_ADDR A:&base_addr+0x8b0628
y.create.l HWIO_RPMH_VRM_MODE_CRS_DRV11_REG7_ADDR A:&base_addr+0x8b0728
y.create.l HWIO_RPMH_VRM_MODE_CRS_DRV11_REG8_ADDR A:&base_addr+0x8b0828
y.create.l HWIO_RPMH_VRM_MODE_CRS_DRV11_REG9_ADDR A:&base_addr+0x8b0928
y.create.l HWIO_RPMH_VRM_MODE_CRS_DRV11_REG10_ADDR A:&base_addr+0x8b0a28
y.create.l HWIO_RPMH_VRM_MODE_CRS_DRV11_REG11_ADDR A:&base_addr+0x8b0b28
y.create.l HWIO_RPMH_VRM_MODE_CRS_DRV11_REG12_ADDR A:&base_addr+0x8b0c28
y.create.l HWIO_RPMH_VRM_MODE_CRS_DRV11_REG13_ADDR A:&base_addr+0x8b0d28
y.create.l HWIO_RPMH_VRM_MODE_CRS_DRV11_REG14_ADDR A:&base_addr+0x8b0e28
y.create.l HWIO_RPMH_VRM_MODE_CRS_DRV11_REG15_ADDR A:&base_addr+0x8b0f28
y.create.l HWIO_RPMH_VRM_MODE_CRS_DRV11_REG16_ADDR A:&base_addr+0x8b1028
y.create.l HWIO_RPMH_VRM_MODE_CRS_DRV11_REG17_ADDR A:&base_addr+0x8b1128
y.create.l HWIO_RPMH_VRM_MODE_CRS_DRV11_REG18_ADDR A:&base_addr+0x8b1228
y.create.l HWIO_RPMH_VRM_MODE_CRS_DRV11_REG19_ADDR A:&base_addr+0x8b1328
y.create.l HWIO_RPMH_VRM_MODE_CRS_DRV11_REG20_ADDR A:&base_addr+0x8b1428
y.create.l HWIO_RPMH_VRM_MODE_CRS_DRV11_REG21_ADDR A:&base_addr+0x8b1528
y.create.l HWIO_RPMH_VRM_MODE_CRS_DRV11_REG22_ADDR A:&base_addr+0x8b1628
y.create.l HWIO_RPMH_VRM_MODE_CRS_DRV11_REG23_ADDR A:&base_addr+0x8b1728
y.create.l HWIO_RPMH_VRM_MODE_CRS_DRV11_REG24_ADDR A:&base_addr+0x8b1828
y.create.l HWIO_RPMH_VRM_MODE_CRS_DRV11_REG25_ADDR A:&base_addr+0x8b1928
y.create.l HWIO_RPMH_VRM_MODE_CRS_DRV11_REG26_ADDR A:&base_addr+0x8b1a28
y.create.l HWIO_RPMH_VRM_MODE_CRS_DRV11_REG27_ADDR A:&base_addr+0x8b1b28
y.create.l HWIO_RPMH_VRM_MODE_CRS_DRV11_REG28_ADDR A:&base_addr+0x8b1c28
y.create.l HWIO_RPMH_VRM_MODE_CRS_DRV11_REG29_ADDR A:&base_addr+0x8b1d28
y.create.l HWIO_RPMH_VRM_MODE_CRS_DRV11_REG30_ADDR A:&base_addr+0x8b1e28
y.create.l HWIO_RPMH_VRM_MODE_CRS_DRV11_REG31_ADDR A:&base_addr+0x8b1f28
y.create.l HWIO_RPMH_VRM_MODE_CRS_DRV11_REG32_ADDR A:&base_addr+0x8b2028
y.create.l HWIO_RPMH_VRM_MODE_CRS_DRV11_REG33_ADDR A:&base_addr+0x8b2128
y.create.l HWIO_RPMH_VRM_MODE_CRS_DRV11_REG34_ADDR A:&base_addr+0x8b2228
y.create.l HWIO_RPMH_VRM_MODE_CRS_DRV11_REG35_ADDR A:&base_addr+0x8b2328
y.create.l HWIO_RPMH_VRM_MODE_CRS_DRV11_REG36_ADDR A:&base_addr+0x8b2428
y.create.l HWIO_RPMH_VRM_MODE_CRS_DRV11_REG37_ADDR A:&base_addr+0x8b2528
y.create.l HWIO_RPMH_VRM_MODE_CRS_DRV11_REG38_ADDR A:&base_addr+0x8b2628
y.create.l HWIO_RPMH_VRM_MODE_CRS_DRV11_REG39_ADDR A:&base_addr+0x8b2728
y.create.l HWIO_RPMH_VRM_MODE_CRS_DRV11_REG40_ADDR A:&base_addr+0x8b2828
y.create.l HWIO_RPMH_VRM_MODE_CRS_DRV11_REG41_ADDR A:&base_addr+0x8b2928
y.create.l HWIO_RPMH_VRM_MODE_CRS_DRV11_REG42_ADDR A:&base_addr+0x8b2a28
y.create.l HWIO_RPMH_VRM_MODE_CRS_DRV11_REG43_ADDR A:&base_addr+0x8b2b28
y.create.l HWIO_RPMH_VRM_MODE_CRS_DRV11_REG44_ADDR A:&base_addr+0x8b2c28
y.create.l HWIO_RPMH_VRM_MODE_CRS_DRV11_REG45_ADDR A:&base_addr+0x8b2d28
y.create.l HWIO_RPMH_VRM_MODE_CRS_DRV12_REG0_ADDR A:&base_addr+0x8c0028
y.create.l HWIO_RPMH_VRM_MODE_CRS_DRV12_REG1_ADDR A:&base_addr+0x8c0128
y.create.l HWIO_RPMH_VRM_MODE_CRS_DRV12_REG2_ADDR A:&base_addr+0x8c0228
y.create.l HWIO_RPMH_VRM_MODE_CRS_DRV12_REG3_ADDR A:&base_addr+0x8c0328
y.create.l HWIO_RPMH_VRM_MODE_CRS_DRV12_REG4_ADDR A:&base_addr+0x8c0428
y.create.l HWIO_RPMH_VRM_MODE_CRS_DRV12_REG5_ADDR A:&base_addr+0x8c0528
y.create.l HWIO_RPMH_VRM_MODE_CRS_DRV12_REG6_ADDR A:&base_addr+0x8c0628
y.create.l HWIO_RPMH_VRM_MODE_CRS_DRV12_REG7_ADDR A:&base_addr+0x8c0728
y.create.l HWIO_RPMH_VRM_MODE_CRS_DRV12_REG8_ADDR A:&base_addr+0x8c0828
y.create.l HWIO_RPMH_VRM_MODE_CRS_DRV12_REG9_ADDR A:&base_addr+0x8c0928
y.create.l HWIO_RPMH_VRM_MODE_CRS_DRV12_REG10_ADDR A:&base_addr+0x8c0a28
y.create.l HWIO_RPMH_VRM_MODE_CRS_DRV12_REG11_ADDR A:&base_addr+0x8c0b28
y.create.l HWIO_RPMH_VRM_MODE_CRS_DRV12_REG12_ADDR A:&base_addr+0x8c0c28
y.create.l HWIO_RPMH_VRM_MODE_CRS_DRV12_REG13_ADDR A:&base_addr+0x8c0d28
y.create.l HWIO_RPMH_VRM_MODE_CRS_DRV12_REG14_ADDR A:&base_addr+0x8c0e28
y.create.l HWIO_RPMH_VRM_MODE_CRS_DRV12_REG15_ADDR A:&base_addr+0x8c0f28
y.create.l HWIO_RPMH_VRM_MODE_CRS_DRV12_REG16_ADDR A:&base_addr+0x8c1028
y.create.l HWIO_RPMH_VRM_MODE_CRS_DRV12_REG17_ADDR A:&base_addr+0x8c1128
y.create.l HWIO_RPMH_VRM_MODE_CRS_DRV12_REG18_ADDR A:&base_addr+0x8c1228
y.create.l HWIO_RPMH_VRM_MODE_CRS_DRV12_REG19_ADDR A:&base_addr+0x8c1328
y.create.l HWIO_RPMH_VRM_MODE_CRS_DRV12_REG20_ADDR A:&base_addr+0x8c1428
y.create.l HWIO_RPMH_VRM_MODE_CRS_DRV12_REG21_ADDR A:&base_addr+0x8c1528
y.create.l HWIO_RPMH_VRM_MODE_CRS_DRV12_REG22_ADDR A:&base_addr+0x8c1628
y.create.l HWIO_RPMH_VRM_MODE_CRS_DRV12_REG23_ADDR A:&base_addr+0x8c1728
y.create.l HWIO_RPMH_VRM_MODE_CRS_DRV12_REG24_ADDR A:&base_addr+0x8c1828
y.create.l HWIO_RPMH_VRM_MODE_CRS_DRV12_REG25_ADDR A:&base_addr+0x8c1928
y.create.l HWIO_RPMH_VRM_MODE_CRS_DRV12_REG26_ADDR A:&base_addr+0x8c1a28
y.create.l HWIO_RPMH_VRM_MODE_CRS_DRV12_REG27_ADDR A:&base_addr+0x8c1b28
y.create.l HWIO_RPMH_VRM_MODE_CRS_DRV12_REG28_ADDR A:&base_addr+0x8c1c28
y.create.l HWIO_RPMH_VRM_MODE_CRS_DRV12_REG29_ADDR A:&base_addr+0x8c1d28
y.create.l HWIO_RPMH_VRM_MODE_CRS_DRV12_REG30_ADDR A:&base_addr+0x8c1e28
y.create.l HWIO_RPMH_VRM_MODE_CRS_DRV12_REG31_ADDR A:&base_addr+0x8c1f28
y.create.l HWIO_RPMH_VRM_MODE_CRS_DRV12_REG32_ADDR A:&base_addr+0x8c2028
y.create.l HWIO_RPMH_VRM_MODE_CRS_DRV12_REG33_ADDR A:&base_addr+0x8c2128
y.create.l HWIO_RPMH_VRM_MODE_CRS_DRV12_REG34_ADDR A:&base_addr+0x8c2228
y.create.l HWIO_RPMH_VRM_MODE_CRS_DRV12_REG35_ADDR A:&base_addr+0x8c2328
y.create.l HWIO_RPMH_VRM_MODE_CRS_DRV12_REG36_ADDR A:&base_addr+0x8c2428
y.create.l HWIO_RPMH_VRM_MODE_CRS_DRV12_REG37_ADDR A:&base_addr+0x8c2528
y.create.l HWIO_RPMH_VRM_MODE_CRS_DRV12_REG38_ADDR A:&base_addr+0x8c2628
y.create.l HWIO_RPMH_VRM_MODE_CRS_DRV12_REG39_ADDR A:&base_addr+0x8c2728
y.create.l HWIO_RPMH_VRM_MODE_CRS_DRV12_REG40_ADDR A:&base_addr+0x8c2828
y.create.l HWIO_RPMH_VRM_MODE_CRS_DRV12_REG41_ADDR A:&base_addr+0x8c2928
y.create.l HWIO_RPMH_VRM_MODE_CRS_DRV12_REG42_ADDR A:&base_addr+0x8c2a28
y.create.l HWIO_RPMH_VRM_MODE_CRS_DRV12_REG43_ADDR A:&base_addr+0x8c2b28
y.create.l HWIO_RPMH_VRM_MODE_CRS_DRV12_REG44_ADDR A:&base_addr+0x8c2c28
y.create.l HWIO_RPMH_VRM_MODE_CRS_DRV12_REG45_ADDR A:&base_addr+0x8c2d28
y.create.l HWIO_RPMH_VRM_MODE_CRS_DRV13_REG0_ADDR A:&base_addr+0x8d0028
y.create.l HWIO_RPMH_VRM_MODE_CRS_DRV13_REG1_ADDR A:&base_addr+0x8d0128
y.create.l HWIO_RPMH_VRM_MODE_CRS_DRV13_REG2_ADDR A:&base_addr+0x8d0228
y.create.l HWIO_RPMH_VRM_MODE_CRS_DRV13_REG3_ADDR A:&base_addr+0x8d0328
y.create.l HWIO_RPMH_VRM_MODE_CRS_DRV13_REG4_ADDR A:&base_addr+0x8d0428
y.create.l HWIO_RPMH_VRM_MODE_CRS_DRV13_REG5_ADDR A:&base_addr+0x8d0528
y.create.l HWIO_RPMH_VRM_MODE_CRS_DRV13_REG6_ADDR A:&base_addr+0x8d0628
y.create.l HWIO_RPMH_VRM_MODE_CRS_DRV13_REG7_ADDR A:&base_addr+0x8d0728
y.create.l HWIO_RPMH_VRM_MODE_CRS_DRV13_REG8_ADDR A:&base_addr+0x8d0828
y.create.l HWIO_RPMH_VRM_MODE_CRS_DRV13_REG9_ADDR A:&base_addr+0x8d0928
y.create.l HWIO_RPMH_VRM_MODE_CRS_DRV13_REG10_ADDR A:&base_addr+0x8d0a28
y.create.l HWIO_RPMH_VRM_MODE_CRS_DRV13_REG11_ADDR A:&base_addr+0x8d0b28
y.create.l HWIO_RPMH_VRM_MODE_CRS_DRV13_REG12_ADDR A:&base_addr+0x8d0c28
y.create.l HWIO_RPMH_VRM_MODE_CRS_DRV13_REG13_ADDR A:&base_addr+0x8d0d28
y.create.l HWIO_RPMH_VRM_MODE_CRS_DRV13_REG14_ADDR A:&base_addr+0x8d0e28
y.create.l HWIO_RPMH_VRM_MODE_CRS_DRV13_REG15_ADDR A:&base_addr+0x8d0f28
y.create.l HWIO_RPMH_VRM_MODE_CRS_DRV13_REG16_ADDR A:&base_addr+0x8d1028
y.create.l HWIO_RPMH_VRM_MODE_CRS_DRV13_REG17_ADDR A:&base_addr+0x8d1128
y.create.l HWIO_RPMH_VRM_MODE_CRS_DRV13_REG18_ADDR A:&base_addr+0x8d1228
y.create.l HWIO_RPMH_VRM_MODE_CRS_DRV13_REG19_ADDR A:&base_addr+0x8d1328
y.create.l HWIO_RPMH_VRM_MODE_CRS_DRV13_REG20_ADDR A:&base_addr+0x8d1428
y.create.l HWIO_RPMH_VRM_MODE_CRS_DRV13_REG21_ADDR A:&base_addr+0x8d1528
y.create.l HWIO_RPMH_VRM_MODE_CRS_DRV13_REG22_ADDR A:&base_addr+0x8d1628
y.create.l HWIO_RPMH_VRM_MODE_CRS_DRV13_REG23_ADDR A:&base_addr+0x8d1728
y.create.l HWIO_RPMH_VRM_MODE_CRS_DRV13_REG24_ADDR A:&base_addr+0x8d1828
y.create.l HWIO_RPMH_VRM_MODE_CRS_DRV13_REG25_ADDR A:&base_addr+0x8d1928
y.create.l HWIO_RPMH_VRM_MODE_CRS_DRV13_REG26_ADDR A:&base_addr+0x8d1a28
y.create.l HWIO_RPMH_VRM_MODE_CRS_DRV13_REG27_ADDR A:&base_addr+0x8d1b28
y.create.l HWIO_RPMH_VRM_MODE_CRS_DRV13_REG28_ADDR A:&base_addr+0x8d1c28
y.create.l HWIO_RPMH_VRM_MODE_CRS_DRV13_REG29_ADDR A:&base_addr+0x8d1d28
y.create.l HWIO_RPMH_VRM_MODE_CRS_DRV13_REG30_ADDR A:&base_addr+0x8d1e28
y.create.l HWIO_RPMH_VRM_MODE_CRS_DRV13_REG31_ADDR A:&base_addr+0x8d1f28
y.create.l HWIO_RPMH_VRM_MODE_CRS_DRV13_REG32_ADDR A:&base_addr+0x8d2028
y.create.l HWIO_RPMH_VRM_MODE_CRS_DRV13_REG33_ADDR A:&base_addr+0x8d2128
y.create.l HWIO_RPMH_VRM_MODE_CRS_DRV13_REG34_ADDR A:&base_addr+0x8d2228
y.create.l HWIO_RPMH_VRM_MODE_CRS_DRV13_REG35_ADDR A:&base_addr+0x8d2328
y.create.l HWIO_RPMH_VRM_MODE_CRS_DRV13_REG36_ADDR A:&base_addr+0x8d2428
y.create.l HWIO_RPMH_VRM_MODE_CRS_DRV13_REG37_ADDR A:&base_addr+0x8d2528
y.create.l HWIO_RPMH_VRM_MODE_CRS_DRV13_REG38_ADDR A:&base_addr+0x8d2628
y.create.l HWIO_RPMH_VRM_MODE_CRS_DRV13_REG39_ADDR A:&base_addr+0x8d2728
y.create.l HWIO_RPMH_VRM_MODE_CRS_DRV13_REG40_ADDR A:&base_addr+0x8d2828
y.create.l HWIO_RPMH_VRM_MODE_CRS_DRV13_REG41_ADDR A:&base_addr+0x8d2928
y.create.l HWIO_RPMH_VRM_MODE_CRS_DRV13_REG42_ADDR A:&base_addr+0x8d2a28
y.create.l HWIO_RPMH_VRM_MODE_CRS_DRV13_REG43_ADDR A:&base_addr+0x8d2b28
y.create.l HWIO_RPMH_VRM_MODE_CRS_DRV13_REG44_ADDR A:&base_addr+0x8d2c28
y.create.l HWIO_RPMH_VRM_MODE_CRS_DRV13_REG45_ADDR A:&base_addr+0x8d2d28
y.create.l HWIO_RPMH_VRM_MODE_CRS_DRV14_REG0_ADDR A:&base_addr+0x8e0028
y.create.l HWIO_RPMH_VRM_MODE_CRS_DRV14_REG1_ADDR A:&base_addr+0x8e0128
y.create.l HWIO_RPMH_VRM_MODE_CRS_DRV14_REG2_ADDR A:&base_addr+0x8e0228
y.create.l HWIO_RPMH_VRM_MODE_CRS_DRV14_REG3_ADDR A:&base_addr+0x8e0328
y.create.l HWIO_RPMH_VRM_MODE_CRS_DRV14_REG4_ADDR A:&base_addr+0x8e0428
y.create.l HWIO_RPMH_VRM_MODE_CRS_DRV14_REG5_ADDR A:&base_addr+0x8e0528
y.create.l HWIO_RPMH_VRM_MODE_CRS_DRV14_REG6_ADDR A:&base_addr+0x8e0628
y.create.l HWIO_RPMH_VRM_MODE_CRS_DRV14_REG7_ADDR A:&base_addr+0x8e0728
y.create.l HWIO_RPMH_VRM_MODE_CRS_DRV14_REG8_ADDR A:&base_addr+0x8e0828
y.create.l HWIO_RPMH_VRM_MODE_CRS_DRV14_REG9_ADDR A:&base_addr+0x8e0928
y.create.l HWIO_RPMH_VRM_MODE_CRS_DRV14_REG10_ADDR A:&base_addr+0x8e0a28
y.create.l HWIO_RPMH_VRM_MODE_CRS_DRV14_REG11_ADDR A:&base_addr+0x8e0b28
y.create.l HWIO_RPMH_VRM_MODE_CRS_DRV14_REG12_ADDR A:&base_addr+0x8e0c28
y.create.l HWIO_RPMH_VRM_MODE_CRS_DRV14_REG13_ADDR A:&base_addr+0x8e0d28
y.create.l HWIO_RPMH_VRM_MODE_CRS_DRV14_REG14_ADDR A:&base_addr+0x8e0e28
y.create.l HWIO_RPMH_VRM_MODE_CRS_DRV14_REG15_ADDR A:&base_addr+0x8e0f28
y.create.l HWIO_RPMH_VRM_MODE_CRS_DRV14_REG16_ADDR A:&base_addr+0x8e1028
y.create.l HWIO_RPMH_VRM_MODE_CRS_DRV14_REG17_ADDR A:&base_addr+0x8e1128
y.create.l HWIO_RPMH_VRM_MODE_CRS_DRV14_REG18_ADDR A:&base_addr+0x8e1228
y.create.l HWIO_RPMH_VRM_MODE_CRS_DRV14_REG19_ADDR A:&base_addr+0x8e1328
y.create.l HWIO_RPMH_VRM_MODE_CRS_DRV14_REG20_ADDR A:&base_addr+0x8e1428
y.create.l HWIO_RPMH_VRM_MODE_CRS_DRV14_REG21_ADDR A:&base_addr+0x8e1528
y.create.l HWIO_RPMH_VRM_MODE_CRS_DRV14_REG22_ADDR A:&base_addr+0x8e1628
y.create.l HWIO_RPMH_VRM_MODE_CRS_DRV14_REG23_ADDR A:&base_addr+0x8e1728
y.create.l HWIO_RPMH_VRM_MODE_CRS_DRV14_REG24_ADDR A:&base_addr+0x8e1828
y.create.l HWIO_RPMH_VRM_MODE_CRS_DRV14_REG25_ADDR A:&base_addr+0x8e1928
y.create.l HWIO_RPMH_VRM_MODE_CRS_DRV14_REG26_ADDR A:&base_addr+0x8e1a28
y.create.l HWIO_RPMH_VRM_MODE_CRS_DRV14_REG27_ADDR A:&base_addr+0x8e1b28
y.create.l HWIO_RPMH_VRM_MODE_CRS_DRV14_REG28_ADDR A:&base_addr+0x8e1c28
y.create.l HWIO_RPMH_VRM_MODE_CRS_DRV14_REG29_ADDR A:&base_addr+0x8e1d28
y.create.l HWIO_RPMH_VRM_MODE_CRS_DRV14_REG30_ADDR A:&base_addr+0x8e1e28
y.create.l HWIO_RPMH_VRM_MODE_CRS_DRV14_REG31_ADDR A:&base_addr+0x8e1f28
y.create.l HWIO_RPMH_VRM_MODE_CRS_DRV14_REG32_ADDR A:&base_addr+0x8e2028
y.create.l HWIO_RPMH_VRM_MODE_CRS_DRV14_REG33_ADDR A:&base_addr+0x8e2128
y.create.l HWIO_RPMH_VRM_MODE_CRS_DRV14_REG34_ADDR A:&base_addr+0x8e2228
y.create.l HWIO_RPMH_VRM_MODE_CRS_DRV14_REG35_ADDR A:&base_addr+0x8e2328
y.create.l HWIO_RPMH_VRM_MODE_CRS_DRV14_REG36_ADDR A:&base_addr+0x8e2428
y.create.l HWIO_RPMH_VRM_MODE_CRS_DRV14_REG37_ADDR A:&base_addr+0x8e2528
y.create.l HWIO_RPMH_VRM_MODE_CRS_DRV14_REG38_ADDR A:&base_addr+0x8e2628
y.create.l HWIO_RPMH_VRM_MODE_CRS_DRV14_REG39_ADDR A:&base_addr+0x8e2728
y.create.l HWIO_RPMH_VRM_MODE_CRS_DRV14_REG40_ADDR A:&base_addr+0x8e2828
y.create.l HWIO_RPMH_VRM_MODE_CRS_DRV14_REG41_ADDR A:&base_addr+0x8e2928
y.create.l HWIO_RPMH_VRM_MODE_CRS_DRV14_REG42_ADDR A:&base_addr+0x8e2a28
y.create.l HWIO_RPMH_VRM_MODE_CRS_DRV14_REG43_ADDR A:&base_addr+0x8e2b28
y.create.l HWIO_RPMH_VRM_MODE_CRS_DRV14_REG44_ADDR A:&base_addr+0x8e2c28
y.create.l HWIO_RPMH_VRM_MODE_CRS_DRV14_REG45_ADDR A:&base_addr+0x8e2d28
y.create.l HWIO_RPMH_VRM_HEADROOM_CRS_DRV0_REG0_ADDR A:&base_addr+0x80002c
y.create.l HWIO_RPMH_VRM_HEADROOM_CRS_DRV0_REG1_ADDR A:&base_addr+0x80012c
y.create.l HWIO_RPMH_VRM_HEADROOM_CRS_DRV0_REG2_ADDR A:&base_addr+0x80022c
y.create.l HWIO_RPMH_VRM_HEADROOM_CRS_DRV0_REG3_ADDR A:&base_addr+0x80032c
y.create.l HWIO_RPMH_VRM_HEADROOM_CRS_DRV0_REG4_ADDR A:&base_addr+0x80042c
y.create.l HWIO_RPMH_VRM_HEADROOM_CRS_DRV0_REG5_ADDR A:&base_addr+0x80052c
y.create.l HWIO_RPMH_VRM_HEADROOM_CRS_DRV0_REG6_ADDR A:&base_addr+0x80062c
y.create.l HWIO_RPMH_VRM_HEADROOM_CRS_DRV0_REG7_ADDR A:&base_addr+0x80072c
y.create.l HWIO_RPMH_VRM_HEADROOM_CRS_DRV0_REG8_ADDR A:&base_addr+0x80082c
y.create.l HWIO_RPMH_VRM_HEADROOM_CRS_DRV0_REG9_ADDR A:&base_addr+0x80092c
y.create.l HWIO_RPMH_VRM_HEADROOM_CRS_DRV0_REG10_ADDR A:&base_addr+0x800a2c
y.create.l HWIO_RPMH_VRM_HEADROOM_CRS_DRV0_REG11_ADDR A:&base_addr+0x800b2c
y.create.l HWIO_RPMH_VRM_HEADROOM_CRS_DRV0_REG12_ADDR A:&base_addr+0x800c2c
y.create.l HWIO_RPMH_VRM_HEADROOM_CRS_DRV0_REG13_ADDR A:&base_addr+0x800d2c
y.create.l HWIO_RPMH_VRM_HEADROOM_CRS_DRV0_REG14_ADDR A:&base_addr+0x800e2c
y.create.l HWIO_RPMH_VRM_HEADROOM_CRS_DRV0_REG15_ADDR A:&base_addr+0x800f2c
y.create.l HWIO_RPMH_VRM_HEADROOM_CRS_DRV0_REG16_ADDR A:&base_addr+0x80102c
y.create.l HWIO_RPMH_VRM_HEADROOM_CRS_DRV0_REG17_ADDR A:&base_addr+0x80112c
y.create.l HWIO_RPMH_VRM_HEADROOM_CRS_DRV0_REG18_ADDR A:&base_addr+0x80122c
y.create.l HWIO_RPMH_VRM_HEADROOM_CRS_DRV0_REG19_ADDR A:&base_addr+0x80132c
y.create.l HWIO_RPMH_VRM_HEADROOM_CRS_DRV0_REG20_ADDR A:&base_addr+0x80142c
y.create.l HWIO_RPMH_VRM_HEADROOM_CRS_DRV0_REG21_ADDR A:&base_addr+0x80152c
y.create.l HWIO_RPMH_VRM_HEADROOM_CRS_DRV0_REG22_ADDR A:&base_addr+0x80162c
y.create.l HWIO_RPMH_VRM_HEADROOM_CRS_DRV0_REG23_ADDR A:&base_addr+0x80172c
y.create.l HWIO_RPMH_VRM_HEADROOM_CRS_DRV0_REG24_ADDR A:&base_addr+0x80182c
y.create.l HWIO_RPMH_VRM_HEADROOM_CRS_DRV0_REG25_ADDR A:&base_addr+0x80192c
y.create.l HWIO_RPMH_VRM_HEADROOM_CRS_DRV0_REG26_ADDR A:&base_addr+0x801a2c
y.create.l HWIO_RPMH_VRM_HEADROOM_CRS_DRV0_REG27_ADDR A:&base_addr+0x801b2c
y.create.l HWIO_RPMH_VRM_HEADROOM_CRS_DRV0_REG28_ADDR A:&base_addr+0x801c2c
y.create.l HWIO_RPMH_VRM_HEADROOM_CRS_DRV0_REG29_ADDR A:&base_addr+0x801d2c
y.create.l HWIO_RPMH_VRM_HEADROOM_CRS_DRV0_REG30_ADDR A:&base_addr+0x801e2c
y.create.l HWIO_RPMH_VRM_HEADROOM_CRS_DRV0_REG31_ADDR A:&base_addr+0x801f2c
y.create.l HWIO_RPMH_VRM_HEADROOM_CRS_DRV0_REG32_ADDR A:&base_addr+0x80202c
y.create.l HWIO_RPMH_VRM_HEADROOM_CRS_DRV0_REG33_ADDR A:&base_addr+0x80212c
y.create.l HWIO_RPMH_VRM_HEADROOM_CRS_DRV0_REG34_ADDR A:&base_addr+0x80222c
y.create.l HWIO_RPMH_VRM_HEADROOM_CRS_DRV0_REG35_ADDR A:&base_addr+0x80232c
y.create.l HWIO_RPMH_VRM_HEADROOM_CRS_DRV0_REG36_ADDR A:&base_addr+0x80242c
y.create.l HWIO_RPMH_VRM_HEADROOM_CRS_DRV0_REG37_ADDR A:&base_addr+0x80252c
y.create.l HWIO_RPMH_VRM_HEADROOM_CRS_DRV0_REG38_ADDR A:&base_addr+0x80262c
y.create.l HWIO_RPMH_VRM_HEADROOM_CRS_DRV0_REG39_ADDR A:&base_addr+0x80272c
y.create.l HWIO_RPMH_VRM_HEADROOM_CRS_DRV0_REG40_ADDR A:&base_addr+0x80282c
y.create.l HWIO_RPMH_VRM_HEADROOM_CRS_DRV0_REG41_ADDR A:&base_addr+0x80292c
y.create.l HWIO_RPMH_VRM_HEADROOM_CRS_DRV0_REG42_ADDR A:&base_addr+0x802a2c
y.create.l HWIO_RPMH_VRM_HEADROOM_CRS_DRV0_REG43_ADDR A:&base_addr+0x802b2c
y.create.l HWIO_RPMH_VRM_HEADROOM_CRS_DRV0_REG44_ADDR A:&base_addr+0x802c2c
y.create.l HWIO_RPMH_VRM_HEADROOM_CRS_DRV0_REG45_ADDR A:&base_addr+0x802d2c
y.create.l HWIO_RPMH_VRM_HEADROOM_CRS_DRV1_REG0_ADDR A:&base_addr+0x81002c
y.create.l HWIO_RPMH_VRM_HEADROOM_CRS_DRV1_REG1_ADDR A:&base_addr+0x81012c
y.create.l HWIO_RPMH_VRM_HEADROOM_CRS_DRV1_REG2_ADDR A:&base_addr+0x81022c
y.create.l HWIO_RPMH_VRM_HEADROOM_CRS_DRV1_REG3_ADDR A:&base_addr+0x81032c
y.create.l HWIO_RPMH_VRM_HEADROOM_CRS_DRV1_REG4_ADDR A:&base_addr+0x81042c
y.create.l HWIO_RPMH_VRM_HEADROOM_CRS_DRV1_REG5_ADDR A:&base_addr+0x81052c
y.create.l HWIO_RPMH_VRM_HEADROOM_CRS_DRV1_REG6_ADDR A:&base_addr+0x81062c
y.create.l HWIO_RPMH_VRM_HEADROOM_CRS_DRV1_REG7_ADDR A:&base_addr+0x81072c
y.create.l HWIO_RPMH_VRM_HEADROOM_CRS_DRV1_REG8_ADDR A:&base_addr+0x81082c
y.create.l HWIO_RPMH_VRM_HEADROOM_CRS_DRV1_REG9_ADDR A:&base_addr+0x81092c
y.create.l HWIO_RPMH_VRM_HEADROOM_CRS_DRV1_REG10_ADDR A:&base_addr+0x810a2c
y.create.l HWIO_RPMH_VRM_HEADROOM_CRS_DRV1_REG11_ADDR A:&base_addr+0x810b2c
y.create.l HWIO_RPMH_VRM_HEADROOM_CRS_DRV1_REG12_ADDR A:&base_addr+0x810c2c
y.create.l HWIO_RPMH_VRM_HEADROOM_CRS_DRV1_REG13_ADDR A:&base_addr+0x810d2c
y.create.l HWIO_RPMH_VRM_HEADROOM_CRS_DRV1_REG14_ADDR A:&base_addr+0x810e2c
y.create.l HWIO_RPMH_VRM_HEADROOM_CRS_DRV1_REG15_ADDR A:&base_addr+0x810f2c
y.create.l HWIO_RPMH_VRM_HEADROOM_CRS_DRV1_REG16_ADDR A:&base_addr+0x81102c
y.create.l HWIO_RPMH_VRM_HEADROOM_CRS_DRV1_REG17_ADDR A:&base_addr+0x81112c
y.create.l HWIO_RPMH_VRM_HEADROOM_CRS_DRV1_REG18_ADDR A:&base_addr+0x81122c
y.create.l HWIO_RPMH_VRM_HEADROOM_CRS_DRV1_REG19_ADDR A:&base_addr+0x81132c
y.create.l HWIO_RPMH_VRM_HEADROOM_CRS_DRV1_REG20_ADDR A:&base_addr+0x81142c
y.create.l HWIO_RPMH_VRM_HEADROOM_CRS_DRV1_REG21_ADDR A:&base_addr+0x81152c
y.create.l HWIO_RPMH_VRM_HEADROOM_CRS_DRV1_REG22_ADDR A:&base_addr+0x81162c
y.create.l HWIO_RPMH_VRM_HEADROOM_CRS_DRV1_REG23_ADDR A:&base_addr+0x81172c
y.create.l HWIO_RPMH_VRM_HEADROOM_CRS_DRV1_REG24_ADDR A:&base_addr+0x81182c
y.create.l HWIO_RPMH_VRM_HEADROOM_CRS_DRV1_REG25_ADDR A:&base_addr+0x81192c
y.create.l HWIO_RPMH_VRM_HEADROOM_CRS_DRV1_REG26_ADDR A:&base_addr+0x811a2c
y.create.l HWIO_RPMH_VRM_HEADROOM_CRS_DRV1_REG27_ADDR A:&base_addr+0x811b2c
y.create.l HWIO_RPMH_VRM_HEADROOM_CRS_DRV1_REG28_ADDR A:&base_addr+0x811c2c
y.create.l HWIO_RPMH_VRM_HEADROOM_CRS_DRV1_REG29_ADDR A:&base_addr+0x811d2c
y.create.l HWIO_RPMH_VRM_HEADROOM_CRS_DRV1_REG30_ADDR A:&base_addr+0x811e2c
y.create.l HWIO_RPMH_VRM_HEADROOM_CRS_DRV1_REG31_ADDR A:&base_addr+0x811f2c
y.create.l HWIO_RPMH_VRM_HEADROOM_CRS_DRV1_REG32_ADDR A:&base_addr+0x81202c
y.create.l HWIO_RPMH_VRM_HEADROOM_CRS_DRV1_REG33_ADDR A:&base_addr+0x81212c
y.create.l HWIO_RPMH_VRM_HEADROOM_CRS_DRV1_REG34_ADDR A:&base_addr+0x81222c
y.create.l HWIO_RPMH_VRM_HEADROOM_CRS_DRV1_REG35_ADDR A:&base_addr+0x81232c
y.create.l HWIO_RPMH_VRM_HEADROOM_CRS_DRV1_REG36_ADDR A:&base_addr+0x81242c
y.create.l HWIO_RPMH_VRM_HEADROOM_CRS_DRV1_REG37_ADDR A:&base_addr+0x81252c
y.create.l HWIO_RPMH_VRM_HEADROOM_CRS_DRV1_REG38_ADDR A:&base_addr+0x81262c
y.create.l HWIO_RPMH_VRM_HEADROOM_CRS_DRV1_REG39_ADDR A:&base_addr+0x81272c
y.create.l HWIO_RPMH_VRM_HEADROOM_CRS_DRV1_REG40_ADDR A:&base_addr+0x81282c
y.create.l HWIO_RPMH_VRM_HEADROOM_CRS_DRV1_REG41_ADDR A:&base_addr+0x81292c
y.create.l HWIO_RPMH_VRM_HEADROOM_CRS_DRV1_REG42_ADDR A:&base_addr+0x812a2c
y.create.l HWIO_RPMH_VRM_HEADROOM_CRS_DRV1_REG43_ADDR A:&base_addr+0x812b2c
y.create.l HWIO_RPMH_VRM_HEADROOM_CRS_DRV1_REG44_ADDR A:&base_addr+0x812c2c
y.create.l HWIO_RPMH_VRM_HEADROOM_CRS_DRV1_REG45_ADDR A:&base_addr+0x812d2c
y.create.l HWIO_RPMH_VRM_HEADROOM_CRS_DRV2_REG0_ADDR A:&base_addr+0x82002c
y.create.l HWIO_RPMH_VRM_HEADROOM_CRS_DRV2_REG1_ADDR A:&base_addr+0x82012c
y.create.l HWIO_RPMH_VRM_HEADROOM_CRS_DRV2_REG2_ADDR A:&base_addr+0x82022c
y.create.l HWIO_RPMH_VRM_HEADROOM_CRS_DRV2_REG3_ADDR A:&base_addr+0x82032c
y.create.l HWIO_RPMH_VRM_HEADROOM_CRS_DRV2_REG4_ADDR A:&base_addr+0x82042c
y.create.l HWIO_RPMH_VRM_HEADROOM_CRS_DRV2_REG5_ADDR A:&base_addr+0x82052c
y.create.l HWIO_RPMH_VRM_HEADROOM_CRS_DRV2_REG6_ADDR A:&base_addr+0x82062c
y.create.l HWIO_RPMH_VRM_HEADROOM_CRS_DRV2_REG7_ADDR A:&base_addr+0x82072c
y.create.l HWIO_RPMH_VRM_HEADROOM_CRS_DRV2_REG8_ADDR A:&base_addr+0x82082c
y.create.l HWIO_RPMH_VRM_HEADROOM_CRS_DRV2_REG9_ADDR A:&base_addr+0x82092c
y.create.l HWIO_RPMH_VRM_HEADROOM_CRS_DRV2_REG10_ADDR A:&base_addr+0x820a2c
y.create.l HWIO_RPMH_VRM_HEADROOM_CRS_DRV2_REG11_ADDR A:&base_addr+0x820b2c
y.create.l HWIO_RPMH_VRM_HEADROOM_CRS_DRV2_REG12_ADDR A:&base_addr+0x820c2c
y.create.l HWIO_RPMH_VRM_HEADROOM_CRS_DRV2_REG13_ADDR A:&base_addr+0x820d2c
y.create.l HWIO_RPMH_VRM_HEADROOM_CRS_DRV2_REG14_ADDR A:&base_addr+0x820e2c
y.create.l HWIO_RPMH_VRM_HEADROOM_CRS_DRV2_REG15_ADDR A:&base_addr+0x820f2c
y.create.l HWIO_RPMH_VRM_HEADROOM_CRS_DRV2_REG16_ADDR A:&base_addr+0x82102c
y.create.l HWIO_RPMH_VRM_HEADROOM_CRS_DRV2_REG17_ADDR A:&base_addr+0x82112c
y.create.l HWIO_RPMH_VRM_HEADROOM_CRS_DRV2_REG18_ADDR A:&base_addr+0x82122c
y.create.l HWIO_RPMH_VRM_HEADROOM_CRS_DRV2_REG19_ADDR A:&base_addr+0x82132c
y.create.l HWIO_RPMH_VRM_HEADROOM_CRS_DRV2_REG20_ADDR A:&base_addr+0x82142c
y.create.l HWIO_RPMH_VRM_HEADROOM_CRS_DRV2_REG21_ADDR A:&base_addr+0x82152c
y.create.l HWIO_RPMH_VRM_HEADROOM_CRS_DRV2_REG22_ADDR A:&base_addr+0x82162c
y.create.l HWIO_RPMH_VRM_HEADROOM_CRS_DRV2_REG23_ADDR A:&base_addr+0x82172c
y.create.l HWIO_RPMH_VRM_HEADROOM_CRS_DRV2_REG24_ADDR A:&base_addr+0x82182c
y.create.l HWIO_RPMH_VRM_HEADROOM_CRS_DRV2_REG25_ADDR A:&base_addr+0x82192c
y.create.l HWIO_RPMH_VRM_HEADROOM_CRS_DRV2_REG26_ADDR A:&base_addr+0x821a2c
y.create.l HWIO_RPMH_VRM_HEADROOM_CRS_DRV2_REG27_ADDR A:&base_addr+0x821b2c
y.create.l HWIO_RPMH_VRM_HEADROOM_CRS_DRV2_REG28_ADDR A:&base_addr+0x821c2c
y.create.l HWIO_RPMH_VRM_HEADROOM_CRS_DRV2_REG29_ADDR A:&base_addr+0x821d2c
y.create.l HWIO_RPMH_VRM_HEADROOM_CRS_DRV2_REG30_ADDR A:&base_addr+0x821e2c
y.create.l HWIO_RPMH_VRM_HEADROOM_CRS_DRV2_REG31_ADDR A:&base_addr+0x821f2c
y.create.l HWIO_RPMH_VRM_HEADROOM_CRS_DRV2_REG32_ADDR A:&base_addr+0x82202c
y.create.l HWIO_RPMH_VRM_HEADROOM_CRS_DRV2_REG33_ADDR A:&base_addr+0x82212c
y.create.l HWIO_RPMH_VRM_HEADROOM_CRS_DRV2_REG34_ADDR A:&base_addr+0x82222c
y.create.l HWIO_RPMH_VRM_HEADROOM_CRS_DRV2_REG35_ADDR A:&base_addr+0x82232c
y.create.l HWIO_RPMH_VRM_HEADROOM_CRS_DRV2_REG36_ADDR A:&base_addr+0x82242c
y.create.l HWIO_RPMH_VRM_HEADROOM_CRS_DRV2_REG37_ADDR A:&base_addr+0x82252c
y.create.l HWIO_RPMH_VRM_HEADROOM_CRS_DRV2_REG38_ADDR A:&base_addr+0x82262c
y.create.l HWIO_RPMH_VRM_HEADROOM_CRS_DRV2_REG39_ADDR A:&base_addr+0x82272c
y.create.l HWIO_RPMH_VRM_HEADROOM_CRS_DRV2_REG40_ADDR A:&base_addr+0x82282c
y.create.l HWIO_RPMH_VRM_HEADROOM_CRS_DRV2_REG41_ADDR A:&base_addr+0x82292c
y.create.l HWIO_RPMH_VRM_HEADROOM_CRS_DRV2_REG42_ADDR A:&base_addr+0x822a2c
y.create.l HWIO_RPMH_VRM_HEADROOM_CRS_DRV2_REG43_ADDR A:&base_addr+0x822b2c
y.create.l HWIO_RPMH_VRM_HEADROOM_CRS_DRV2_REG44_ADDR A:&base_addr+0x822c2c
y.create.l HWIO_RPMH_VRM_HEADROOM_CRS_DRV2_REG45_ADDR A:&base_addr+0x822d2c
y.create.l HWIO_RPMH_VRM_HEADROOM_CRS_DRV3_REG0_ADDR A:&base_addr+0x83002c
y.create.l HWIO_RPMH_VRM_HEADROOM_CRS_DRV3_REG1_ADDR A:&base_addr+0x83012c
y.create.l HWIO_RPMH_VRM_HEADROOM_CRS_DRV3_REG2_ADDR A:&base_addr+0x83022c
y.create.l HWIO_RPMH_VRM_HEADROOM_CRS_DRV3_REG3_ADDR A:&base_addr+0x83032c
y.create.l HWIO_RPMH_VRM_HEADROOM_CRS_DRV3_REG4_ADDR A:&base_addr+0x83042c
y.create.l HWIO_RPMH_VRM_HEADROOM_CRS_DRV3_REG5_ADDR A:&base_addr+0x83052c
y.create.l HWIO_RPMH_VRM_HEADROOM_CRS_DRV3_REG6_ADDR A:&base_addr+0x83062c
y.create.l HWIO_RPMH_VRM_HEADROOM_CRS_DRV3_REG7_ADDR A:&base_addr+0x83072c
y.create.l HWIO_RPMH_VRM_HEADROOM_CRS_DRV3_REG8_ADDR A:&base_addr+0x83082c
y.create.l HWIO_RPMH_VRM_HEADROOM_CRS_DRV3_REG9_ADDR A:&base_addr+0x83092c
y.create.l HWIO_RPMH_VRM_HEADROOM_CRS_DRV3_REG10_ADDR A:&base_addr+0x830a2c
y.create.l HWIO_RPMH_VRM_HEADROOM_CRS_DRV3_REG11_ADDR A:&base_addr+0x830b2c
y.create.l HWIO_RPMH_VRM_HEADROOM_CRS_DRV3_REG12_ADDR A:&base_addr+0x830c2c
y.create.l HWIO_RPMH_VRM_HEADROOM_CRS_DRV3_REG13_ADDR A:&base_addr+0x830d2c
y.create.l HWIO_RPMH_VRM_HEADROOM_CRS_DRV3_REG14_ADDR A:&base_addr+0x830e2c
y.create.l HWIO_RPMH_VRM_HEADROOM_CRS_DRV3_REG15_ADDR A:&base_addr+0x830f2c
y.create.l HWIO_RPMH_VRM_HEADROOM_CRS_DRV3_REG16_ADDR A:&base_addr+0x83102c
y.create.l HWIO_RPMH_VRM_HEADROOM_CRS_DRV3_REG17_ADDR A:&base_addr+0x83112c
y.create.l HWIO_RPMH_VRM_HEADROOM_CRS_DRV3_REG18_ADDR A:&base_addr+0x83122c
y.create.l HWIO_RPMH_VRM_HEADROOM_CRS_DRV3_REG19_ADDR A:&base_addr+0x83132c
y.create.l HWIO_RPMH_VRM_HEADROOM_CRS_DRV3_REG20_ADDR A:&base_addr+0x83142c
y.create.l HWIO_RPMH_VRM_HEADROOM_CRS_DRV3_REG21_ADDR A:&base_addr+0x83152c
y.create.l HWIO_RPMH_VRM_HEADROOM_CRS_DRV3_REG22_ADDR A:&base_addr+0x83162c
y.create.l HWIO_RPMH_VRM_HEADROOM_CRS_DRV3_REG23_ADDR A:&base_addr+0x83172c
y.create.l HWIO_RPMH_VRM_HEADROOM_CRS_DRV3_REG24_ADDR A:&base_addr+0x83182c
y.create.l HWIO_RPMH_VRM_HEADROOM_CRS_DRV3_REG25_ADDR A:&base_addr+0x83192c
y.create.l HWIO_RPMH_VRM_HEADROOM_CRS_DRV3_REG26_ADDR A:&base_addr+0x831a2c
y.create.l HWIO_RPMH_VRM_HEADROOM_CRS_DRV3_REG27_ADDR A:&base_addr+0x831b2c
y.create.l HWIO_RPMH_VRM_HEADROOM_CRS_DRV3_REG28_ADDR A:&base_addr+0x831c2c
y.create.l HWIO_RPMH_VRM_HEADROOM_CRS_DRV3_REG29_ADDR A:&base_addr+0x831d2c
y.create.l HWIO_RPMH_VRM_HEADROOM_CRS_DRV3_REG30_ADDR A:&base_addr+0x831e2c
y.create.l HWIO_RPMH_VRM_HEADROOM_CRS_DRV3_REG31_ADDR A:&base_addr+0x831f2c
y.create.l HWIO_RPMH_VRM_HEADROOM_CRS_DRV3_REG32_ADDR A:&base_addr+0x83202c
y.create.l HWIO_RPMH_VRM_HEADROOM_CRS_DRV3_REG33_ADDR A:&base_addr+0x83212c
y.create.l HWIO_RPMH_VRM_HEADROOM_CRS_DRV3_REG34_ADDR A:&base_addr+0x83222c
y.create.l HWIO_RPMH_VRM_HEADROOM_CRS_DRV3_REG35_ADDR A:&base_addr+0x83232c
y.create.l HWIO_RPMH_VRM_HEADROOM_CRS_DRV3_REG36_ADDR A:&base_addr+0x83242c
y.create.l HWIO_RPMH_VRM_HEADROOM_CRS_DRV3_REG37_ADDR A:&base_addr+0x83252c
y.create.l HWIO_RPMH_VRM_HEADROOM_CRS_DRV3_REG38_ADDR A:&base_addr+0x83262c
y.create.l HWIO_RPMH_VRM_HEADROOM_CRS_DRV3_REG39_ADDR A:&base_addr+0x83272c
y.create.l HWIO_RPMH_VRM_HEADROOM_CRS_DRV3_REG40_ADDR A:&base_addr+0x83282c
y.create.l HWIO_RPMH_VRM_HEADROOM_CRS_DRV3_REG41_ADDR A:&base_addr+0x83292c
y.create.l HWIO_RPMH_VRM_HEADROOM_CRS_DRV3_REG42_ADDR A:&base_addr+0x832a2c
y.create.l HWIO_RPMH_VRM_HEADROOM_CRS_DRV3_REG43_ADDR A:&base_addr+0x832b2c
y.create.l HWIO_RPMH_VRM_HEADROOM_CRS_DRV3_REG44_ADDR A:&base_addr+0x832c2c
y.create.l HWIO_RPMH_VRM_HEADROOM_CRS_DRV3_REG45_ADDR A:&base_addr+0x832d2c
y.create.l HWIO_RPMH_VRM_HEADROOM_CRS_DRV4_REG0_ADDR A:&base_addr+0x84002c
y.create.l HWIO_RPMH_VRM_HEADROOM_CRS_DRV4_REG1_ADDR A:&base_addr+0x84012c
y.create.l HWIO_RPMH_VRM_HEADROOM_CRS_DRV4_REG2_ADDR A:&base_addr+0x84022c
y.create.l HWIO_RPMH_VRM_HEADROOM_CRS_DRV4_REG3_ADDR A:&base_addr+0x84032c
y.create.l HWIO_RPMH_VRM_HEADROOM_CRS_DRV4_REG4_ADDR A:&base_addr+0x84042c
y.create.l HWIO_RPMH_VRM_HEADROOM_CRS_DRV4_REG5_ADDR A:&base_addr+0x84052c
y.create.l HWIO_RPMH_VRM_HEADROOM_CRS_DRV4_REG6_ADDR A:&base_addr+0x84062c
y.create.l HWIO_RPMH_VRM_HEADROOM_CRS_DRV4_REG7_ADDR A:&base_addr+0x84072c
y.create.l HWIO_RPMH_VRM_HEADROOM_CRS_DRV4_REG8_ADDR A:&base_addr+0x84082c
y.create.l HWIO_RPMH_VRM_HEADROOM_CRS_DRV4_REG9_ADDR A:&base_addr+0x84092c
y.create.l HWIO_RPMH_VRM_HEADROOM_CRS_DRV4_REG10_ADDR A:&base_addr+0x840a2c
y.create.l HWIO_RPMH_VRM_HEADROOM_CRS_DRV4_REG11_ADDR A:&base_addr+0x840b2c
y.create.l HWIO_RPMH_VRM_HEADROOM_CRS_DRV4_REG12_ADDR A:&base_addr+0x840c2c
y.create.l HWIO_RPMH_VRM_HEADROOM_CRS_DRV4_REG13_ADDR A:&base_addr+0x840d2c
y.create.l HWIO_RPMH_VRM_HEADROOM_CRS_DRV4_REG14_ADDR A:&base_addr+0x840e2c
y.create.l HWIO_RPMH_VRM_HEADROOM_CRS_DRV4_REG15_ADDR A:&base_addr+0x840f2c
y.create.l HWIO_RPMH_VRM_HEADROOM_CRS_DRV4_REG16_ADDR A:&base_addr+0x84102c
y.create.l HWIO_RPMH_VRM_HEADROOM_CRS_DRV4_REG17_ADDR A:&base_addr+0x84112c
y.create.l HWIO_RPMH_VRM_HEADROOM_CRS_DRV4_REG18_ADDR A:&base_addr+0x84122c
y.create.l HWIO_RPMH_VRM_HEADROOM_CRS_DRV4_REG19_ADDR A:&base_addr+0x84132c
y.create.l HWIO_RPMH_VRM_HEADROOM_CRS_DRV4_REG20_ADDR A:&base_addr+0x84142c
y.create.l HWIO_RPMH_VRM_HEADROOM_CRS_DRV4_REG21_ADDR A:&base_addr+0x84152c
y.create.l HWIO_RPMH_VRM_HEADROOM_CRS_DRV4_REG22_ADDR A:&base_addr+0x84162c
y.create.l HWIO_RPMH_VRM_HEADROOM_CRS_DRV4_REG23_ADDR A:&base_addr+0x84172c
y.create.l HWIO_RPMH_VRM_HEADROOM_CRS_DRV4_REG24_ADDR A:&base_addr+0x84182c
y.create.l HWIO_RPMH_VRM_HEADROOM_CRS_DRV4_REG25_ADDR A:&base_addr+0x84192c
y.create.l HWIO_RPMH_VRM_HEADROOM_CRS_DRV4_REG26_ADDR A:&base_addr+0x841a2c
y.create.l HWIO_RPMH_VRM_HEADROOM_CRS_DRV4_REG27_ADDR A:&base_addr+0x841b2c
y.create.l HWIO_RPMH_VRM_HEADROOM_CRS_DRV4_REG28_ADDR A:&base_addr+0x841c2c
y.create.l HWIO_RPMH_VRM_HEADROOM_CRS_DRV4_REG29_ADDR A:&base_addr+0x841d2c
y.create.l HWIO_RPMH_VRM_HEADROOM_CRS_DRV4_REG30_ADDR A:&base_addr+0x841e2c
y.create.l HWIO_RPMH_VRM_HEADROOM_CRS_DRV4_REG31_ADDR A:&base_addr+0x841f2c
y.create.l HWIO_RPMH_VRM_HEADROOM_CRS_DRV4_REG32_ADDR A:&base_addr+0x84202c
y.create.l HWIO_RPMH_VRM_HEADROOM_CRS_DRV4_REG33_ADDR A:&base_addr+0x84212c
y.create.l HWIO_RPMH_VRM_HEADROOM_CRS_DRV4_REG34_ADDR A:&base_addr+0x84222c
y.create.l HWIO_RPMH_VRM_HEADROOM_CRS_DRV4_REG35_ADDR A:&base_addr+0x84232c
y.create.l HWIO_RPMH_VRM_HEADROOM_CRS_DRV4_REG36_ADDR A:&base_addr+0x84242c
y.create.l HWIO_RPMH_VRM_HEADROOM_CRS_DRV4_REG37_ADDR A:&base_addr+0x84252c
y.create.l HWIO_RPMH_VRM_HEADROOM_CRS_DRV4_REG38_ADDR A:&base_addr+0x84262c
y.create.l HWIO_RPMH_VRM_HEADROOM_CRS_DRV4_REG39_ADDR A:&base_addr+0x84272c
y.create.l HWIO_RPMH_VRM_HEADROOM_CRS_DRV4_REG40_ADDR A:&base_addr+0x84282c
y.create.l HWIO_RPMH_VRM_HEADROOM_CRS_DRV4_REG41_ADDR A:&base_addr+0x84292c
y.create.l HWIO_RPMH_VRM_HEADROOM_CRS_DRV4_REG42_ADDR A:&base_addr+0x842a2c
y.create.l HWIO_RPMH_VRM_HEADROOM_CRS_DRV4_REG43_ADDR A:&base_addr+0x842b2c
y.create.l HWIO_RPMH_VRM_HEADROOM_CRS_DRV4_REG44_ADDR A:&base_addr+0x842c2c
y.create.l HWIO_RPMH_VRM_HEADROOM_CRS_DRV4_REG45_ADDR A:&base_addr+0x842d2c
y.create.l HWIO_RPMH_VRM_HEADROOM_CRS_DRV5_REG0_ADDR A:&base_addr+0x85002c
y.create.l HWIO_RPMH_VRM_HEADROOM_CRS_DRV5_REG1_ADDR A:&base_addr+0x85012c
y.create.l HWIO_RPMH_VRM_HEADROOM_CRS_DRV5_REG2_ADDR A:&base_addr+0x85022c
y.create.l HWIO_RPMH_VRM_HEADROOM_CRS_DRV5_REG3_ADDR A:&base_addr+0x85032c
y.create.l HWIO_RPMH_VRM_HEADROOM_CRS_DRV5_REG4_ADDR A:&base_addr+0x85042c
y.create.l HWIO_RPMH_VRM_HEADROOM_CRS_DRV5_REG5_ADDR A:&base_addr+0x85052c
y.create.l HWIO_RPMH_VRM_HEADROOM_CRS_DRV5_REG6_ADDR A:&base_addr+0x85062c
y.create.l HWIO_RPMH_VRM_HEADROOM_CRS_DRV5_REG7_ADDR A:&base_addr+0x85072c
y.create.l HWIO_RPMH_VRM_HEADROOM_CRS_DRV5_REG8_ADDR A:&base_addr+0x85082c
y.create.l HWIO_RPMH_VRM_HEADROOM_CRS_DRV5_REG9_ADDR A:&base_addr+0x85092c
y.create.l HWIO_RPMH_VRM_HEADROOM_CRS_DRV5_REG10_ADDR A:&base_addr+0x850a2c
y.create.l HWIO_RPMH_VRM_HEADROOM_CRS_DRV5_REG11_ADDR A:&base_addr+0x850b2c
y.create.l HWIO_RPMH_VRM_HEADROOM_CRS_DRV5_REG12_ADDR A:&base_addr+0x850c2c
y.create.l HWIO_RPMH_VRM_HEADROOM_CRS_DRV5_REG13_ADDR A:&base_addr+0x850d2c
y.create.l HWIO_RPMH_VRM_HEADROOM_CRS_DRV5_REG14_ADDR A:&base_addr+0x850e2c
y.create.l HWIO_RPMH_VRM_HEADROOM_CRS_DRV5_REG15_ADDR A:&base_addr+0x850f2c
y.create.l HWIO_RPMH_VRM_HEADROOM_CRS_DRV5_REG16_ADDR A:&base_addr+0x85102c
y.create.l HWIO_RPMH_VRM_HEADROOM_CRS_DRV5_REG17_ADDR A:&base_addr+0x85112c
y.create.l HWIO_RPMH_VRM_HEADROOM_CRS_DRV5_REG18_ADDR A:&base_addr+0x85122c
y.create.l HWIO_RPMH_VRM_HEADROOM_CRS_DRV5_REG19_ADDR A:&base_addr+0x85132c
y.create.l HWIO_RPMH_VRM_HEADROOM_CRS_DRV5_REG20_ADDR A:&base_addr+0x85142c
y.create.l HWIO_RPMH_VRM_HEADROOM_CRS_DRV5_REG21_ADDR A:&base_addr+0x85152c
y.create.l HWIO_RPMH_VRM_HEADROOM_CRS_DRV5_REG22_ADDR A:&base_addr+0x85162c
y.create.l HWIO_RPMH_VRM_HEADROOM_CRS_DRV5_REG23_ADDR A:&base_addr+0x85172c
y.create.l HWIO_RPMH_VRM_HEADROOM_CRS_DRV5_REG24_ADDR A:&base_addr+0x85182c
y.create.l HWIO_RPMH_VRM_HEADROOM_CRS_DRV5_REG25_ADDR A:&base_addr+0x85192c
y.create.l HWIO_RPMH_VRM_HEADROOM_CRS_DRV5_REG26_ADDR A:&base_addr+0x851a2c
y.create.l HWIO_RPMH_VRM_HEADROOM_CRS_DRV5_REG27_ADDR A:&base_addr+0x851b2c
y.create.l HWIO_RPMH_VRM_HEADROOM_CRS_DRV5_REG28_ADDR A:&base_addr+0x851c2c
y.create.l HWIO_RPMH_VRM_HEADROOM_CRS_DRV5_REG29_ADDR A:&base_addr+0x851d2c
y.create.l HWIO_RPMH_VRM_HEADROOM_CRS_DRV5_REG30_ADDR A:&base_addr+0x851e2c
y.create.l HWIO_RPMH_VRM_HEADROOM_CRS_DRV5_REG31_ADDR A:&base_addr+0x851f2c
y.create.l HWIO_RPMH_VRM_HEADROOM_CRS_DRV5_REG32_ADDR A:&base_addr+0x85202c
y.create.l HWIO_RPMH_VRM_HEADROOM_CRS_DRV5_REG33_ADDR A:&base_addr+0x85212c
y.create.l HWIO_RPMH_VRM_HEADROOM_CRS_DRV5_REG34_ADDR A:&base_addr+0x85222c
y.create.l HWIO_RPMH_VRM_HEADROOM_CRS_DRV5_REG35_ADDR A:&base_addr+0x85232c
y.create.l HWIO_RPMH_VRM_HEADROOM_CRS_DRV5_REG36_ADDR A:&base_addr+0x85242c
y.create.l HWIO_RPMH_VRM_HEADROOM_CRS_DRV5_REG37_ADDR A:&base_addr+0x85252c
y.create.l HWIO_RPMH_VRM_HEADROOM_CRS_DRV5_REG38_ADDR A:&base_addr+0x85262c
y.create.l HWIO_RPMH_VRM_HEADROOM_CRS_DRV5_REG39_ADDR A:&base_addr+0x85272c
y.create.l HWIO_RPMH_VRM_HEADROOM_CRS_DRV5_REG40_ADDR A:&base_addr+0x85282c
y.create.l HWIO_RPMH_VRM_HEADROOM_CRS_DRV5_REG41_ADDR A:&base_addr+0x85292c
y.create.l HWIO_RPMH_VRM_HEADROOM_CRS_DRV5_REG42_ADDR A:&base_addr+0x852a2c
y.create.l HWIO_RPMH_VRM_HEADROOM_CRS_DRV5_REG43_ADDR A:&base_addr+0x852b2c
y.create.l HWIO_RPMH_VRM_HEADROOM_CRS_DRV5_REG44_ADDR A:&base_addr+0x852c2c
y.create.l HWIO_RPMH_VRM_HEADROOM_CRS_DRV5_REG45_ADDR A:&base_addr+0x852d2c
y.create.l HWIO_RPMH_VRM_HEADROOM_CRS_DRV6_REG0_ADDR A:&base_addr+0x86002c
y.create.l HWIO_RPMH_VRM_HEADROOM_CRS_DRV6_REG1_ADDR A:&base_addr+0x86012c
y.create.l HWIO_RPMH_VRM_HEADROOM_CRS_DRV6_REG2_ADDR A:&base_addr+0x86022c
y.create.l HWIO_RPMH_VRM_HEADROOM_CRS_DRV6_REG3_ADDR A:&base_addr+0x86032c
y.create.l HWIO_RPMH_VRM_HEADROOM_CRS_DRV6_REG4_ADDR A:&base_addr+0x86042c
y.create.l HWIO_RPMH_VRM_HEADROOM_CRS_DRV6_REG5_ADDR A:&base_addr+0x86052c
y.create.l HWIO_RPMH_VRM_HEADROOM_CRS_DRV6_REG6_ADDR A:&base_addr+0x86062c
y.create.l HWIO_RPMH_VRM_HEADROOM_CRS_DRV6_REG7_ADDR A:&base_addr+0x86072c
y.create.l HWIO_RPMH_VRM_HEADROOM_CRS_DRV6_REG8_ADDR A:&base_addr+0x86082c
y.create.l HWIO_RPMH_VRM_HEADROOM_CRS_DRV6_REG9_ADDR A:&base_addr+0x86092c
y.create.l HWIO_RPMH_VRM_HEADROOM_CRS_DRV6_REG10_ADDR A:&base_addr+0x860a2c
y.create.l HWIO_RPMH_VRM_HEADROOM_CRS_DRV6_REG11_ADDR A:&base_addr+0x860b2c
y.create.l HWIO_RPMH_VRM_HEADROOM_CRS_DRV6_REG12_ADDR A:&base_addr+0x860c2c
y.create.l HWIO_RPMH_VRM_HEADROOM_CRS_DRV6_REG13_ADDR A:&base_addr+0x860d2c
y.create.l HWIO_RPMH_VRM_HEADROOM_CRS_DRV6_REG14_ADDR A:&base_addr+0x860e2c
y.create.l HWIO_RPMH_VRM_HEADROOM_CRS_DRV6_REG15_ADDR A:&base_addr+0x860f2c
y.create.l HWIO_RPMH_VRM_HEADROOM_CRS_DRV6_REG16_ADDR A:&base_addr+0x86102c
y.create.l HWIO_RPMH_VRM_HEADROOM_CRS_DRV6_REG17_ADDR A:&base_addr+0x86112c
y.create.l HWIO_RPMH_VRM_HEADROOM_CRS_DRV6_REG18_ADDR A:&base_addr+0x86122c
y.create.l HWIO_RPMH_VRM_HEADROOM_CRS_DRV6_REG19_ADDR A:&base_addr+0x86132c
y.create.l HWIO_RPMH_VRM_HEADROOM_CRS_DRV6_REG20_ADDR A:&base_addr+0x86142c
y.create.l HWIO_RPMH_VRM_HEADROOM_CRS_DRV6_REG21_ADDR A:&base_addr+0x86152c
y.create.l HWIO_RPMH_VRM_HEADROOM_CRS_DRV6_REG22_ADDR A:&base_addr+0x86162c
y.create.l HWIO_RPMH_VRM_HEADROOM_CRS_DRV6_REG23_ADDR A:&base_addr+0x86172c
y.create.l HWIO_RPMH_VRM_HEADROOM_CRS_DRV6_REG24_ADDR A:&base_addr+0x86182c
y.create.l HWIO_RPMH_VRM_HEADROOM_CRS_DRV6_REG25_ADDR A:&base_addr+0x86192c
y.create.l HWIO_RPMH_VRM_HEADROOM_CRS_DRV6_REG26_ADDR A:&base_addr+0x861a2c
y.create.l HWIO_RPMH_VRM_HEADROOM_CRS_DRV6_REG27_ADDR A:&base_addr+0x861b2c
y.create.l HWIO_RPMH_VRM_HEADROOM_CRS_DRV6_REG28_ADDR A:&base_addr+0x861c2c
y.create.l HWIO_RPMH_VRM_HEADROOM_CRS_DRV6_REG29_ADDR A:&base_addr+0x861d2c
y.create.l HWIO_RPMH_VRM_HEADROOM_CRS_DRV6_REG30_ADDR A:&base_addr+0x861e2c
y.create.l HWIO_RPMH_VRM_HEADROOM_CRS_DRV6_REG31_ADDR A:&base_addr+0x861f2c
y.create.l HWIO_RPMH_VRM_HEADROOM_CRS_DRV6_REG32_ADDR A:&base_addr+0x86202c
y.create.l HWIO_RPMH_VRM_HEADROOM_CRS_DRV6_REG33_ADDR A:&base_addr+0x86212c
y.create.l HWIO_RPMH_VRM_HEADROOM_CRS_DRV6_REG34_ADDR A:&base_addr+0x86222c
y.create.l HWIO_RPMH_VRM_HEADROOM_CRS_DRV6_REG35_ADDR A:&base_addr+0x86232c
y.create.l HWIO_RPMH_VRM_HEADROOM_CRS_DRV6_REG36_ADDR A:&base_addr+0x86242c
y.create.l HWIO_RPMH_VRM_HEADROOM_CRS_DRV6_REG37_ADDR A:&base_addr+0x86252c
y.create.l HWIO_RPMH_VRM_HEADROOM_CRS_DRV6_REG38_ADDR A:&base_addr+0x86262c
y.create.l HWIO_RPMH_VRM_HEADROOM_CRS_DRV6_REG39_ADDR A:&base_addr+0x86272c
y.create.l HWIO_RPMH_VRM_HEADROOM_CRS_DRV6_REG40_ADDR A:&base_addr+0x86282c
y.create.l HWIO_RPMH_VRM_HEADROOM_CRS_DRV6_REG41_ADDR A:&base_addr+0x86292c
y.create.l HWIO_RPMH_VRM_HEADROOM_CRS_DRV6_REG42_ADDR A:&base_addr+0x862a2c
y.create.l HWIO_RPMH_VRM_HEADROOM_CRS_DRV6_REG43_ADDR A:&base_addr+0x862b2c
y.create.l HWIO_RPMH_VRM_HEADROOM_CRS_DRV6_REG44_ADDR A:&base_addr+0x862c2c
y.create.l HWIO_RPMH_VRM_HEADROOM_CRS_DRV6_REG45_ADDR A:&base_addr+0x862d2c
y.create.l HWIO_RPMH_VRM_HEADROOM_CRS_DRV7_REG0_ADDR A:&base_addr+0x87002c
y.create.l HWIO_RPMH_VRM_HEADROOM_CRS_DRV7_REG1_ADDR A:&base_addr+0x87012c
y.create.l HWIO_RPMH_VRM_HEADROOM_CRS_DRV7_REG2_ADDR A:&base_addr+0x87022c
y.create.l HWIO_RPMH_VRM_HEADROOM_CRS_DRV7_REG3_ADDR A:&base_addr+0x87032c
y.create.l HWIO_RPMH_VRM_HEADROOM_CRS_DRV7_REG4_ADDR A:&base_addr+0x87042c
y.create.l HWIO_RPMH_VRM_HEADROOM_CRS_DRV7_REG5_ADDR A:&base_addr+0x87052c
y.create.l HWIO_RPMH_VRM_HEADROOM_CRS_DRV7_REG6_ADDR A:&base_addr+0x87062c
y.create.l HWIO_RPMH_VRM_HEADROOM_CRS_DRV7_REG7_ADDR A:&base_addr+0x87072c
y.create.l HWIO_RPMH_VRM_HEADROOM_CRS_DRV7_REG8_ADDR A:&base_addr+0x87082c
y.create.l HWIO_RPMH_VRM_HEADROOM_CRS_DRV7_REG9_ADDR A:&base_addr+0x87092c
y.create.l HWIO_RPMH_VRM_HEADROOM_CRS_DRV7_REG10_ADDR A:&base_addr+0x870a2c
y.create.l HWIO_RPMH_VRM_HEADROOM_CRS_DRV7_REG11_ADDR A:&base_addr+0x870b2c
y.create.l HWIO_RPMH_VRM_HEADROOM_CRS_DRV7_REG12_ADDR A:&base_addr+0x870c2c
y.create.l HWIO_RPMH_VRM_HEADROOM_CRS_DRV7_REG13_ADDR A:&base_addr+0x870d2c
y.create.l HWIO_RPMH_VRM_HEADROOM_CRS_DRV7_REG14_ADDR A:&base_addr+0x870e2c
y.create.l HWIO_RPMH_VRM_HEADROOM_CRS_DRV7_REG15_ADDR A:&base_addr+0x870f2c
y.create.l HWIO_RPMH_VRM_HEADROOM_CRS_DRV7_REG16_ADDR A:&base_addr+0x87102c
y.create.l HWIO_RPMH_VRM_HEADROOM_CRS_DRV7_REG17_ADDR A:&base_addr+0x87112c
y.create.l HWIO_RPMH_VRM_HEADROOM_CRS_DRV7_REG18_ADDR A:&base_addr+0x87122c
y.create.l HWIO_RPMH_VRM_HEADROOM_CRS_DRV7_REG19_ADDR A:&base_addr+0x87132c
y.create.l HWIO_RPMH_VRM_HEADROOM_CRS_DRV7_REG20_ADDR A:&base_addr+0x87142c
y.create.l HWIO_RPMH_VRM_HEADROOM_CRS_DRV7_REG21_ADDR A:&base_addr+0x87152c
y.create.l HWIO_RPMH_VRM_HEADROOM_CRS_DRV7_REG22_ADDR A:&base_addr+0x87162c
y.create.l HWIO_RPMH_VRM_HEADROOM_CRS_DRV7_REG23_ADDR A:&base_addr+0x87172c
y.create.l HWIO_RPMH_VRM_HEADROOM_CRS_DRV7_REG24_ADDR A:&base_addr+0x87182c
y.create.l HWIO_RPMH_VRM_HEADROOM_CRS_DRV7_REG25_ADDR A:&base_addr+0x87192c
y.create.l HWIO_RPMH_VRM_HEADROOM_CRS_DRV7_REG26_ADDR A:&base_addr+0x871a2c
y.create.l HWIO_RPMH_VRM_HEADROOM_CRS_DRV7_REG27_ADDR A:&base_addr+0x871b2c
y.create.l HWIO_RPMH_VRM_HEADROOM_CRS_DRV7_REG28_ADDR A:&base_addr+0x871c2c
y.create.l HWIO_RPMH_VRM_HEADROOM_CRS_DRV7_REG29_ADDR A:&base_addr+0x871d2c
y.create.l HWIO_RPMH_VRM_HEADROOM_CRS_DRV7_REG30_ADDR A:&base_addr+0x871e2c
y.create.l HWIO_RPMH_VRM_HEADROOM_CRS_DRV7_REG31_ADDR A:&base_addr+0x871f2c
y.create.l HWIO_RPMH_VRM_HEADROOM_CRS_DRV7_REG32_ADDR A:&base_addr+0x87202c
y.create.l HWIO_RPMH_VRM_HEADROOM_CRS_DRV7_REG33_ADDR A:&base_addr+0x87212c
y.create.l HWIO_RPMH_VRM_HEADROOM_CRS_DRV7_REG34_ADDR A:&base_addr+0x87222c
y.create.l HWIO_RPMH_VRM_HEADROOM_CRS_DRV7_REG35_ADDR A:&base_addr+0x87232c
y.create.l HWIO_RPMH_VRM_HEADROOM_CRS_DRV7_REG36_ADDR A:&base_addr+0x87242c
y.create.l HWIO_RPMH_VRM_HEADROOM_CRS_DRV7_REG37_ADDR A:&base_addr+0x87252c
y.create.l HWIO_RPMH_VRM_HEADROOM_CRS_DRV7_REG38_ADDR A:&base_addr+0x87262c
y.create.l HWIO_RPMH_VRM_HEADROOM_CRS_DRV7_REG39_ADDR A:&base_addr+0x87272c
y.create.l HWIO_RPMH_VRM_HEADROOM_CRS_DRV7_REG40_ADDR A:&base_addr+0x87282c
y.create.l HWIO_RPMH_VRM_HEADROOM_CRS_DRV7_REG41_ADDR A:&base_addr+0x87292c
y.create.l HWIO_RPMH_VRM_HEADROOM_CRS_DRV7_REG42_ADDR A:&base_addr+0x872a2c
y.create.l HWIO_RPMH_VRM_HEADROOM_CRS_DRV7_REG43_ADDR A:&base_addr+0x872b2c
y.create.l HWIO_RPMH_VRM_HEADROOM_CRS_DRV7_REG44_ADDR A:&base_addr+0x872c2c
y.create.l HWIO_RPMH_VRM_HEADROOM_CRS_DRV7_REG45_ADDR A:&base_addr+0x872d2c
y.create.l HWIO_RPMH_VRM_HEADROOM_CRS_DRV8_REG0_ADDR A:&base_addr+0x88002c
y.create.l HWIO_RPMH_VRM_HEADROOM_CRS_DRV8_REG1_ADDR A:&base_addr+0x88012c
y.create.l HWIO_RPMH_VRM_HEADROOM_CRS_DRV8_REG2_ADDR A:&base_addr+0x88022c
y.create.l HWIO_RPMH_VRM_HEADROOM_CRS_DRV8_REG3_ADDR A:&base_addr+0x88032c
y.create.l HWIO_RPMH_VRM_HEADROOM_CRS_DRV8_REG4_ADDR A:&base_addr+0x88042c
y.create.l HWIO_RPMH_VRM_HEADROOM_CRS_DRV8_REG5_ADDR A:&base_addr+0x88052c
y.create.l HWIO_RPMH_VRM_HEADROOM_CRS_DRV8_REG6_ADDR A:&base_addr+0x88062c
y.create.l HWIO_RPMH_VRM_HEADROOM_CRS_DRV8_REG7_ADDR A:&base_addr+0x88072c
y.create.l HWIO_RPMH_VRM_HEADROOM_CRS_DRV8_REG8_ADDR A:&base_addr+0x88082c
y.create.l HWIO_RPMH_VRM_HEADROOM_CRS_DRV8_REG9_ADDR A:&base_addr+0x88092c
y.create.l HWIO_RPMH_VRM_HEADROOM_CRS_DRV8_REG10_ADDR A:&base_addr+0x880a2c
y.create.l HWIO_RPMH_VRM_HEADROOM_CRS_DRV8_REG11_ADDR A:&base_addr+0x880b2c
y.create.l HWIO_RPMH_VRM_HEADROOM_CRS_DRV8_REG12_ADDR A:&base_addr+0x880c2c
y.create.l HWIO_RPMH_VRM_HEADROOM_CRS_DRV8_REG13_ADDR A:&base_addr+0x880d2c
y.create.l HWIO_RPMH_VRM_HEADROOM_CRS_DRV8_REG14_ADDR A:&base_addr+0x880e2c
y.create.l HWIO_RPMH_VRM_HEADROOM_CRS_DRV8_REG15_ADDR A:&base_addr+0x880f2c
y.create.l HWIO_RPMH_VRM_HEADROOM_CRS_DRV8_REG16_ADDR A:&base_addr+0x88102c
y.create.l HWIO_RPMH_VRM_HEADROOM_CRS_DRV8_REG17_ADDR A:&base_addr+0x88112c
y.create.l HWIO_RPMH_VRM_HEADROOM_CRS_DRV8_REG18_ADDR A:&base_addr+0x88122c
y.create.l HWIO_RPMH_VRM_HEADROOM_CRS_DRV8_REG19_ADDR A:&base_addr+0x88132c
y.create.l HWIO_RPMH_VRM_HEADROOM_CRS_DRV8_REG20_ADDR A:&base_addr+0x88142c
y.create.l HWIO_RPMH_VRM_HEADROOM_CRS_DRV8_REG21_ADDR A:&base_addr+0x88152c
y.create.l HWIO_RPMH_VRM_HEADROOM_CRS_DRV8_REG22_ADDR A:&base_addr+0x88162c
y.create.l HWIO_RPMH_VRM_HEADROOM_CRS_DRV8_REG23_ADDR A:&base_addr+0x88172c
y.create.l HWIO_RPMH_VRM_HEADROOM_CRS_DRV8_REG24_ADDR A:&base_addr+0x88182c
y.create.l HWIO_RPMH_VRM_HEADROOM_CRS_DRV8_REG25_ADDR A:&base_addr+0x88192c
y.create.l HWIO_RPMH_VRM_HEADROOM_CRS_DRV8_REG26_ADDR A:&base_addr+0x881a2c
y.create.l HWIO_RPMH_VRM_HEADROOM_CRS_DRV8_REG27_ADDR A:&base_addr+0x881b2c
y.create.l HWIO_RPMH_VRM_HEADROOM_CRS_DRV8_REG28_ADDR A:&base_addr+0x881c2c
y.create.l HWIO_RPMH_VRM_HEADROOM_CRS_DRV8_REG29_ADDR A:&base_addr+0x881d2c
y.create.l HWIO_RPMH_VRM_HEADROOM_CRS_DRV8_REG30_ADDR A:&base_addr+0x881e2c
y.create.l HWIO_RPMH_VRM_HEADROOM_CRS_DRV8_REG31_ADDR A:&base_addr+0x881f2c
y.create.l HWIO_RPMH_VRM_HEADROOM_CRS_DRV8_REG32_ADDR A:&base_addr+0x88202c
y.create.l HWIO_RPMH_VRM_HEADROOM_CRS_DRV8_REG33_ADDR A:&base_addr+0x88212c
y.create.l HWIO_RPMH_VRM_HEADROOM_CRS_DRV8_REG34_ADDR A:&base_addr+0x88222c
y.create.l HWIO_RPMH_VRM_HEADROOM_CRS_DRV8_REG35_ADDR A:&base_addr+0x88232c
y.create.l HWIO_RPMH_VRM_HEADROOM_CRS_DRV8_REG36_ADDR A:&base_addr+0x88242c
y.create.l HWIO_RPMH_VRM_HEADROOM_CRS_DRV8_REG37_ADDR A:&base_addr+0x88252c
y.create.l HWIO_RPMH_VRM_HEADROOM_CRS_DRV8_REG38_ADDR A:&base_addr+0x88262c
y.create.l HWIO_RPMH_VRM_HEADROOM_CRS_DRV8_REG39_ADDR A:&base_addr+0x88272c
y.create.l HWIO_RPMH_VRM_HEADROOM_CRS_DRV8_REG40_ADDR A:&base_addr+0x88282c
y.create.l HWIO_RPMH_VRM_HEADROOM_CRS_DRV8_REG41_ADDR A:&base_addr+0x88292c
y.create.l HWIO_RPMH_VRM_HEADROOM_CRS_DRV8_REG42_ADDR A:&base_addr+0x882a2c
y.create.l HWIO_RPMH_VRM_HEADROOM_CRS_DRV8_REG43_ADDR A:&base_addr+0x882b2c
y.create.l HWIO_RPMH_VRM_HEADROOM_CRS_DRV8_REG44_ADDR A:&base_addr+0x882c2c
y.create.l HWIO_RPMH_VRM_HEADROOM_CRS_DRV8_REG45_ADDR A:&base_addr+0x882d2c
y.create.l HWIO_RPMH_VRM_HEADROOM_CRS_DRV9_REG0_ADDR A:&base_addr+0x89002c
y.create.l HWIO_RPMH_VRM_HEADROOM_CRS_DRV9_REG1_ADDR A:&base_addr+0x89012c
y.create.l HWIO_RPMH_VRM_HEADROOM_CRS_DRV9_REG2_ADDR A:&base_addr+0x89022c
y.create.l HWIO_RPMH_VRM_HEADROOM_CRS_DRV9_REG3_ADDR A:&base_addr+0x89032c
y.create.l HWIO_RPMH_VRM_HEADROOM_CRS_DRV9_REG4_ADDR A:&base_addr+0x89042c
y.create.l HWIO_RPMH_VRM_HEADROOM_CRS_DRV9_REG5_ADDR A:&base_addr+0x89052c
y.create.l HWIO_RPMH_VRM_HEADROOM_CRS_DRV9_REG6_ADDR A:&base_addr+0x89062c
y.create.l HWIO_RPMH_VRM_HEADROOM_CRS_DRV9_REG7_ADDR A:&base_addr+0x89072c
y.create.l HWIO_RPMH_VRM_HEADROOM_CRS_DRV9_REG8_ADDR A:&base_addr+0x89082c
y.create.l HWIO_RPMH_VRM_HEADROOM_CRS_DRV9_REG9_ADDR A:&base_addr+0x89092c
y.create.l HWIO_RPMH_VRM_HEADROOM_CRS_DRV9_REG10_ADDR A:&base_addr+0x890a2c
y.create.l HWIO_RPMH_VRM_HEADROOM_CRS_DRV9_REG11_ADDR A:&base_addr+0x890b2c
y.create.l HWIO_RPMH_VRM_HEADROOM_CRS_DRV9_REG12_ADDR A:&base_addr+0x890c2c
y.create.l HWIO_RPMH_VRM_HEADROOM_CRS_DRV9_REG13_ADDR A:&base_addr+0x890d2c
y.create.l HWIO_RPMH_VRM_HEADROOM_CRS_DRV9_REG14_ADDR A:&base_addr+0x890e2c
y.create.l HWIO_RPMH_VRM_HEADROOM_CRS_DRV9_REG15_ADDR A:&base_addr+0x890f2c
y.create.l HWIO_RPMH_VRM_HEADROOM_CRS_DRV9_REG16_ADDR A:&base_addr+0x89102c
y.create.l HWIO_RPMH_VRM_HEADROOM_CRS_DRV9_REG17_ADDR A:&base_addr+0x89112c
y.create.l HWIO_RPMH_VRM_HEADROOM_CRS_DRV9_REG18_ADDR A:&base_addr+0x89122c
y.create.l HWIO_RPMH_VRM_HEADROOM_CRS_DRV9_REG19_ADDR A:&base_addr+0x89132c
y.create.l HWIO_RPMH_VRM_HEADROOM_CRS_DRV9_REG20_ADDR A:&base_addr+0x89142c
y.create.l HWIO_RPMH_VRM_HEADROOM_CRS_DRV9_REG21_ADDR A:&base_addr+0x89152c
y.create.l HWIO_RPMH_VRM_HEADROOM_CRS_DRV9_REG22_ADDR A:&base_addr+0x89162c
y.create.l HWIO_RPMH_VRM_HEADROOM_CRS_DRV9_REG23_ADDR A:&base_addr+0x89172c
y.create.l HWIO_RPMH_VRM_HEADROOM_CRS_DRV9_REG24_ADDR A:&base_addr+0x89182c
y.create.l HWIO_RPMH_VRM_HEADROOM_CRS_DRV9_REG25_ADDR A:&base_addr+0x89192c
y.create.l HWIO_RPMH_VRM_HEADROOM_CRS_DRV9_REG26_ADDR A:&base_addr+0x891a2c
y.create.l HWIO_RPMH_VRM_HEADROOM_CRS_DRV9_REG27_ADDR A:&base_addr+0x891b2c
y.create.l HWIO_RPMH_VRM_HEADROOM_CRS_DRV9_REG28_ADDR A:&base_addr+0x891c2c
y.create.l HWIO_RPMH_VRM_HEADROOM_CRS_DRV9_REG29_ADDR A:&base_addr+0x891d2c
y.create.l HWIO_RPMH_VRM_HEADROOM_CRS_DRV9_REG30_ADDR A:&base_addr+0x891e2c
y.create.l HWIO_RPMH_VRM_HEADROOM_CRS_DRV9_REG31_ADDR A:&base_addr+0x891f2c
y.create.l HWIO_RPMH_VRM_HEADROOM_CRS_DRV9_REG32_ADDR A:&base_addr+0x89202c
y.create.l HWIO_RPMH_VRM_HEADROOM_CRS_DRV9_REG33_ADDR A:&base_addr+0x89212c
y.create.l HWIO_RPMH_VRM_HEADROOM_CRS_DRV9_REG34_ADDR A:&base_addr+0x89222c
y.create.l HWIO_RPMH_VRM_HEADROOM_CRS_DRV9_REG35_ADDR A:&base_addr+0x89232c
y.create.l HWIO_RPMH_VRM_HEADROOM_CRS_DRV9_REG36_ADDR A:&base_addr+0x89242c
y.create.l HWIO_RPMH_VRM_HEADROOM_CRS_DRV9_REG37_ADDR A:&base_addr+0x89252c
y.create.l HWIO_RPMH_VRM_HEADROOM_CRS_DRV9_REG38_ADDR A:&base_addr+0x89262c
y.create.l HWIO_RPMH_VRM_HEADROOM_CRS_DRV9_REG39_ADDR A:&base_addr+0x89272c
y.create.l HWIO_RPMH_VRM_HEADROOM_CRS_DRV9_REG40_ADDR A:&base_addr+0x89282c
y.create.l HWIO_RPMH_VRM_HEADROOM_CRS_DRV9_REG41_ADDR A:&base_addr+0x89292c
y.create.l HWIO_RPMH_VRM_HEADROOM_CRS_DRV9_REG42_ADDR A:&base_addr+0x892a2c
y.create.l HWIO_RPMH_VRM_HEADROOM_CRS_DRV9_REG43_ADDR A:&base_addr+0x892b2c
y.create.l HWIO_RPMH_VRM_HEADROOM_CRS_DRV9_REG44_ADDR A:&base_addr+0x892c2c
y.create.l HWIO_RPMH_VRM_HEADROOM_CRS_DRV9_REG45_ADDR A:&base_addr+0x892d2c
y.create.l HWIO_RPMH_VRM_HEADROOM_CRS_DRV10_REG0_ADDR A:&base_addr+0x8a002c
y.create.l HWIO_RPMH_VRM_HEADROOM_CRS_DRV10_REG1_ADDR A:&base_addr+0x8a012c
y.create.l HWIO_RPMH_VRM_HEADROOM_CRS_DRV10_REG2_ADDR A:&base_addr+0x8a022c
y.create.l HWIO_RPMH_VRM_HEADROOM_CRS_DRV10_REG3_ADDR A:&base_addr+0x8a032c
y.create.l HWIO_RPMH_VRM_HEADROOM_CRS_DRV10_REG4_ADDR A:&base_addr+0x8a042c
y.create.l HWIO_RPMH_VRM_HEADROOM_CRS_DRV10_REG5_ADDR A:&base_addr+0x8a052c
y.create.l HWIO_RPMH_VRM_HEADROOM_CRS_DRV10_REG6_ADDR A:&base_addr+0x8a062c
y.create.l HWIO_RPMH_VRM_HEADROOM_CRS_DRV10_REG7_ADDR A:&base_addr+0x8a072c
y.create.l HWIO_RPMH_VRM_HEADROOM_CRS_DRV10_REG8_ADDR A:&base_addr+0x8a082c
y.create.l HWIO_RPMH_VRM_HEADROOM_CRS_DRV10_REG9_ADDR A:&base_addr+0x8a092c
y.create.l HWIO_RPMH_VRM_HEADROOM_CRS_DRV10_REG10_ADDR A:&base_addr+0x8a0a2c
y.create.l HWIO_RPMH_VRM_HEADROOM_CRS_DRV10_REG11_ADDR A:&base_addr+0x8a0b2c
y.create.l HWIO_RPMH_VRM_HEADROOM_CRS_DRV10_REG12_ADDR A:&base_addr+0x8a0c2c
y.create.l HWIO_RPMH_VRM_HEADROOM_CRS_DRV10_REG13_ADDR A:&base_addr+0x8a0d2c
y.create.l HWIO_RPMH_VRM_HEADROOM_CRS_DRV10_REG14_ADDR A:&base_addr+0x8a0e2c
y.create.l HWIO_RPMH_VRM_HEADROOM_CRS_DRV10_REG15_ADDR A:&base_addr+0x8a0f2c
y.create.l HWIO_RPMH_VRM_HEADROOM_CRS_DRV10_REG16_ADDR A:&base_addr+0x8a102c
y.create.l HWIO_RPMH_VRM_HEADROOM_CRS_DRV10_REG17_ADDR A:&base_addr+0x8a112c
y.create.l HWIO_RPMH_VRM_HEADROOM_CRS_DRV10_REG18_ADDR A:&base_addr+0x8a122c
y.create.l HWIO_RPMH_VRM_HEADROOM_CRS_DRV10_REG19_ADDR A:&base_addr+0x8a132c
y.create.l HWIO_RPMH_VRM_HEADROOM_CRS_DRV10_REG20_ADDR A:&base_addr+0x8a142c
y.create.l HWIO_RPMH_VRM_HEADROOM_CRS_DRV10_REG21_ADDR A:&base_addr+0x8a152c
y.create.l HWIO_RPMH_VRM_HEADROOM_CRS_DRV10_REG22_ADDR A:&base_addr+0x8a162c
y.create.l HWIO_RPMH_VRM_HEADROOM_CRS_DRV10_REG23_ADDR A:&base_addr+0x8a172c
y.create.l HWIO_RPMH_VRM_HEADROOM_CRS_DRV10_REG24_ADDR A:&base_addr+0x8a182c
y.create.l HWIO_RPMH_VRM_HEADROOM_CRS_DRV10_REG25_ADDR A:&base_addr+0x8a192c
y.create.l HWIO_RPMH_VRM_HEADROOM_CRS_DRV10_REG26_ADDR A:&base_addr+0x8a1a2c
y.create.l HWIO_RPMH_VRM_HEADROOM_CRS_DRV10_REG27_ADDR A:&base_addr+0x8a1b2c
y.create.l HWIO_RPMH_VRM_HEADROOM_CRS_DRV10_REG28_ADDR A:&base_addr+0x8a1c2c
y.create.l HWIO_RPMH_VRM_HEADROOM_CRS_DRV10_REG29_ADDR A:&base_addr+0x8a1d2c
y.create.l HWIO_RPMH_VRM_HEADROOM_CRS_DRV10_REG30_ADDR A:&base_addr+0x8a1e2c
y.create.l HWIO_RPMH_VRM_HEADROOM_CRS_DRV10_REG31_ADDR A:&base_addr+0x8a1f2c
y.create.l HWIO_RPMH_VRM_HEADROOM_CRS_DRV10_REG32_ADDR A:&base_addr+0x8a202c
y.create.l HWIO_RPMH_VRM_HEADROOM_CRS_DRV10_REG33_ADDR A:&base_addr+0x8a212c
y.create.l HWIO_RPMH_VRM_HEADROOM_CRS_DRV10_REG34_ADDR A:&base_addr+0x8a222c
y.create.l HWIO_RPMH_VRM_HEADROOM_CRS_DRV10_REG35_ADDR A:&base_addr+0x8a232c
y.create.l HWIO_RPMH_VRM_HEADROOM_CRS_DRV10_REG36_ADDR A:&base_addr+0x8a242c
y.create.l HWIO_RPMH_VRM_HEADROOM_CRS_DRV10_REG37_ADDR A:&base_addr+0x8a252c
y.create.l HWIO_RPMH_VRM_HEADROOM_CRS_DRV10_REG38_ADDR A:&base_addr+0x8a262c
y.create.l HWIO_RPMH_VRM_HEADROOM_CRS_DRV10_REG39_ADDR A:&base_addr+0x8a272c
y.create.l HWIO_RPMH_VRM_HEADROOM_CRS_DRV10_REG40_ADDR A:&base_addr+0x8a282c
y.create.l HWIO_RPMH_VRM_HEADROOM_CRS_DRV10_REG41_ADDR A:&base_addr+0x8a292c
y.create.l HWIO_RPMH_VRM_HEADROOM_CRS_DRV10_REG42_ADDR A:&base_addr+0x8a2a2c
y.create.l HWIO_RPMH_VRM_HEADROOM_CRS_DRV10_REG43_ADDR A:&base_addr+0x8a2b2c
y.create.l HWIO_RPMH_VRM_HEADROOM_CRS_DRV10_REG44_ADDR A:&base_addr+0x8a2c2c
y.create.l HWIO_RPMH_VRM_HEADROOM_CRS_DRV10_REG45_ADDR A:&base_addr+0x8a2d2c
y.create.l HWIO_RPMH_VRM_HEADROOM_CRS_DRV11_REG0_ADDR A:&base_addr+0x8b002c
y.create.l HWIO_RPMH_VRM_HEADROOM_CRS_DRV11_REG1_ADDR A:&base_addr+0x8b012c
y.create.l HWIO_RPMH_VRM_HEADROOM_CRS_DRV11_REG2_ADDR A:&base_addr+0x8b022c
y.create.l HWIO_RPMH_VRM_HEADROOM_CRS_DRV11_REG3_ADDR A:&base_addr+0x8b032c
y.create.l HWIO_RPMH_VRM_HEADROOM_CRS_DRV11_REG4_ADDR A:&base_addr+0x8b042c
y.create.l HWIO_RPMH_VRM_HEADROOM_CRS_DRV11_REG5_ADDR A:&base_addr+0x8b052c
y.create.l HWIO_RPMH_VRM_HEADROOM_CRS_DRV11_REG6_ADDR A:&base_addr+0x8b062c
y.create.l HWIO_RPMH_VRM_HEADROOM_CRS_DRV11_REG7_ADDR A:&base_addr+0x8b072c
y.create.l HWIO_RPMH_VRM_HEADROOM_CRS_DRV11_REG8_ADDR A:&base_addr+0x8b082c
y.create.l HWIO_RPMH_VRM_HEADROOM_CRS_DRV11_REG9_ADDR A:&base_addr+0x8b092c
y.create.l HWIO_RPMH_VRM_HEADROOM_CRS_DRV11_REG10_ADDR A:&base_addr+0x8b0a2c
y.create.l HWIO_RPMH_VRM_HEADROOM_CRS_DRV11_REG11_ADDR A:&base_addr+0x8b0b2c
y.create.l HWIO_RPMH_VRM_HEADROOM_CRS_DRV11_REG12_ADDR A:&base_addr+0x8b0c2c
y.create.l HWIO_RPMH_VRM_HEADROOM_CRS_DRV11_REG13_ADDR A:&base_addr+0x8b0d2c
y.create.l HWIO_RPMH_VRM_HEADROOM_CRS_DRV11_REG14_ADDR A:&base_addr+0x8b0e2c
y.create.l HWIO_RPMH_VRM_HEADROOM_CRS_DRV11_REG15_ADDR A:&base_addr+0x8b0f2c
y.create.l HWIO_RPMH_VRM_HEADROOM_CRS_DRV11_REG16_ADDR A:&base_addr+0x8b102c
y.create.l HWIO_RPMH_VRM_HEADROOM_CRS_DRV11_REG17_ADDR A:&base_addr+0x8b112c
y.create.l HWIO_RPMH_VRM_HEADROOM_CRS_DRV11_REG18_ADDR A:&base_addr+0x8b122c
y.create.l HWIO_RPMH_VRM_HEADROOM_CRS_DRV11_REG19_ADDR A:&base_addr+0x8b132c
y.create.l HWIO_RPMH_VRM_HEADROOM_CRS_DRV11_REG20_ADDR A:&base_addr+0x8b142c
y.create.l HWIO_RPMH_VRM_HEADROOM_CRS_DRV11_REG21_ADDR A:&base_addr+0x8b152c
y.create.l HWIO_RPMH_VRM_HEADROOM_CRS_DRV11_REG22_ADDR A:&base_addr+0x8b162c
y.create.l HWIO_RPMH_VRM_HEADROOM_CRS_DRV11_REG23_ADDR A:&base_addr+0x8b172c
y.create.l HWIO_RPMH_VRM_HEADROOM_CRS_DRV11_REG24_ADDR A:&base_addr+0x8b182c
y.create.l HWIO_RPMH_VRM_HEADROOM_CRS_DRV11_REG25_ADDR A:&base_addr+0x8b192c
y.create.l HWIO_RPMH_VRM_HEADROOM_CRS_DRV11_REG26_ADDR A:&base_addr+0x8b1a2c
y.create.l HWIO_RPMH_VRM_HEADROOM_CRS_DRV11_REG27_ADDR A:&base_addr+0x8b1b2c
y.create.l HWIO_RPMH_VRM_HEADROOM_CRS_DRV11_REG28_ADDR A:&base_addr+0x8b1c2c
y.create.l HWIO_RPMH_VRM_HEADROOM_CRS_DRV11_REG29_ADDR A:&base_addr+0x8b1d2c
y.create.l HWIO_RPMH_VRM_HEADROOM_CRS_DRV11_REG30_ADDR A:&base_addr+0x8b1e2c
y.create.l HWIO_RPMH_VRM_HEADROOM_CRS_DRV11_REG31_ADDR A:&base_addr+0x8b1f2c
y.create.l HWIO_RPMH_VRM_HEADROOM_CRS_DRV11_REG32_ADDR A:&base_addr+0x8b202c
y.create.l HWIO_RPMH_VRM_HEADROOM_CRS_DRV11_REG33_ADDR A:&base_addr+0x8b212c
y.create.l HWIO_RPMH_VRM_HEADROOM_CRS_DRV11_REG34_ADDR A:&base_addr+0x8b222c
y.create.l HWIO_RPMH_VRM_HEADROOM_CRS_DRV11_REG35_ADDR A:&base_addr+0x8b232c
y.create.l HWIO_RPMH_VRM_HEADROOM_CRS_DRV11_REG36_ADDR A:&base_addr+0x8b242c
y.create.l HWIO_RPMH_VRM_HEADROOM_CRS_DRV11_REG37_ADDR A:&base_addr+0x8b252c
y.create.l HWIO_RPMH_VRM_HEADROOM_CRS_DRV11_REG38_ADDR A:&base_addr+0x8b262c
y.create.l HWIO_RPMH_VRM_HEADROOM_CRS_DRV11_REG39_ADDR A:&base_addr+0x8b272c
y.create.l HWIO_RPMH_VRM_HEADROOM_CRS_DRV11_REG40_ADDR A:&base_addr+0x8b282c
y.create.l HWIO_RPMH_VRM_HEADROOM_CRS_DRV11_REG41_ADDR A:&base_addr+0x8b292c
y.create.l HWIO_RPMH_VRM_HEADROOM_CRS_DRV11_REG42_ADDR A:&base_addr+0x8b2a2c
y.create.l HWIO_RPMH_VRM_HEADROOM_CRS_DRV11_REG43_ADDR A:&base_addr+0x8b2b2c
y.create.l HWIO_RPMH_VRM_HEADROOM_CRS_DRV11_REG44_ADDR A:&base_addr+0x8b2c2c
y.create.l HWIO_RPMH_VRM_HEADROOM_CRS_DRV11_REG45_ADDR A:&base_addr+0x8b2d2c
y.create.l HWIO_RPMH_VRM_HEADROOM_CRS_DRV12_REG0_ADDR A:&base_addr+0x8c002c
y.create.l HWIO_RPMH_VRM_HEADROOM_CRS_DRV12_REG1_ADDR A:&base_addr+0x8c012c
y.create.l HWIO_RPMH_VRM_HEADROOM_CRS_DRV12_REG2_ADDR A:&base_addr+0x8c022c
y.create.l HWIO_RPMH_VRM_HEADROOM_CRS_DRV12_REG3_ADDR A:&base_addr+0x8c032c
y.create.l HWIO_RPMH_VRM_HEADROOM_CRS_DRV12_REG4_ADDR A:&base_addr+0x8c042c
y.create.l HWIO_RPMH_VRM_HEADROOM_CRS_DRV12_REG5_ADDR A:&base_addr+0x8c052c
y.create.l HWIO_RPMH_VRM_HEADROOM_CRS_DRV12_REG6_ADDR A:&base_addr+0x8c062c
y.create.l HWIO_RPMH_VRM_HEADROOM_CRS_DRV12_REG7_ADDR A:&base_addr+0x8c072c
y.create.l HWIO_RPMH_VRM_HEADROOM_CRS_DRV12_REG8_ADDR A:&base_addr+0x8c082c
y.create.l HWIO_RPMH_VRM_HEADROOM_CRS_DRV12_REG9_ADDR A:&base_addr+0x8c092c
y.create.l HWIO_RPMH_VRM_HEADROOM_CRS_DRV12_REG10_ADDR A:&base_addr+0x8c0a2c
y.create.l HWIO_RPMH_VRM_HEADROOM_CRS_DRV12_REG11_ADDR A:&base_addr+0x8c0b2c
y.create.l HWIO_RPMH_VRM_HEADROOM_CRS_DRV12_REG12_ADDR A:&base_addr+0x8c0c2c
y.create.l HWIO_RPMH_VRM_HEADROOM_CRS_DRV12_REG13_ADDR A:&base_addr+0x8c0d2c
y.create.l HWIO_RPMH_VRM_HEADROOM_CRS_DRV12_REG14_ADDR A:&base_addr+0x8c0e2c
y.create.l HWIO_RPMH_VRM_HEADROOM_CRS_DRV12_REG15_ADDR A:&base_addr+0x8c0f2c
y.create.l HWIO_RPMH_VRM_HEADROOM_CRS_DRV12_REG16_ADDR A:&base_addr+0x8c102c
y.create.l HWIO_RPMH_VRM_HEADROOM_CRS_DRV12_REG17_ADDR A:&base_addr+0x8c112c
y.create.l HWIO_RPMH_VRM_HEADROOM_CRS_DRV12_REG18_ADDR A:&base_addr+0x8c122c
y.create.l HWIO_RPMH_VRM_HEADROOM_CRS_DRV12_REG19_ADDR A:&base_addr+0x8c132c
y.create.l HWIO_RPMH_VRM_HEADROOM_CRS_DRV12_REG20_ADDR A:&base_addr+0x8c142c
y.create.l HWIO_RPMH_VRM_HEADROOM_CRS_DRV12_REG21_ADDR A:&base_addr+0x8c152c
y.create.l HWIO_RPMH_VRM_HEADROOM_CRS_DRV12_REG22_ADDR A:&base_addr+0x8c162c
y.create.l HWIO_RPMH_VRM_HEADROOM_CRS_DRV12_REG23_ADDR A:&base_addr+0x8c172c
y.create.l HWIO_RPMH_VRM_HEADROOM_CRS_DRV12_REG24_ADDR A:&base_addr+0x8c182c
y.create.l HWIO_RPMH_VRM_HEADROOM_CRS_DRV12_REG25_ADDR A:&base_addr+0x8c192c
y.create.l HWIO_RPMH_VRM_HEADROOM_CRS_DRV12_REG26_ADDR A:&base_addr+0x8c1a2c
y.create.l HWIO_RPMH_VRM_HEADROOM_CRS_DRV12_REG27_ADDR A:&base_addr+0x8c1b2c
y.create.l HWIO_RPMH_VRM_HEADROOM_CRS_DRV12_REG28_ADDR A:&base_addr+0x8c1c2c
y.create.l HWIO_RPMH_VRM_HEADROOM_CRS_DRV12_REG29_ADDR A:&base_addr+0x8c1d2c
y.create.l HWIO_RPMH_VRM_HEADROOM_CRS_DRV12_REG30_ADDR A:&base_addr+0x8c1e2c
y.create.l HWIO_RPMH_VRM_HEADROOM_CRS_DRV12_REG31_ADDR A:&base_addr+0x8c1f2c
y.create.l HWIO_RPMH_VRM_HEADROOM_CRS_DRV12_REG32_ADDR A:&base_addr+0x8c202c
y.create.l HWIO_RPMH_VRM_HEADROOM_CRS_DRV12_REG33_ADDR A:&base_addr+0x8c212c
y.create.l HWIO_RPMH_VRM_HEADROOM_CRS_DRV12_REG34_ADDR A:&base_addr+0x8c222c
y.create.l HWIO_RPMH_VRM_HEADROOM_CRS_DRV12_REG35_ADDR A:&base_addr+0x8c232c
y.create.l HWIO_RPMH_VRM_HEADROOM_CRS_DRV12_REG36_ADDR A:&base_addr+0x8c242c
y.create.l HWIO_RPMH_VRM_HEADROOM_CRS_DRV12_REG37_ADDR A:&base_addr+0x8c252c
y.create.l HWIO_RPMH_VRM_HEADROOM_CRS_DRV12_REG38_ADDR A:&base_addr+0x8c262c
y.create.l HWIO_RPMH_VRM_HEADROOM_CRS_DRV12_REG39_ADDR A:&base_addr+0x8c272c
y.create.l HWIO_RPMH_VRM_HEADROOM_CRS_DRV12_REG40_ADDR A:&base_addr+0x8c282c
y.create.l HWIO_RPMH_VRM_HEADROOM_CRS_DRV12_REG41_ADDR A:&base_addr+0x8c292c
y.create.l HWIO_RPMH_VRM_HEADROOM_CRS_DRV12_REG42_ADDR A:&base_addr+0x8c2a2c
y.create.l HWIO_RPMH_VRM_HEADROOM_CRS_DRV12_REG43_ADDR A:&base_addr+0x8c2b2c
y.create.l HWIO_RPMH_VRM_HEADROOM_CRS_DRV12_REG44_ADDR A:&base_addr+0x8c2c2c
y.create.l HWIO_RPMH_VRM_HEADROOM_CRS_DRV12_REG45_ADDR A:&base_addr+0x8c2d2c
y.create.l HWIO_RPMH_VRM_HEADROOM_CRS_DRV13_REG0_ADDR A:&base_addr+0x8d002c
y.create.l HWIO_RPMH_VRM_HEADROOM_CRS_DRV13_REG1_ADDR A:&base_addr+0x8d012c
y.create.l HWIO_RPMH_VRM_HEADROOM_CRS_DRV13_REG2_ADDR A:&base_addr+0x8d022c
y.create.l HWIO_RPMH_VRM_HEADROOM_CRS_DRV13_REG3_ADDR A:&base_addr+0x8d032c
y.create.l HWIO_RPMH_VRM_HEADROOM_CRS_DRV13_REG4_ADDR A:&base_addr+0x8d042c
y.create.l HWIO_RPMH_VRM_HEADROOM_CRS_DRV13_REG5_ADDR A:&base_addr+0x8d052c
y.create.l HWIO_RPMH_VRM_HEADROOM_CRS_DRV13_REG6_ADDR A:&base_addr+0x8d062c
y.create.l HWIO_RPMH_VRM_HEADROOM_CRS_DRV13_REG7_ADDR A:&base_addr+0x8d072c
y.create.l HWIO_RPMH_VRM_HEADROOM_CRS_DRV13_REG8_ADDR A:&base_addr+0x8d082c
y.create.l HWIO_RPMH_VRM_HEADROOM_CRS_DRV13_REG9_ADDR A:&base_addr+0x8d092c
y.create.l HWIO_RPMH_VRM_HEADROOM_CRS_DRV13_REG10_ADDR A:&base_addr+0x8d0a2c
y.create.l HWIO_RPMH_VRM_HEADROOM_CRS_DRV13_REG11_ADDR A:&base_addr+0x8d0b2c
y.create.l HWIO_RPMH_VRM_HEADROOM_CRS_DRV13_REG12_ADDR A:&base_addr+0x8d0c2c
y.create.l HWIO_RPMH_VRM_HEADROOM_CRS_DRV13_REG13_ADDR A:&base_addr+0x8d0d2c
y.create.l HWIO_RPMH_VRM_HEADROOM_CRS_DRV13_REG14_ADDR A:&base_addr+0x8d0e2c
y.create.l HWIO_RPMH_VRM_HEADROOM_CRS_DRV13_REG15_ADDR A:&base_addr+0x8d0f2c
y.create.l HWIO_RPMH_VRM_HEADROOM_CRS_DRV13_REG16_ADDR A:&base_addr+0x8d102c
y.create.l HWIO_RPMH_VRM_HEADROOM_CRS_DRV13_REG17_ADDR A:&base_addr+0x8d112c
y.create.l HWIO_RPMH_VRM_HEADROOM_CRS_DRV13_REG18_ADDR A:&base_addr+0x8d122c
y.create.l HWIO_RPMH_VRM_HEADROOM_CRS_DRV13_REG19_ADDR A:&base_addr+0x8d132c
y.create.l HWIO_RPMH_VRM_HEADROOM_CRS_DRV13_REG20_ADDR A:&base_addr+0x8d142c
y.create.l HWIO_RPMH_VRM_HEADROOM_CRS_DRV13_REG21_ADDR A:&base_addr+0x8d152c
y.create.l HWIO_RPMH_VRM_HEADROOM_CRS_DRV13_REG22_ADDR A:&base_addr+0x8d162c
y.create.l HWIO_RPMH_VRM_HEADROOM_CRS_DRV13_REG23_ADDR A:&base_addr+0x8d172c
y.create.l HWIO_RPMH_VRM_HEADROOM_CRS_DRV13_REG24_ADDR A:&base_addr+0x8d182c
y.create.l HWIO_RPMH_VRM_HEADROOM_CRS_DRV13_REG25_ADDR A:&base_addr+0x8d192c
y.create.l HWIO_RPMH_VRM_HEADROOM_CRS_DRV13_REG26_ADDR A:&base_addr+0x8d1a2c
y.create.l HWIO_RPMH_VRM_HEADROOM_CRS_DRV13_REG27_ADDR A:&base_addr+0x8d1b2c
y.create.l HWIO_RPMH_VRM_HEADROOM_CRS_DRV13_REG28_ADDR A:&base_addr+0x8d1c2c
y.create.l HWIO_RPMH_VRM_HEADROOM_CRS_DRV13_REG29_ADDR A:&base_addr+0x8d1d2c
y.create.l HWIO_RPMH_VRM_HEADROOM_CRS_DRV13_REG30_ADDR A:&base_addr+0x8d1e2c
y.create.l HWIO_RPMH_VRM_HEADROOM_CRS_DRV13_REG31_ADDR A:&base_addr+0x8d1f2c
y.create.l HWIO_RPMH_VRM_HEADROOM_CRS_DRV13_REG32_ADDR A:&base_addr+0x8d202c
y.create.l HWIO_RPMH_VRM_HEADROOM_CRS_DRV13_REG33_ADDR A:&base_addr+0x8d212c
y.create.l HWIO_RPMH_VRM_HEADROOM_CRS_DRV13_REG34_ADDR A:&base_addr+0x8d222c
y.create.l HWIO_RPMH_VRM_HEADROOM_CRS_DRV13_REG35_ADDR A:&base_addr+0x8d232c
y.create.l HWIO_RPMH_VRM_HEADROOM_CRS_DRV13_REG36_ADDR A:&base_addr+0x8d242c
y.create.l HWIO_RPMH_VRM_HEADROOM_CRS_DRV13_REG37_ADDR A:&base_addr+0x8d252c
y.create.l HWIO_RPMH_VRM_HEADROOM_CRS_DRV13_REG38_ADDR A:&base_addr+0x8d262c
y.create.l HWIO_RPMH_VRM_HEADROOM_CRS_DRV13_REG39_ADDR A:&base_addr+0x8d272c
y.create.l HWIO_RPMH_VRM_HEADROOM_CRS_DRV13_REG40_ADDR A:&base_addr+0x8d282c
y.create.l HWIO_RPMH_VRM_HEADROOM_CRS_DRV13_REG41_ADDR A:&base_addr+0x8d292c
y.create.l HWIO_RPMH_VRM_HEADROOM_CRS_DRV13_REG42_ADDR A:&base_addr+0x8d2a2c
y.create.l HWIO_RPMH_VRM_HEADROOM_CRS_DRV13_REG43_ADDR A:&base_addr+0x8d2b2c
y.create.l HWIO_RPMH_VRM_HEADROOM_CRS_DRV13_REG44_ADDR A:&base_addr+0x8d2c2c
y.create.l HWIO_RPMH_VRM_HEADROOM_CRS_DRV13_REG45_ADDR A:&base_addr+0x8d2d2c
y.create.l HWIO_RPMH_VRM_HEADROOM_CRS_DRV14_REG0_ADDR A:&base_addr+0x8e002c
y.create.l HWIO_RPMH_VRM_HEADROOM_CRS_DRV14_REG1_ADDR A:&base_addr+0x8e012c
y.create.l HWIO_RPMH_VRM_HEADROOM_CRS_DRV14_REG2_ADDR A:&base_addr+0x8e022c
y.create.l HWIO_RPMH_VRM_HEADROOM_CRS_DRV14_REG3_ADDR A:&base_addr+0x8e032c
y.create.l HWIO_RPMH_VRM_HEADROOM_CRS_DRV14_REG4_ADDR A:&base_addr+0x8e042c
y.create.l HWIO_RPMH_VRM_HEADROOM_CRS_DRV14_REG5_ADDR A:&base_addr+0x8e052c
y.create.l HWIO_RPMH_VRM_HEADROOM_CRS_DRV14_REG6_ADDR A:&base_addr+0x8e062c
y.create.l HWIO_RPMH_VRM_HEADROOM_CRS_DRV14_REG7_ADDR A:&base_addr+0x8e072c
y.create.l HWIO_RPMH_VRM_HEADROOM_CRS_DRV14_REG8_ADDR A:&base_addr+0x8e082c
y.create.l HWIO_RPMH_VRM_HEADROOM_CRS_DRV14_REG9_ADDR A:&base_addr+0x8e092c
y.create.l HWIO_RPMH_VRM_HEADROOM_CRS_DRV14_REG10_ADDR A:&base_addr+0x8e0a2c
y.create.l HWIO_RPMH_VRM_HEADROOM_CRS_DRV14_REG11_ADDR A:&base_addr+0x8e0b2c
y.create.l HWIO_RPMH_VRM_HEADROOM_CRS_DRV14_REG12_ADDR A:&base_addr+0x8e0c2c
y.create.l HWIO_RPMH_VRM_HEADROOM_CRS_DRV14_REG13_ADDR A:&base_addr+0x8e0d2c
y.create.l HWIO_RPMH_VRM_HEADROOM_CRS_DRV14_REG14_ADDR A:&base_addr+0x8e0e2c
y.create.l HWIO_RPMH_VRM_HEADROOM_CRS_DRV14_REG15_ADDR A:&base_addr+0x8e0f2c
y.create.l HWIO_RPMH_VRM_HEADROOM_CRS_DRV14_REG16_ADDR A:&base_addr+0x8e102c
y.create.l HWIO_RPMH_VRM_HEADROOM_CRS_DRV14_REG17_ADDR A:&base_addr+0x8e112c
y.create.l HWIO_RPMH_VRM_HEADROOM_CRS_DRV14_REG18_ADDR A:&base_addr+0x8e122c
y.create.l HWIO_RPMH_VRM_HEADROOM_CRS_DRV14_REG19_ADDR A:&base_addr+0x8e132c
y.create.l HWIO_RPMH_VRM_HEADROOM_CRS_DRV14_REG20_ADDR A:&base_addr+0x8e142c
y.create.l HWIO_RPMH_VRM_HEADROOM_CRS_DRV14_REG21_ADDR A:&base_addr+0x8e152c
y.create.l HWIO_RPMH_VRM_HEADROOM_CRS_DRV14_REG22_ADDR A:&base_addr+0x8e162c
y.create.l HWIO_RPMH_VRM_HEADROOM_CRS_DRV14_REG23_ADDR A:&base_addr+0x8e172c
y.create.l HWIO_RPMH_VRM_HEADROOM_CRS_DRV14_REG24_ADDR A:&base_addr+0x8e182c
y.create.l HWIO_RPMH_VRM_HEADROOM_CRS_DRV14_REG25_ADDR A:&base_addr+0x8e192c
y.create.l HWIO_RPMH_VRM_HEADROOM_CRS_DRV14_REG26_ADDR A:&base_addr+0x8e1a2c
y.create.l HWIO_RPMH_VRM_HEADROOM_CRS_DRV14_REG27_ADDR A:&base_addr+0x8e1b2c
y.create.l HWIO_RPMH_VRM_HEADROOM_CRS_DRV14_REG28_ADDR A:&base_addr+0x8e1c2c
y.create.l HWIO_RPMH_VRM_HEADROOM_CRS_DRV14_REG29_ADDR A:&base_addr+0x8e1d2c
y.create.l HWIO_RPMH_VRM_HEADROOM_CRS_DRV14_REG30_ADDR A:&base_addr+0x8e1e2c
y.create.l HWIO_RPMH_VRM_HEADROOM_CRS_DRV14_REG31_ADDR A:&base_addr+0x8e1f2c
y.create.l HWIO_RPMH_VRM_HEADROOM_CRS_DRV14_REG32_ADDR A:&base_addr+0x8e202c
y.create.l HWIO_RPMH_VRM_HEADROOM_CRS_DRV14_REG33_ADDR A:&base_addr+0x8e212c
y.create.l HWIO_RPMH_VRM_HEADROOM_CRS_DRV14_REG34_ADDR A:&base_addr+0x8e222c
y.create.l HWIO_RPMH_VRM_HEADROOM_CRS_DRV14_REG35_ADDR A:&base_addr+0x8e232c
y.create.l HWIO_RPMH_VRM_HEADROOM_CRS_DRV14_REG36_ADDR A:&base_addr+0x8e242c
y.create.l HWIO_RPMH_VRM_HEADROOM_CRS_DRV14_REG37_ADDR A:&base_addr+0x8e252c
y.create.l HWIO_RPMH_VRM_HEADROOM_CRS_DRV14_REG38_ADDR A:&base_addr+0x8e262c
y.create.l HWIO_RPMH_VRM_HEADROOM_CRS_DRV14_REG39_ADDR A:&base_addr+0x8e272c
y.create.l HWIO_RPMH_VRM_HEADROOM_CRS_DRV14_REG40_ADDR A:&base_addr+0x8e282c
y.create.l HWIO_RPMH_VRM_HEADROOM_CRS_DRV14_REG41_ADDR A:&base_addr+0x8e292c
y.create.l HWIO_RPMH_VRM_HEADROOM_CRS_DRV14_REG42_ADDR A:&base_addr+0x8e2a2c
y.create.l HWIO_RPMH_VRM_HEADROOM_CRS_DRV14_REG43_ADDR A:&base_addr+0x8e2b2c
y.create.l HWIO_RPMH_VRM_HEADROOM_CRS_DRV14_REG44_ADDR A:&base_addr+0x8e2c2c
y.create.l HWIO_RPMH_VRM_HEADROOM_CRS_DRV14_REG45_ADDR A:&base_addr+0x8e2d2c
y.create.l HWIO_RPMH_VRM_ENABLE_CRS_DRV0_XOB0_ADDR A:&base_addr+0x80c024
y.create.l HWIO_RPMH_VRM_ENABLE_CRS_DRV0_XOB1_ADDR A:&base_addr+0x80c124
y.create.l HWIO_RPMH_VRM_ENABLE_CRS_DRV0_XOB2_ADDR A:&base_addr+0x80c224
y.create.l HWIO_RPMH_VRM_ENABLE_CRS_DRV0_XOB3_ADDR A:&base_addr+0x80c324
y.create.l HWIO_RPMH_VRM_ENABLE_CRS_DRV0_XOB4_ADDR A:&base_addr+0x80c424
y.create.l HWIO_RPMH_VRM_ENABLE_CRS_DRV0_XOB5_ADDR A:&base_addr+0x80c524
y.create.l HWIO_RPMH_VRM_ENABLE_CRS_DRV0_XOB6_ADDR A:&base_addr+0x80c624
y.create.l HWIO_RPMH_VRM_ENABLE_CRS_DRV0_XOB7_ADDR A:&base_addr+0x80c724
y.create.l HWIO_RPMH_VRM_ENABLE_CRS_DRV1_XOB0_ADDR A:&base_addr+0x81c024
y.create.l HWIO_RPMH_VRM_ENABLE_CRS_DRV1_XOB1_ADDR A:&base_addr+0x81c124
y.create.l HWIO_RPMH_VRM_ENABLE_CRS_DRV1_XOB2_ADDR A:&base_addr+0x81c224
y.create.l HWIO_RPMH_VRM_ENABLE_CRS_DRV1_XOB3_ADDR A:&base_addr+0x81c324
y.create.l HWIO_RPMH_VRM_ENABLE_CRS_DRV1_XOB4_ADDR A:&base_addr+0x81c424
y.create.l HWIO_RPMH_VRM_ENABLE_CRS_DRV1_XOB5_ADDR A:&base_addr+0x81c524
y.create.l HWIO_RPMH_VRM_ENABLE_CRS_DRV1_XOB6_ADDR A:&base_addr+0x81c624
y.create.l HWIO_RPMH_VRM_ENABLE_CRS_DRV1_XOB7_ADDR A:&base_addr+0x81c724
y.create.l HWIO_RPMH_VRM_ENABLE_CRS_DRV2_XOB0_ADDR A:&base_addr+0x82c024
y.create.l HWIO_RPMH_VRM_ENABLE_CRS_DRV2_XOB1_ADDR A:&base_addr+0x82c124
y.create.l HWIO_RPMH_VRM_ENABLE_CRS_DRV2_XOB2_ADDR A:&base_addr+0x82c224
y.create.l HWIO_RPMH_VRM_ENABLE_CRS_DRV2_XOB3_ADDR A:&base_addr+0x82c324
y.create.l HWIO_RPMH_VRM_ENABLE_CRS_DRV2_XOB4_ADDR A:&base_addr+0x82c424
y.create.l HWIO_RPMH_VRM_ENABLE_CRS_DRV2_XOB5_ADDR A:&base_addr+0x82c524
y.create.l HWIO_RPMH_VRM_ENABLE_CRS_DRV2_XOB6_ADDR A:&base_addr+0x82c624
y.create.l HWIO_RPMH_VRM_ENABLE_CRS_DRV2_XOB7_ADDR A:&base_addr+0x82c724
y.create.l HWIO_RPMH_VRM_ENABLE_CRS_DRV3_XOB0_ADDR A:&base_addr+0x83c024
y.create.l HWIO_RPMH_VRM_ENABLE_CRS_DRV3_XOB1_ADDR A:&base_addr+0x83c124
y.create.l HWIO_RPMH_VRM_ENABLE_CRS_DRV3_XOB2_ADDR A:&base_addr+0x83c224
y.create.l HWIO_RPMH_VRM_ENABLE_CRS_DRV3_XOB3_ADDR A:&base_addr+0x83c324
y.create.l HWIO_RPMH_VRM_ENABLE_CRS_DRV3_XOB4_ADDR A:&base_addr+0x83c424
y.create.l HWIO_RPMH_VRM_ENABLE_CRS_DRV3_XOB5_ADDR A:&base_addr+0x83c524
y.create.l HWIO_RPMH_VRM_ENABLE_CRS_DRV3_XOB6_ADDR A:&base_addr+0x83c624
y.create.l HWIO_RPMH_VRM_ENABLE_CRS_DRV3_XOB7_ADDR A:&base_addr+0x83c724
y.create.l HWIO_RPMH_VRM_ENABLE_CRS_DRV4_XOB0_ADDR A:&base_addr+0x84c024
y.create.l HWIO_RPMH_VRM_ENABLE_CRS_DRV4_XOB1_ADDR A:&base_addr+0x84c124
y.create.l HWIO_RPMH_VRM_ENABLE_CRS_DRV4_XOB2_ADDR A:&base_addr+0x84c224
y.create.l HWIO_RPMH_VRM_ENABLE_CRS_DRV4_XOB3_ADDR A:&base_addr+0x84c324
y.create.l HWIO_RPMH_VRM_ENABLE_CRS_DRV4_XOB4_ADDR A:&base_addr+0x84c424
y.create.l HWIO_RPMH_VRM_ENABLE_CRS_DRV4_XOB5_ADDR A:&base_addr+0x84c524
y.create.l HWIO_RPMH_VRM_ENABLE_CRS_DRV4_XOB6_ADDR A:&base_addr+0x84c624
y.create.l HWIO_RPMH_VRM_ENABLE_CRS_DRV4_XOB7_ADDR A:&base_addr+0x84c724
y.create.l HWIO_RPMH_VRM_ENABLE_CRS_DRV5_XOB0_ADDR A:&base_addr+0x85c024
y.create.l HWIO_RPMH_VRM_ENABLE_CRS_DRV5_XOB1_ADDR A:&base_addr+0x85c124
y.create.l HWIO_RPMH_VRM_ENABLE_CRS_DRV5_XOB2_ADDR A:&base_addr+0x85c224
y.create.l HWIO_RPMH_VRM_ENABLE_CRS_DRV5_XOB3_ADDR A:&base_addr+0x85c324
y.create.l HWIO_RPMH_VRM_ENABLE_CRS_DRV5_XOB4_ADDR A:&base_addr+0x85c424
y.create.l HWIO_RPMH_VRM_ENABLE_CRS_DRV5_XOB5_ADDR A:&base_addr+0x85c524
y.create.l HWIO_RPMH_VRM_ENABLE_CRS_DRV5_XOB6_ADDR A:&base_addr+0x85c624
y.create.l HWIO_RPMH_VRM_ENABLE_CRS_DRV5_XOB7_ADDR A:&base_addr+0x85c724
y.create.l HWIO_RPMH_VRM_ENABLE_CRS_DRV6_XOB0_ADDR A:&base_addr+0x86c024
y.create.l HWIO_RPMH_VRM_ENABLE_CRS_DRV6_XOB1_ADDR A:&base_addr+0x86c124
y.create.l HWIO_RPMH_VRM_ENABLE_CRS_DRV6_XOB2_ADDR A:&base_addr+0x86c224
y.create.l HWIO_RPMH_VRM_ENABLE_CRS_DRV6_XOB3_ADDR A:&base_addr+0x86c324
y.create.l HWIO_RPMH_VRM_ENABLE_CRS_DRV6_XOB4_ADDR A:&base_addr+0x86c424
y.create.l HWIO_RPMH_VRM_ENABLE_CRS_DRV6_XOB5_ADDR A:&base_addr+0x86c524
y.create.l HWIO_RPMH_VRM_ENABLE_CRS_DRV6_XOB6_ADDR A:&base_addr+0x86c624
y.create.l HWIO_RPMH_VRM_ENABLE_CRS_DRV6_XOB7_ADDR A:&base_addr+0x86c724
y.create.l HWIO_RPMH_VRM_ENABLE_CRS_DRV7_XOB0_ADDR A:&base_addr+0x87c024
y.create.l HWIO_RPMH_VRM_ENABLE_CRS_DRV7_XOB1_ADDR A:&base_addr+0x87c124
y.create.l HWIO_RPMH_VRM_ENABLE_CRS_DRV7_XOB2_ADDR A:&base_addr+0x87c224
y.create.l HWIO_RPMH_VRM_ENABLE_CRS_DRV7_XOB3_ADDR A:&base_addr+0x87c324
y.create.l HWIO_RPMH_VRM_ENABLE_CRS_DRV7_XOB4_ADDR A:&base_addr+0x87c424
y.create.l HWIO_RPMH_VRM_ENABLE_CRS_DRV7_XOB5_ADDR A:&base_addr+0x87c524
y.create.l HWIO_RPMH_VRM_ENABLE_CRS_DRV7_XOB6_ADDR A:&base_addr+0x87c624
y.create.l HWIO_RPMH_VRM_ENABLE_CRS_DRV7_XOB7_ADDR A:&base_addr+0x87c724
y.create.l HWIO_RPMH_VRM_ENABLE_CRS_DRV8_XOB0_ADDR A:&base_addr+0x88c024
y.create.l HWIO_RPMH_VRM_ENABLE_CRS_DRV8_XOB1_ADDR A:&base_addr+0x88c124
y.create.l HWIO_RPMH_VRM_ENABLE_CRS_DRV8_XOB2_ADDR A:&base_addr+0x88c224
y.create.l HWIO_RPMH_VRM_ENABLE_CRS_DRV8_XOB3_ADDR A:&base_addr+0x88c324
y.create.l HWIO_RPMH_VRM_ENABLE_CRS_DRV8_XOB4_ADDR A:&base_addr+0x88c424
y.create.l HWIO_RPMH_VRM_ENABLE_CRS_DRV8_XOB5_ADDR A:&base_addr+0x88c524
y.create.l HWIO_RPMH_VRM_ENABLE_CRS_DRV8_XOB6_ADDR A:&base_addr+0x88c624
y.create.l HWIO_RPMH_VRM_ENABLE_CRS_DRV8_XOB7_ADDR A:&base_addr+0x88c724
y.create.l HWIO_RPMH_VRM_ENABLE_CRS_DRV9_XOB0_ADDR A:&base_addr+0x89c024
y.create.l HWIO_RPMH_VRM_ENABLE_CRS_DRV9_XOB1_ADDR A:&base_addr+0x89c124
y.create.l HWIO_RPMH_VRM_ENABLE_CRS_DRV9_XOB2_ADDR A:&base_addr+0x89c224
y.create.l HWIO_RPMH_VRM_ENABLE_CRS_DRV9_XOB3_ADDR A:&base_addr+0x89c324
y.create.l HWIO_RPMH_VRM_ENABLE_CRS_DRV9_XOB4_ADDR A:&base_addr+0x89c424
y.create.l HWIO_RPMH_VRM_ENABLE_CRS_DRV9_XOB5_ADDR A:&base_addr+0x89c524
y.create.l HWIO_RPMH_VRM_ENABLE_CRS_DRV9_XOB6_ADDR A:&base_addr+0x89c624
y.create.l HWIO_RPMH_VRM_ENABLE_CRS_DRV9_XOB7_ADDR A:&base_addr+0x89c724
y.create.l HWIO_RPMH_VRM_ENABLE_CRS_DRV10_XOB0_ADDR A:&base_addr+0x8ac024
y.create.l HWIO_RPMH_VRM_ENABLE_CRS_DRV10_XOB1_ADDR A:&base_addr+0x8ac124
y.create.l HWIO_RPMH_VRM_ENABLE_CRS_DRV10_XOB2_ADDR A:&base_addr+0x8ac224
y.create.l HWIO_RPMH_VRM_ENABLE_CRS_DRV10_XOB3_ADDR A:&base_addr+0x8ac324
y.create.l HWIO_RPMH_VRM_ENABLE_CRS_DRV10_XOB4_ADDR A:&base_addr+0x8ac424
y.create.l HWIO_RPMH_VRM_ENABLE_CRS_DRV10_XOB5_ADDR A:&base_addr+0x8ac524
y.create.l HWIO_RPMH_VRM_ENABLE_CRS_DRV10_XOB6_ADDR A:&base_addr+0x8ac624
y.create.l HWIO_RPMH_VRM_ENABLE_CRS_DRV10_XOB7_ADDR A:&base_addr+0x8ac724
y.create.l HWIO_RPMH_VRM_ENABLE_CRS_DRV11_XOB0_ADDR A:&base_addr+0x8bc024
y.create.l HWIO_RPMH_VRM_ENABLE_CRS_DRV11_XOB1_ADDR A:&base_addr+0x8bc124
y.create.l HWIO_RPMH_VRM_ENABLE_CRS_DRV11_XOB2_ADDR A:&base_addr+0x8bc224
y.create.l HWIO_RPMH_VRM_ENABLE_CRS_DRV11_XOB3_ADDR A:&base_addr+0x8bc324
y.create.l HWIO_RPMH_VRM_ENABLE_CRS_DRV11_XOB4_ADDR A:&base_addr+0x8bc424
y.create.l HWIO_RPMH_VRM_ENABLE_CRS_DRV11_XOB5_ADDR A:&base_addr+0x8bc524
y.create.l HWIO_RPMH_VRM_ENABLE_CRS_DRV11_XOB6_ADDR A:&base_addr+0x8bc624
y.create.l HWIO_RPMH_VRM_ENABLE_CRS_DRV11_XOB7_ADDR A:&base_addr+0x8bc724
y.create.l HWIO_RPMH_VRM_ENABLE_CRS_DRV12_XOB0_ADDR A:&base_addr+0x8cc024
y.create.l HWIO_RPMH_VRM_ENABLE_CRS_DRV12_XOB1_ADDR A:&base_addr+0x8cc124
y.create.l HWIO_RPMH_VRM_ENABLE_CRS_DRV12_XOB2_ADDR A:&base_addr+0x8cc224
y.create.l HWIO_RPMH_VRM_ENABLE_CRS_DRV12_XOB3_ADDR A:&base_addr+0x8cc324
y.create.l HWIO_RPMH_VRM_ENABLE_CRS_DRV12_XOB4_ADDR A:&base_addr+0x8cc424
y.create.l HWIO_RPMH_VRM_ENABLE_CRS_DRV12_XOB5_ADDR A:&base_addr+0x8cc524
y.create.l HWIO_RPMH_VRM_ENABLE_CRS_DRV12_XOB6_ADDR A:&base_addr+0x8cc624
y.create.l HWIO_RPMH_VRM_ENABLE_CRS_DRV12_XOB7_ADDR A:&base_addr+0x8cc724
y.create.l HWIO_RPMH_VRM_ENABLE_CRS_DRV13_XOB0_ADDR A:&base_addr+0x8dc024
y.create.l HWIO_RPMH_VRM_ENABLE_CRS_DRV13_XOB1_ADDR A:&base_addr+0x8dc124
y.create.l HWIO_RPMH_VRM_ENABLE_CRS_DRV13_XOB2_ADDR A:&base_addr+0x8dc224
y.create.l HWIO_RPMH_VRM_ENABLE_CRS_DRV13_XOB3_ADDR A:&base_addr+0x8dc324
y.create.l HWIO_RPMH_VRM_ENABLE_CRS_DRV13_XOB4_ADDR A:&base_addr+0x8dc424
y.create.l HWIO_RPMH_VRM_ENABLE_CRS_DRV13_XOB5_ADDR A:&base_addr+0x8dc524
y.create.l HWIO_RPMH_VRM_ENABLE_CRS_DRV13_XOB6_ADDR A:&base_addr+0x8dc624
y.create.l HWIO_RPMH_VRM_ENABLE_CRS_DRV13_XOB7_ADDR A:&base_addr+0x8dc724
y.create.l HWIO_RPMH_VRM_ENABLE_CRS_DRV14_XOB0_ADDR A:&base_addr+0x8ec024
y.create.l HWIO_RPMH_VRM_ENABLE_CRS_DRV14_XOB1_ADDR A:&base_addr+0x8ec124
y.create.l HWIO_RPMH_VRM_ENABLE_CRS_DRV14_XOB2_ADDR A:&base_addr+0x8ec224
y.create.l HWIO_RPMH_VRM_ENABLE_CRS_DRV14_XOB3_ADDR A:&base_addr+0x8ec324
y.create.l HWIO_RPMH_VRM_ENABLE_CRS_DRV14_XOB4_ADDR A:&base_addr+0x8ec424
y.create.l HWIO_RPMH_VRM_ENABLE_CRS_DRV14_XOB5_ADDR A:&base_addr+0x8ec524
y.create.l HWIO_RPMH_VRM_ENABLE_CRS_DRV14_XOB6_ADDR A:&base_addr+0x8ec624
y.create.l HWIO_RPMH_VRM_ENABLE_CRS_DRV14_XOB7_ADDR A:&base_addr+0x8ec724
y.create.l HWIO_RPMH_VRM_ENABLE_CRS_DRV0_XO0_ADDR A:&base_addr+0x80d824
y.create.l HWIO_RPMH_VRM_ENABLE_CRS_DRV1_XO0_ADDR A:&base_addr+0x81d824
y.create.l HWIO_RPMH_VRM_ENABLE_CRS_DRV2_XO0_ADDR A:&base_addr+0x82d824
y.create.l HWIO_RPMH_VRM_ENABLE_CRS_DRV3_XO0_ADDR A:&base_addr+0x83d824
y.create.l HWIO_RPMH_VRM_ENABLE_CRS_DRV4_XO0_ADDR A:&base_addr+0x84d824
y.create.l HWIO_RPMH_VRM_ENABLE_CRS_DRV5_XO0_ADDR A:&base_addr+0x85d824
y.create.l HWIO_RPMH_VRM_ENABLE_CRS_DRV6_XO0_ADDR A:&base_addr+0x86d824
y.create.l HWIO_RPMH_VRM_ENABLE_CRS_DRV7_XO0_ADDR A:&base_addr+0x87d824
y.create.l HWIO_RPMH_VRM_ENABLE_CRS_DRV8_XO0_ADDR A:&base_addr+0x88d824
y.create.l HWIO_RPMH_VRM_ENABLE_CRS_DRV9_XO0_ADDR A:&base_addr+0x89d824
y.create.l HWIO_RPMH_VRM_ENABLE_CRS_DRV10_XO0_ADDR A:&base_addr+0x8ad824
y.create.l HWIO_RPMH_VRM_ENABLE_CRS_DRV11_XO0_ADDR A:&base_addr+0x8bd824
y.create.l HWIO_RPMH_VRM_ENABLE_CRS_DRV12_XO0_ADDR A:&base_addr+0x8cd824
y.create.l HWIO_RPMH_VRM_ENABLE_CRS_DRV13_XO0_ADDR A:&base_addr+0x8dd824
y.create.l HWIO_RPMH_VRM_ENABLE_CRS_DRV14_XO0_ADDR A:&base_addr+0x8ed824
y.create.l HWIO_RPMH_VRM_VOLTAGE_CRS_CSR_REG0_ADDR A:&base_addr+0x9e0000
y.create.l HWIO_RPMH_VRM_VOLTAGE_CRS_CSR_REG1_ADDR A:&base_addr+0x9e0100
y.create.l HWIO_RPMH_VRM_VOLTAGE_CRS_CSR_REG2_ADDR A:&base_addr+0x9e0200
y.create.l HWIO_RPMH_VRM_VOLTAGE_CRS_CSR_REG3_ADDR A:&base_addr+0x9e0300
y.create.l HWIO_RPMH_VRM_VOLTAGE_CRS_CSR_REG4_ADDR A:&base_addr+0x9e0400
y.create.l HWIO_RPMH_VRM_VOLTAGE_CRS_CSR_REG5_ADDR A:&base_addr+0x9e0500
y.create.l HWIO_RPMH_VRM_VOLTAGE_CRS_CSR_REG6_ADDR A:&base_addr+0x9e0600
y.create.l HWIO_RPMH_VRM_VOLTAGE_CRS_CSR_REG7_ADDR A:&base_addr+0x9e0700
y.create.l HWIO_RPMH_VRM_VOLTAGE_CRS_CSR_REG8_ADDR A:&base_addr+0x9e0800
y.create.l HWIO_RPMH_VRM_VOLTAGE_CRS_CSR_REG9_ADDR A:&base_addr+0x9e0900
y.create.l HWIO_RPMH_VRM_VOLTAGE_CRS_CSR_REG10_ADDR A:&base_addr+0x9e0a00
y.create.l HWIO_RPMH_VRM_VOLTAGE_CRS_CSR_REG11_ADDR A:&base_addr+0x9e0b00
y.create.l HWIO_RPMH_VRM_VOLTAGE_CRS_CSR_REG12_ADDR A:&base_addr+0x9e0c00
y.create.l HWIO_RPMH_VRM_VOLTAGE_CRS_CSR_REG13_ADDR A:&base_addr+0x9e0d00
y.create.l HWIO_RPMH_VRM_VOLTAGE_CRS_CSR_REG14_ADDR A:&base_addr+0x9e0e00
y.create.l HWIO_RPMH_VRM_VOLTAGE_CRS_CSR_REG15_ADDR A:&base_addr+0x9e0f00
y.create.l HWIO_RPMH_VRM_VOLTAGE_CRS_CSR_REG16_ADDR A:&base_addr+0x9e1000
y.create.l HWIO_RPMH_VRM_VOLTAGE_CRS_CSR_REG17_ADDR A:&base_addr+0x9e1100
y.create.l HWIO_RPMH_VRM_VOLTAGE_CRS_CSR_REG18_ADDR A:&base_addr+0x9e1200
y.create.l HWIO_RPMH_VRM_VOLTAGE_CRS_CSR_REG19_ADDR A:&base_addr+0x9e1300
y.create.l HWIO_RPMH_VRM_VOLTAGE_CRS_CSR_REG20_ADDR A:&base_addr+0x9e1400
y.create.l HWIO_RPMH_VRM_VOLTAGE_CRS_CSR_REG21_ADDR A:&base_addr+0x9e1500
y.create.l HWIO_RPMH_VRM_VOLTAGE_CRS_CSR_REG22_ADDR A:&base_addr+0x9e1600
y.create.l HWIO_RPMH_VRM_VOLTAGE_CRS_CSR_REG23_ADDR A:&base_addr+0x9e1700
y.create.l HWIO_RPMH_VRM_VOLTAGE_CRS_CSR_REG24_ADDR A:&base_addr+0x9e1800
y.create.l HWIO_RPMH_VRM_VOLTAGE_CRS_CSR_REG25_ADDR A:&base_addr+0x9e1900
y.create.l HWIO_RPMH_VRM_VOLTAGE_CRS_CSR_REG26_ADDR A:&base_addr+0x9e1a00
y.create.l HWIO_RPMH_VRM_VOLTAGE_CRS_CSR_REG27_ADDR A:&base_addr+0x9e1b00
y.create.l HWIO_RPMH_VRM_VOLTAGE_CRS_CSR_REG28_ADDR A:&base_addr+0x9e1c00
y.create.l HWIO_RPMH_VRM_VOLTAGE_CRS_CSR_REG29_ADDR A:&base_addr+0x9e1d00
y.create.l HWIO_RPMH_VRM_VOLTAGE_CRS_CSR_REG30_ADDR A:&base_addr+0x9e1e00
y.create.l HWIO_RPMH_VRM_VOLTAGE_CRS_CSR_REG31_ADDR A:&base_addr+0x9e1f00
y.create.l HWIO_RPMH_VRM_VOLTAGE_CRS_CSR_REG32_ADDR A:&base_addr+0x9e2000
y.create.l HWIO_RPMH_VRM_VOLTAGE_CRS_CSR_REG33_ADDR A:&base_addr+0x9e2100
y.create.l HWIO_RPMH_VRM_VOLTAGE_CRS_CSR_REG34_ADDR A:&base_addr+0x9e2200
y.create.l HWIO_RPMH_VRM_VOLTAGE_CRS_CSR_REG35_ADDR A:&base_addr+0x9e2300
y.create.l HWIO_RPMH_VRM_VOLTAGE_CRS_CSR_REG36_ADDR A:&base_addr+0x9e2400
y.create.l HWIO_RPMH_VRM_VOLTAGE_CRS_CSR_REG37_ADDR A:&base_addr+0x9e2500
y.create.l HWIO_RPMH_VRM_VOLTAGE_CRS_CSR_REG38_ADDR A:&base_addr+0x9e2600
y.create.l HWIO_RPMH_VRM_VOLTAGE_CRS_CSR_REG39_ADDR A:&base_addr+0x9e2700
y.create.l HWIO_RPMH_VRM_VOLTAGE_CRS_CSR_REG40_ADDR A:&base_addr+0x9e2800
y.create.l HWIO_RPMH_VRM_VOLTAGE_CRS_CSR_REG41_ADDR A:&base_addr+0x9e2900
y.create.l HWIO_RPMH_VRM_VOLTAGE_CRS_CSR_REG42_ADDR A:&base_addr+0x9e2a00
y.create.l HWIO_RPMH_VRM_VOLTAGE_CRS_CSR_REG43_ADDR A:&base_addr+0x9e2b00
y.create.l HWIO_RPMH_VRM_VOLTAGE_CRS_CSR_REG44_ADDR A:&base_addr+0x9e2c00
y.create.l HWIO_RPMH_VRM_VOLTAGE_CRS_CSR_REG45_ADDR A:&base_addr+0x9e2d00
y.create.l HWIO_RPMH_VRM_ENABLE_CRS_CSR_REG0_ADDR A:&base_addr+0x9e0004
y.create.l HWIO_RPMH_VRM_ENABLE_CRS_CSR_REG1_ADDR A:&base_addr+0x9e0104
y.create.l HWIO_RPMH_VRM_ENABLE_CRS_CSR_REG2_ADDR A:&base_addr+0x9e0204
y.create.l HWIO_RPMH_VRM_ENABLE_CRS_CSR_REG3_ADDR A:&base_addr+0x9e0304
y.create.l HWIO_RPMH_VRM_ENABLE_CRS_CSR_REG4_ADDR A:&base_addr+0x9e0404
y.create.l HWIO_RPMH_VRM_ENABLE_CRS_CSR_REG5_ADDR A:&base_addr+0x9e0504
y.create.l HWIO_RPMH_VRM_ENABLE_CRS_CSR_REG6_ADDR A:&base_addr+0x9e0604
y.create.l HWIO_RPMH_VRM_ENABLE_CRS_CSR_REG7_ADDR A:&base_addr+0x9e0704
y.create.l HWIO_RPMH_VRM_ENABLE_CRS_CSR_REG8_ADDR A:&base_addr+0x9e0804
y.create.l HWIO_RPMH_VRM_ENABLE_CRS_CSR_REG9_ADDR A:&base_addr+0x9e0904
y.create.l HWIO_RPMH_VRM_ENABLE_CRS_CSR_REG10_ADDR A:&base_addr+0x9e0a04
y.create.l HWIO_RPMH_VRM_ENABLE_CRS_CSR_REG11_ADDR A:&base_addr+0x9e0b04
y.create.l HWIO_RPMH_VRM_ENABLE_CRS_CSR_REG12_ADDR A:&base_addr+0x9e0c04
y.create.l HWIO_RPMH_VRM_ENABLE_CRS_CSR_REG13_ADDR A:&base_addr+0x9e0d04
y.create.l HWIO_RPMH_VRM_ENABLE_CRS_CSR_REG14_ADDR A:&base_addr+0x9e0e04
y.create.l HWIO_RPMH_VRM_ENABLE_CRS_CSR_REG15_ADDR A:&base_addr+0x9e0f04
y.create.l HWIO_RPMH_VRM_ENABLE_CRS_CSR_REG16_ADDR A:&base_addr+0x9e1004
y.create.l HWIO_RPMH_VRM_ENABLE_CRS_CSR_REG17_ADDR A:&base_addr+0x9e1104
y.create.l HWIO_RPMH_VRM_ENABLE_CRS_CSR_REG18_ADDR A:&base_addr+0x9e1204
y.create.l HWIO_RPMH_VRM_ENABLE_CRS_CSR_REG19_ADDR A:&base_addr+0x9e1304
y.create.l HWIO_RPMH_VRM_ENABLE_CRS_CSR_REG20_ADDR A:&base_addr+0x9e1404
y.create.l HWIO_RPMH_VRM_ENABLE_CRS_CSR_REG21_ADDR A:&base_addr+0x9e1504
y.create.l HWIO_RPMH_VRM_ENABLE_CRS_CSR_REG22_ADDR A:&base_addr+0x9e1604
y.create.l HWIO_RPMH_VRM_ENABLE_CRS_CSR_REG23_ADDR A:&base_addr+0x9e1704
y.create.l HWIO_RPMH_VRM_ENABLE_CRS_CSR_REG24_ADDR A:&base_addr+0x9e1804
y.create.l HWIO_RPMH_VRM_ENABLE_CRS_CSR_REG25_ADDR A:&base_addr+0x9e1904
y.create.l HWIO_RPMH_VRM_ENABLE_CRS_CSR_REG26_ADDR A:&base_addr+0x9e1a04
y.create.l HWIO_RPMH_VRM_ENABLE_CRS_CSR_REG27_ADDR A:&base_addr+0x9e1b04
y.create.l HWIO_RPMH_VRM_ENABLE_CRS_CSR_REG28_ADDR A:&base_addr+0x9e1c04
y.create.l HWIO_RPMH_VRM_ENABLE_CRS_CSR_REG29_ADDR A:&base_addr+0x9e1d04
y.create.l HWIO_RPMH_VRM_ENABLE_CRS_CSR_REG30_ADDR A:&base_addr+0x9e1e04
y.create.l HWIO_RPMH_VRM_ENABLE_CRS_CSR_REG31_ADDR A:&base_addr+0x9e1f04
y.create.l HWIO_RPMH_VRM_ENABLE_CRS_CSR_REG32_ADDR A:&base_addr+0x9e2004
y.create.l HWIO_RPMH_VRM_ENABLE_CRS_CSR_REG33_ADDR A:&base_addr+0x9e2104
y.create.l HWIO_RPMH_VRM_ENABLE_CRS_CSR_REG34_ADDR A:&base_addr+0x9e2204
y.create.l HWIO_RPMH_VRM_ENABLE_CRS_CSR_REG35_ADDR A:&base_addr+0x9e2304
y.create.l HWIO_RPMH_VRM_ENABLE_CRS_CSR_REG36_ADDR A:&base_addr+0x9e2404
y.create.l HWIO_RPMH_VRM_ENABLE_CRS_CSR_REG37_ADDR A:&base_addr+0x9e2504
y.create.l HWIO_RPMH_VRM_ENABLE_CRS_CSR_REG38_ADDR A:&base_addr+0x9e2604
y.create.l HWIO_RPMH_VRM_ENABLE_CRS_CSR_REG39_ADDR A:&base_addr+0x9e2704
y.create.l HWIO_RPMH_VRM_ENABLE_CRS_CSR_REG40_ADDR A:&base_addr+0x9e2804
y.create.l HWIO_RPMH_VRM_ENABLE_CRS_CSR_REG41_ADDR A:&base_addr+0x9e2904
y.create.l HWIO_RPMH_VRM_ENABLE_CRS_CSR_REG42_ADDR A:&base_addr+0x9e2a04
y.create.l HWIO_RPMH_VRM_ENABLE_CRS_CSR_REG43_ADDR A:&base_addr+0x9e2b04
y.create.l HWIO_RPMH_VRM_ENABLE_CRS_CSR_REG44_ADDR A:&base_addr+0x9e2c04
y.create.l HWIO_RPMH_VRM_ENABLE_CRS_CSR_REG45_ADDR A:&base_addr+0x9e2d04
y.create.l HWIO_RPMH_VRM_MODE_CRS_CSR_REG0_ADDR A:&base_addr+0x9e0008
y.create.l HWIO_RPMH_VRM_MODE_CRS_CSR_REG1_ADDR A:&base_addr+0x9e0108
y.create.l HWIO_RPMH_VRM_MODE_CRS_CSR_REG2_ADDR A:&base_addr+0x9e0208
y.create.l HWIO_RPMH_VRM_MODE_CRS_CSR_REG3_ADDR A:&base_addr+0x9e0308
y.create.l HWIO_RPMH_VRM_MODE_CRS_CSR_REG4_ADDR A:&base_addr+0x9e0408
y.create.l HWIO_RPMH_VRM_MODE_CRS_CSR_REG5_ADDR A:&base_addr+0x9e0508
y.create.l HWIO_RPMH_VRM_MODE_CRS_CSR_REG6_ADDR A:&base_addr+0x9e0608
y.create.l HWIO_RPMH_VRM_MODE_CRS_CSR_REG7_ADDR A:&base_addr+0x9e0708
y.create.l HWIO_RPMH_VRM_MODE_CRS_CSR_REG8_ADDR A:&base_addr+0x9e0808
y.create.l HWIO_RPMH_VRM_MODE_CRS_CSR_REG9_ADDR A:&base_addr+0x9e0908
y.create.l HWIO_RPMH_VRM_MODE_CRS_CSR_REG10_ADDR A:&base_addr+0x9e0a08
y.create.l HWIO_RPMH_VRM_MODE_CRS_CSR_REG11_ADDR A:&base_addr+0x9e0b08
y.create.l HWIO_RPMH_VRM_MODE_CRS_CSR_REG12_ADDR A:&base_addr+0x9e0c08
y.create.l HWIO_RPMH_VRM_MODE_CRS_CSR_REG13_ADDR A:&base_addr+0x9e0d08
y.create.l HWIO_RPMH_VRM_MODE_CRS_CSR_REG14_ADDR A:&base_addr+0x9e0e08
y.create.l HWIO_RPMH_VRM_MODE_CRS_CSR_REG15_ADDR A:&base_addr+0x9e0f08
y.create.l HWIO_RPMH_VRM_MODE_CRS_CSR_REG16_ADDR A:&base_addr+0x9e1008
y.create.l HWIO_RPMH_VRM_MODE_CRS_CSR_REG17_ADDR A:&base_addr+0x9e1108
y.create.l HWIO_RPMH_VRM_MODE_CRS_CSR_REG18_ADDR A:&base_addr+0x9e1208
y.create.l HWIO_RPMH_VRM_MODE_CRS_CSR_REG19_ADDR A:&base_addr+0x9e1308
y.create.l HWIO_RPMH_VRM_MODE_CRS_CSR_REG20_ADDR A:&base_addr+0x9e1408
y.create.l HWIO_RPMH_VRM_MODE_CRS_CSR_REG21_ADDR A:&base_addr+0x9e1508
y.create.l HWIO_RPMH_VRM_MODE_CRS_CSR_REG22_ADDR A:&base_addr+0x9e1608
y.create.l HWIO_RPMH_VRM_MODE_CRS_CSR_REG23_ADDR A:&base_addr+0x9e1708
y.create.l HWIO_RPMH_VRM_MODE_CRS_CSR_REG24_ADDR A:&base_addr+0x9e1808
y.create.l HWIO_RPMH_VRM_MODE_CRS_CSR_REG25_ADDR A:&base_addr+0x9e1908
y.create.l HWIO_RPMH_VRM_MODE_CRS_CSR_REG26_ADDR A:&base_addr+0x9e1a08
y.create.l HWIO_RPMH_VRM_MODE_CRS_CSR_REG27_ADDR A:&base_addr+0x9e1b08
y.create.l HWIO_RPMH_VRM_MODE_CRS_CSR_REG28_ADDR A:&base_addr+0x9e1c08
y.create.l HWIO_RPMH_VRM_MODE_CRS_CSR_REG29_ADDR A:&base_addr+0x9e1d08
y.create.l HWIO_RPMH_VRM_MODE_CRS_CSR_REG30_ADDR A:&base_addr+0x9e1e08
y.create.l HWIO_RPMH_VRM_MODE_CRS_CSR_REG31_ADDR A:&base_addr+0x9e1f08
y.create.l HWIO_RPMH_VRM_MODE_CRS_CSR_REG32_ADDR A:&base_addr+0x9e2008
y.create.l HWIO_RPMH_VRM_MODE_CRS_CSR_REG33_ADDR A:&base_addr+0x9e2108
y.create.l HWIO_RPMH_VRM_MODE_CRS_CSR_REG34_ADDR A:&base_addr+0x9e2208
y.create.l HWIO_RPMH_VRM_MODE_CRS_CSR_REG35_ADDR A:&base_addr+0x9e2308
y.create.l HWIO_RPMH_VRM_MODE_CRS_CSR_REG36_ADDR A:&base_addr+0x9e2408
y.create.l HWIO_RPMH_VRM_MODE_CRS_CSR_REG37_ADDR A:&base_addr+0x9e2508
y.create.l HWIO_RPMH_VRM_MODE_CRS_CSR_REG38_ADDR A:&base_addr+0x9e2608
y.create.l HWIO_RPMH_VRM_MODE_CRS_CSR_REG39_ADDR A:&base_addr+0x9e2708
y.create.l HWIO_RPMH_VRM_MODE_CRS_CSR_REG40_ADDR A:&base_addr+0x9e2808
y.create.l HWIO_RPMH_VRM_MODE_CRS_CSR_REG41_ADDR A:&base_addr+0x9e2908
y.create.l HWIO_RPMH_VRM_MODE_CRS_CSR_REG42_ADDR A:&base_addr+0x9e2a08
y.create.l HWIO_RPMH_VRM_MODE_CRS_CSR_REG43_ADDR A:&base_addr+0x9e2b08
y.create.l HWIO_RPMH_VRM_MODE_CRS_CSR_REG44_ADDR A:&base_addr+0x9e2c08
y.create.l HWIO_RPMH_VRM_MODE_CRS_CSR_REG45_ADDR A:&base_addr+0x9e2d08
y.create.l HWIO_RPMH_VRM_HEADROOM_CRS_CSR_REG0_ADDR A:&base_addr+0x9e000c
y.create.l HWIO_RPMH_VRM_HEADROOM_CRS_CSR_REG1_ADDR A:&base_addr+0x9e010c
y.create.l HWIO_RPMH_VRM_HEADROOM_CRS_CSR_REG2_ADDR A:&base_addr+0x9e020c
y.create.l HWIO_RPMH_VRM_HEADROOM_CRS_CSR_REG3_ADDR A:&base_addr+0x9e030c
y.create.l HWIO_RPMH_VRM_HEADROOM_CRS_CSR_REG4_ADDR A:&base_addr+0x9e040c
y.create.l HWIO_RPMH_VRM_HEADROOM_CRS_CSR_REG5_ADDR A:&base_addr+0x9e050c
y.create.l HWIO_RPMH_VRM_HEADROOM_CRS_CSR_REG6_ADDR A:&base_addr+0x9e060c
y.create.l HWIO_RPMH_VRM_HEADROOM_CRS_CSR_REG7_ADDR A:&base_addr+0x9e070c
y.create.l HWIO_RPMH_VRM_HEADROOM_CRS_CSR_REG8_ADDR A:&base_addr+0x9e080c
y.create.l HWIO_RPMH_VRM_HEADROOM_CRS_CSR_REG9_ADDR A:&base_addr+0x9e090c
y.create.l HWIO_RPMH_VRM_HEADROOM_CRS_CSR_REG10_ADDR A:&base_addr+0x9e0a0c
y.create.l HWIO_RPMH_VRM_HEADROOM_CRS_CSR_REG11_ADDR A:&base_addr+0x9e0b0c
y.create.l HWIO_RPMH_VRM_HEADROOM_CRS_CSR_REG12_ADDR A:&base_addr+0x9e0c0c
y.create.l HWIO_RPMH_VRM_HEADROOM_CRS_CSR_REG13_ADDR A:&base_addr+0x9e0d0c
y.create.l HWIO_RPMH_VRM_HEADROOM_CRS_CSR_REG14_ADDR A:&base_addr+0x9e0e0c
y.create.l HWIO_RPMH_VRM_HEADROOM_CRS_CSR_REG15_ADDR A:&base_addr+0x9e0f0c
y.create.l HWIO_RPMH_VRM_HEADROOM_CRS_CSR_REG16_ADDR A:&base_addr+0x9e100c
y.create.l HWIO_RPMH_VRM_HEADROOM_CRS_CSR_REG17_ADDR A:&base_addr+0x9e110c
y.create.l HWIO_RPMH_VRM_HEADROOM_CRS_CSR_REG18_ADDR A:&base_addr+0x9e120c
y.create.l HWIO_RPMH_VRM_HEADROOM_CRS_CSR_REG19_ADDR A:&base_addr+0x9e130c
y.create.l HWIO_RPMH_VRM_HEADROOM_CRS_CSR_REG20_ADDR A:&base_addr+0x9e140c
y.create.l HWIO_RPMH_VRM_HEADROOM_CRS_CSR_REG21_ADDR A:&base_addr+0x9e150c
y.create.l HWIO_RPMH_VRM_HEADROOM_CRS_CSR_REG22_ADDR A:&base_addr+0x9e160c
y.create.l HWIO_RPMH_VRM_HEADROOM_CRS_CSR_REG23_ADDR A:&base_addr+0x9e170c
y.create.l HWIO_RPMH_VRM_HEADROOM_CRS_CSR_REG24_ADDR A:&base_addr+0x9e180c
y.create.l HWIO_RPMH_VRM_HEADROOM_CRS_CSR_REG25_ADDR A:&base_addr+0x9e190c
y.create.l HWIO_RPMH_VRM_HEADROOM_CRS_CSR_REG26_ADDR A:&base_addr+0x9e1a0c
y.create.l HWIO_RPMH_VRM_HEADROOM_CRS_CSR_REG27_ADDR A:&base_addr+0x9e1b0c
y.create.l HWIO_RPMH_VRM_HEADROOM_CRS_CSR_REG28_ADDR A:&base_addr+0x9e1c0c
y.create.l HWIO_RPMH_VRM_HEADROOM_CRS_CSR_REG29_ADDR A:&base_addr+0x9e1d0c
y.create.l HWIO_RPMH_VRM_HEADROOM_CRS_CSR_REG30_ADDR A:&base_addr+0x9e1e0c
y.create.l HWIO_RPMH_VRM_HEADROOM_CRS_CSR_REG31_ADDR A:&base_addr+0x9e1f0c
y.create.l HWIO_RPMH_VRM_HEADROOM_CRS_CSR_REG32_ADDR A:&base_addr+0x9e200c
y.create.l HWIO_RPMH_VRM_HEADROOM_CRS_CSR_REG33_ADDR A:&base_addr+0x9e210c
y.create.l HWIO_RPMH_VRM_HEADROOM_CRS_CSR_REG34_ADDR A:&base_addr+0x9e220c
y.create.l HWIO_RPMH_VRM_HEADROOM_CRS_CSR_REG35_ADDR A:&base_addr+0x9e230c
y.create.l HWIO_RPMH_VRM_HEADROOM_CRS_CSR_REG36_ADDR A:&base_addr+0x9e240c
y.create.l HWIO_RPMH_VRM_HEADROOM_CRS_CSR_REG37_ADDR A:&base_addr+0x9e250c
y.create.l HWIO_RPMH_VRM_HEADROOM_CRS_CSR_REG38_ADDR A:&base_addr+0x9e260c
y.create.l HWIO_RPMH_VRM_HEADROOM_CRS_CSR_REG39_ADDR A:&base_addr+0x9e270c
y.create.l HWIO_RPMH_VRM_HEADROOM_CRS_CSR_REG40_ADDR A:&base_addr+0x9e280c
y.create.l HWIO_RPMH_VRM_HEADROOM_CRS_CSR_REG41_ADDR A:&base_addr+0x9e290c
y.create.l HWIO_RPMH_VRM_HEADROOM_CRS_CSR_REG42_ADDR A:&base_addr+0x9e2a0c
y.create.l HWIO_RPMH_VRM_HEADROOM_CRS_CSR_REG43_ADDR A:&base_addr+0x9e2b0c
y.create.l HWIO_RPMH_VRM_HEADROOM_CRS_CSR_REG44_ADDR A:&base_addr+0x9e2c0c
y.create.l HWIO_RPMH_VRM_HEADROOM_CRS_CSR_REG45_ADDR A:&base_addr+0x9e2d0c
y.create.l HWIO_RPMH_VRM_ENABLE_CRS_CSR_XOB0_ADDR A:&base_addr+0x9ec004
y.create.l HWIO_RPMH_VRM_ENABLE_CRS_CSR_XOB1_ADDR A:&base_addr+0x9ec104
y.create.l HWIO_RPMH_VRM_ENABLE_CRS_CSR_XOB2_ADDR A:&base_addr+0x9ec204
y.create.l HWIO_RPMH_VRM_ENABLE_CRS_CSR_XOB3_ADDR A:&base_addr+0x9ec304
y.create.l HWIO_RPMH_VRM_ENABLE_CRS_CSR_XOB4_ADDR A:&base_addr+0x9ec404
y.create.l HWIO_RPMH_VRM_ENABLE_CRS_CSR_XOB5_ADDR A:&base_addr+0x9ec504
y.create.l HWIO_RPMH_VRM_ENABLE_CRS_CSR_XOB6_ADDR A:&base_addr+0x9ec604
y.create.l HWIO_RPMH_VRM_ENABLE_CRS_CSR_XOB7_ADDR A:&base_addr+0x9ec704
y.create.l HWIO_RPMH_VRM_ENABLE_CRS_CSR_XO0_ADDR A:&base_addr+0x9ed804
y.create.l HWIO_RPMH_VRM_VOLTAGE_WRS_CSR_REG0_ADDR A:&base_addr+0x9e0020
y.create.l HWIO_RPMH_VRM_VOLTAGE_WRS_CSR_REG1_ADDR A:&base_addr+0x9e0120
y.create.l HWIO_RPMH_VRM_VOLTAGE_WRS_CSR_REG2_ADDR A:&base_addr+0x9e0220
y.create.l HWIO_RPMH_VRM_VOLTAGE_WRS_CSR_REG3_ADDR A:&base_addr+0x9e0320
y.create.l HWIO_RPMH_VRM_VOLTAGE_WRS_CSR_REG4_ADDR A:&base_addr+0x9e0420
y.create.l HWIO_RPMH_VRM_VOLTAGE_WRS_CSR_REG5_ADDR A:&base_addr+0x9e0520
y.create.l HWIO_RPMH_VRM_VOLTAGE_WRS_CSR_REG6_ADDR A:&base_addr+0x9e0620
y.create.l HWIO_RPMH_VRM_VOLTAGE_WRS_CSR_REG7_ADDR A:&base_addr+0x9e0720
y.create.l HWIO_RPMH_VRM_VOLTAGE_WRS_CSR_REG8_ADDR A:&base_addr+0x9e0820
y.create.l HWIO_RPMH_VRM_VOLTAGE_WRS_CSR_REG9_ADDR A:&base_addr+0x9e0920
y.create.l HWIO_RPMH_VRM_VOLTAGE_WRS_CSR_REG10_ADDR A:&base_addr+0x9e0a20
y.create.l HWIO_RPMH_VRM_VOLTAGE_WRS_CSR_REG11_ADDR A:&base_addr+0x9e0b20
y.create.l HWIO_RPMH_VRM_VOLTAGE_WRS_CSR_REG12_ADDR A:&base_addr+0x9e0c20
y.create.l HWIO_RPMH_VRM_VOLTAGE_WRS_CSR_REG13_ADDR A:&base_addr+0x9e0d20
y.create.l HWIO_RPMH_VRM_VOLTAGE_WRS_CSR_REG14_ADDR A:&base_addr+0x9e0e20
y.create.l HWIO_RPMH_VRM_VOLTAGE_WRS_CSR_REG15_ADDR A:&base_addr+0x9e0f20
y.create.l HWIO_RPMH_VRM_VOLTAGE_WRS_CSR_REG16_ADDR A:&base_addr+0x9e1020
y.create.l HWIO_RPMH_VRM_VOLTAGE_WRS_CSR_REG17_ADDR A:&base_addr+0x9e1120
y.create.l HWIO_RPMH_VRM_VOLTAGE_WRS_CSR_REG18_ADDR A:&base_addr+0x9e1220
y.create.l HWIO_RPMH_VRM_VOLTAGE_WRS_CSR_REG19_ADDR A:&base_addr+0x9e1320
y.create.l HWIO_RPMH_VRM_VOLTAGE_WRS_CSR_REG20_ADDR A:&base_addr+0x9e1420
y.create.l HWIO_RPMH_VRM_VOLTAGE_WRS_CSR_REG21_ADDR A:&base_addr+0x9e1520
y.create.l HWIO_RPMH_VRM_VOLTAGE_WRS_CSR_REG22_ADDR A:&base_addr+0x9e1620
y.create.l HWIO_RPMH_VRM_VOLTAGE_WRS_CSR_REG23_ADDR A:&base_addr+0x9e1720
y.create.l HWIO_RPMH_VRM_VOLTAGE_WRS_CSR_REG24_ADDR A:&base_addr+0x9e1820
y.create.l HWIO_RPMH_VRM_VOLTAGE_WRS_CSR_REG25_ADDR A:&base_addr+0x9e1920
y.create.l HWIO_RPMH_VRM_VOLTAGE_WRS_CSR_REG26_ADDR A:&base_addr+0x9e1a20
y.create.l HWIO_RPMH_VRM_VOLTAGE_WRS_CSR_REG27_ADDR A:&base_addr+0x9e1b20
y.create.l HWIO_RPMH_VRM_VOLTAGE_WRS_CSR_REG28_ADDR A:&base_addr+0x9e1c20
y.create.l HWIO_RPMH_VRM_VOLTAGE_WRS_CSR_REG29_ADDR A:&base_addr+0x9e1d20
y.create.l HWIO_RPMH_VRM_VOLTAGE_WRS_CSR_REG30_ADDR A:&base_addr+0x9e1e20
y.create.l HWIO_RPMH_VRM_VOLTAGE_WRS_CSR_REG31_ADDR A:&base_addr+0x9e1f20
y.create.l HWIO_RPMH_VRM_VOLTAGE_WRS_CSR_REG32_ADDR A:&base_addr+0x9e2020
y.create.l HWIO_RPMH_VRM_VOLTAGE_WRS_CSR_REG33_ADDR A:&base_addr+0x9e2120
y.create.l HWIO_RPMH_VRM_VOLTAGE_WRS_CSR_REG34_ADDR A:&base_addr+0x9e2220
y.create.l HWIO_RPMH_VRM_VOLTAGE_WRS_CSR_REG35_ADDR A:&base_addr+0x9e2320
y.create.l HWIO_RPMH_VRM_VOLTAGE_WRS_CSR_REG36_ADDR A:&base_addr+0x9e2420
y.create.l HWIO_RPMH_VRM_VOLTAGE_WRS_CSR_REG37_ADDR A:&base_addr+0x9e2520
y.create.l HWIO_RPMH_VRM_VOLTAGE_WRS_CSR_REG38_ADDR A:&base_addr+0x9e2620
y.create.l HWIO_RPMH_VRM_VOLTAGE_WRS_CSR_REG39_ADDR A:&base_addr+0x9e2720
y.create.l HWIO_RPMH_VRM_VOLTAGE_WRS_CSR_REG40_ADDR A:&base_addr+0x9e2820
y.create.l HWIO_RPMH_VRM_VOLTAGE_WRS_CSR_REG41_ADDR A:&base_addr+0x9e2920
y.create.l HWIO_RPMH_VRM_VOLTAGE_WRS_CSR_REG42_ADDR A:&base_addr+0x9e2a20
y.create.l HWIO_RPMH_VRM_VOLTAGE_WRS_CSR_REG43_ADDR A:&base_addr+0x9e2b20
y.create.l HWIO_RPMH_VRM_VOLTAGE_WRS_CSR_REG44_ADDR A:&base_addr+0x9e2c20
y.create.l HWIO_RPMH_VRM_VOLTAGE_WRS_CSR_REG45_ADDR A:&base_addr+0x9e2d20
y.create.l HWIO_RPMH_VRM_ENABLE_WRS_CSR_REG0_ADDR A:&base_addr+0x9e0024
y.create.l HWIO_RPMH_VRM_ENABLE_WRS_CSR_REG1_ADDR A:&base_addr+0x9e0124
y.create.l HWIO_RPMH_VRM_ENABLE_WRS_CSR_REG2_ADDR A:&base_addr+0x9e0224
y.create.l HWIO_RPMH_VRM_ENABLE_WRS_CSR_REG3_ADDR A:&base_addr+0x9e0324
y.create.l HWIO_RPMH_VRM_ENABLE_WRS_CSR_REG4_ADDR A:&base_addr+0x9e0424
y.create.l HWIO_RPMH_VRM_ENABLE_WRS_CSR_REG5_ADDR A:&base_addr+0x9e0524
y.create.l HWIO_RPMH_VRM_ENABLE_WRS_CSR_REG6_ADDR A:&base_addr+0x9e0624
y.create.l HWIO_RPMH_VRM_ENABLE_WRS_CSR_REG7_ADDR A:&base_addr+0x9e0724
y.create.l HWIO_RPMH_VRM_ENABLE_WRS_CSR_REG8_ADDR A:&base_addr+0x9e0824
y.create.l HWIO_RPMH_VRM_ENABLE_WRS_CSR_REG9_ADDR A:&base_addr+0x9e0924
y.create.l HWIO_RPMH_VRM_ENABLE_WRS_CSR_REG10_ADDR A:&base_addr+0x9e0a24
y.create.l HWIO_RPMH_VRM_ENABLE_WRS_CSR_REG11_ADDR A:&base_addr+0x9e0b24
y.create.l HWIO_RPMH_VRM_ENABLE_WRS_CSR_REG12_ADDR A:&base_addr+0x9e0c24
y.create.l HWIO_RPMH_VRM_ENABLE_WRS_CSR_REG13_ADDR A:&base_addr+0x9e0d24
y.create.l HWIO_RPMH_VRM_ENABLE_WRS_CSR_REG14_ADDR A:&base_addr+0x9e0e24
y.create.l HWIO_RPMH_VRM_ENABLE_WRS_CSR_REG15_ADDR A:&base_addr+0x9e0f24
y.create.l HWIO_RPMH_VRM_ENABLE_WRS_CSR_REG16_ADDR A:&base_addr+0x9e1024
y.create.l HWIO_RPMH_VRM_ENABLE_WRS_CSR_REG17_ADDR A:&base_addr+0x9e1124
y.create.l HWIO_RPMH_VRM_ENABLE_WRS_CSR_REG18_ADDR A:&base_addr+0x9e1224
y.create.l HWIO_RPMH_VRM_ENABLE_WRS_CSR_REG19_ADDR A:&base_addr+0x9e1324
y.create.l HWIO_RPMH_VRM_ENABLE_WRS_CSR_REG20_ADDR A:&base_addr+0x9e1424
y.create.l HWIO_RPMH_VRM_ENABLE_WRS_CSR_REG21_ADDR A:&base_addr+0x9e1524
y.create.l HWIO_RPMH_VRM_ENABLE_WRS_CSR_REG22_ADDR A:&base_addr+0x9e1624
y.create.l HWIO_RPMH_VRM_ENABLE_WRS_CSR_REG23_ADDR A:&base_addr+0x9e1724
y.create.l HWIO_RPMH_VRM_ENABLE_WRS_CSR_REG24_ADDR A:&base_addr+0x9e1824
y.create.l HWIO_RPMH_VRM_ENABLE_WRS_CSR_REG25_ADDR A:&base_addr+0x9e1924
y.create.l HWIO_RPMH_VRM_ENABLE_WRS_CSR_REG26_ADDR A:&base_addr+0x9e1a24
y.create.l HWIO_RPMH_VRM_ENABLE_WRS_CSR_REG27_ADDR A:&base_addr+0x9e1b24
y.create.l HWIO_RPMH_VRM_ENABLE_WRS_CSR_REG28_ADDR A:&base_addr+0x9e1c24
y.create.l HWIO_RPMH_VRM_ENABLE_WRS_CSR_REG29_ADDR A:&base_addr+0x9e1d24
y.create.l HWIO_RPMH_VRM_ENABLE_WRS_CSR_REG30_ADDR A:&base_addr+0x9e1e24
y.create.l HWIO_RPMH_VRM_ENABLE_WRS_CSR_REG31_ADDR A:&base_addr+0x9e1f24
y.create.l HWIO_RPMH_VRM_ENABLE_WRS_CSR_REG32_ADDR A:&base_addr+0x9e2024
y.create.l HWIO_RPMH_VRM_ENABLE_WRS_CSR_REG33_ADDR A:&base_addr+0x9e2124
y.create.l HWIO_RPMH_VRM_ENABLE_WRS_CSR_REG34_ADDR A:&base_addr+0x9e2224
y.create.l HWIO_RPMH_VRM_ENABLE_WRS_CSR_REG35_ADDR A:&base_addr+0x9e2324
y.create.l HWIO_RPMH_VRM_ENABLE_WRS_CSR_REG36_ADDR A:&base_addr+0x9e2424
y.create.l HWIO_RPMH_VRM_ENABLE_WRS_CSR_REG37_ADDR A:&base_addr+0x9e2524
y.create.l HWIO_RPMH_VRM_ENABLE_WRS_CSR_REG38_ADDR A:&base_addr+0x9e2624
y.create.l HWIO_RPMH_VRM_ENABLE_WRS_CSR_REG39_ADDR A:&base_addr+0x9e2724
y.create.l HWIO_RPMH_VRM_ENABLE_WRS_CSR_REG40_ADDR A:&base_addr+0x9e2824
y.create.l HWIO_RPMH_VRM_ENABLE_WRS_CSR_REG41_ADDR A:&base_addr+0x9e2924
y.create.l HWIO_RPMH_VRM_ENABLE_WRS_CSR_REG42_ADDR A:&base_addr+0x9e2a24
y.create.l HWIO_RPMH_VRM_ENABLE_WRS_CSR_REG43_ADDR A:&base_addr+0x9e2b24
y.create.l HWIO_RPMH_VRM_ENABLE_WRS_CSR_REG44_ADDR A:&base_addr+0x9e2c24
y.create.l HWIO_RPMH_VRM_ENABLE_WRS_CSR_REG45_ADDR A:&base_addr+0x9e2d24
y.create.l HWIO_RPMH_VRM_MODE_WRS_CSR_REG0_ADDR A:&base_addr+0x9e0028
y.create.l HWIO_RPMH_VRM_MODE_WRS_CSR_REG1_ADDR A:&base_addr+0x9e0128
y.create.l HWIO_RPMH_VRM_MODE_WRS_CSR_REG2_ADDR A:&base_addr+0x9e0228
y.create.l HWIO_RPMH_VRM_MODE_WRS_CSR_REG3_ADDR A:&base_addr+0x9e0328
y.create.l HWIO_RPMH_VRM_MODE_WRS_CSR_REG4_ADDR A:&base_addr+0x9e0428
y.create.l HWIO_RPMH_VRM_MODE_WRS_CSR_REG5_ADDR A:&base_addr+0x9e0528
y.create.l HWIO_RPMH_VRM_MODE_WRS_CSR_REG6_ADDR A:&base_addr+0x9e0628
y.create.l HWIO_RPMH_VRM_MODE_WRS_CSR_REG7_ADDR A:&base_addr+0x9e0728
y.create.l HWIO_RPMH_VRM_MODE_WRS_CSR_REG8_ADDR A:&base_addr+0x9e0828
y.create.l HWIO_RPMH_VRM_MODE_WRS_CSR_REG9_ADDR A:&base_addr+0x9e0928
y.create.l HWIO_RPMH_VRM_MODE_WRS_CSR_REG10_ADDR A:&base_addr+0x9e0a28
y.create.l HWIO_RPMH_VRM_MODE_WRS_CSR_REG11_ADDR A:&base_addr+0x9e0b28
y.create.l HWIO_RPMH_VRM_MODE_WRS_CSR_REG12_ADDR A:&base_addr+0x9e0c28
y.create.l HWIO_RPMH_VRM_MODE_WRS_CSR_REG13_ADDR A:&base_addr+0x9e0d28
y.create.l HWIO_RPMH_VRM_MODE_WRS_CSR_REG14_ADDR A:&base_addr+0x9e0e28
y.create.l HWIO_RPMH_VRM_MODE_WRS_CSR_REG15_ADDR A:&base_addr+0x9e0f28
y.create.l HWIO_RPMH_VRM_MODE_WRS_CSR_REG16_ADDR A:&base_addr+0x9e1028
y.create.l HWIO_RPMH_VRM_MODE_WRS_CSR_REG17_ADDR A:&base_addr+0x9e1128
y.create.l HWIO_RPMH_VRM_MODE_WRS_CSR_REG18_ADDR A:&base_addr+0x9e1228
y.create.l HWIO_RPMH_VRM_MODE_WRS_CSR_REG19_ADDR A:&base_addr+0x9e1328
y.create.l HWIO_RPMH_VRM_MODE_WRS_CSR_REG20_ADDR A:&base_addr+0x9e1428
y.create.l HWIO_RPMH_VRM_MODE_WRS_CSR_REG21_ADDR A:&base_addr+0x9e1528
y.create.l HWIO_RPMH_VRM_MODE_WRS_CSR_REG22_ADDR A:&base_addr+0x9e1628
y.create.l HWIO_RPMH_VRM_MODE_WRS_CSR_REG23_ADDR A:&base_addr+0x9e1728
y.create.l HWIO_RPMH_VRM_MODE_WRS_CSR_REG24_ADDR A:&base_addr+0x9e1828
y.create.l HWIO_RPMH_VRM_MODE_WRS_CSR_REG25_ADDR A:&base_addr+0x9e1928
y.create.l HWIO_RPMH_VRM_MODE_WRS_CSR_REG26_ADDR A:&base_addr+0x9e1a28
y.create.l HWIO_RPMH_VRM_MODE_WRS_CSR_REG27_ADDR A:&base_addr+0x9e1b28
y.create.l HWIO_RPMH_VRM_MODE_WRS_CSR_REG28_ADDR A:&base_addr+0x9e1c28
y.create.l HWIO_RPMH_VRM_MODE_WRS_CSR_REG29_ADDR A:&base_addr+0x9e1d28
y.create.l HWIO_RPMH_VRM_MODE_WRS_CSR_REG30_ADDR A:&base_addr+0x9e1e28
y.create.l HWIO_RPMH_VRM_MODE_WRS_CSR_REG31_ADDR A:&base_addr+0x9e1f28
y.create.l HWIO_RPMH_VRM_MODE_WRS_CSR_REG32_ADDR A:&base_addr+0x9e2028
y.create.l HWIO_RPMH_VRM_MODE_WRS_CSR_REG33_ADDR A:&base_addr+0x9e2128
y.create.l HWIO_RPMH_VRM_MODE_WRS_CSR_REG34_ADDR A:&base_addr+0x9e2228
y.create.l HWIO_RPMH_VRM_MODE_WRS_CSR_REG35_ADDR A:&base_addr+0x9e2328
y.create.l HWIO_RPMH_VRM_MODE_WRS_CSR_REG36_ADDR A:&base_addr+0x9e2428
y.create.l HWIO_RPMH_VRM_MODE_WRS_CSR_REG37_ADDR A:&base_addr+0x9e2528
y.create.l HWIO_RPMH_VRM_MODE_WRS_CSR_REG38_ADDR A:&base_addr+0x9e2628
y.create.l HWIO_RPMH_VRM_MODE_WRS_CSR_REG39_ADDR A:&base_addr+0x9e2728
y.create.l HWIO_RPMH_VRM_MODE_WRS_CSR_REG40_ADDR A:&base_addr+0x9e2828
y.create.l HWIO_RPMH_VRM_MODE_WRS_CSR_REG41_ADDR A:&base_addr+0x9e2928
y.create.l HWIO_RPMH_VRM_MODE_WRS_CSR_REG42_ADDR A:&base_addr+0x9e2a28
y.create.l HWIO_RPMH_VRM_MODE_WRS_CSR_REG43_ADDR A:&base_addr+0x9e2b28
y.create.l HWIO_RPMH_VRM_MODE_WRS_CSR_REG44_ADDR A:&base_addr+0x9e2c28
y.create.l HWIO_RPMH_VRM_MODE_WRS_CSR_REG45_ADDR A:&base_addr+0x9e2d28
y.create.l HWIO_RPMH_VRM_HEADROOM_WRS_CSR_REG0_ADDR A:&base_addr+0x9e002c
y.create.l HWIO_RPMH_VRM_HEADROOM_WRS_CSR_REG1_ADDR A:&base_addr+0x9e012c
y.create.l HWIO_RPMH_VRM_HEADROOM_WRS_CSR_REG2_ADDR A:&base_addr+0x9e022c
y.create.l HWIO_RPMH_VRM_HEADROOM_WRS_CSR_REG3_ADDR A:&base_addr+0x9e032c
y.create.l HWIO_RPMH_VRM_HEADROOM_WRS_CSR_REG4_ADDR A:&base_addr+0x9e042c
y.create.l HWIO_RPMH_VRM_HEADROOM_WRS_CSR_REG5_ADDR A:&base_addr+0x9e052c
y.create.l HWIO_RPMH_VRM_HEADROOM_WRS_CSR_REG6_ADDR A:&base_addr+0x9e062c
y.create.l HWIO_RPMH_VRM_HEADROOM_WRS_CSR_REG7_ADDR A:&base_addr+0x9e072c
y.create.l HWIO_RPMH_VRM_HEADROOM_WRS_CSR_REG8_ADDR A:&base_addr+0x9e082c
y.create.l HWIO_RPMH_VRM_HEADROOM_WRS_CSR_REG9_ADDR A:&base_addr+0x9e092c
y.create.l HWIO_RPMH_VRM_HEADROOM_WRS_CSR_REG10_ADDR A:&base_addr+0x9e0a2c
y.create.l HWIO_RPMH_VRM_HEADROOM_WRS_CSR_REG11_ADDR A:&base_addr+0x9e0b2c
y.create.l HWIO_RPMH_VRM_HEADROOM_WRS_CSR_REG12_ADDR A:&base_addr+0x9e0c2c
y.create.l HWIO_RPMH_VRM_HEADROOM_WRS_CSR_REG13_ADDR A:&base_addr+0x9e0d2c
y.create.l HWIO_RPMH_VRM_HEADROOM_WRS_CSR_REG14_ADDR A:&base_addr+0x9e0e2c
y.create.l HWIO_RPMH_VRM_HEADROOM_WRS_CSR_REG15_ADDR A:&base_addr+0x9e0f2c
y.create.l HWIO_RPMH_VRM_HEADROOM_WRS_CSR_REG16_ADDR A:&base_addr+0x9e102c
y.create.l HWIO_RPMH_VRM_HEADROOM_WRS_CSR_REG17_ADDR A:&base_addr+0x9e112c
y.create.l HWIO_RPMH_VRM_HEADROOM_WRS_CSR_REG18_ADDR A:&base_addr+0x9e122c
y.create.l HWIO_RPMH_VRM_HEADROOM_WRS_CSR_REG19_ADDR A:&base_addr+0x9e132c
y.create.l HWIO_RPMH_VRM_HEADROOM_WRS_CSR_REG20_ADDR A:&base_addr+0x9e142c
y.create.l HWIO_RPMH_VRM_HEADROOM_WRS_CSR_REG21_ADDR A:&base_addr+0x9e152c
y.create.l HWIO_RPMH_VRM_HEADROOM_WRS_CSR_REG22_ADDR A:&base_addr+0x9e162c
y.create.l HWIO_RPMH_VRM_HEADROOM_WRS_CSR_REG23_ADDR A:&base_addr+0x9e172c
y.create.l HWIO_RPMH_VRM_HEADROOM_WRS_CSR_REG24_ADDR A:&base_addr+0x9e182c
y.create.l HWIO_RPMH_VRM_HEADROOM_WRS_CSR_REG25_ADDR A:&base_addr+0x9e192c
y.create.l HWIO_RPMH_VRM_HEADROOM_WRS_CSR_REG26_ADDR A:&base_addr+0x9e1a2c
y.create.l HWIO_RPMH_VRM_HEADROOM_WRS_CSR_REG27_ADDR A:&base_addr+0x9e1b2c
y.create.l HWIO_RPMH_VRM_HEADROOM_WRS_CSR_REG28_ADDR A:&base_addr+0x9e1c2c
y.create.l HWIO_RPMH_VRM_HEADROOM_WRS_CSR_REG29_ADDR A:&base_addr+0x9e1d2c
y.create.l HWIO_RPMH_VRM_HEADROOM_WRS_CSR_REG30_ADDR A:&base_addr+0x9e1e2c
y.create.l HWIO_RPMH_VRM_HEADROOM_WRS_CSR_REG31_ADDR A:&base_addr+0x9e1f2c
y.create.l HWIO_RPMH_VRM_HEADROOM_WRS_CSR_REG32_ADDR A:&base_addr+0x9e202c
y.create.l HWIO_RPMH_VRM_HEADROOM_WRS_CSR_REG33_ADDR A:&base_addr+0x9e212c
y.create.l HWIO_RPMH_VRM_HEADROOM_WRS_CSR_REG34_ADDR A:&base_addr+0x9e222c
y.create.l HWIO_RPMH_VRM_HEADROOM_WRS_CSR_REG35_ADDR A:&base_addr+0x9e232c
y.create.l HWIO_RPMH_VRM_HEADROOM_WRS_CSR_REG36_ADDR A:&base_addr+0x9e242c
y.create.l HWIO_RPMH_VRM_HEADROOM_WRS_CSR_REG37_ADDR A:&base_addr+0x9e252c
y.create.l HWIO_RPMH_VRM_HEADROOM_WRS_CSR_REG38_ADDR A:&base_addr+0x9e262c
y.create.l HWIO_RPMH_VRM_HEADROOM_WRS_CSR_REG39_ADDR A:&base_addr+0x9e272c
y.create.l HWIO_RPMH_VRM_HEADROOM_WRS_CSR_REG40_ADDR A:&base_addr+0x9e282c
y.create.l HWIO_RPMH_VRM_HEADROOM_WRS_CSR_REG41_ADDR A:&base_addr+0x9e292c
y.create.l HWIO_RPMH_VRM_HEADROOM_WRS_CSR_REG42_ADDR A:&base_addr+0x9e2a2c
y.create.l HWIO_RPMH_VRM_HEADROOM_WRS_CSR_REG43_ADDR A:&base_addr+0x9e2b2c
y.create.l HWIO_RPMH_VRM_HEADROOM_WRS_CSR_REG44_ADDR A:&base_addr+0x9e2c2c
y.create.l HWIO_RPMH_VRM_HEADROOM_WRS_CSR_REG45_ADDR A:&base_addr+0x9e2d2c
y.create.l HWIO_RPMH_VRM_ENABLE_WRS_CSR_XOB0_ADDR A:&base_addr+0x9ec024
y.create.l HWIO_RPMH_VRM_ENABLE_WRS_CSR_XOB1_ADDR A:&base_addr+0x9ec124
y.create.l HWIO_RPMH_VRM_ENABLE_WRS_CSR_XOB2_ADDR A:&base_addr+0x9ec224
y.create.l HWIO_RPMH_VRM_ENABLE_WRS_CSR_XOB3_ADDR A:&base_addr+0x9ec324
y.create.l HWIO_RPMH_VRM_ENABLE_WRS_CSR_XOB4_ADDR A:&base_addr+0x9ec424
y.create.l HWIO_RPMH_VRM_ENABLE_WRS_CSR_XOB5_ADDR A:&base_addr+0x9ec524
y.create.l HWIO_RPMH_VRM_ENABLE_WRS_CSR_XOB6_ADDR A:&base_addr+0x9ec624
y.create.l HWIO_RPMH_VRM_ENABLE_WRS_CSR_XOB7_ADDR A:&base_addr+0x9ec724
y.create.l HWIO_RPMH_VRM_ENABLE_WRS_CSR_XO0_ADDR A:&base_addr+0x9ed824
y.create.l HWIO_RPMH_VRM_VOLTAGE_DRS_CSR_REG0_ADDR A:&base_addr+0x9e0040
y.create.l HWIO_RPMH_VRM_VOLTAGE_DRS_CSR_REG1_ADDR A:&base_addr+0x9e0140
y.create.l HWIO_RPMH_VRM_VOLTAGE_DRS_CSR_REG2_ADDR A:&base_addr+0x9e0240
y.create.l HWIO_RPMH_VRM_VOLTAGE_DRS_CSR_REG3_ADDR A:&base_addr+0x9e0340
y.create.l HWIO_RPMH_VRM_VOLTAGE_DRS_CSR_REG4_ADDR A:&base_addr+0x9e0440
y.create.l HWIO_RPMH_VRM_VOLTAGE_DRS_CSR_REG5_ADDR A:&base_addr+0x9e0540
y.create.l HWIO_RPMH_VRM_VOLTAGE_DRS_CSR_REG6_ADDR A:&base_addr+0x9e0640
y.create.l HWIO_RPMH_VRM_VOLTAGE_DRS_CSR_REG7_ADDR A:&base_addr+0x9e0740
y.create.l HWIO_RPMH_VRM_VOLTAGE_DRS_CSR_REG8_ADDR A:&base_addr+0x9e0840
y.create.l HWIO_RPMH_VRM_VOLTAGE_DRS_CSR_REG9_ADDR A:&base_addr+0x9e0940
y.create.l HWIO_RPMH_VRM_VOLTAGE_DRS_CSR_REG10_ADDR A:&base_addr+0x9e0a40
y.create.l HWIO_RPMH_VRM_VOLTAGE_DRS_CSR_REG11_ADDR A:&base_addr+0x9e0b40
y.create.l HWIO_RPMH_VRM_VOLTAGE_DRS_CSR_REG12_ADDR A:&base_addr+0x9e0c40
y.create.l HWIO_RPMH_VRM_VOLTAGE_DRS_CSR_REG13_ADDR A:&base_addr+0x9e0d40
y.create.l HWIO_RPMH_VRM_VOLTAGE_DRS_CSR_REG14_ADDR A:&base_addr+0x9e0e40
y.create.l HWIO_RPMH_VRM_VOLTAGE_DRS_CSR_REG15_ADDR A:&base_addr+0x9e0f40
y.create.l HWIO_RPMH_VRM_VOLTAGE_DRS_CSR_REG16_ADDR A:&base_addr+0x9e1040
y.create.l HWIO_RPMH_VRM_VOLTAGE_DRS_CSR_REG17_ADDR A:&base_addr+0x9e1140
y.create.l HWIO_RPMH_VRM_VOLTAGE_DRS_CSR_REG18_ADDR A:&base_addr+0x9e1240
y.create.l HWIO_RPMH_VRM_VOLTAGE_DRS_CSR_REG19_ADDR A:&base_addr+0x9e1340
y.create.l HWIO_RPMH_VRM_VOLTAGE_DRS_CSR_REG20_ADDR A:&base_addr+0x9e1440
y.create.l HWIO_RPMH_VRM_VOLTAGE_DRS_CSR_REG21_ADDR A:&base_addr+0x9e1540
y.create.l HWIO_RPMH_VRM_VOLTAGE_DRS_CSR_REG22_ADDR A:&base_addr+0x9e1640
y.create.l HWIO_RPMH_VRM_VOLTAGE_DRS_CSR_REG23_ADDR A:&base_addr+0x9e1740
y.create.l HWIO_RPMH_VRM_VOLTAGE_DRS_CSR_REG24_ADDR A:&base_addr+0x9e1840
y.create.l HWIO_RPMH_VRM_VOLTAGE_DRS_CSR_REG25_ADDR A:&base_addr+0x9e1940
y.create.l HWIO_RPMH_VRM_VOLTAGE_DRS_CSR_REG26_ADDR A:&base_addr+0x9e1a40
y.create.l HWIO_RPMH_VRM_VOLTAGE_DRS_CSR_REG27_ADDR A:&base_addr+0x9e1b40
y.create.l HWIO_RPMH_VRM_VOLTAGE_DRS_CSR_REG28_ADDR A:&base_addr+0x9e1c40
y.create.l HWIO_RPMH_VRM_VOLTAGE_DRS_CSR_REG29_ADDR A:&base_addr+0x9e1d40
y.create.l HWIO_RPMH_VRM_VOLTAGE_DRS_CSR_REG30_ADDR A:&base_addr+0x9e1e40
y.create.l HWIO_RPMH_VRM_VOLTAGE_DRS_CSR_REG31_ADDR A:&base_addr+0x9e1f40
y.create.l HWIO_RPMH_VRM_VOLTAGE_DRS_CSR_REG32_ADDR A:&base_addr+0x9e2040
y.create.l HWIO_RPMH_VRM_VOLTAGE_DRS_CSR_REG33_ADDR A:&base_addr+0x9e2140
y.create.l HWIO_RPMH_VRM_VOLTAGE_DRS_CSR_REG34_ADDR A:&base_addr+0x9e2240
y.create.l HWIO_RPMH_VRM_VOLTAGE_DRS_CSR_REG35_ADDR A:&base_addr+0x9e2340
y.create.l HWIO_RPMH_VRM_VOLTAGE_DRS_CSR_REG36_ADDR A:&base_addr+0x9e2440
y.create.l HWIO_RPMH_VRM_VOLTAGE_DRS_CSR_REG37_ADDR A:&base_addr+0x9e2540
y.create.l HWIO_RPMH_VRM_VOLTAGE_DRS_CSR_REG38_ADDR A:&base_addr+0x9e2640
y.create.l HWIO_RPMH_VRM_VOLTAGE_DRS_CSR_REG39_ADDR A:&base_addr+0x9e2740
y.create.l HWIO_RPMH_VRM_VOLTAGE_DRS_CSR_REG40_ADDR A:&base_addr+0x9e2840
y.create.l HWIO_RPMH_VRM_VOLTAGE_DRS_CSR_REG41_ADDR A:&base_addr+0x9e2940
y.create.l HWIO_RPMH_VRM_VOLTAGE_DRS_CSR_REG42_ADDR A:&base_addr+0x9e2a40
y.create.l HWIO_RPMH_VRM_VOLTAGE_DRS_CSR_REG43_ADDR A:&base_addr+0x9e2b40
y.create.l HWIO_RPMH_VRM_VOLTAGE_DRS_CSR_REG44_ADDR A:&base_addr+0x9e2c40
y.create.l HWIO_RPMH_VRM_VOLTAGE_DRS_CSR_REG45_ADDR A:&base_addr+0x9e2d40
y.create.l HWIO_RPMH_VRM_ENABLE_DRS_CSR_REG0_ADDR A:&base_addr+0x9e0044
y.create.l HWIO_RPMH_VRM_ENABLE_DRS_CSR_REG1_ADDR A:&base_addr+0x9e0144
y.create.l HWIO_RPMH_VRM_ENABLE_DRS_CSR_REG2_ADDR A:&base_addr+0x9e0244
y.create.l HWIO_RPMH_VRM_ENABLE_DRS_CSR_REG3_ADDR A:&base_addr+0x9e0344
y.create.l HWIO_RPMH_VRM_ENABLE_DRS_CSR_REG4_ADDR A:&base_addr+0x9e0444
y.create.l HWIO_RPMH_VRM_ENABLE_DRS_CSR_REG5_ADDR A:&base_addr+0x9e0544
y.create.l HWIO_RPMH_VRM_ENABLE_DRS_CSR_REG6_ADDR A:&base_addr+0x9e0644
y.create.l HWIO_RPMH_VRM_ENABLE_DRS_CSR_REG7_ADDR A:&base_addr+0x9e0744
y.create.l HWIO_RPMH_VRM_ENABLE_DRS_CSR_REG8_ADDR A:&base_addr+0x9e0844
y.create.l HWIO_RPMH_VRM_ENABLE_DRS_CSR_REG9_ADDR A:&base_addr+0x9e0944
y.create.l HWIO_RPMH_VRM_ENABLE_DRS_CSR_REG10_ADDR A:&base_addr+0x9e0a44
y.create.l HWIO_RPMH_VRM_ENABLE_DRS_CSR_REG11_ADDR A:&base_addr+0x9e0b44
y.create.l HWIO_RPMH_VRM_ENABLE_DRS_CSR_REG12_ADDR A:&base_addr+0x9e0c44
y.create.l HWIO_RPMH_VRM_ENABLE_DRS_CSR_REG13_ADDR A:&base_addr+0x9e0d44
y.create.l HWIO_RPMH_VRM_ENABLE_DRS_CSR_REG14_ADDR A:&base_addr+0x9e0e44
y.create.l HWIO_RPMH_VRM_ENABLE_DRS_CSR_REG15_ADDR A:&base_addr+0x9e0f44
y.create.l HWIO_RPMH_VRM_ENABLE_DRS_CSR_REG16_ADDR A:&base_addr+0x9e1044
y.create.l HWIO_RPMH_VRM_ENABLE_DRS_CSR_REG17_ADDR A:&base_addr+0x9e1144
y.create.l HWIO_RPMH_VRM_ENABLE_DRS_CSR_REG18_ADDR A:&base_addr+0x9e1244
y.create.l HWIO_RPMH_VRM_ENABLE_DRS_CSR_REG19_ADDR A:&base_addr+0x9e1344
y.create.l HWIO_RPMH_VRM_ENABLE_DRS_CSR_REG20_ADDR A:&base_addr+0x9e1444
y.create.l HWIO_RPMH_VRM_ENABLE_DRS_CSR_REG21_ADDR A:&base_addr+0x9e1544
y.create.l HWIO_RPMH_VRM_ENABLE_DRS_CSR_REG22_ADDR A:&base_addr+0x9e1644
y.create.l HWIO_RPMH_VRM_ENABLE_DRS_CSR_REG23_ADDR A:&base_addr+0x9e1744
y.create.l HWIO_RPMH_VRM_ENABLE_DRS_CSR_REG24_ADDR A:&base_addr+0x9e1844
y.create.l HWIO_RPMH_VRM_ENABLE_DRS_CSR_REG25_ADDR A:&base_addr+0x9e1944
y.create.l HWIO_RPMH_VRM_ENABLE_DRS_CSR_REG26_ADDR A:&base_addr+0x9e1a44
y.create.l HWIO_RPMH_VRM_ENABLE_DRS_CSR_REG27_ADDR A:&base_addr+0x9e1b44
y.create.l HWIO_RPMH_VRM_ENABLE_DRS_CSR_REG28_ADDR A:&base_addr+0x9e1c44
y.create.l HWIO_RPMH_VRM_ENABLE_DRS_CSR_REG29_ADDR A:&base_addr+0x9e1d44
y.create.l HWIO_RPMH_VRM_ENABLE_DRS_CSR_REG30_ADDR A:&base_addr+0x9e1e44
y.create.l HWIO_RPMH_VRM_ENABLE_DRS_CSR_REG31_ADDR A:&base_addr+0x9e1f44
y.create.l HWIO_RPMH_VRM_ENABLE_DRS_CSR_REG32_ADDR A:&base_addr+0x9e2044
y.create.l HWIO_RPMH_VRM_ENABLE_DRS_CSR_REG33_ADDR A:&base_addr+0x9e2144
y.create.l HWIO_RPMH_VRM_ENABLE_DRS_CSR_REG34_ADDR A:&base_addr+0x9e2244
y.create.l HWIO_RPMH_VRM_ENABLE_DRS_CSR_REG35_ADDR A:&base_addr+0x9e2344
y.create.l HWIO_RPMH_VRM_ENABLE_DRS_CSR_REG36_ADDR A:&base_addr+0x9e2444
y.create.l HWIO_RPMH_VRM_ENABLE_DRS_CSR_REG37_ADDR A:&base_addr+0x9e2544
y.create.l HWIO_RPMH_VRM_ENABLE_DRS_CSR_REG38_ADDR A:&base_addr+0x9e2644
y.create.l HWIO_RPMH_VRM_ENABLE_DRS_CSR_REG39_ADDR A:&base_addr+0x9e2744
y.create.l HWIO_RPMH_VRM_ENABLE_DRS_CSR_REG40_ADDR A:&base_addr+0x9e2844
y.create.l HWIO_RPMH_VRM_ENABLE_DRS_CSR_REG41_ADDR A:&base_addr+0x9e2944
y.create.l HWIO_RPMH_VRM_ENABLE_DRS_CSR_REG42_ADDR A:&base_addr+0x9e2a44
y.create.l HWIO_RPMH_VRM_ENABLE_DRS_CSR_REG43_ADDR A:&base_addr+0x9e2b44
y.create.l HWIO_RPMH_VRM_ENABLE_DRS_CSR_REG44_ADDR A:&base_addr+0x9e2c44
y.create.l HWIO_RPMH_VRM_ENABLE_DRS_CSR_REG45_ADDR A:&base_addr+0x9e2d44
y.create.l HWIO_RPMH_VRM_MODE_DRS_CSR_REG0_ADDR A:&base_addr+0x9e0048
y.create.l HWIO_RPMH_VRM_MODE_DRS_CSR_REG1_ADDR A:&base_addr+0x9e0148
y.create.l HWIO_RPMH_VRM_MODE_DRS_CSR_REG2_ADDR A:&base_addr+0x9e0248
y.create.l HWIO_RPMH_VRM_MODE_DRS_CSR_REG3_ADDR A:&base_addr+0x9e0348
y.create.l HWIO_RPMH_VRM_MODE_DRS_CSR_REG4_ADDR A:&base_addr+0x9e0448
y.create.l HWIO_RPMH_VRM_MODE_DRS_CSR_REG5_ADDR A:&base_addr+0x9e0548
y.create.l HWIO_RPMH_VRM_MODE_DRS_CSR_REG6_ADDR A:&base_addr+0x9e0648
y.create.l HWIO_RPMH_VRM_MODE_DRS_CSR_REG7_ADDR A:&base_addr+0x9e0748
y.create.l HWIO_RPMH_VRM_MODE_DRS_CSR_REG8_ADDR A:&base_addr+0x9e0848
y.create.l HWIO_RPMH_VRM_MODE_DRS_CSR_REG9_ADDR A:&base_addr+0x9e0948
y.create.l HWIO_RPMH_VRM_MODE_DRS_CSR_REG10_ADDR A:&base_addr+0x9e0a48
y.create.l HWIO_RPMH_VRM_MODE_DRS_CSR_REG11_ADDR A:&base_addr+0x9e0b48
y.create.l HWIO_RPMH_VRM_MODE_DRS_CSR_REG12_ADDR A:&base_addr+0x9e0c48
y.create.l HWIO_RPMH_VRM_MODE_DRS_CSR_REG13_ADDR A:&base_addr+0x9e0d48
y.create.l HWIO_RPMH_VRM_MODE_DRS_CSR_REG14_ADDR A:&base_addr+0x9e0e48
y.create.l HWIO_RPMH_VRM_MODE_DRS_CSR_REG15_ADDR A:&base_addr+0x9e0f48
y.create.l HWIO_RPMH_VRM_MODE_DRS_CSR_REG16_ADDR A:&base_addr+0x9e1048
y.create.l HWIO_RPMH_VRM_MODE_DRS_CSR_REG17_ADDR A:&base_addr+0x9e1148
y.create.l HWIO_RPMH_VRM_MODE_DRS_CSR_REG18_ADDR A:&base_addr+0x9e1248
y.create.l HWIO_RPMH_VRM_MODE_DRS_CSR_REG19_ADDR A:&base_addr+0x9e1348
y.create.l HWIO_RPMH_VRM_MODE_DRS_CSR_REG20_ADDR A:&base_addr+0x9e1448
y.create.l HWIO_RPMH_VRM_MODE_DRS_CSR_REG21_ADDR A:&base_addr+0x9e1548
y.create.l HWIO_RPMH_VRM_MODE_DRS_CSR_REG22_ADDR A:&base_addr+0x9e1648
y.create.l HWIO_RPMH_VRM_MODE_DRS_CSR_REG23_ADDR A:&base_addr+0x9e1748
y.create.l HWIO_RPMH_VRM_MODE_DRS_CSR_REG24_ADDR A:&base_addr+0x9e1848
y.create.l HWIO_RPMH_VRM_MODE_DRS_CSR_REG25_ADDR A:&base_addr+0x9e1948
y.create.l HWIO_RPMH_VRM_MODE_DRS_CSR_REG26_ADDR A:&base_addr+0x9e1a48
y.create.l HWIO_RPMH_VRM_MODE_DRS_CSR_REG27_ADDR A:&base_addr+0x9e1b48
y.create.l HWIO_RPMH_VRM_MODE_DRS_CSR_REG28_ADDR A:&base_addr+0x9e1c48
y.create.l HWIO_RPMH_VRM_MODE_DRS_CSR_REG29_ADDR A:&base_addr+0x9e1d48
y.create.l HWIO_RPMH_VRM_MODE_DRS_CSR_REG30_ADDR A:&base_addr+0x9e1e48
y.create.l HWIO_RPMH_VRM_MODE_DRS_CSR_REG31_ADDR A:&base_addr+0x9e1f48
y.create.l HWIO_RPMH_VRM_MODE_DRS_CSR_REG32_ADDR A:&base_addr+0x9e2048
y.create.l HWIO_RPMH_VRM_MODE_DRS_CSR_REG33_ADDR A:&base_addr+0x9e2148
y.create.l HWIO_RPMH_VRM_MODE_DRS_CSR_REG34_ADDR A:&base_addr+0x9e2248
y.create.l HWIO_RPMH_VRM_MODE_DRS_CSR_REG35_ADDR A:&base_addr+0x9e2348
y.create.l HWIO_RPMH_VRM_MODE_DRS_CSR_REG36_ADDR A:&base_addr+0x9e2448
y.create.l HWIO_RPMH_VRM_MODE_DRS_CSR_REG37_ADDR A:&base_addr+0x9e2548
y.create.l HWIO_RPMH_VRM_MODE_DRS_CSR_REG38_ADDR A:&base_addr+0x9e2648
y.create.l HWIO_RPMH_VRM_MODE_DRS_CSR_REG39_ADDR A:&base_addr+0x9e2748
y.create.l HWIO_RPMH_VRM_MODE_DRS_CSR_REG40_ADDR A:&base_addr+0x9e2848
y.create.l HWIO_RPMH_VRM_MODE_DRS_CSR_REG41_ADDR A:&base_addr+0x9e2948
y.create.l HWIO_RPMH_VRM_MODE_DRS_CSR_REG42_ADDR A:&base_addr+0x9e2a48
y.create.l HWIO_RPMH_VRM_MODE_DRS_CSR_REG43_ADDR A:&base_addr+0x9e2b48
y.create.l HWIO_RPMH_VRM_MODE_DRS_CSR_REG44_ADDR A:&base_addr+0x9e2c48
y.create.l HWIO_RPMH_VRM_MODE_DRS_CSR_REG45_ADDR A:&base_addr+0x9e2d48
y.create.l HWIO_RPMH_VRM_HEADROOM_DRS_CSR_REG0_ADDR A:&base_addr+0x9e004c
y.create.l HWIO_RPMH_VRM_HEADROOM_DRS_CSR_REG1_ADDR A:&base_addr+0x9e014c
y.create.l HWIO_RPMH_VRM_HEADROOM_DRS_CSR_REG2_ADDR A:&base_addr+0x9e024c
y.create.l HWIO_RPMH_VRM_HEADROOM_DRS_CSR_REG3_ADDR A:&base_addr+0x9e034c
y.create.l HWIO_RPMH_VRM_HEADROOM_DRS_CSR_REG4_ADDR A:&base_addr+0x9e044c
y.create.l HWIO_RPMH_VRM_HEADROOM_DRS_CSR_REG5_ADDR A:&base_addr+0x9e054c
y.create.l HWIO_RPMH_VRM_HEADROOM_DRS_CSR_REG6_ADDR A:&base_addr+0x9e064c
y.create.l HWIO_RPMH_VRM_HEADROOM_DRS_CSR_REG7_ADDR A:&base_addr+0x9e074c
y.create.l HWIO_RPMH_VRM_HEADROOM_DRS_CSR_REG8_ADDR A:&base_addr+0x9e084c
y.create.l HWIO_RPMH_VRM_HEADROOM_DRS_CSR_REG9_ADDR A:&base_addr+0x9e094c
y.create.l HWIO_RPMH_VRM_HEADROOM_DRS_CSR_REG10_ADDR A:&base_addr+0x9e0a4c
y.create.l HWIO_RPMH_VRM_HEADROOM_DRS_CSR_REG11_ADDR A:&base_addr+0x9e0b4c
y.create.l HWIO_RPMH_VRM_HEADROOM_DRS_CSR_REG12_ADDR A:&base_addr+0x9e0c4c
y.create.l HWIO_RPMH_VRM_HEADROOM_DRS_CSR_REG13_ADDR A:&base_addr+0x9e0d4c
y.create.l HWIO_RPMH_VRM_HEADROOM_DRS_CSR_REG14_ADDR A:&base_addr+0x9e0e4c
y.create.l HWIO_RPMH_VRM_HEADROOM_DRS_CSR_REG15_ADDR A:&base_addr+0x9e0f4c
y.create.l HWIO_RPMH_VRM_HEADROOM_DRS_CSR_REG16_ADDR A:&base_addr+0x9e104c
y.create.l HWIO_RPMH_VRM_HEADROOM_DRS_CSR_REG17_ADDR A:&base_addr+0x9e114c
y.create.l HWIO_RPMH_VRM_HEADROOM_DRS_CSR_REG18_ADDR A:&base_addr+0x9e124c
y.create.l HWIO_RPMH_VRM_HEADROOM_DRS_CSR_REG19_ADDR A:&base_addr+0x9e134c
y.create.l HWIO_RPMH_VRM_HEADROOM_DRS_CSR_REG20_ADDR A:&base_addr+0x9e144c
y.create.l HWIO_RPMH_VRM_HEADROOM_DRS_CSR_REG21_ADDR A:&base_addr+0x9e154c
y.create.l HWIO_RPMH_VRM_HEADROOM_DRS_CSR_REG22_ADDR A:&base_addr+0x9e164c
y.create.l HWIO_RPMH_VRM_HEADROOM_DRS_CSR_REG23_ADDR A:&base_addr+0x9e174c
y.create.l HWIO_RPMH_VRM_HEADROOM_DRS_CSR_REG24_ADDR A:&base_addr+0x9e184c
y.create.l HWIO_RPMH_VRM_HEADROOM_DRS_CSR_REG25_ADDR A:&base_addr+0x9e194c
y.create.l HWIO_RPMH_VRM_HEADROOM_DRS_CSR_REG26_ADDR A:&base_addr+0x9e1a4c
y.create.l HWIO_RPMH_VRM_HEADROOM_DRS_CSR_REG27_ADDR A:&base_addr+0x9e1b4c
y.create.l HWIO_RPMH_VRM_HEADROOM_DRS_CSR_REG28_ADDR A:&base_addr+0x9e1c4c
y.create.l HWIO_RPMH_VRM_HEADROOM_DRS_CSR_REG29_ADDR A:&base_addr+0x9e1d4c
y.create.l HWIO_RPMH_VRM_HEADROOM_DRS_CSR_REG30_ADDR A:&base_addr+0x9e1e4c
y.create.l HWIO_RPMH_VRM_HEADROOM_DRS_CSR_REG31_ADDR A:&base_addr+0x9e1f4c
y.create.l HWIO_RPMH_VRM_HEADROOM_DRS_CSR_REG32_ADDR A:&base_addr+0x9e204c
y.create.l HWIO_RPMH_VRM_HEADROOM_DRS_CSR_REG33_ADDR A:&base_addr+0x9e214c
y.create.l HWIO_RPMH_VRM_HEADROOM_DRS_CSR_REG34_ADDR A:&base_addr+0x9e224c
y.create.l HWIO_RPMH_VRM_HEADROOM_DRS_CSR_REG35_ADDR A:&base_addr+0x9e234c
y.create.l HWIO_RPMH_VRM_HEADROOM_DRS_CSR_REG36_ADDR A:&base_addr+0x9e244c
y.create.l HWIO_RPMH_VRM_HEADROOM_DRS_CSR_REG37_ADDR A:&base_addr+0x9e254c
y.create.l HWIO_RPMH_VRM_HEADROOM_DRS_CSR_REG38_ADDR A:&base_addr+0x9e264c
y.create.l HWIO_RPMH_VRM_HEADROOM_DRS_CSR_REG39_ADDR A:&base_addr+0x9e274c
y.create.l HWIO_RPMH_VRM_HEADROOM_DRS_CSR_REG40_ADDR A:&base_addr+0x9e284c
y.create.l HWIO_RPMH_VRM_HEADROOM_DRS_CSR_REG41_ADDR A:&base_addr+0x9e294c
y.create.l HWIO_RPMH_VRM_HEADROOM_DRS_CSR_REG42_ADDR A:&base_addr+0x9e2a4c
y.create.l HWIO_RPMH_VRM_HEADROOM_DRS_CSR_REG43_ADDR A:&base_addr+0x9e2b4c
y.create.l HWIO_RPMH_VRM_HEADROOM_DRS_CSR_REG44_ADDR A:&base_addr+0x9e2c4c
y.create.l HWIO_RPMH_VRM_HEADROOM_DRS_CSR_REG45_ADDR A:&base_addr+0x9e2d4c
y.create.l HWIO_RPMH_VRM_ENABLE_DRS_CSR_XOB0_ADDR A:&base_addr+0x9ec044
y.create.l HWIO_RPMH_VRM_ENABLE_DRS_CSR_XOB1_ADDR A:&base_addr+0x9ec144
y.create.l HWIO_RPMH_VRM_ENABLE_DRS_CSR_XOB2_ADDR A:&base_addr+0x9ec244
y.create.l HWIO_RPMH_VRM_ENABLE_DRS_CSR_XOB3_ADDR A:&base_addr+0x9ec344
y.create.l HWIO_RPMH_VRM_ENABLE_DRS_CSR_XOB4_ADDR A:&base_addr+0x9ec444
y.create.l HWIO_RPMH_VRM_ENABLE_DRS_CSR_XOB5_ADDR A:&base_addr+0x9ec544
y.create.l HWIO_RPMH_VRM_ENABLE_DRS_CSR_XOB6_ADDR A:&base_addr+0x9ec644
y.create.l HWIO_RPMH_VRM_ENABLE_DRS_CSR_XOB7_ADDR A:&base_addr+0x9ec744
y.create.l HWIO_RPMH_VRM_ENABLE_DRS_CSR_XO0_ADDR A:&base_addr+0x9ed844
y.create.l HWIO_RPMH_VRM_VOLTAGE_ARS_CSR_REG0_ADDR A:&base_addr+0x9e0060
y.create.l HWIO_RPMH_VRM_VOLTAGE_ARS_CSR_REG1_ADDR A:&base_addr+0x9e0160
y.create.l HWIO_RPMH_VRM_VOLTAGE_ARS_CSR_REG2_ADDR A:&base_addr+0x9e0260
y.create.l HWIO_RPMH_VRM_VOLTAGE_ARS_CSR_REG3_ADDR A:&base_addr+0x9e0360
y.create.l HWIO_RPMH_VRM_VOLTAGE_ARS_CSR_REG4_ADDR A:&base_addr+0x9e0460
y.create.l HWIO_RPMH_VRM_VOLTAGE_ARS_CSR_REG5_ADDR A:&base_addr+0x9e0560
y.create.l HWIO_RPMH_VRM_VOLTAGE_ARS_CSR_REG6_ADDR A:&base_addr+0x9e0660
y.create.l HWIO_RPMH_VRM_VOLTAGE_ARS_CSR_REG7_ADDR A:&base_addr+0x9e0760
y.create.l HWIO_RPMH_VRM_VOLTAGE_ARS_CSR_REG8_ADDR A:&base_addr+0x9e0860
y.create.l HWIO_RPMH_VRM_VOLTAGE_ARS_CSR_REG9_ADDR A:&base_addr+0x9e0960
y.create.l HWIO_RPMH_VRM_VOLTAGE_ARS_CSR_REG10_ADDR A:&base_addr+0x9e0a60
y.create.l HWIO_RPMH_VRM_VOLTAGE_ARS_CSR_REG11_ADDR A:&base_addr+0x9e0b60
y.create.l HWIO_RPMH_VRM_VOLTAGE_ARS_CSR_REG12_ADDR A:&base_addr+0x9e0c60
y.create.l HWIO_RPMH_VRM_VOLTAGE_ARS_CSR_REG13_ADDR A:&base_addr+0x9e0d60
y.create.l HWIO_RPMH_VRM_VOLTAGE_ARS_CSR_REG14_ADDR A:&base_addr+0x9e0e60
y.create.l HWIO_RPMH_VRM_VOLTAGE_ARS_CSR_REG15_ADDR A:&base_addr+0x9e0f60
y.create.l HWIO_RPMH_VRM_VOLTAGE_ARS_CSR_REG16_ADDR A:&base_addr+0x9e1060
y.create.l HWIO_RPMH_VRM_VOLTAGE_ARS_CSR_REG17_ADDR A:&base_addr+0x9e1160
y.create.l HWIO_RPMH_VRM_VOLTAGE_ARS_CSR_REG18_ADDR A:&base_addr+0x9e1260
y.create.l HWIO_RPMH_VRM_VOLTAGE_ARS_CSR_REG19_ADDR A:&base_addr+0x9e1360
y.create.l HWIO_RPMH_VRM_VOLTAGE_ARS_CSR_REG20_ADDR A:&base_addr+0x9e1460
y.create.l HWIO_RPMH_VRM_VOLTAGE_ARS_CSR_REG21_ADDR A:&base_addr+0x9e1560
y.create.l HWIO_RPMH_VRM_VOLTAGE_ARS_CSR_REG22_ADDR A:&base_addr+0x9e1660
y.create.l HWIO_RPMH_VRM_VOLTAGE_ARS_CSR_REG23_ADDR A:&base_addr+0x9e1760
y.create.l HWIO_RPMH_VRM_VOLTAGE_ARS_CSR_REG24_ADDR A:&base_addr+0x9e1860
y.create.l HWIO_RPMH_VRM_VOLTAGE_ARS_CSR_REG25_ADDR A:&base_addr+0x9e1960
y.create.l HWIO_RPMH_VRM_VOLTAGE_ARS_CSR_REG26_ADDR A:&base_addr+0x9e1a60
y.create.l HWIO_RPMH_VRM_VOLTAGE_ARS_CSR_REG27_ADDR A:&base_addr+0x9e1b60
y.create.l HWIO_RPMH_VRM_VOLTAGE_ARS_CSR_REG28_ADDR A:&base_addr+0x9e1c60
y.create.l HWIO_RPMH_VRM_VOLTAGE_ARS_CSR_REG29_ADDR A:&base_addr+0x9e1d60
y.create.l HWIO_RPMH_VRM_VOLTAGE_ARS_CSR_REG30_ADDR A:&base_addr+0x9e1e60
y.create.l HWIO_RPMH_VRM_VOLTAGE_ARS_CSR_REG31_ADDR A:&base_addr+0x9e1f60
y.create.l HWIO_RPMH_VRM_VOLTAGE_ARS_CSR_REG32_ADDR A:&base_addr+0x9e2060
y.create.l HWIO_RPMH_VRM_VOLTAGE_ARS_CSR_REG33_ADDR A:&base_addr+0x9e2160
y.create.l HWIO_RPMH_VRM_VOLTAGE_ARS_CSR_REG34_ADDR A:&base_addr+0x9e2260
y.create.l HWIO_RPMH_VRM_VOLTAGE_ARS_CSR_REG35_ADDR A:&base_addr+0x9e2360
y.create.l HWIO_RPMH_VRM_VOLTAGE_ARS_CSR_REG36_ADDR A:&base_addr+0x9e2460
y.create.l HWIO_RPMH_VRM_VOLTAGE_ARS_CSR_REG37_ADDR A:&base_addr+0x9e2560
y.create.l HWIO_RPMH_VRM_VOLTAGE_ARS_CSR_REG38_ADDR A:&base_addr+0x9e2660
y.create.l HWIO_RPMH_VRM_VOLTAGE_ARS_CSR_REG39_ADDR A:&base_addr+0x9e2760
y.create.l HWIO_RPMH_VRM_VOLTAGE_ARS_CSR_REG40_ADDR A:&base_addr+0x9e2860
y.create.l HWIO_RPMH_VRM_VOLTAGE_ARS_CSR_REG41_ADDR A:&base_addr+0x9e2960
y.create.l HWIO_RPMH_VRM_VOLTAGE_ARS_CSR_REG42_ADDR A:&base_addr+0x9e2a60
y.create.l HWIO_RPMH_VRM_VOLTAGE_ARS_CSR_REG43_ADDR A:&base_addr+0x9e2b60
y.create.l HWIO_RPMH_VRM_VOLTAGE_ARS_CSR_REG44_ADDR A:&base_addr+0x9e2c60
y.create.l HWIO_RPMH_VRM_VOLTAGE_ARS_CSR_REG45_ADDR A:&base_addr+0x9e2d60
y.create.l HWIO_RPMH_VRM_ENABLE_ARS_CSR_REG0_ADDR A:&base_addr+0x9e0064
y.create.l HWIO_RPMH_VRM_ENABLE_ARS_CSR_REG1_ADDR A:&base_addr+0x9e0164
y.create.l HWIO_RPMH_VRM_ENABLE_ARS_CSR_REG2_ADDR A:&base_addr+0x9e0264
y.create.l HWIO_RPMH_VRM_ENABLE_ARS_CSR_REG3_ADDR A:&base_addr+0x9e0364
y.create.l HWIO_RPMH_VRM_ENABLE_ARS_CSR_REG4_ADDR A:&base_addr+0x9e0464
y.create.l HWIO_RPMH_VRM_ENABLE_ARS_CSR_REG5_ADDR A:&base_addr+0x9e0564
y.create.l HWIO_RPMH_VRM_ENABLE_ARS_CSR_REG6_ADDR A:&base_addr+0x9e0664
y.create.l HWIO_RPMH_VRM_ENABLE_ARS_CSR_REG7_ADDR A:&base_addr+0x9e0764
y.create.l HWIO_RPMH_VRM_ENABLE_ARS_CSR_REG8_ADDR A:&base_addr+0x9e0864
y.create.l HWIO_RPMH_VRM_ENABLE_ARS_CSR_REG9_ADDR A:&base_addr+0x9e0964
y.create.l HWIO_RPMH_VRM_ENABLE_ARS_CSR_REG10_ADDR A:&base_addr+0x9e0a64
y.create.l HWIO_RPMH_VRM_ENABLE_ARS_CSR_REG11_ADDR A:&base_addr+0x9e0b64
y.create.l HWIO_RPMH_VRM_ENABLE_ARS_CSR_REG12_ADDR A:&base_addr+0x9e0c64
y.create.l HWIO_RPMH_VRM_ENABLE_ARS_CSR_REG13_ADDR A:&base_addr+0x9e0d64
y.create.l HWIO_RPMH_VRM_ENABLE_ARS_CSR_REG14_ADDR A:&base_addr+0x9e0e64
y.create.l HWIO_RPMH_VRM_ENABLE_ARS_CSR_REG15_ADDR A:&base_addr+0x9e0f64
y.create.l HWIO_RPMH_VRM_ENABLE_ARS_CSR_REG16_ADDR A:&base_addr+0x9e1064
y.create.l HWIO_RPMH_VRM_ENABLE_ARS_CSR_REG17_ADDR A:&base_addr+0x9e1164
y.create.l HWIO_RPMH_VRM_ENABLE_ARS_CSR_REG18_ADDR A:&base_addr+0x9e1264
y.create.l HWIO_RPMH_VRM_ENABLE_ARS_CSR_REG19_ADDR A:&base_addr+0x9e1364
y.create.l HWIO_RPMH_VRM_ENABLE_ARS_CSR_REG20_ADDR A:&base_addr+0x9e1464
y.create.l HWIO_RPMH_VRM_ENABLE_ARS_CSR_REG21_ADDR A:&base_addr+0x9e1564
y.create.l HWIO_RPMH_VRM_ENABLE_ARS_CSR_REG22_ADDR A:&base_addr+0x9e1664
y.create.l HWIO_RPMH_VRM_ENABLE_ARS_CSR_REG23_ADDR A:&base_addr+0x9e1764
y.create.l HWIO_RPMH_VRM_ENABLE_ARS_CSR_REG24_ADDR A:&base_addr+0x9e1864
y.create.l HWIO_RPMH_VRM_ENABLE_ARS_CSR_REG25_ADDR A:&base_addr+0x9e1964
y.create.l HWIO_RPMH_VRM_ENABLE_ARS_CSR_REG26_ADDR A:&base_addr+0x9e1a64
y.create.l HWIO_RPMH_VRM_ENABLE_ARS_CSR_REG27_ADDR A:&base_addr+0x9e1b64
y.create.l HWIO_RPMH_VRM_ENABLE_ARS_CSR_REG28_ADDR A:&base_addr+0x9e1c64
y.create.l HWIO_RPMH_VRM_ENABLE_ARS_CSR_REG29_ADDR A:&base_addr+0x9e1d64
y.create.l HWIO_RPMH_VRM_ENABLE_ARS_CSR_REG30_ADDR A:&base_addr+0x9e1e64
y.create.l HWIO_RPMH_VRM_ENABLE_ARS_CSR_REG31_ADDR A:&base_addr+0x9e1f64
y.create.l HWIO_RPMH_VRM_ENABLE_ARS_CSR_REG32_ADDR A:&base_addr+0x9e2064
y.create.l HWIO_RPMH_VRM_ENABLE_ARS_CSR_REG33_ADDR A:&base_addr+0x9e2164
y.create.l HWIO_RPMH_VRM_ENABLE_ARS_CSR_REG34_ADDR A:&base_addr+0x9e2264
y.create.l HWIO_RPMH_VRM_ENABLE_ARS_CSR_REG35_ADDR A:&base_addr+0x9e2364
y.create.l HWIO_RPMH_VRM_ENABLE_ARS_CSR_REG36_ADDR A:&base_addr+0x9e2464
y.create.l HWIO_RPMH_VRM_ENABLE_ARS_CSR_REG37_ADDR A:&base_addr+0x9e2564
y.create.l HWIO_RPMH_VRM_ENABLE_ARS_CSR_REG38_ADDR A:&base_addr+0x9e2664
y.create.l HWIO_RPMH_VRM_ENABLE_ARS_CSR_REG39_ADDR A:&base_addr+0x9e2764
y.create.l HWIO_RPMH_VRM_ENABLE_ARS_CSR_REG40_ADDR A:&base_addr+0x9e2864
y.create.l HWIO_RPMH_VRM_ENABLE_ARS_CSR_REG41_ADDR A:&base_addr+0x9e2964
y.create.l HWIO_RPMH_VRM_ENABLE_ARS_CSR_REG42_ADDR A:&base_addr+0x9e2a64
y.create.l HWIO_RPMH_VRM_ENABLE_ARS_CSR_REG43_ADDR A:&base_addr+0x9e2b64
y.create.l HWIO_RPMH_VRM_ENABLE_ARS_CSR_REG44_ADDR A:&base_addr+0x9e2c64
y.create.l HWIO_RPMH_VRM_ENABLE_ARS_CSR_REG45_ADDR A:&base_addr+0x9e2d64
y.create.l HWIO_RPMH_VRM_MODE_ARS_CSR_REG0_ADDR A:&base_addr+0x9e0068
y.create.l HWIO_RPMH_VRM_MODE_ARS_CSR_REG1_ADDR A:&base_addr+0x9e0168
y.create.l HWIO_RPMH_VRM_MODE_ARS_CSR_REG2_ADDR A:&base_addr+0x9e0268
y.create.l HWIO_RPMH_VRM_MODE_ARS_CSR_REG3_ADDR A:&base_addr+0x9e0368
y.create.l HWIO_RPMH_VRM_MODE_ARS_CSR_REG4_ADDR A:&base_addr+0x9e0468
y.create.l HWIO_RPMH_VRM_MODE_ARS_CSR_REG5_ADDR A:&base_addr+0x9e0568
y.create.l HWIO_RPMH_VRM_MODE_ARS_CSR_REG6_ADDR A:&base_addr+0x9e0668
y.create.l HWIO_RPMH_VRM_MODE_ARS_CSR_REG7_ADDR A:&base_addr+0x9e0768
y.create.l HWIO_RPMH_VRM_MODE_ARS_CSR_REG8_ADDR A:&base_addr+0x9e0868
y.create.l HWIO_RPMH_VRM_MODE_ARS_CSR_REG9_ADDR A:&base_addr+0x9e0968
y.create.l HWIO_RPMH_VRM_MODE_ARS_CSR_REG10_ADDR A:&base_addr+0x9e0a68
y.create.l HWIO_RPMH_VRM_MODE_ARS_CSR_REG11_ADDR A:&base_addr+0x9e0b68
y.create.l HWIO_RPMH_VRM_MODE_ARS_CSR_REG12_ADDR A:&base_addr+0x9e0c68
y.create.l HWIO_RPMH_VRM_MODE_ARS_CSR_REG13_ADDR A:&base_addr+0x9e0d68
y.create.l HWIO_RPMH_VRM_MODE_ARS_CSR_REG14_ADDR A:&base_addr+0x9e0e68
y.create.l HWIO_RPMH_VRM_MODE_ARS_CSR_REG15_ADDR A:&base_addr+0x9e0f68
y.create.l HWIO_RPMH_VRM_MODE_ARS_CSR_REG16_ADDR A:&base_addr+0x9e1068
y.create.l HWIO_RPMH_VRM_MODE_ARS_CSR_REG17_ADDR A:&base_addr+0x9e1168
y.create.l HWIO_RPMH_VRM_MODE_ARS_CSR_REG18_ADDR A:&base_addr+0x9e1268
y.create.l HWIO_RPMH_VRM_MODE_ARS_CSR_REG19_ADDR A:&base_addr+0x9e1368
y.create.l HWIO_RPMH_VRM_MODE_ARS_CSR_REG20_ADDR A:&base_addr+0x9e1468
y.create.l HWIO_RPMH_VRM_MODE_ARS_CSR_REG21_ADDR A:&base_addr+0x9e1568
y.create.l HWIO_RPMH_VRM_MODE_ARS_CSR_REG22_ADDR A:&base_addr+0x9e1668
y.create.l HWIO_RPMH_VRM_MODE_ARS_CSR_REG23_ADDR A:&base_addr+0x9e1768
y.create.l HWIO_RPMH_VRM_MODE_ARS_CSR_REG24_ADDR A:&base_addr+0x9e1868
y.create.l HWIO_RPMH_VRM_MODE_ARS_CSR_REG25_ADDR A:&base_addr+0x9e1968
y.create.l HWIO_RPMH_VRM_MODE_ARS_CSR_REG26_ADDR A:&base_addr+0x9e1a68
y.create.l HWIO_RPMH_VRM_MODE_ARS_CSR_REG27_ADDR A:&base_addr+0x9e1b68
y.create.l HWIO_RPMH_VRM_MODE_ARS_CSR_REG28_ADDR A:&base_addr+0x9e1c68
y.create.l HWIO_RPMH_VRM_MODE_ARS_CSR_REG29_ADDR A:&base_addr+0x9e1d68
y.create.l HWIO_RPMH_VRM_MODE_ARS_CSR_REG30_ADDR A:&base_addr+0x9e1e68
y.create.l HWIO_RPMH_VRM_MODE_ARS_CSR_REG31_ADDR A:&base_addr+0x9e1f68
y.create.l HWIO_RPMH_VRM_MODE_ARS_CSR_REG32_ADDR A:&base_addr+0x9e2068
y.create.l HWIO_RPMH_VRM_MODE_ARS_CSR_REG33_ADDR A:&base_addr+0x9e2168
y.create.l HWIO_RPMH_VRM_MODE_ARS_CSR_REG34_ADDR A:&base_addr+0x9e2268
y.create.l HWIO_RPMH_VRM_MODE_ARS_CSR_REG35_ADDR A:&base_addr+0x9e2368
y.create.l HWIO_RPMH_VRM_MODE_ARS_CSR_REG36_ADDR A:&base_addr+0x9e2468
y.create.l HWIO_RPMH_VRM_MODE_ARS_CSR_REG37_ADDR A:&base_addr+0x9e2568
y.create.l HWIO_RPMH_VRM_MODE_ARS_CSR_REG38_ADDR A:&base_addr+0x9e2668
y.create.l HWIO_RPMH_VRM_MODE_ARS_CSR_REG39_ADDR A:&base_addr+0x9e2768
y.create.l HWIO_RPMH_VRM_MODE_ARS_CSR_REG40_ADDR A:&base_addr+0x9e2868
y.create.l HWIO_RPMH_VRM_MODE_ARS_CSR_REG41_ADDR A:&base_addr+0x9e2968
y.create.l HWIO_RPMH_VRM_MODE_ARS_CSR_REG42_ADDR A:&base_addr+0x9e2a68
y.create.l HWIO_RPMH_VRM_MODE_ARS_CSR_REG43_ADDR A:&base_addr+0x9e2b68
y.create.l HWIO_RPMH_VRM_MODE_ARS_CSR_REG44_ADDR A:&base_addr+0x9e2c68
y.create.l HWIO_RPMH_VRM_MODE_ARS_CSR_REG45_ADDR A:&base_addr+0x9e2d68
y.create.l HWIO_RPMH_VRM_HEADROOM_ARS_CSR_REG0_ADDR A:&base_addr+0x9e006c
y.create.l HWIO_RPMH_VRM_HEADROOM_ARS_CSR_REG1_ADDR A:&base_addr+0x9e016c
y.create.l HWIO_RPMH_VRM_HEADROOM_ARS_CSR_REG2_ADDR A:&base_addr+0x9e026c
y.create.l HWIO_RPMH_VRM_HEADROOM_ARS_CSR_REG3_ADDR A:&base_addr+0x9e036c
y.create.l HWIO_RPMH_VRM_HEADROOM_ARS_CSR_REG4_ADDR A:&base_addr+0x9e046c
y.create.l HWIO_RPMH_VRM_HEADROOM_ARS_CSR_REG5_ADDR A:&base_addr+0x9e056c
y.create.l HWIO_RPMH_VRM_HEADROOM_ARS_CSR_REG6_ADDR A:&base_addr+0x9e066c
y.create.l HWIO_RPMH_VRM_HEADROOM_ARS_CSR_REG7_ADDR A:&base_addr+0x9e076c
y.create.l HWIO_RPMH_VRM_HEADROOM_ARS_CSR_REG8_ADDR A:&base_addr+0x9e086c
y.create.l HWIO_RPMH_VRM_HEADROOM_ARS_CSR_REG9_ADDR A:&base_addr+0x9e096c
y.create.l HWIO_RPMH_VRM_HEADROOM_ARS_CSR_REG10_ADDR A:&base_addr+0x9e0a6c
y.create.l HWIO_RPMH_VRM_HEADROOM_ARS_CSR_REG11_ADDR A:&base_addr+0x9e0b6c
y.create.l HWIO_RPMH_VRM_HEADROOM_ARS_CSR_REG12_ADDR A:&base_addr+0x9e0c6c
y.create.l HWIO_RPMH_VRM_HEADROOM_ARS_CSR_REG13_ADDR A:&base_addr+0x9e0d6c
y.create.l HWIO_RPMH_VRM_HEADROOM_ARS_CSR_REG14_ADDR A:&base_addr+0x9e0e6c
y.create.l HWIO_RPMH_VRM_HEADROOM_ARS_CSR_REG15_ADDR A:&base_addr+0x9e0f6c
y.create.l HWIO_RPMH_VRM_HEADROOM_ARS_CSR_REG16_ADDR A:&base_addr+0x9e106c
y.create.l HWIO_RPMH_VRM_HEADROOM_ARS_CSR_REG17_ADDR A:&base_addr+0x9e116c
y.create.l HWIO_RPMH_VRM_HEADROOM_ARS_CSR_REG18_ADDR A:&base_addr+0x9e126c
y.create.l HWIO_RPMH_VRM_HEADROOM_ARS_CSR_REG19_ADDR A:&base_addr+0x9e136c
y.create.l HWIO_RPMH_VRM_HEADROOM_ARS_CSR_REG20_ADDR A:&base_addr+0x9e146c
y.create.l HWIO_RPMH_VRM_HEADROOM_ARS_CSR_REG21_ADDR A:&base_addr+0x9e156c
y.create.l HWIO_RPMH_VRM_HEADROOM_ARS_CSR_REG22_ADDR A:&base_addr+0x9e166c
y.create.l HWIO_RPMH_VRM_HEADROOM_ARS_CSR_REG23_ADDR A:&base_addr+0x9e176c
y.create.l HWIO_RPMH_VRM_HEADROOM_ARS_CSR_REG24_ADDR A:&base_addr+0x9e186c
y.create.l HWIO_RPMH_VRM_HEADROOM_ARS_CSR_REG25_ADDR A:&base_addr+0x9e196c
y.create.l HWIO_RPMH_VRM_HEADROOM_ARS_CSR_REG26_ADDR A:&base_addr+0x9e1a6c
y.create.l HWIO_RPMH_VRM_HEADROOM_ARS_CSR_REG27_ADDR A:&base_addr+0x9e1b6c
y.create.l HWIO_RPMH_VRM_HEADROOM_ARS_CSR_REG28_ADDR A:&base_addr+0x9e1c6c
y.create.l HWIO_RPMH_VRM_HEADROOM_ARS_CSR_REG29_ADDR A:&base_addr+0x9e1d6c
y.create.l HWIO_RPMH_VRM_HEADROOM_ARS_CSR_REG30_ADDR A:&base_addr+0x9e1e6c
y.create.l HWIO_RPMH_VRM_HEADROOM_ARS_CSR_REG31_ADDR A:&base_addr+0x9e1f6c
y.create.l HWIO_RPMH_VRM_HEADROOM_ARS_CSR_REG32_ADDR A:&base_addr+0x9e206c
y.create.l HWIO_RPMH_VRM_HEADROOM_ARS_CSR_REG33_ADDR A:&base_addr+0x9e216c
y.create.l HWIO_RPMH_VRM_HEADROOM_ARS_CSR_REG34_ADDR A:&base_addr+0x9e226c
y.create.l HWIO_RPMH_VRM_HEADROOM_ARS_CSR_REG35_ADDR A:&base_addr+0x9e236c
y.create.l HWIO_RPMH_VRM_HEADROOM_ARS_CSR_REG36_ADDR A:&base_addr+0x9e246c
y.create.l HWIO_RPMH_VRM_HEADROOM_ARS_CSR_REG37_ADDR A:&base_addr+0x9e256c
y.create.l HWIO_RPMH_VRM_HEADROOM_ARS_CSR_REG38_ADDR A:&base_addr+0x9e266c
y.create.l HWIO_RPMH_VRM_HEADROOM_ARS_CSR_REG39_ADDR A:&base_addr+0x9e276c
y.create.l HWIO_RPMH_VRM_HEADROOM_ARS_CSR_REG40_ADDR A:&base_addr+0x9e286c
y.create.l HWIO_RPMH_VRM_HEADROOM_ARS_CSR_REG41_ADDR A:&base_addr+0x9e296c
y.create.l HWIO_RPMH_VRM_HEADROOM_ARS_CSR_REG42_ADDR A:&base_addr+0x9e2a6c
y.create.l HWIO_RPMH_VRM_HEADROOM_ARS_CSR_REG43_ADDR A:&base_addr+0x9e2b6c
y.create.l HWIO_RPMH_VRM_HEADROOM_ARS_CSR_REG44_ADDR A:&base_addr+0x9e2c6c
y.create.l HWIO_RPMH_VRM_HEADROOM_ARS_CSR_REG45_ADDR A:&base_addr+0x9e2d6c
y.create.l HWIO_RPMH_VRM_ENABLE_ARS_CSR_XOB0_ADDR A:&base_addr+0x9ec064
y.create.l HWIO_RPMH_VRM_ENABLE_ARS_CSR_XOB1_ADDR A:&base_addr+0x9ec164
y.create.l HWIO_RPMH_VRM_ENABLE_ARS_CSR_XOB2_ADDR A:&base_addr+0x9ec264
y.create.l HWIO_RPMH_VRM_ENABLE_ARS_CSR_XOB3_ADDR A:&base_addr+0x9ec364
y.create.l HWIO_RPMH_VRM_ENABLE_ARS_CSR_XOB4_ADDR A:&base_addr+0x9ec464
y.create.l HWIO_RPMH_VRM_ENABLE_ARS_CSR_XOB5_ADDR A:&base_addr+0x9ec564
y.create.l HWIO_RPMH_VRM_ENABLE_ARS_CSR_XOB6_ADDR A:&base_addr+0x9ec664
y.create.l HWIO_RPMH_VRM_ENABLE_ARS_CSR_XOB7_ADDR A:&base_addr+0x9ec764
y.create.l HWIO_RPMH_VRM_ENABLE_ARS_CSR_XO0_ADDR A:&base_addr+0x9ed864
y.create.l HWIO_RPMH_VRM_TYPE_CSR_REG0_ADDR A:&base_addr+0x9e0080
y.create.l HWIO_RPMH_VRM_TYPE_CSR_REG1_ADDR A:&base_addr+0x9e0180
y.create.l HWIO_RPMH_VRM_TYPE_CSR_REG2_ADDR A:&base_addr+0x9e0280
y.create.l HWIO_RPMH_VRM_TYPE_CSR_REG3_ADDR A:&base_addr+0x9e0380
y.create.l HWIO_RPMH_VRM_TYPE_CSR_REG4_ADDR A:&base_addr+0x9e0480
y.create.l HWIO_RPMH_VRM_TYPE_CSR_REG5_ADDR A:&base_addr+0x9e0580
y.create.l HWIO_RPMH_VRM_TYPE_CSR_REG6_ADDR A:&base_addr+0x9e0680
y.create.l HWIO_RPMH_VRM_TYPE_CSR_REG7_ADDR A:&base_addr+0x9e0780
y.create.l HWIO_RPMH_VRM_TYPE_CSR_REG8_ADDR A:&base_addr+0x9e0880
y.create.l HWIO_RPMH_VRM_TYPE_CSR_REG9_ADDR A:&base_addr+0x9e0980
y.create.l HWIO_RPMH_VRM_TYPE_CSR_REG10_ADDR A:&base_addr+0x9e0a80
y.create.l HWIO_RPMH_VRM_TYPE_CSR_REG11_ADDR A:&base_addr+0x9e0b80
y.create.l HWIO_RPMH_VRM_TYPE_CSR_REG12_ADDR A:&base_addr+0x9e0c80
y.create.l HWIO_RPMH_VRM_TYPE_CSR_REG13_ADDR A:&base_addr+0x9e0d80
y.create.l HWIO_RPMH_VRM_TYPE_CSR_REG14_ADDR A:&base_addr+0x9e0e80
y.create.l HWIO_RPMH_VRM_TYPE_CSR_REG15_ADDR A:&base_addr+0x9e0f80
y.create.l HWIO_RPMH_VRM_TYPE_CSR_REG16_ADDR A:&base_addr+0x9e1080
y.create.l HWIO_RPMH_VRM_TYPE_CSR_REG17_ADDR A:&base_addr+0x9e1180
y.create.l HWIO_RPMH_VRM_TYPE_CSR_REG18_ADDR A:&base_addr+0x9e1280
y.create.l HWIO_RPMH_VRM_TYPE_CSR_REG19_ADDR A:&base_addr+0x9e1380
y.create.l HWIO_RPMH_VRM_TYPE_CSR_REG20_ADDR A:&base_addr+0x9e1480
y.create.l HWIO_RPMH_VRM_TYPE_CSR_REG21_ADDR A:&base_addr+0x9e1580
y.create.l HWIO_RPMH_VRM_TYPE_CSR_REG22_ADDR A:&base_addr+0x9e1680
y.create.l HWIO_RPMH_VRM_TYPE_CSR_REG23_ADDR A:&base_addr+0x9e1780
y.create.l HWIO_RPMH_VRM_TYPE_CSR_REG24_ADDR A:&base_addr+0x9e1880
y.create.l HWIO_RPMH_VRM_TYPE_CSR_REG25_ADDR A:&base_addr+0x9e1980
y.create.l HWIO_RPMH_VRM_TYPE_CSR_REG26_ADDR A:&base_addr+0x9e1a80
y.create.l HWIO_RPMH_VRM_TYPE_CSR_REG27_ADDR A:&base_addr+0x9e1b80
y.create.l HWIO_RPMH_VRM_TYPE_CSR_REG28_ADDR A:&base_addr+0x9e1c80
y.create.l HWIO_RPMH_VRM_TYPE_CSR_REG29_ADDR A:&base_addr+0x9e1d80
y.create.l HWIO_RPMH_VRM_TYPE_CSR_REG30_ADDR A:&base_addr+0x9e1e80
y.create.l HWIO_RPMH_VRM_TYPE_CSR_REG31_ADDR A:&base_addr+0x9e1f80
y.create.l HWIO_RPMH_VRM_TYPE_CSR_REG32_ADDR A:&base_addr+0x9e2080
y.create.l HWIO_RPMH_VRM_TYPE_CSR_REG33_ADDR A:&base_addr+0x9e2180
y.create.l HWIO_RPMH_VRM_TYPE_CSR_REG34_ADDR A:&base_addr+0x9e2280
y.create.l HWIO_RPMH_VRM_TYPE_CSR_REG35_ADDR A:&base_addr+0x9e2380
y.create.l HWIO_RPMH_VRM_TYPE_CSR_REG36_ADDR A:&base_addr+0x9e2480
y.create.l HWIO_RPMH_VRM_TYPE_CSR_REG37_ADDR A:&base_addr+0x9e2580
y.create.l HWIO_RPMH_VRM_TYPE_CSR_REG38_ADDR A:&base_addr+0x9e2680
y.create.l HWIO_RPMH_VRM_TYPE_CSR_REG39_ADDR A:&base_addr+0x9e2780
y.create.l HWIO_RPMH_VRM_TYPE_CSR_REG40_ADDR A:&base_addr+0x9e2880
y.create.l HWIO_RPMH_VRM_TYPE_CSR_REG41_ADDR A:&base_addr+0x9e2980
y.create.l HWIO_RPMH_VRM_TYPE_CSR_REG42_ADDR A:&base_addr+0x9e2a80
y.create.l HWIO_RPMH_VRM_TYPE_CSR_REG43_ADDR A:&base_addr+0x9e2b80
y.create.l HWIO_RPMH_VRM_TYPE_CSR_REG44_ADDR A:&base_addr+0x9e2c80
y.create.l HWIO_RPMH_VRM_TYPE_CSR_REG45_ADDR A:&base_addr+0x9e2d80
y.create.l HWIO_RPMH_VRM_BASE_ADDR_CSR_REG0_ADDR A:&base_addr+0x9e0084
y.create.l HWIO_RPMH_VRM_BASE_ADDR_CSR_REG1_ADDR A:&base_addr+0x9e0184
y.create.l HWIO_RPMH_VRM_BASE_ADDR_CSR_REG2_ADDR A:&base_addr+0x9e0284
y.create.l HWIO_RPMH_VRM_BASE_ADDR_CSR_REG3_ADDR A:&base_addr+0x9e0384
y.create.l HWIO_RPMH_VRM_BASE_ADDR_CSR_REG4_ADDR A:&base_addr+0x9e0484
y.create.l HWIO_RPMH_VRM_BASE_ADDR_CSR_REG5_ADDR A:&base_addr+0x9e0584
y.create.l HWIO_RPMH_VRM_BASE_ADDR_CSR_REG6_ADDR A:&base_addr+0x9e0684
y.create.l HWIO_RPMH_VRM_BASE_ADDR_CSR_REG7_ADDR A:&base_addr+0x9e0784
y.create.l HWIO_RPMH_VRM_BASE_ADDR_CSR_REG8_ADDR A:&base_addr+0x9e0884
y.create.l HWIO_RPMH_VRM_BASE_ADDR_CSR_REG9_ADDR A:&base_addr+0x9e0984
y.create.l HWIO_RPMH_VRM_BASE_ADDR_CSR_REG10_ADDR A:&base_addr+0x9e0a84
y.create.l HWIO_RPMH_VRM_BASE_ADDR_CSR_REG11_ADDR A:&base_addr+0x9e0b84
y.create.l HWIO_RPMH_VRM_BASE_ADDR_CSR_REG12_ADDR A:&base_addr+0x9e0c84
y.create.l HWIO_RPMH_VRM_BASE_ADDR_CSR_REG13_ADDR A:&base_addr+0x9e0d84
y.create.l HWIO_RPMH_VRM_BASE_ADDR_CSR_REG14_ADDR A:&base_addr+0x9e0e84
y.create.l HWIO_RPMH_VRM_BASE_ADDR_CSR_REG15_ADDR A:&base_addr+0x9e0f84
y.create.l HWIO_RPMH_VRM_BASE_ADDR_CSR_REG16_ADDR A:&base_addr+0x9e1084
y.create.l HWIO_RPMH_VRM_BASE_ADDR_CSR_REG17_ADDR A:&base_addr+0x9e1184
y.create.l HWIO_RPMH_VRM_BASE_ADDR_CSR_REG18_ADDR A:&base_addr+0x9e1284
y.create.l HWIO_RPMH_VRM_BASE_ADDR_CSR_REG19_ADDR A:&base_addr+0x9e1384
y.create.l HWIO_RPMH_VRM_BASE_ADDR_CSR_REG20_ADDR A:&base_addr+0x9e1484
y.create.l HWIO_RPMH_VRM_BASE_ADDR_CSR_REG21_ADDR A:&base_addr+0x9e1584
y.create.l HWIO_RPMH_VRM_BASE_ADDR_CSR_REG22_ADDR A:&base_addr+0x9e1684
y.create.l HWIO_RPMH_VRM_BASE_ADDR_CSR_REG23_ADDR A:&base_addr+0x9e1784
y.create.l HWIO_RPMH_VRM_BASE_ADDR_CSR_REG24_ADDR A:&base_addr+0x9e1884
y.create.l HWIO_RPMH_VRM_BASE_ADDR_CSR_REG25_ADDR A:&base_addr+0x9e1984
y.create.l HWIO_RPMH_VRM_BASE_ADDR_CSR_REG26_ADDR A:&base_addr+0x9e1a84
y.create.l HWIO_RPMH_VRM_BASE_ADDR_CSR_REG27_ADDR A:&base_addr+0x9e1b84
y.create.l HWIO_RPMH_VRM_BASE_ADDR_CSR_REG28_ADDR A:&base_addr+0x9e1c84
y.create.l HWIO_RPMH_VRM_BASE_ADDR_CSR_REG29_ADDR A:&base_addr+0x9e1d84
y.create.l HWIO_RPMH_VRM_BASE_ADDR_CSR_REG30_ADDR A:&base_addr+0x9e1e84
y.create.l HWIO_RPMH_VRM_BASE_ADDR_CSR_REG31_ADDR A:&base_addr+0x9e1f84
y.create.l HWIO_RPMH_VRM_BASE_ADDR_CSR_REG32_ADDR A:&base_addr+0x9e2084
y.create.l HWIO_RPMH_VRM_BASE_ADDR_CSR_REG33_ADDR A:&base_addr+0x9e2184
y.create.l HWIO_RPMH_VRM_BASE_ADDR_CSR_REG34_ADDR A:&base_addr+0x9e2284
y.create.l HWIO_RPMH_VRM_BASE_ADDR_CSR_REG35_ADDR A:&base_addr+0x9e2384
y.create.l HWIO_RPMH_VRM_BASE_ADDR_CSR_REG36_ADDR A:&base_addr+0x9e2484
y.create.l HWIO_RPMH_VRM_BASE_ADDR_CSR_REG37_ADDR A:&base_addr+0x9e2584
y.create.l HWIO_RPMH_VRM_BASE_ADDR_CSR_REG38_ADDR A:&base_addr+0x9e2684
y.create.l HWIO_RPMH_VRM_BASE_ADDR_CSR_REG39_ADDR A:&base_addr+0x9e2784
y.create.l HWIO_RPMH_VRM_BASE_ADDR_CSR_REG40_ADDR A:&base_addr+0x9e2884
y.create.l HWIO_RPMH_VRM_BASE_ADDR_CSR_REG41_ADDR A:&base_addr+0x9e2984
y.create.l HWIO_RPMH_VRM_BASE_ADDR_CSR_REG42_ADDR A:&base_addr+0x9e2a84
y.create.l HWIO_RPMH_VRM_BASE_ADDR_CSR_REG43_ADDR A:&base_addr+0x9e2b84
y.create.l HWIO_RPMH_VRM_BASE_ADDR_CSR_REG44_ADDR A:&base_addr+0x9e2c84
y.create.l HWIO_RPMH_VRM_BASE_ADDR_CSR_REG45_ADDR A:&base_addr+0x9e2d84
y.create.l HWIO_RPMH_VRM_MAX_VOLTAGE_CSR_REG0_ADDR A:&base_addr+0x9e0088
y.create.l HWIO_RPMH_VRM_MAX_VOLTAGE_CSR_REG1_ADDR A:&base_addr+0x9e0188
y.create.l HWIO_RPMH_VRM_MAX_VOLTAGE_CSR_REG2_ADDR A:&base_addr+0x9e0288
y.create.l HWIO_RPMH_VRM_MAX_VOLTAGE_CSR_REG3_ADDR A:&base_addr+0x9e0388
y.create.l HWIO_RPMH_VRM_MAX_VOLTAGE_CSR_REG4_ADDR A:&base_addr+0x9e0488
y.create.l HWIO_RPMH_VRM_MAX_VOLTAGE_CSR_REG5_ADDR A:&base_addr+0x9e0588
y.create.l HWIO_RPMH_VRM_MAX_VOLTAGE_CSR_REG6_ADDR A:&base_addr+0x9e0688
y.create.l HWIO_RPMH_VRM_MAX_VOLTAGE_CSR_REG7_ADDR A:&base_addr+0x9e0788
y.create.l HWIO_RPMH_VRM_MAX_VOLTAGE_CSR_REG8_ADDR A:&base_addr+0x9e0888
y.create.l HWIO_RPMH_VRM_MAX_VOLTAGE_CSR_REG9_ADDR A:&base_addr+0x9e0988
y.create.l HWIO_RPMH_VRM_MAX_VOLTAGE_CSR_REG10_ADDR A:&base_addr+0x9e0a88
y.create.l HWIO_RPMH_VRM_MAX_VOLTAGE_CSR_REG11_ADDR A:&base_addr+0x9e0b88
y.create.l HWIO_RPMH_VRM_MAX_VOLTAGE_CSR_REG12_ADDR A:&base_addr+0x9e0c88
y.create.l HWIO_RPMH_VRM_MAX_VOLTAGE_CSR_REG13_ADDR A:&base_addr+0x9e0d88
y.create.l HWIO_RPMH_VRM_MAX_VOLTAGE_CSR_REG14_ADDR A:&base_addr+0x9e0e88
y.create.l HWIO_RPMH_VRM_MAX_VOLTAGE_CSR_REG15_ADDR A:&base_addr+0x9e0f88
y.create.l HWIO_RPMH_VRM_MAX_VOLTAGE_CSR_REG16_ADDR A:&base_addr+0x9e1088
y.create.l HWIO_RPMH_VRM_MAX_VOLTAGE_CSR_REG17_ADDR A:&base_addr+0x9e1188
y.create.l HWIO_RPMH_VRM_MAX_VOLTAGE_CSR_REG18_ADDR A:&base_addr+0x9e1288
y.create.l HWIO_RPMH_VRM_MAX_VOLTAGE_CSR_REG19_ADDR A:&base_addr+0x9e1388
y.create.l HWIO_RPMH_VRM_MAX_VOLTAGE_CSR_REG20_ADDR A:&base_addr+0x9e1488
y.create.l HWIO_RPMH_VRM_MAX_VOLTAGE_CSR_REG21_ADDR A:&base_addr+0x9e1588
y.create.l HWIO_RPMH_VRM_MAX_VOLTAGE_CSR_REG22_ADDR A:&base_addr+0x9e1688
y.create.l HWIO_RPMH_VRM_MAX_VOLTAGE_CSR_REG23_ADDR A:&base_addr+0x9e1788
y.create.l HWIO_RPMH_VRM_MAX_VOLTAGE_CSR_REG24_ADDR A:&base_addr+0x9e1888
y.create.l HWIO_RPMH_VRM_MAX_VOLTAGE_CSR_REG25_ADDR A:&base_addr+0x9e1988
y.create.l HWIO_RPMH_VRM_MAX_VOLTAGE_CSR_REG26_ADDR A:&base_addr+0x9e1a88
y.create.l HWIO_RPMH_VRM_MAX_VOLTAGE_CSR_REG27_ADDR A:&base_addr+0x9e1b88
y.create.l HWIO_RPMH_VRM_MAX_VOLTAGE_CSR_REG28_ADDR A:&base_addr+0x9e1c88
y.create.l HWIO_RPMH_VRM_MAX_VOLTAGE_CSR_REG29_ADDR A:&base_addr+0x9e1d88
y.create.l HWIO_RPMH_VRM_MAX_VOLTAGE_CSR_REG30_ADDR A:&base_addr+0x9e1e88
y.create.l HWIO_RPMH_VRM_MAX_VOLTAGE_CSR_REG31_ADDR A:&base_addr+0x9e1f88
y.create.l HWIO_RPMH_VRM_MAX_VOLTAGE_CSR_REG32_ADDR A:&base_addr+0x9e2088
y.create.l HWIO_RPMH_VRM_MAX_VOLTAGE_CSR_REG33_ADDR A:&base_addr+0x9e2188
y.create.l HWIO_RPMH_VRM_MAX_VOLTAGE_CSR_REG34_ADDR A:&base_addr+0x9e2288
y.create.l HWIO_RPMH_VRM_MAX_VOLTAGE_CSR_REG35_ADDR A:&base_addr+0x9e2388
y.create.l HWIO_RPMH_VRM_MAX_VOLTAGE_CSR_REG36_ADDR A:&base_addr+0x9e2488
y.create.l HWIO_RPMH_VRM_MAX_VOLTAGE_CSR_REG37_ADDR A:&base_addr+0x9e2588
y.create.l HWIO_RPMH_VRM_MAX_VOLTAGE_CSR_REG38_ADDR A:&base_addr+0x9e2688
y.create.l HWIO_RPMH_VRM_MAX_VOLTAGE_CSR_REG39_ADDR A:&base_addr+0x9e2788
y.create.l HWIO_RPMH_VRM_MAX_VOLTAGE_CSR_REG40_ADDR A:&base_addr+0x9e2888
y.create.l HWIO_RPMH_VRM_MAX_VOLTAGE_CSR_REG41_ADDR A:&base_addr+0x9e2988
y.create.l HWIO_RPMH_VRM_MAX_VOLTAGE_CSR_REG42_ADDR A:&base_addr+0x9e2a88
y.create.l HWIO_RPMH_VRM_MAX_VOLTAGE_CSR_REG43_ADDR A:&base_addr+0x9e2b88
y.create.l HWIO_RPMH_VRM_MAX_VOLTAGE_CSR_REG44_ADDR A:&base_addr+0x9e2c88
y.create.l HWIO_RPMH_VRM_MAX_VOLTAGE_CSR_REG45_ADDR A:&base_addr+0x9e2d88
y.create.l HWIO_RPMH_VRM_VOLTAGE_SEQ_ID_CSR_REG0_ADDR A:&base_addr+0x9e008c
y.create.l HWIO_RPMH_VRM_VOLTAGE_SEQ_ID_CSR_REG1_ADDR A:&base_addr+0x9e018c
y.create.l HWIO_RPMH_VRM_VOLTAGE_SEQ_ID_CSR_REG2_ADDR A:&base_addr+0x9e028c
y.create.l HWIO_RPMH_VRM_VOLTAGE_SEQ_ID_CSR_REG3_ADDR A:&base_addr+0x9e038c
y.create.l HWIO_RPMH_VRM_VOLTAGE_SEQ_ID_CSR_REG4_ADDR A:&base_addr+0x9e048c
y.create.l HWIO_RPMH_VRM_VOLTAGE_SEQ_ID_CSR_REG5_ADDR A:&base_addr+0x9e058c
y.create.l HWIO_RPMH_VRM_VOLTAGE_SEQ_ID_CSR_REG6_ADDR A:&base_addr+0x9e068c
y.create.l HWIO_RPMH_VRM_VOLTAGE_SEQ_ID_CSR_REG7_ADDR A:&base_addr+0x9e078c
y.create.l HWIO_RPMH_VRM_VOLTAGE_SEQ_ID_CSR_REG8_ADDR A:&base_addr+0x9e088c
y.create.l HWIO_RPMH_VRM_VOLTAGE_SEQ_ID_CSR_REG9_ADDR A:&base_addr+0x9e098c
y.create.l HWIO_RPMH_VRM_VOLTAGE_SEQ_ID_CSR_REG10_ADDR A:&base_addr+0x9e0a8c
y.create.l HWIO_RPMH_VRM_VOLTAGE_SEQ_ID_CSR_REG11_ADDR A:&base_addr+0x9e0b8c
y.create.l HWIO_RPMH_VRM_VOLTAGE_SEQ_ID_CSR_REG12_ADDR A:&base_addr+0x9e0c8c
y.create.l HWIO_RPMH_VRM_VOLTAGE_SEQ_ID_CSR_REG13_ADDR A:&base_addr+0x9e0d8c
y.create.l HWIO_RPMH_VRM_VOLTAGE_SEQ_ID_CSR_REG14_ADDR A:&base_addr+0x9e0e8c
y.create.l HWIO_RPMH_VRM_VOLTAGE_SEQ_ID_CSR_REG15_ADDR A:&base_addr+0x9e0f8c
y.create.l HWIO_RPMH_VRM_VOLTAGE_SEQ_ID_CSR_REG16_ADDR A:&base_addr+0x9e108c
y.create.l HWIO_RPMH_VRM_VOLTAGE_SEQ_ID_CSR_REG17_ADDR A:&base_addr+0x9e118c
y.create.l HWIO_RPMH_VRM_VOLTAGE_SEQ_ID_CSR_REG18_ADDR A:&base_addr+0x9e128c
y.create.l HWIO_RPMH_VRM_VOLTAGE_SEQ_ID_CSR_REG19_ADDR A:&base_addr+0x9e138c
y.create.l HWIO_RPMH_VRM_VOLTAGE_SEQ_ID_CSR_REG20_ADDR A:&base_addr+0x9e148c
y.create.l HWIO_RPMH_VRM_VOLTAGE_SEQ_ID_CSR_REG21_ADDR A:&base_addr+0x9e158c
y.create.l HWIO_RPMH_VRM_VOLTAGE_SEQ_ID_CSR_REG22_ADDR A:&base_addr+0x9e168c
y.create.l HWIO_RPMH_VRM_VOLTAGE_SEQ_ID_CSR_REG23_ADDR A:&base_addr+0x9e178c
y.create.l HWIO_RPMH_VRM_VOLTAGE_SEQ_ID_CSR_REG24_ADDR A:&base_addr+0x9e188c
y.create.l HWIO_RPMH_VRM_VOLTAGE_SEQ_ID_CSR_REG25_ADDR A:&base_addr+0x9e198c
y.create.l HWIO_RPMH_VRM_VOLTAGE_SEQ_ID_CSR_REG26_ADDR A:&base_addr+0x9e1a8c
y.create.l HWIO_RPMH_VRM_VOLTAGE_SEQ_ID_CSR_REG27_ADDR A:&base_addr+0x9e1b8c
y.create.l HWIO_RPMH_VRM_VOLTAGE_SEQ_ID_CSR_REG28_ADDR A:&base_addr+0x9e1c8c
y.create.l HWIO_RPMH_VRM_VOLTAGE_SEQ_ID_CSR_REG29_ADDR A:&base_addr+0x9e1d8c
y.create.l HWIO_RPMH_VRM_VOLTAGE_SEQ_ID_CSR_REG30_ADDR A:&base_addr+0x9e1e8c
y.create.l HWIO_RPMH_VRM_VOLTAGE_SEQ_ID_CSR_REG31_ADDR A:&base_addr+0x9e1f8c
y.create.l HWIO_RPMH_VRM_VOLTAGE_SEQ_ID_CSR_REG32_ADDR A:&base_addr+0x9e208c
y.create.l HWIO_RPMH_VRM_VOLTAGE_SEQ_ID_CSR_REG33_ADDR A:&base_addr+0x9e218c
y.create.l HWIO_RPMH_VRM_VOLTAGE_SEQ_ID_CSR_REG34_ADDR A:&base_addr+0x9e228c
y.create.l HWIO_RPMH_VRM_VOLTAGE_SEQ_ID_CSR_REG35_ADDR A:&base_addr+0x9e238c
y.create.l HWIO_RPMH_VRM_VOLTAGE_SEQ_ID_CSR_REG36_ADDR A:&base_addr+0x9e248c
y.create.l HWIO_RPMH_VRM_VOLTAGE_SEQ_ID_CSR_REG37_ADDR A:&base_addr+0x9e258c
y.create.l HWIO_RPMH_VRM_VOLTAGE_SEQ_ID_CSR_REG38_ADDR A:&base_addr+0x9e268c
y.create.l HWIO_RPMH_VRM_VOLTAGE_SEQ_ID_CSR_REG39_ADDR A:&base_addr+0x9e278c
y.create.l HWIO_RPMH_VRM_VOLTAGE_SEQ_ID_CSR_REG40_ADDR A:&base_addr+0x9e288c
y.create.l HWIO_RPMH_VRM_VOLTAGE_SEQ_ID_CSR_REG41_ADDR A:&base_addr+0x9e298c
y.create.l HWIO_RPMH_VRM_VOLTAGE_SEQ_ID_CSR_REG42_ADDR A:&base_addr+0x9e2a8c
y.create.l HWIO_RPMH_VRM_VOLTAGE_SEQ_ID_CSR_REG43_ADDR A:&base_addr+0x9e2b8c
y.create.l HWIO_RPMH_VRM_VOLTAGE_SEQ_ID_CSR_REG44_ADDR A:&base_addr+0x9e2c8c
y.create.l HWIO_RPMH_VRM_VOLTAGE_SEQ_ID_CSR_REG45_ADDR A:&base_addr+0x9e2d8c
y.create.l HWIO_RPMH_VRM_ENABLE_SEQ_ID_CSR_REG0_ADDR A:&base_addr+0x9e0090
y.create.l HWIO_RPMH_VRM_ENABLE_SEQ_ID_CSR_REG1_ADDR A:&base_addr+0x9e0190
y.create.l HWIO_RPMH_VRM_ENABLE_SEQ_ID_CSR_REG2_ADDR A:&base_addr+0x9e0290
y.create.l HWIO_RPMH_VRM_ENABLE_SEQ_ID_CSR_REG3_ADDR A:&base_addr+0x9e0390
y.create.l HWIO_RPMH_VRM_ENABLE_SEQ_ID_CSR_REG4_ADDR A:&base_addr+0x9e0490
y.create.l HWIO_RPMH_VRM_ENABLE_SEQ_ID_CSR_REG5_ADDR A:&base_addr+0x9e0590
y.create.l HWIO_RPMH_VRM_ENABLE_SEQ_ID_CSR_REG6_ADDR A:&base_addr+0x9e0690
y.create.l HWIO_RPMH_VRM_ENABLE_SEQ_ID_CSR_REG7_ADDR A:&base_addr+0x9e0790
y.create.l HWIO_RPMH_VRM_ENABLE_SEQ_ID_CSR_REG8_ADDR A:&base_addr+0x9e0890
y.create.l HWIO_RPMH_VRM_ENABLE_SEQ_ID_CSR_REG9_ADDR A:&base_addr+0x9e0990
y.create.l HWIO_RPMH_VRM_ENABLE_SEQ_ID_CSR_REG10_ADDR A:&base_addr+0x9e0a90
y.create.l HWIO_RPMH_VRM_ENABLE_SEQ_ID_CSR_REG11_ADDR A:&base_addr+0x9e0b90
y.create.l HWIO_RPMH_VRM_ENABLE_SEQ_ID_CSR_REG12_ADDR A:&base_addr+0x9e0c90
y.create.l HWIO_RPMH_VRM_ENABLE_SEQ_ID_CSR_REG13_ADDR A:&base_addr+0x9e0d90
y.create.l HWIO_RPMH_VRM_ENABLE_SEQ_ID_CSR_REG14_ADDR A:&base_addr+0x9e0e90
y.create.l HWIO_RPMH_VRM_ENABLE_SEQ_ID_CSR_REG15_ADDR A:&base_addr+0x9e0f90
y.create.l HWIO_RPMH_VRM_ENABLE_SEQ_ID_CSR_REG16_ADDR A:&base_addr+0x9e1090
y.create.l HWIO_RPMH_VRM_ENABLE_SEQ_ID_CSR_REG17_ADDR A:&base_addr+0x9e1190
y.create.l HWIO_RPMH_VRM_ENABLE_SEQ_ID_CSR_REG18_ADDR A:&base_addr+0x9e1290
y.create.l HWIO_RPMH_VRM_ENABLE_SEQ_ID_CSR_REG19_ADDR A:&base_addr+0x9e1390
y.create.l HWIO_RPMH_VRM_ENABLE_SEQ_ID_CSR_REG20_ADDR A:&base_addr+0x9e1490
y.create.l HWIO_RPMH_VRM_ENABLE_SEQ_ID_CSR_REG21_ADDR A:&base_addr+0x9e1590
y.create.l HWIO_RPMH_VRM_ENABLE_SEQ_ID_CSR_REG22_ADDR A:&base_addr+0x9e1690
y.create.l HWIO_RPMH_VRM_ENABLE_SEQ_ID_CSR_REG23_ADDR A:&base_addr+0x9e1790
y.create.l HWIO_RPMH_VRM_ENABLE_SEQ_ID_CSR_REG24_ADDR A:&base_addr+0x9e1890
y.create.l HWIO_RPMH_VRM_ENABLE_SEQ_ID_CSR_REG25_ADDR A:&base_addr+0x9e1990
y.create.l HWIO_RPMH_VRM_ENABLE_SEQ_ID_CSR_REG26_ADDR A:&base_addr+0x9e1a90
y.create.l HWIO_RPMH_VRM_ENABLE_SEQ_ID_CSR_REG27_ADDR A:&base_addr+0x9e1b90
y.create.l HWIO_RPMH_VRM_ENABLE_SEQ_ID_CSR_REG28_ADDR A:&base_addr+0x9e1c90
y.create.l HWIO_RPMH_VRM_ENABLE_SEQ_ID_CSR_REG29_ADDR A:&base_addr+0x9e1d90
y.create.l HWIO_RPMH_VRM_ENABLE_SEQ_ID_CSR_REG30_ADDR A:&base_addr+0x9e1e90
y.create.l HWIO_RPMH_VRM_ENABLE_SEQ_ID_CSR_REG31_ADDR A:&base_addr+0x9e1f90
y.create.l HWIO_RPMH_VRM_ENABLE_SEQ_ID_CSR_REG32_ADDR A:&base_addr+0x9e2090
y.create.l HWIO_RPMH_VRM_ENABLE_SEQ_ID_CSR_REG33_ADDR A:&base_addr+0x9e2190
y.create.l HWIO_RPMH_VRM_ENABLE_SEQ_ID_CSR_REG34_ADDR A:&base_addr+0x9e2290
y.create.l HWIO_RPMH_VRM_ENABLE_SEQ_ID_CSR_REG35_ADDR A:&base_addr+0x9e2390
y.create.l HWIO_RPMH_VRM_ENABLE_SEQ_ID_CSR_REG36_ADDR A:&base_addr+0x9e2490
y.create.l HWIO_RPMH_VRM_ENABLE_SEQ_ID_CSR_REG37_ADDR A:&base_addr+0x9e2590
y.create.l HWIO_RPMH_VRM_ENABLE_SEQ_ID_CSR_REG38_ADDR A:&base_addr+0x9e2690
y.create.l HWIO_RPMH_VRM_ENABLE_SEQ_ID_CSR_REG39_ADDR A:&base_addr+0x9e2790
y.create.l HWIO_RPMH_VRM_ENABLE_SEQ_ID_CSR_REG40_ADDR A:&base_addr+0x9e2890
y.create.l HWIO_RPMH_VRM_ENABLE_SEQ_ID_CSR_REG41_ADDR A:&base_addr+0x9e2990
y.create.l HWIO_RPMH_VRM_ENABLE_SEQ_ID_CSR_REG42_ADDR A:&base_addr+0x9e2a90
y.create.l HWIO_RPMH_VRM_ENABLE_SEQ_ID_CSR_REG43_ADDR A:&base_addr+0x9e2b90
y.create.l HWIO_RPMH_VRM_ENABLE_SEQ_ID_CSR_REG44_ADDR A:&base_addr+0x9e2c90
y.create.l HWIO_RPMH_VRM_ENABLE_SEQ_ID_CSR_REG45_ADDR A:&base_addr+0x9e2d90
y.create.l HWIO_RPMH_VRM_MODE_SEQ_ID_CSR_REG0_ADDR A:&base_addr+0x9e0094
y.create.l HWIO_RPMH_VRM_MODE_SEQ_ID_CSR_REG1_ADDR A:&base_addr+0x9e0194
y.create.l HWIO_RPMH_VRM_MODE_SEQ_ID_CSR_REG2_ADDR A:&base_addr+0x9e0294
y.create.l HWIO_RPMH_VRM_MODE_SEQ_ID_CSR_REG3_ADDR A:&base_addr+0x9e0394
y.create.l HWIO_RPMH_VRM_MODE_SEQ_ID_CSR_REG4_ADDR A:&base_addr+0x9e0494
y.create.l HWIO_RPMH_VRM_MODE_SEQ_ID_CSR_REG5_ADDR A:&base_addr+0x9e0594
y.create.l HWIO_RPMH_VRM_MODE_SEQ_ID_CSR_REG6_ADDR A:&base_addr+0x9e0694
y.create.l HWIO_RPMH_VRM_MODE_SEQ_ID_CSR_REG7_ADDR A:&base_addr+0x9e0794
y.create.l HWIO_RPMH_VRM_MODE_SEQ_ID_CSR_REG8_ADDR A:&base_addr+0x9e0894
y.create.l HWIO_RPMH_VRM_MODE_SEQ_ID_CSR_REG9_ADDR A:&base_addr+0x9e0994
y.create.l HWIO_RPMH_VRM_MODE_SEQ_ID_CSR_REG10_ADDR A:&base_addr+0x9e0a94
y.create.l HWIO_RPMH_VRM_MODE_SEQ_ID_CSR_REG11_ADDR A:&base_addr+0x9e0b94
y.create.l HWIO_RPMH_VRM_MODE_SEQ_ID_CSR_REG12_ADDR A:&base_addr+0x9e0c94
y.create.l HWIO_RPMH_VRM_MODE_SEQ_ID_CSR_REG13_ADDR A:&base_addr+0x9e0d94
y.create.l HWIO_RPMH_VRM_MODE_SEQ_ID_CSR_REG14_ADDR A:&base_addr+0x9e0e94
y.create.l HWIO_RPMH_VRM_MODE_SEQ_ID_CSR_REG15_ADDR A:&base_addr+0x9e0f94
y.create.l HWIO_RPMH_VRM_MODE_SEQ_ID_CSR_REG16_ADDR A:&base_addr+0x9e1094
y.create.l HWIO_RPMH_VRM_MODE_SEQ_ID_CSR_REG17_ADDR A:&base_addr+0x9e1194
y.create.l HWIO_RPMH_VRM_MODE_SEQ_ID_CSR_REG18_ADDR A:&base_addr+0x9e1294
y.create.l HWIO_RPMH_VRM_MODE_SEQ_ID_CSR_REG19_ADDR A:&base_addr+0x9e1394
y.create.l HWIO_RPMH_VRM_MODE_SEQ_ID_CSR_REG20_ADDR A:&base_addr+0x9e1494
y.create.l HWIO_RPMH_VRM_MODE_SEQ_ID_CSR_REG21_ADDR A:&base_addr+0x9e1594
y.create.l HWIO_RPMH_VRM_MODE_SEQ_ID_CSR_REG22_ADDR A:&base_addr+0x9e1694
y.create.l HWIO_RPMH_VRM_MODE_SEQ_ID_CSR_REG23_ADDR A:&base_addr+0x9e1794
y.create.l HWIO_RPMH_VRM_MODE_SEQ_ID_CSR_REG24_ADDR A:&base_addr+0x9e1894
y.create.l HWIO_RPMH_VRM_MODE_SEQ_ID_CSR_REG25_ADDR A:&base_addr+0x9e1994
y.create.l HWIO_RPMH_VRM_MODE_SEQ_ID_CSR_REG26_ADDR A:&base_addr+0x9e1a94
y.create.l HWIO_RPMH_VRM_MODE_SEQ_ID_CSR_REG27_ADDR A:&base_addr+0x9e1b94
y.create.l HWIO_RPMH_VRM_MODE_SEQ_ID_CSR_REG28_ADDR A:&base_addr+0x9e1c94
y.create.l HWIO_RPMH_VRM_MODE_SEQ_ID_CSR_REG29_ADDR A:&base_addr+0x9e1d94
y.create.l HWIO_RPMH_VRM_MODE_SEQ_ID_CSR_REG30_ADDR A:&base_addr+0x9e1e94
y.create.l HWIO_RPMH_VRM_MODE_SEQ_ID_CSR_REG31_ADDR A:&base_addr+0x9e1f94
y.create.l HWIO_RPMH_VRM_MODE_SEQ_ID_CSR_REG32_ADDR A:&base_addr+0x9e2094
y.create.l HWIO_RPMH_VRM_MODE_SEQ_ID_CSR_REG33_ADDR A:&base_addr+0x9e2194
y.create.l HWIO_RPMH_VRM_MODE_SEQ_ID_CSR_REG34_ADDR A:&base_addr+0x9e2294
y.create.l HWIO_RPMH_VRM_MODE_SEQ_ID_CSR_REG35_ADDR A:&base_addr+0x9e2394
y.create.l HWIO_RPMH_VRM_MODE_SEQ_ID_CSR_REG36_ADDR A:&base_addr+0x9e2494
y.create.l HWIO_RPMH_VRM_MODE_SEQ_ID_CSR_REG37_ADDR A:&base_addr+0x9e2594
y.create.l HWIO_RPMH_VRM_MODE_SEQ_ID_CSR_REG38_ADDR A:&base_addr+0x9e2694
y.create.l HWIO_RPMH_VRM_MODE_SEQ_ID_CSR_REG39_ADDR A:&base_addr+0x9e2794
y.create.l HWIO_RPMH_VRM_MODE_SEQ_ID_CSR_REG40_ADDR A:&base_addr+0x9e2894
y.create.l HWIO_RPMH_VRM_MODE_SEQ_ID_CSR_REG41_ADDR A:&base_addr+0x9e2994
y.create.l HWIO_RPMH_VRM_MODE_SEQ_ID_CSR_REG42_ADDR A:&base_addr+0x9e2a94
y.create.l HWIO_RPMH_VRM_MODE_SEQ_ID_CSR_REG43_ADDR A:&base_addr+0x9e2b94
y.create.l HWIO_RPMH_VRM_MODE_SEQ_ID_CSR_REG44_ADDR A:&base_addr+0x9e2c94
y.create.l HWIO_RPMH_VRM_MODE_SEQ_ID_CSR_REG45_ADDR A:&base_addr+0x9e2d94
y.create.l HWIO_RPMH_VRM_HEADROOM_SEQ_ID_CSR_REG0_ADDR A:&base_addr+0x9e0098
y.create.l HWIO_RPMH_VRM_HEADROOM_SEQ_ID_CSR_REG1_ADDR A:&base_addr+0x9e0198
y.create.l HWIO_RPMH_VRM_HEADROOM_SEQ_ID_CSR_REG2_ADDR A:&base_addr+0x9e0298
y.create.l HWIO_RPMH_VRM_HEADROOM_SEQ_ID_CSR_REG3_ADDR A:&base_addr+0x9e0398
y.create.l HWIO_RPMH_VRM_HEADROOM_SEQ_ID_CSR_REG4_ADDR A:&base_addr+0x9e0498
y.create.l HWIO_RPMH_VRM_HEADROOM_SEQ_ID_CSR_REG5_ADDR A:&base_addr+0x9e0598
y.create.l HWIO_RPMH_VRM_HEADROOM_SEQ_ID_CSR_REG6_ADDR A:&base_addr+0x9e0698
y.create.l HWIO_RPMH_VRM_HEADROOM_SEQ_ID_CSR_REG7_ADDR A:&base_addr+0x9e0798
y.create.l HWIO_RPMH_VRM_HEADROOM_SEQ_ID_CSR_REG8_ADDR A:&base_addr+0x9e0898
y.create.l HWIO_RPMH_VRM_HEADROOM_SEQ_ID_CSR_REG9_ADDR A:&base_addr+0x9e0998
y.create.l HWIO_RPMH_VRM_HEADROOM_SEQ_ID_CSR_REG10_ADDR A:&base_addr+0x9e0a98
y.create.l HWIO_RPMH_VRM_HEADROOM_SEQ_ID_CSR_REG11_ADDR A:&base_addr+0x9e0b98
y.create.l HWIO_RPMH_VRM_HEADROOM_SEQ_ID_CSR_REG12_ADDR A:&base_addr+0x9e0c98
y.create.l HWIO_RPMH_VRM_HEADROOM_SEQ_ID_CSR_REG13_ADDR A:&base_addr+0x9e0d98
y.create.l HWIO_RPMH_VRM_HEADROOM_SEQ_ID_CSR_REG14_ADDR A:&base_addr+0x9e0e98
y.create.l HWIO_RPMH_VRM_HEADROOM_SEQ_ID_CSR_REG15_ADDR A:&base_addr+0x9e0f98
y.create.l HWIO_RPMH_VRM_HEADROOM_SEQ_ID_CSR_REG16_ADDR A:&base_addr+0x9e1098
y.create.l HWIO_RPMH_VRM_HEADROOM_SEQ_ID_CSR_REG17_ADDR A:&base_addr+0x9e1198
y.create.l HWIO_RPMH_VRM_HEADROOM_SEQ_ID_CSR_REG18_ADDR A:&base_addr+0x9e1298
y.create.l HWIO_RPMH_VRM_HEADROOM_SEQ_ID_CSR_REG19_ADDR A:&base_addr+0x9e1398
y.create.l HWIO_RPMH_VRM_HEADROOM_SEQ_ID_CSR_REG20_ADDR A:&base_addr+0x9e1498
y.create.l HWIO_RPMH_VRM_HEADROOM_SEQ_ID_CSR_REG21_ADDR A:&base_addr+0x9e1598
y.create.l HWIO_RPMH_VRM_HEADROOM_SEQ_ID_CSR_REG22_ADDR A:&base_addr+0x9e1698
y.create.l HWIO_RPMH_VRM_HEADROOM_SEQ_ID_CSR_REG23_ADDR A:&base_addr+0x9e1798
y.create.l HWIO_RPMH_VRM_HEADROOM_SEQ_ID_CSR_REG24_ADDR A:&base_addr+0x9e1898
y.create.l HWIO_RPMH_VRM_HEADROOM_SEQ_ID_CSR_REG25_ADDR A:&base_addr+0x9e1998
y.create.l HWIO_RPMH_VRM_HEADROOM_SEQ_ID_CSR_REG26_ADDR A:&base_addr+0x9e1a98
y.create.l HWIO_RPMH_VRM_HEADROOM_SEQ_ID_CSR_REG27_ADDR A:&base_addr+0x9e1b98
y.create.l HWIO_RPMH_VRM_HEADROOM_SEQ_ID_CSR_REG28_ADDR A:&base_addr+0x9e1c98
y.create.l HWIO_RPMH_VRM_HEADROOM_SEQ_ID_CSR_REG29_ADDR A:&base_addr+0x9e1d98
y.create.l HWIO_RPMH_VRM_HEADROOM_SEQ_ID_CSR_REG30_ADDR A:&base_addr+0x9e1e98
y.create.l HWIO_RPMH_VRM_HEADROOM_SEQ_ID_CSR_REG31_ADDR A:&base_addr+0x9e1f98
y.create.l HWIO_RPMH_VRM_HEADROOM_SEQ_ID_CSR_REG32_ADDR A:&base_addr+0x9e2098
y.create.l HWIO_RPMH_VRM_HEADROOM_SEQ_ID_CSR_REG33_ADDR A:&base_addr+0x9e2198
y.create.l HWIO_RPMH_VRM_HEADROOM_SEQ_ID_CSR_REG34_ADDR A:&base_addr+0x9e2298
y.create.l HWIO_RPMH_VRM_HEADROOM_SEQ_ID_CSR_REG35_ADDR A:&base_addr+0x9e2398
y.create.l HWIO_RPMH_VRM_HEADROOM_SEQ_ID_CSR_REG36_ADDR A:&base_addr+0x9e2498
y.create.l HWIO_RPMH_VRM_HEADROOM_SEQ_ID_CSR_REG37_ADDR A:&base_addr+0x9e2598
y.create.l HWIO_RPMH_VRM_HEADROOM_SEQ_ID_CSR_REG38_ADDR A:&base_addr+0x9e2698
y.create.l HWIO_RPMH_VRM_HEADROOM_SEQ_ID_CSR_REG39_ADDR A:&base_addr+0x9e2798
y.create.l HWIO_RPMH_VRM_HEADROOM_SEQ_ID_CSR_REG40_ADDR A:&base_addr+0x9e2898
y.create.l HWIO_RPMH_VRM_HEADROOM_SEQ_ID_CSR_REG41_ADDR A:&base_addr+0x9e2998
y.create.l HWIO_RPMH_VRM_HEADROOM_SEQ_ID_CSR_REG42_ADDR A:&base_addr+0x9e2a98
y.create.l HWIO_RPMH_VRM_HEADROOM_SEQ_ID_CSR_REG43_ADDR A:&base_addr+0x9e2b98
y.create.l HWIO_RPMH_VRM_HEADROOM_SEQ_ID_CSR_REG44_ADDR A:&base_addr+0x9e2c98
y.create.l HWIO_RPMH_VRM_HEADROOM_SEQ_ID_CSR_REG45_ADDR A:&base_addr+0x9e2d98
y.create.l HWIO_RPMH_VRM_VOLTAGE_DEP_ENABLE_CSR_REG0_ADDR A:&base_addr+0x9e00a8
y.create.l HWIO_RPMH_VRM_VOLTAGE_DEP_ENABLE_CSR_REG1_ADDR A:&base_addr+0x9e01a8
y.create.l HWIO_RPMH_VRM_VOLTAGE_DEP_ENABLE_CSR_REG2_ADDR A:&base_addr+0x9e02a8
y.create.l HWIO_RPMH_VRM_VOLTAGE_DEP_ENABLE_CSR_REG3_ADDR A:&base_addr+0x9e03a8
y.create.l HWIO_RPMH_VRM_VOLTAGE_DEP_ENABLE_CSR_REG4_ADDR A:&base_addr+0x9e04a8
y.create.l HWIO_RPMH_VRM_VOLTAGE_DEP_ENABLE_CSR_REG5_ADDR A:&base_addr+0x9e05a8
y.create.l HWIO_RPMH_VRM_VOLTAGE_DEP_ENABLE_CSR_REG6_ADDR A:&base_addr+0x9e06a8
y.create.l HWIO_RPMH_VRM_VOLTAGE_DEP_ENABLE_CSR_REG7_ADDR A:&base_addr+0x9e07a8
y.create.l HWIO_RPMH_VRM_VOLTAGE_DEP_ENABLE_CSR_REG8_ADDR A:&base_addr+0x9e08a8
y.create.l HWIO_RPMH_VRM_VOLTAGE_DEP_ENABLE_CSR_REG9_ADDR A:&base_addr+0x9e09a8
y.create.l HWIO_RPMH_VRM_VOLTAGE_DEP_ENABLE_CSR_REG10_ADDR A:&base_addr+0x9e0aa8
y.create.l HWIO_RPMH_VRM_VOLTAGE_DEP_ENABLE_CSR_REG11_ADDR A:&base_addr+0x9e0ba8
y.create.l HWIO_RPMH_VRM_VOLTAGE_DEP_ENABLE_CSR_REG12_ADDR A:&base_addr+0x9e0ca8
y.create.l HWIO_RPMH_VRM_VOLTAGE_DEP_ENABLE_CSR_REG13_ADDR A:&base_addr+0x9e0da8
y.create.l HWIO_RPMH_VRM_VOLTAGE_DEP_ENABLE_CSR_REG14_ADDR A:&base_addr+0x9e0ea8
y.create.l HWIO_RPMH_VRM_VOLTAGE_DEP_ENABLE_CSR_REG15_ADDR A:&base_addr+0x9e0fa8
y.create.l HWIO_RPMH_VRM_VOLTAGE_DEP_ENABLE_CSR_REG16_ADDR A:&base_addr+0x9e10a8
y.create.l HWIO_RPMH_VRM_VOLTAGE_DEP_ENABLE_CSR_REG17_ADDR A:&base_addr+0x9e11a8
y.create.l HWIO_RPMH_VRM_VOLTAGE_DEP_ENABLE_CSR_REG18_ADDR A:&base_addr+0x9e12a8
y.create.l HWIO_RPMH_VRM_VOLTAGE_DEP_ENABLE_CSR_REG19_ADDR A:&base_addr+0x9e13a8
y.create.l HWIO_RPMH_VRM_VOLTAGE_DEP_ENABLE_CSR_REG20_ADDR A:&base_addr+0x9e14a8
y.create.l HWIO_RPMH_VRM_VOLTAGE_DEP_ENABLE_CSR_REG21_ADDR A:&base_addr+0x9e15a8
y.create.l HWIO_RPMH_VRM_VOLTAGE_DEP_ENABLE_CSR_REG22_ADDR A:&base_addr+0x9e16a8
y.create.l HWIO_RPMH_VRM_VOLTAGE_DEP_ENABLE_CSR_REG23_ADDR A:&base_addr+0x9e17a8
y.create.l HWIO_RPMH_VRM_VOLTAGE_DEP_ENABLE_CSR_REG24_ADDR A:&base_addr+0x9e18a8
y.create.l HWIO_RPMH_VRM_VOLTAGE_DEP_ENABLE_CSR_REG25_ADDR A:&base_addr+0x9e19a8
y.create.l HWIO_RPMH_VRM_VOLTAGE_DEP_ENABLE_CSR_REG26_ADDR A:&base_addr+0x9e1aa8
y.create.l HWIO_RPMH_VRM_VOLTAGE_DEP_ENABLE_CSR_REG27_ADDR A:&base_addr+0x9e1ba8
y.create.l HWIO_RPMH_VRM_VOLTAGE_DEP_ENABLE_CSR_REG28_ADDR A:&base_addr+0x9e1ca8
y.create.l HWIO_RPMH_VRM_VOLTAGE_DEP_ENABLE_CSR_REG29_ADDR A:&base_addr+0x9e1da8
y.create.l HWIO_RPMH_VRM_VOLTAGE_DEP_ENABLE_CSR_REG30_ADDR A:&base_addr+0x9e1ea8
y.create.l HWIO_RPMH_VRM_VOLTAGE_DEP_ENABLE_CSR_REG31_ADDR A:&base_addr+0x9e1fa8
y.create.l HWIO_RPMH_VRM_VOLTAGE_DEP_ENABLE_CSR_REG32_ADDR A:&base_addr+0x9e20a8
y.create.l HWIO_RPMH_VRM_VOLTAGE_DEP_ENABLE_CSR_REG33_ADDR A:&base_addr+0x9e21a8
y.create.l HWIO_RPMH_VRM_VOLTAGE_DEP_ENABLE_CSR_REG34_ADDR A:&base_addr+0x9e22a8
y.create.l HWIO_RPMH_VRM_VOLTAGE_DEP_ENABLE_CSR_REG35_ADDR A:&base_addr+0x9e23a8
y.create.l HWIO_RPMH_VRM_VOLTAGE_DEP_ENABLE_CSR_REG36_ADDR A:&base_addr+0x9e24a8
y.create.l HWIO_RPMH_VRM_VOLTAGE_DEP_ENABLE_CSR_REG37_ADDR A:&base_addr+0x9e25a8
y.create.l HWIO_RPMH_VRM_VOLTAGE_DEP_ENABLE_CSR_REG38_ADDR A:&base_addr+0x9e26a8
y.create.l HWIO_RPMH_VRM_VOLTAGE_DEP_ENABLE_CSR_REG39_ADDR A:&base_addr+0x9e27a8
y.create.l HWIO_RPMH_VRM_VOLTAGE_DEP_ENABLE_CSR_REG40_ADDR A:&base_addr+0x9e28a8
y.create.l HWIO_RPMH_VRM_VOLTAGE_DEP_ENABLE_CSR_REG41_ADDR A:&base_addr+0x9e29a8
y.create.l HWIO_RPMH_VRM_VOLTAGE_DEP_ENABLE_CSR_REG42_ADDR A:&base_addr+0x9e2aa8
y.create.l HWIO_RPMH_VRM_VOLTAGE_DEP_ENABLE_CSR_REG43_ADDR A:&base_addr+0x9e2ba8
y.create.l HWIO_RPMH_VRM_VOLTAGE_DEP_ENABLE_CSR_REG44_ADDR A:&base_addr+0x9e2ca8
y.create.l HWIO_RPMH_VRM_VOLTAGE_DEP_ENABLE_CSR_REG45_ADDR A:&base_addr+0x9e2da8
y.create.l HWIO_RPMH_VRM_ENABLE_DEP_ENABLE_CSR_REG0_ADDR A:&base_addr+0x9e00ac
y.create.l HWIO_RPMH_VRM_ENABLE_DEP_ENABLE_CSR_REG1_ADDR A:&base_addr+0x9e01ac
y.create.l HWIO_RPMH_VRM_ENABLE_DEP_ENABLE_CSR_REG2_ADDR A:&base_addr+0x9e02ac
y.create.l HWIO_RPMH_VRM_ENABLE_DEP_ENABLE_CSR_REG3_ADDR A:&base_addr+0x9e03ac
y.create.l HWIO_RPMH_VRM_ENABLE_DEP_ENABLE_CSR_REG4_ADDR A:&base_addr+0x9e04ac
y.create.l HWIO_RPMH_VRM_ENABLE_DEP_ENABLE_CSR_REG5_ADDR A:&base_addr+0x9e05ac
y.create.l HWIO_RPMH_VRM_ENABLE_DEP_ENABLE_CSR_REG6_ADDR A:&base_addr+0x9e06ac
y.create.l HWIO_RPMH_VRM_ENABLE_DEP_ENABLE_CSR_REG7_ADDR A:&base_addr+0x9e07ac
y.create.l HWIO_RPMH_VRM_ENABLE_DEP_ENABLE_CSR_REG8_ADDR A:&base_addr+0x9e08ac
y.create.l HWIO_RPMH_VRM_ENABLE_DEP_ENABLE_CSR_REG9_ADDR A:&base_addr+0x9e09ac
y.create.l HWIO_RPMH_VRM_ENABLE_DEP_ENABLE_CSR_REG10_ADDR A:&base_addr+0x9e0aac
y.create.l HWIO_RPMH_VRM_ENABLE_DEP_ENABLE_CSR_REG11_ADDR A:&base_addr+0x9e0bac
y.create.l HWIO_RPMH_VRM_ENABLE_DEP_ENABLE_CSR_REG12_ADDR A:&base_addr+0x9e0cac
y.create.l HWIO_RPMH_VRM_ENABLE_DEP_ENABLE_CSR_REG13_ADDR A:&base_addr+0x9e0dac
y.create.l HWIO_RPMH_VRM_ENABLE_DEP_ENABLE_CSR_REG14_ADDR A:&base_addr+0x9e0eac
y.create.l HWIO_RPMH_VRM_ENABLE_DEP_ENABLE_CSR_REG15_ADDR A:&base_addr+0x9e0fac
y.create.l HWIO_RPMH_VRM_ENABLE_DEP_ENABLE_CSR_REG16_ADDR A:&base_addr+0x9e10ac
y.create.l HWIO_RPMH_VRM_ENABLE_DEP_ENABLE_CSR_REG17_ADDR A:&base_addr+0x9e11ac
y.create.l HWIO_RPMH_VRM_ENABLE_DEP_ENABLE_CSR_REG18_ADDR A:&base_addr+0x9e12ac
y.create.l HWIO_RPMH_VRM_ENABLE_DEP_ENABLE_CSR_REG19_ADDR A:&base_addr+0x9e13ac
y.create.l HWIO_RPMH_VRM_ENABLE_DEP_ENABLE_CSR_REG20_ADDR A:&base_addr+0x9e14ac
y.create.l HWIO_RPMH_VRM_ENABLE_DEP_ENABLE_CSR_REG21_ADDR A:&base_addr+0x9e15ac
y.create.l HWIO_RPMH_VRM_ENABLE_DEP_ENABLE_CSR_REG22_ADDR A:&base_addr+0x9e16ac
y.create.l HWIO_RPMH_VRM_ENABLE_DEP_ENABLE_CSR_REG23_ADDR A:&base_addr+0x9e17ac
y.create.l HWIO_RPMH_VRM_ENABLE_DEP_ENABLE_CSR_REG24_ADDR A:&base_addr+0x9e18ac
y.create.l HWIO_RPMH_VRM_ENABLE_DEP_ENABLE_CSR_REG25_ADDR A:&base_addr+0x9e19ac
y.create.l HWIO_RPMH_VRM_ENABLE_DEP_ENABLE_CSR_REG26_ADDR A:&base_addr+0x9e1aac
y.create.l HWIO_RPMH_VRM_ENABLE_DEP_ENABLE_CSR_REG27_ADDR A:&base_addr+0x9e1bac
y.create.l HWIO_RPMH_VRM_ENABLE_DEP_ENABLE_CSR_REG28_ADDR A:&base_addr+0x9e1cac
y.create.l HWIO_RPMH_VRM_ENABLE_DEP_ENABLE_CSR_REG29_ADDR A:&base_addr+0x9e1dac
y.create.l HWIO_RPMH_VRM_ENABLE_DEP_ENABLE_CSR_REG30_ADDR A:&base_addr+0x9e1eac
y.create.l HWIO_RPMH_VRM_ENABLE_DEP_ENABLE_CSR_REG31_ADDR A:&base_addr+0x9e1fac
y.create.l HWIO_RPMH_VRM_ENABLE_DEP_ENABLE_CSR_REG32_ADDR A:&base_addr+0x9e20ac
y.create.l HWIO_RPMH_VRM_ENABLE_DEP_ENABLE_CSR_REG33_ADDR A:&base_addr+0x9e21ac
y.create.l HWIO_RPMH_VRM_ENABLE_DEP_ENABLE_CSR_REG34_ADDR A:&base_addr+0x9e22ac
y.create.l HWIO_RPMH_VRM_ENABLE_DEP_ENABLE_CSR_REG35_ADDR A:&base_addr+0x9e23ac
y.create.l HWIO_RPMH_VRM_ENABLE_DEP_ENABLE_CSR_REG36_ADDR A:&base_addr+0x9e24ac
y.create.l HWIO_RPMH_VRM_ENABLE_DEP_ENABLE_CSR_REG37_ADDR A:&base_addr+0x9e25ac
y.create.l HWIO_RPMH_VRM_ENABLE_DEP_ENABLE_CSR_REG38_ADDR A:&base_addr+0x9e26ac
y.create.l HWIO_RPMH_VRM_ENABLE_DEP_ENABLE_CSR_REG39_ADDR A:&base_addr+0x9e27ac
y.create.l HWIO_RPMH_VRM_ENABLE_DEP_ENABLE_CSR_REG40_ADDR A:&base_addr+0x9e28ac
y.create.l HWIO_RPMH_VRM_ENABLE_DEP_ENABLE_CSR_REG41_ADDR A:&base_addr+0x9e29ac
y.create.l HWIO_RPMH_VRM_ENABLE_DEP_ENABLE_CSR_REG42_ADDR A:&base_addr+0x9e2aac
y.create.l HWIO_RPMH_VRM_ENABLE_DEP_ENABLE_CSR_REG43_ADDR A:&base_addr+0x9e2bac
y.create.l HWIO_RPMH_VRM_ENABLE_DEP_ENABLE_CSR_REG44_ADDR A:&base_addr+0x9e2cac
y.create.l HWIO_RPMH_VRM_ENABLE_DEP_ENABLE_CSR_REG45_ADDR A:&base_addr+0x9e2dac
y.create.l HWIO_RPMH_VRM_MODE_DEP_ENABLE_CSR_REG0_ADDR A:&base_addr+0x9e00b0
y.create.l HWIO_RPMH_VRM_MODE_DEP_ENABLE_CSR_REG1_ADDR A:&base_addr+0x9e01b0
y.create.l HWIO_RPMH_VRM_MODE_DEP_ENABLE_CSR_REG2_ADDR A:&base_addr+0x9e02b0
y.create.l HWIO_RPMH_VRM_MODE_DEP_ENABLE_CSR_REG3_ADDR A:&base_addr+0x9e03b0
y.create.l HWIO_RPMH_VRM_MODE_DEP_ENABLE_CSR_REG4_ADDR A:&base_addr+0x9e04b0
y.create.l HWIO_RPMH_VRM_MODE_DEP_ENABLE_CSR_REG5_ADDR A:&base_addr+0x9e05b0
y.create.l HWIO_RPMH_VRM_MODE_DEP_ENABLE_CSR_REG6_ADDR A:&base_addr+0x9e06b0
y.create.l HWIO_RPMH_VRM_MODE_DEP_ENABLE_CSR_REG7_ADDR A:&base_addr+0x9e07b0
y.create.l HWIO_RPMH_VRM_MODE_DEP_ENABLE_CSR_REG8_ADDR A:&base_addr+0x9e08b0
y.create.l HWIO_RPMH_VRM_MODE_DEP_ENABLE_CSR_REG9_ADDR A:&base_addr+0x9e09b0
y.create.l HWIO_RPMH_VRM_MODE_DEP_ENABLE_CSR_REG10_ADDR A:&base_addr+0x9e0ab0
y.create.l HWIO_RPMH_VRM_MODE_DEP_ENABLE_CSR_REG11_ADDR A:&base_addr+0x9e0bb0
y.create.l HWIO_RPMH_VRM_MODE_DEP_ENABLE_CSR_REG12_ADDR A:&base_addr+0x9e0cb0
y.create.l HWIO_RPMH_VRM_MODE_DEP_ENABLE_CSR_REG13_ADDR A:&base_addr+0x9e0db0
y.create.l HWIO_RPMH_VRM_MODE_DEP_ENABLE_CSR_REG14_ADDR A:&base_addr+0x9e0eb0
y.create.l HWIO_RPMH_VRM_MODE_DEP_ENABLE_CSR_REG15_ADDR A:&base_addr+0x9e0fb0
y.create.l HWIO_RPMH_VRM_MODE_DEP_ENABLE_CSR_REG16_ADDR A:&base_addr+0x9e10b0
y.create.l HWIO_RPMH_VRM_MODE_DEP_ENABLE_CSR_REG17_ADDR A:&base_addr+0x9e11b0
y.create.l HWIO_RPMH_VRM_MODE_DEP_ENABLE_CSR_REG18_ADDR A:&base_addr+0x9e12b0
y.create.l HWIO_RPMH_VRM_MODE_DEP_ENABLE_CSR_REG19_ADDR A:&base_addr+0x9e13b0
y.create.l HWIO_RPMH_VRM_MODE_DEP_ENABLE_CSR_REG20_ADDR A:&base_addr+0x9e14b0
y.create.l HWIO_RPMH_VRM_MODE_DEP_ENABLE_CSR_REG21_ADDR A:&base_addr+0x9e15b0
y.create.l HWIO_RPMH_VRM_MODE_DEP_ENABLE_CSR_REG22_ADDR A:&base_addr+0x9e16b0
y.create.l HWIO_RPMH_VRM_MODE_DEP_ENABLE_CSR_REG23_ADDR A:&base_addr+0x9e17b0
y.create.l HWIO_RPMH_VRM_MODE_DEP_ENABLE_CSR_REG24_ADDR A:&base_addr+0x9e18b0
y.create.l HWIO_RPMH_VRM_MODE_DEP_ENABLE_CSR_REG25_ADDR A:&base_addr+0x9e19b0
y.create.l HWIO_RPMH_VRM_MODE_DEP_ENABLE_CSR_REG26_ADDR A:&base_addr+0x9e1ab0
y.create.l HWIO_RPMH_VRM_MODE_DEP_ENABLE_CSR_REG27_ADDR A:&base_addr+0x9e1bb0
y.create.l HWIO_RPMH_VRM_MODE_DEP_ENABLE_CSR_REG28_ADDR A:&base_addr+0x9e1cb0
y.create.l HWIO_RPMH_VRM_MODE_DEP_ENABLE_CSR_REG29_ADDR A:&base_addr+0x9e1db0
y.create.l HWIO_RPMH_VRM_MODE_DEP_ENABLE_CSR_REG30_ADDR A:&base_addr+0x9e1eb0
y.create.l HWIO_RPMH_VRM_MODE_DEP_ENABLE_CSR_REG31_ADDR A:&base_addr+0x9e1fb0
y.create.l HWIO_RPMH_VRM_MODE_DEP_ENABLE_CSR_REG32_ADDR A:&base_addr+0x9e20b0
y.create.l HWIO_RPMH_VRM_MODE_DEP_ENABLE_CSR_REG33_ADDR A:&base_addr+0x9e21b0
y.create.l HWIO_RPMH_VRM_MODE_DEP_ENABLE_CSR_REG34_ADDR A:&base_addr+0x9e22b0
y.create.l HWIO_RPMH_VRM_MODE_DEP_ENABLE_CSR_REG35_ADDR A:&base_addr+0x9e23b0
y.create.l HWIO_RPMH_VRM_MODE_DEP_ENABLE_CSR_REG36_ADDR A:&base_addr+0x9e24b0
y.create.l HWIO_RPMH_VRM_MODE_DEP_ENABLE_CSR_REG37_ADDR A:&base_addr+0x9e25b0
y.create.l HWIO_RPMH_VRM_MODE_DEP_ENABLE_CSR_REG38_ADDR A:&base_addr+0x9e26b0
y.create.l HWIO_RPMH_VRM_MODE_DEP_ENABLE_CSR_REG39_ADDR A:&base_addr+0x9e27b0
y.create.l HWIO_RPMH_VRM_MODE_DEP_ENABLE_CSR_REG40_ADDR A:&base_addr+0x9e28b0
y.create.l HWIO_RPMH_VRM_MODE_DEP_ENABLE_CSR_REG41_ADDR A:&base_addr+0x9e29b0
y.create.l HWIO_RPMH_VRM_MODE_DEP_ENABLE_CSR_REG42_ADDR A:&base_addr+0x9e2ab0
y.create.l HWIO_RPMH_VRM_MODE_DEP_ENABLE_CSR_REG43_ADDR A:&base_addr+0x9e2bb0
y.create.l HWIO_RPMH_VRM_MODE_DEP_ENABLE_CSR_REG44_ADDR A:&base_addr+0x9e2cb0
y.create.l HWIO_RPMH_VRM_MODE_DEP_ENABLE_CSR_REG45_ADDR A:&base_addr+0x9e2db0
y.create.l HWIO_RPMH_VRM_HEADROOM_DEP_ENABLE_CSR_REG0_ADDR A:&base_addr+0x9e00b4
y.create.l HWIO_RPMH_VRM_HEADROOM_DEP_ENABLE_CSR_REG1_ADDR A:&base_addr+0x9e01b4
y.create.l HWIO_RPMH_VRM_HEADROOM_DEP_ENABLE_CSR_REG2_ADDR A:&base_addr+0x9e02b4
y.create.l HWIO_RPMH_VRM_HEADROOM_DEP_ENABLE_CSR_REG3_ADDR A:&base_addr+0x9e03b4
y.create.l HWIO_RPMH_VRM_HEADROOM_DEP_ENABLE_CSR_REG4_ADDR A:&base_addr+0x9e04b4
y.create.l HWIO_RPMH_VRM_HEADROOM_DEP_ENABLE_CSR_REG5_ADDR A:&base_addr+0x9e05b4
y.create.l HWIO_RPMH_VRM_HEADROOM_DEP_ENABLE_CSR_REG6_ADDR A:&base_addr+0x9e06b4
y.create.l HWIO_RPMH_VRM_HEADROOM_DEP_ENABLE_CSR_REG7_ADDR A:&base_addr+0x9e07b4
y.create.l HWIO_RPMH_VRM_HEADROOM_DEP_ENABLE_CSR_REG8_ADDR A:&base_addr+0x9e08b4
y.create.l HWIO_RPMH_VRM_HEADROOM_DEP_ENABLE_CSR_REG9_ADDR A:&base_addr+0x9e09b4
y.create.l HWIO_RPMH_VRM_HEADROOM_DEP_ENABLE_CSR_REG10_ADDR A:&base_addr+0x9e0ab4
y.create.l HWIO_RPMH_VRM_HEADROOM_DEP_ENABLE_CSR_REG11_ADDR A:&base_addr+0x9e0bb4
y.create.l HWIO_RPMH_VRM_HEADROOM_DEP_ENABLE_CSR_REG12_ADDR A:&base_addr+0x9e0cb4
y.create.l HWIO_RPMH_VRM_HEADROOM_DEP_ENABLE_CSR_REG13_ADDR A:&base_addr+0x9e0db4
y.create.l HWIO_RPMH_VRM_HEADROOM_DEP_ENABLE_CSR_REG14_ADDR A:&base_addr+0x9e0eb4
y.create.l HWIO_RPMH_VRM_HEADROOM_DEP_ENABLE_CSR_REG15_ADDR A:&base_addr+0x9e0fb4
y.create.l HWIO_RPMH_VRM_HEADROOM_DEP_ENABLE_CSR_REG16_ADDR A:&base_addr+0x9e10b4
y.create.l HWIO_RPMH_VRM_HEADROOM_DEP_ENABLE_CSR_REG17_ADDR A:&base_addr+0x9e11b4
y.create.l HWIO_RPMH_VRM_HEADROOM_DEP_ENABLE_CSR_REG18_ADDR A:&base_addr+0x9e12b4
y.create.l HWIO_RPMH_VRM_HEADROOM_DEP_ENABLE_CSR_REG19_ADDR A:&base_addr+0x9e13b4
y.create.l HWIO_RPMH_VRM_HEADROOM_DEP_ENABLE_CSR_REG20_ADDR A:&base_addr+0x9e14b4
y.create.l HWIO_RPMH_VRM_HEADROOM_DEP_ENABLE_CSR_REG21_ADDR A:&base_addr+0x9e15b4
y.create.l HWIO_RPMH_VRM_HEADROOM_DEP_ENABLE_CSR_REG22_ADDR A:&base_addr+0x9e16b4
y.create.l HWIO_RPMH_VRM_HEADROOM_DEP_ENABLE_CSR_REG23_ADDR A:&base_addr+0x9e17b4
y.create.l HWIO_RPMH_VRM_HEADROOM_DEP_ENABLE_CSR_REG24_ADDR A:&base_addr+0x9e18b4
y.create.l HWIO_RPMH_VRM_HEADROOM_DEP_ENABLE_CSR_REG25_ADDR A:&base_addr+0x9e19b4
y.create.l HWIO_RPMH_VRM_HEADROOM_DEP_ENABLE_CSR_REG26_ADDR A:&base_addr+0x9e1ab4
y.create.l HWIO_RPMH_VRM_HEADROOM_DEP_ENABLE_CSR_REG27_ADDR A:&base_addr+0x9e1bb4
y.create.l HWIO_RPMH_VRM_HEADROOM_DEP_ENABLE_CSR_REG28_ADDR A:&base_addr+0x9e1cb4
y.create.l HWIO_RPMH_VRM_HEADROOM_DEP_ENABLE_CSR_REG29_ADDR A:&base_addr+0x9e1db4
y.create.l HWIO_RPMH_VRM_HEADROOM_DEP_ENABLE_CSR_REG30_ADDR A:&base_addr+0x9e1eb4
y.create.l HWIO_RPMH_VRM_HEADROOM_DEP_ENABLE_CSR_REG31_ADDR A:&base_addr+0x9e1fb4
y.create.l HWIO_RPMH_VRM_HEADROOM_DEP_ENABLE_CSR_REG32_ADDR A:&base_addr+0x9e20b4
y.create.l HWIO_RPMH_VRM_HEADROOM_DEP_ENABLE_CSR_REG33_ADDR A:&base_addr+0x9e21b4
y.create.l HWIO_RPMH_VRM_HEADROOM_DEP_ENABLE_CSR_REG34_ADDR A:&base_addr+0x9e22b4
y.create.l HWIO_RPMH_VRM_HEADROOM_DEP_ENABLE_CSR_REG35_ADDR A:&base_addr+0x9e23b4
y.create.l HWIO_RPMH_VRM_HEADROOM_DEP_ENABLE_CSR_REG36_ADDR A:&base_addr+0x9e24b4
y.create.l HWIO_RPMH_VRM_HEADROOM_DEP_ENABLE_CSR_REG37_ADDR A:&base_addr+0x9e25b4
y.create.l HWIO_RPMH_VRM_HEADROOM_DEP_ENABLE_CSR_REG38_ADDR A:&base_addr+0x9e26b4
y.create.l HWIO_RPMH_VRM_HEADROOM_DEP_ENABLE_CSR_REG39_ADDR A:&base_addr+0x9e27b4
y.create.l HWIO_RPMH_VRM_HEADROOM_DEP_ENABLE_CSR_REG40_ADDR A:&base_addr+0x9e28b4
y.create.l HWIO_RPMH_VRM_HEADROOM_DEP_ENABLE_CSR_REG41_ADDR A:&base_addr+0x9e29b4
y.create.l HWIO_RPMH_VRM_HEADROOM_DEP_ENABLE_CSR_REG42_ADDR A:&base_addr+0x9e2ab4
y.create.l HWIO_RPMH_VRM_HEADROOM_DEP_ENABLE_CSR_REG43_ADDR A:&base_addr+0x9e2bb4
y.create.l HWIO_RPMH_VRM_HEADROOM_DEP_ENABLE_CSR_REG44_ADDR A:&base_addr+0x9e2cb4
y.create.l HWIO_RPMH_VRM_HEADROOM_DEP_ENABLE_CSR_REG45_ADDR A:&base_addr+0x9e2db4
y.create.l HWIO_RPMH_VRM_VOLTAGE_SETTLING_BLOCK_ENABLE_CSR_REG0_ADDR A:&base_addr+0x9e00c4
y.create.l HWIO_RPMH_VRM_VOLTAGE_SETTLING_BLOCK_ENABLE_CSR_REG1_ADDR A:&base_addr+0x9e01c4
y.create.l HWIO_RPMH_VRM_VOLTAGE_SETTLING_BLOCK_ENABLE_CSR_REG2_ADDR A:&base_addr+0x9e02c4
y.create.l HWIO_RPMH_VRM_VOLTAGE_SETTLING_BLOCK_ENABLE_CSR_REG3_ADDR A:&base_addr+0x9e03c4
y.create.l HWIO_RPMH_VRM_VOLTAGE_SETTLING_BLOCK_ENABLE_CSR_REG4_ADDR A:&base_addr+0x9e04c4
y.create.l HWIO_RPMH_VRM_VOLTAGE_SETTLING_BLOCK_ENABLE_CSR_REG5_ADDR A:&base_addr+0x9e05c4
y.create.l HWIO_RPMH_VRM_VOLTAGE_SETTLING_BLOCK_ENABLE_CSR_REG6_ADDR A:&base_addr+0x9e06c4
y.create.l HWIO_RPMH_VRM_VOLTAGE_SETTLING_BLOCK_ENABLE_CSR_REG7_ADDR A:&base_addr+0x9e07c4
y.create.l HWIO_RPMH_VRM_VOLTAGE_SETTLING_BLOCK_ENABLE_CSR_REG8_ADDR A:&base_addr+0x9e08c4
y.create.l HWIO_RPMH_VRM_VOLTAGE_SETTLING_BLOCK_ENABLE_CSR_REG9_ADDR A:&base_addr+0x9e09c4
y.create.l HWIO_RPMH_VRM_VOLTAGE_SETTLING_BLOCK_ENABLE_CSR_REG10_ADDR A:&base_addr+0x9e0ac4
y.create.l HWIO_RPMH_VRM_VOLTAGE_SETTLING_BLOCK_ENABLE_CSR_REG11_ADDR A:&base_addr+0x9e0bc4
y.create.l HWIO_RPMH_VRM_VOLTAGE_SETTLING_BLOCK_ENABLE_CSR_REG12_ADDR A:&base_addr+0x9e0cc4
y.create.l HWIO_RPMH_VRM_VOLTAGE_SETTLING_BLOCK_ENABLE_CSR_REG13_ADDR A:&base_addr+0x9e0dc4
y.create.l HWIO_RPMH_VRM_VOLTAGE_SETTLING_BLOCK_ENABLE_CSR_REG14_ADDR A:&base_addr+0x9e0ec4
y.create.l HWIO_RPMH_VRM_VOLTAGE_SETTLING_BLOCK_ENABLE_CSR_REG15_ADDR A:&base_addr+0x9e0fc4
y.create.l HWIO_RPMH_VRM_VOLTAGE_SETTLING_BLOCK_ENABLE_CSR_REG16_ADDR A:&base_addr+0x9e10c4
y.create.l HWIO_RPMH_VRM_VOLTAGE_SETTLING_BLOCK_ENABLE_CSR_REG17_ADDR A:&base_addr+0x9e11c4
y.create.l HWIO_RPMH_VRM_VOLTAGE_SETTLING_BLOCK_ENABLE_CSR_REG18_ADDR A:&base_addr+0x9e12c4
y.create.l HWIO_RPMH_VRM_VOLTAGE_SETTLING_BLOCK_ENABLE_CSR_REG19_ADDR A:&base_addr+0x9e13c4
y.create.l HWIO_RPMH_VRM_VOLTAGE_SETTLING_BLOCK_ENABLE_CSR_REG20_ADDR A:&base_addr+0x9e14c4
y.create.l HWIO_RPMH_VRM_VOLTAGE_SETTLING_BLOCK_ENABLE_CSR_REG21_ADDR A:&base_addr+0x9e15c4
y.create.l HWIO_RPMH_VRM_VOLTAGE_SETTLING_BLOCK_ENABLE_CSR_REG22_ADDR A:&base_addr+0x9e16c4
y.create.l HWIO_RPMH_VRM_VOLTAGE_SETTLING_BLOCK_ENABLE_CSR_REG23_ADDR A:&base_addr+0x9e17c4
y.create.l HWIO_RPMH_VRM_VOLTAGE_SETTLING_BLOCK_ENABLE_CSR_REG24_ADDR A:&base_addr+0x9e18c4
y.create.l HWIO_RPMH_VRM_VOLTAGE_SETTLING_BLOCK_ENABLE_CSR_REG25_ADDR A:&base_addr+0x9e19c4
y.create.l HWIO_RPMH_VRM_VOLTAGE_SETTLING_BLOCK_ENABLE_CSR_REG26_ADDR A:&base_addr+0x9e1ac4
y.create.l HWIO_RPMH_VRM_VOLTAGE_SETTLING_BLOCK_ENABLE_CSR_REG27_ADDR A:&base_addr+0x9e1bc4
y.create.l HWIO_RPMH_VRM_VOLTAGE_SETTLING_BLOCK_ENABLE_CSR_REG28_ADDR A:&base_addr+0x9e1cc4
y.create.l HWIO_RPMH_VRM_VOLTAGE_SETTLING_BLOCK_ENABLE_CSR_REG29_ADDR A:&base_addr+0x9e1dc4
y.create.l HWIO_RPMH_VRM_VOLTAGE_SETTLING_BLOCK_ENABLE_CSR_REG30_ADDR A:&base_addr+0x9e1ec4
y.create.l HWIO_RPMH_VRM_VOLTAGE_SETTLING_BLOCK_ENABLE_CSR_REG31_ADDR A:&base_addr+0x9e1fc4
y.create.l HWIO_RPMH_VRM_VOLTAGE_SETTLING_BLOCK_ENABLE_CSR_REG32_ADDR A:&base_addr+0x9e20c4
y.create.l HWIO_RPMH_VRM_VOLTAGE_SETTLING_BLOCK_ENABLE_CSR_REG33_ADDR A:&base_addr+0x9e21c4
y.create.l HWIO_RPMH_VRM_VOLTAGE_SETTLING_BLOCK_ENABLE_CSR_REG34_ADDR A:&base_addr+0x9e22c4
y.create.l HWIO_RPMH_VRM_VOLTAGE_SETTLING_BLOCK_ENABLE_CSR_REG35_ADDR A:&base_addr+0x9e23c4
y.create.l HWIO_RPMH_VRM_VOLTAGE_SETTLING_BLOCK_ENABLE_CSR_REG36_ADDR A:&base_addr+0x9e24c4
y.create.l HWIO_RPMH_VRM_VOLTAGE_SETTLING_BLOCK_ENABLE_CSR_REG37_ADDR A:&base_addr+0x9e25c4
y.create.l HWIO_RPMH_VRM_VOLTAGE_SETTLING_BLOCK_ENABLE_CSR_REG38_ADDR A:&base_addr+0x9e26c4
y.create.l HWIO_RPMH_VRM_VOLTAGE_SETTLING_BLOCK_ENABLE_CSR_REG39_ADDR A:&base_addr+0x9e27c4
y.create.l HWIO_RPMH_VRM_VOLTAGE_SETTLING_BLOCK_ENABLE_CSR_REG40_ADDR A:&base_addr+0x9e28c4
y.create.l HWIO_RPMH_VRM_VOLTAGE_SETTLING_BLOCK_ENABLE_CSR_REG41_ADDR A:&base_addr+0x9e29c4
y.create.l HWIO_RPMH_VRM_VOLTAGE_SETTLING_BLOCK_ENABLE_CSR_REG42_ADDR A:&base_addr+0x9e2ac4
y.create.l HWIO_RPMH_VRM_VOLTAGE_SETTLING_BLOCK_ENABLE_CSR_REG43_ADDR A:&base_addr+0x9e2bc4
y.create.l HWIO_RPMH_VRM_VOLTAGE_SETTLING_BLOCK_ENABLE_CSR_REG44_ADDR A:&base_addr+0x9e2cc4
y.create.l HWIO_RPMH_VRM_VOLTAGE_SETTLING_BLOCK_ENABLE_CSR_REG45_ADDR A:&base_addr+0x9e2dc4
y.create.l HWIO_RPMH_VRM_ENABLE_SETTLING_BLOCK_ENABLE_CSR_REG0_ADDR A:&base_addr+0x9e00c8
y.create.l HWIO_RPMH_VRM_ENABLE_SETTLING_BLOCK_ENABLE_CSR_REG1_ADDR A:&base_addr+0x9e01c8
y.create.l HWIO_RPMH_VRM_ENABLE_SETTLING_BLOCK_ENABLE_CSR_REG2_ADDR A:&base_addr+0x9e02c8
y.create.l HWIO_RPMH_VRM_ENABLE_SETTLING_BLOCK_ENABLE_CSR_REG3_ADDR A:&base_addr+0x9e03c8
y.create.l HWIO_RPMH_VRM_ENABLE_SETTLING_BLOCK_ENABLE_CSR_REG4_ADDR A:&base_addr+0x9e04c8
y.create.l HWIO_RPMH_VRM_ENABLE_SETTLING_BLOCK_ENABLE_CSR_REG5_ADDR A:&base_addr+0x9e05c8
y.create.l HWIO_RPMH_VRM_ENABLE_SETTLING_BLOCK_ENABLE_CSR_REG6_ADDR A:&base_addr+0x9e06c8
y.create.l HWIO_RPMH_VRM_ENABLE_SETTLING_BLOCK_ENABLE_CSR_REG7_ADDR A:&base_addr+0x9e07c8
y.create.l HWIO_RPMH_VRM_ENABLE_SETTLING_BLOCK_ENABLE_CSR_REG8_ADDR A:&base_addr+0x9e08c8
y.create.l HWIO_RPMH_VRM_ENABLE_SETTLING_BLOCK_ENABLE_CSR_REG9_ADDR A:&base_addr+0x9e09c8
y.create.l HWIO_RPMH_VRM_ENABLE_SETTLING_BLOCK_ENABLE_CSR_REG10_ADDR A:&base_addr+0x9e0ac8
y.create.l HWIO_RPMH_VRM_ENABLE_SETTLING_BLOCK_ENABLE_CSR_REG11_ADDR A:&base_addr+0x9e0bc8
y.create.l HWIO_RPMH_VRM_ENABLE_SETTLING_BLOCK_ENABLE_CSR_REG12_ADDR A:&base_addr+0x9e0cc8
y.create.l HWIO_RPMH_VRM_ENABLE_SETTLING_BLOCK_ENABLE_CSR_REG13_ADDR A:&base_addr+0x9e0dc8
y.create.l HWIO_RPMH_VRM_ENABLE_SETTLING_BLOCK_ENABLE_CSR_REG14_ADDR A:&base_addr+0x9e0ec8
y.create.l HWIO_RPMH_VRM_ENABLE_SETTLING_BLOCK_ENABLE_CSR_REG15_ADDR A:&base_addr+0x9e0fc8
y.create.l HWIO_RPMH_VRM_ENABLE_SETTLING_BLOCK_ENABLE_CSR_REG16_ADDR A:&base_addr+0x9e10c8
y.create.l HWIO_RPMH_VRM_ENABLE_SETTLING_BLOCK_ENABLE_CSR_REG17_ADDR A:&base_addr+0x9e11c8
y.create.l HWIO_RPMH_VRM_ENABLE_SETTLING_BLOCK_ENABLE_CSR_REG18_ADDR A:&base_addr+0x9e12c8
y.create.l HWIO_RPMH_VRM_ENABLE_SETTLING_BLOCK_ENABLE_CSR_REG19_ADDR A:&base_addr+0x9e13c8
y.create.l HWIO_RPMH_VRM_ENABLE_SETTLING_BLOCK_ENABLE_CSR_REG20_ADDR A:&base_addr+0x9e14c8
y.create.l HWIO_RPMH_VRM_ENABLE_SETTLING_BLOCK_ENABLE_CSR_REG21_ADDR A:&base_addr+0x9e15c8
y.create.l HWIO_RPMH_VRM_ENABLE_SETTLING_BLOCK_ENABLE_CSR_REG22_ADDR A:&base_addr+0x9e16c8
y.create.l HWIO_RPMH_VRM_ENABLE_SETTLING_BLOCK_ENABLE_CSR_REG23_ADDR A:&base_addr+0x9e17c8
y.create.l HWIO_RPMH_VRM_ENABLE_SETTLING_BLOCK_ENABLE_CSR_REG24_ADDR A:&base_addr+0x9e18c8
y.create.l HWIO_RPMH_VRM_ENABLE_SETTLING_BLOCK_ENABLE_CSR_REG25_ADDR A:&base_addr+0x9e19c8
y.create.l HWIO_RPMH_VRM_ENABLE_SETTLING_BLOCK_ENABLE_CSR_REG26_ADDR A:&base_addr+0x9e1ac8
y.create.l HWIO_RPMH_VRM_ENABLE_SETTLING_BLOCK_ENABLE_CSR_REG27_ADDR A:&base_addr+0x9e1bc8
y.create.l HWIO_RPMH_VRM_ENABLE_SETTLING_BLOCK_ENABLE_CSR_REG28_ADDR A:&base_addr+0x9e1cc8
y.create.l HWIO_RPMH_VRM_ENABLE_SETTLING_BLOCK_ENABLE_CSR_REG29_ADDR A:&base_addr+0x9e1dc8
y.create.l HWIO_RPMH_VRM_ENABLE_SETTLING_BLOCK_ENABLE_CSR_REG30_ADDR A:&base_addr+0x9e1ec8
y.create.l HWIO_RPMH_VRM_ENABLE_SETTLING_BLOCK_ENABLE_CSR_REG31_ADDR A:&base_addr+0x9e1fc8
y.create.l HWIO_RPMH_VRM_ENABLE_SETTLING_BLOCK_ENABLE_CSR_REG32_ADDR A:&base_addr+0x9e20c8
y.create.l HWIO_RPMH_VRM_ENABLE_SETTLING_BLOCK_ENABLE_CSR_REG33_ADDR A:&base_addr+0x9e21c8
y.create.l HWIO_RPMH_VRM_ENABLE_SETTLING_BLOCK_ENABLE_CSR_REG34_ADDR A:&base_addr+0x9e22c8
y.create.l HWIO_RPMH_VRM_ENABLE_SETTLING_BLOCK_ENABLE_CSR_REG35_ADDR A:&base_addr+0x9e23c8
y.create.l HWIO_RPMH_VRM_ENABLE_SETTLING_BLOCK_ENABLE_CSR_REG36_ADDR A:&base_addr+0x9e24c8
y.create.l HWIO_RPMH_VRM_ENABLE_SETTLING_BLOCK_ENABLE_CSR_REG37_ADDR A:&base_addr+0x9e25c8
y.create.l HWIO_RPMH_VRM_ENABLE_SETTLING_BLOCK_ENABLE_CSR_REG38_ADDR A:&base_addr+0x9e26c8
y.create.l HWIO_RPMH_VRM_ENABLE_SETTLING_BLOCK_ENABLE_CSR_REG39_ADDR A:&base_addr+0x9e27c8
y.create.l HWIO_RPMH_VRM_ENABLE_SETTLING_BLOCK_ENABLE_CSR_REG40_ADDR A:&base_addr+0x9e28c8
y.create.l HWIO_RPMH_VRM_ENABLE_SETTLING_BLOCK_ENABLE_CSR_REG41_ADDR A:&base_addr+0x9e29c8
y.create.l HWIO_RPMH_VRM_ENABLE_SETTLING_BLOCK_ENABLE_CSR_REG42_ADDR A:&base_addr+0x9e2ac8
y.create.l HWIO_RPMH_VRM_ENABLE_SETTLING_BLOCK_ENABLE_CSR_REG43_ADDR A:&base_addr+0x9e2bc8
y.create.l HWIO_RPMH_VRM_ENABLE_SETTLING_BLOCK_ENABLE_CSR_REG44_ADDR A:&base_addr+0x9e2cc8
y.create.l HWIO_RPMH_VRM_ENABLE_SETTLING_BLOCK_ENABLE_CSR_REG45_ADDR A:&base_addr+0x9e2dc8
y.create.l HWIO_RPMH_VRM_MODE_SETTLING_BLOCK_ENABLE_CSR_REG0_ADDR A:&base_addr+0x9e00cc
y.create.l HWIO_RPMH_VRM_MODE_SETTLING_BLOCK_ENABLE_CSR_REG1_ADDR A:&base_addr+0x9e01cc
y.create.l HWIO_RPMH_VRM_MODE_SETTLING_BLOCK_ENABLE_CSR_REG2_ADDR A:&base_addr+0x9e02cc
y.create.l HWIO_RPMH_VRM_MODE_SETTLING_BLOCK_ENABLE_CSR_REG3_ADDR A:&base_addr+0x9e03cc
y.create.l HWIO_RPMH_VRM_MODE_SETTLING_BLOCK_ENABLE_CSR_REG4_ADDR A:&base_addr+0x9e04cc
y.create.l HWIO_RPMH_VRM_MODE_SETTLING_BLOCK_ENABLE_CSR_REG5_ADDR A:&base_addr+0x9e05cc
y.create.l HWIO_RPMH_VRM_MODE_SETTLING_BLOCK_ENABLE_CSR_REG6_ADDR A:&base_addr+0x9e06cc
y.create.l HWIO_RPMH_VRM_MODE_SETTLING_BLOCK_ENABLE_CSR_REG7_ADDR A:&base_addr+0x9e07cc
y.create.l HWIO_RPMH_VRM_MODE_SETTLING_BLOCK_ENABLE_CSR_REG8_ADDR A:&base_addr+0x9e08cc
y.create.l HWIO_RPMH_VRM_MODE_SETTLING_BLOCK_ENABLE_CSR_REG9_ADDR A:&base_addr+0x9e09cc
y.create.l HWIO_RPMH_VRM_MODE_SETTLING_BLOCK_ENABLE_CSR_REG10_ADDR A:&base_addr+0x9e0acc
y.create.l HWIO_RPMH_VRM_MODE_SETTLING_BLOCK_ENABLE_CSR_REG11_ADDR A:&base_addr+0x9e0bcc
y.create.l HWIO_RPMH_VRM_MODE_SETTLING_BLOCK_ENABLE_CSR_REG12_ADDR A:&base_addr+0x9e0ccc
y.create.l HWIO_RPMH_VRM_MODE_SETTLING_BLOCK_ENABLE_CSR_REG13_ADDR A:&base_addr+0x9e0dcc
y.create.l HWIO_RPMH_VRM_MODE_SETTLING_BLOCK_ENABLE_CSR_REG14_ADDR A:&base_addr+0x9e0ecc
y.create.l HWIO_RPMH_VRM_MODE_SETTLING_BLOCK_ENABLE_CSR_REG15_ADDR A:&base_addr+0x9e0fcc
y.create.l HWIO_RPMH_VRM_MODE_SETTLING_BLOCK_ENABLE_CSR_REG16_ADDR A:&base_addr+0x9e10cc
y.create.l HWIO_RPMH_VRM_MODE_SETTLING_BLOCK_ENABLE_CSR_REG17_ADDR A:&base_addr+0x9e11cc
y.create.l HWIO_RPMH_VRM_MODE_SETTLING_BLOCK_ENABLE_CSR_REG18_ADDR A:&base_addr+0x9e12cc
y.create.l HWIO_RPMH_VRM_MODE_SETTLING_BLOCK_ENABLE_CSR_REG19_ADDR A:&base_addr+0x9e13cc
y.create.l HWIO_RPMH_VRM_MODE_SETTLING_BLOCK_ENABLE_CSR_REG20_ADDR A:&base_addr+0x9e14cc
y.create.l HWIO_RPMH_VRM_MODE_SETTLING_BLOCK_ENABLE_CSR_REG21_ADDR A:&base_addr+0x9e15cc
y.create.l HWIO_RPMH_VRM_MODE_SETTLING_BLOCK_ENABLE_CSR_REG22_ADDR A:&base_addr+0x9e16cc
y.create.l HWIO_RPMH_VRM_MODE_SETTLING_BLOCK_ENABLE_CSR_REG23_ADDR A:&base_addr+0x9e17cc
y.create.l HWIO_RPMH_VRM_MODE_SETTLING_BLOCK_ENABLE_CSR_REG24_ADDR A:&base_addr+0x9e18cc
y.create.l HWIO_RPMH_VRM_MODE_SETTLING_BLOCK_ENABLE_CSR_REG25_ADDR A:&base_addr+0x9e19cc
y.create.l HWIO_RPMH_VRM_MODE_SETTLING_BLOCK_ENABLE_CSR_REG26_ADDR A:&base_addr+0x9e1acc
y.create.l HWIO_RPMH_VRM_MODE_SETTLING_BLOCK_ENABLE_CSR_REG27_ADDR A:&base_addr+0x9e1bcc
y.create.l HWIO_RPMH_VRM_MODE_SETTLING_BLOCK_ENABLE_CSR_REG28_ADDR A:&base_addr+0x9e1ccc
y.create.l HWIO_RPMH_VRM_MODE_SETTLING_BLOCK_ENABLE_CSR_REG29_ADDR A:&base_addr+0x9e1dcc
y.create.l HWIO_RPMH_VRM_MODE_SETTLING_BLOCK_ENABLE_CSR_REG30_ADDR A:&base_addr+0x9e1ecc
y.create.l HWIO_RPMH_VRM_MODE_SETTLING_BLOCK_ENABLE_CSR_REG31_ADDR A:&base_addr+0x9e1fcc
y.create.l HWIO_RPMH_VRM_MODE_SETTLING_BLOCK_ENABLE_CSR_REG32_ADDR A:&base_addr+0x9e20cc
y.create.l HWIO_RPMH_VRM_MODE_SETTLING_BLOCK_ENABLE_CSR_REG33_ADDR A:&base_addr+0x9e21cc
y.create.l HWIO_RPMH_VRM_MODE_SETTLING_BLOCK_ENABLE_CSR_REG34_ADDR A:&base_addr+0x9e22cc
y.create.l HWIO_RPMH_VRM_MODE_SETTLING_BLOCK_ENABLE_CSR_REG35_ADDR A:&base_addr+0x9e23cc
y.create.l HWIO_RPMH_VRM_MODE_SETTLING_BLOCK_ENABLE_CSR_REG36_ADDR A:&base_addr+0x9e24cc
y.create.l HWIO_RPMH_VRM_MODE_SETTLING_BLOCK_ENABLE_CSR_REG37_ADDR A:&base_addr+0x9e25cc
y.create.l HWIO_RPMH_VRM_MODE_SETTLING_BLOCK_ENABLE_CSR_REG38_ADDR A:&base_addr+0x9e26cc
y.create.l HWIO_RPMH_VRM_MODE_SETTLING_BLOCK_ENABLE_CSR_REG39_ADDR A:&base_addr+0x9e27cc
y.create.l HWIO_RPMH_VRM_MODE_SETTLING_BLOCK_ENABLE_CSR_REG40_ADDR A:&base_addr+0x9e28cc
y.create.l HWIO_RPMH_VRM_MODE_SETTLING_BLOCK_ENABLE_CSR_REG41_ADDR A:&base_addr+0x9e29cc
y.create.l HWIO_RPMH_VRM_MODE_SETTLING_BLOCK_ENABLE_CSR_REG42_ADDR A:&base_addr+0x9e2acc
y.create.l HWIO_RPMH_VRM_MODE_SETTLING_BLOCK_ENABLE_CSR_REG43_ADDR A:&base_addr+0x9e2bcc
y.create.l HWIO_RPMH_VRM_MODE_SETTLING_BLOCK_ENABLE_CSR_REG44_ADDR A:&base_addr+0x9e2ccc
y.create.l HWIO_RPMH_VRM_MODE_SETTLING_BLOCK_ENABLE_CSR_REG45_ADDR A:&base_addr+0x9e2dcc
y.create.l HWIO_RPMH_VRM_HEADROOM_SETTLING_BLOCK_ENABLE_CSR_REG0_ADDR A:&base_addr+0x9e00d0
y.create.l HWIO_RPMH_VRM_HEADROOM_SETTLING_BLOCK_ENABLE_CSR_REG1_ADDR A:&base_addr+0x9e01d0
y.create.l HWIO_RPMH_VRM_HEADROOM_SETTLING_BLOCK_ENABLE_CSR_REG2_ADDR A:&base_addr+0x9e02d0
y.create.l HWIO_RPMH_VRM_HEADROOM_SETTLING_BLOCK_ENABLE_CSR_REG3_ADDR A:&base_addr+0x9e03d0
y.create.l HWIO_RPMH_VRM_HEADROOM_SETTLING_BLOCK_ENABLE_CSR_REG4_ADDR A:&base_addr+0x9e04d0
y.create.l HWIO_RPMH_VRM_HEADROOM_SETTLING_BLOCK_ENABLE_CSR_REG5_ADDR A:&base_addr+0x9e05d0
y.create.l HWIO_RPMH_VRM_HEADROOM_SETTLING_BLOCK_ENABLE_CSR_REG6_ADDR A:&base_addr+0x9e06d0
y.create.l HWIO_RPMH_VRM_HEADROOM_SETTLING_BLOCK_ENABLE_CSR_REG7_ADDR A:&base_addr+0x9e07d0
y.create.l HWIO_RPMH_VRM_HEADROOM_SETTLING_BLOCK_ENABLE_CSR_REG8_ADDR A:&base_addr+0x9e08d0
y.create.l HWIO_RPMH_VRM_HEADROOM_SETTLING_BLOCK_ENABLE_CSR_REG9_ADDR A:&base_addr+0x9e09d0
y.create.l HWIO_RPMH_VRM_HEADROOM_SETTLING_BLOCK_ENABLE_CSR_REG10_ADDR A:&base_addr+0x9e0ad0
y.create.l HWIO_RPMH_VRM_HEADROOM_SETTLING_BLOCK_ENABLE_CSR_REG11_ADDR A:&base_addr+0x9e0bd0
y.create.l HWIO_RPMH_VRM_HEADROOM_SETTLING_BLOCK_ENABLE_CSR_REG12_ADDR A:&base_addr+0x9e0cd0
y.create.l HWIO_RPMH_VRM_HEADROOM_SETTLING_BLOCK_ENABLE_CSR_REG13_ADDR A:&base_addr+0x9e0dd0
y.create.l HWIO_RPMH_VRM_HEADROOM_SETTLING_BLOCK_ENABLE_CSR_REG14_ADDR A:&base_addr+0x9e0ed0
y.create.l HWIO_RPMH_VRM_HEADROOM_SETTLING_BLOCK_ENABLE_CSR_REG15_ADDR A:&base_addr+0x9e0fd0
y.create.l HWIO_RPMH_VRM_HEADROOM_SETTLING_BLOCK_ENABLE_CSR_REG16_ADDR A:&base_addr+0x9e10d0
y.create.l HWIO_RPMH_VRM_HEADROOM_SETTLING_BLOCK_ENABLE_CSR_REG17_ADDR A:&base_addr+0x9e11d0
y.create.l HWIO_RPMH_VRM_HEADROOM_SETTLING_BLOCK_ENABLE_CSR_REG18_ADDR A:&base_addr+0x9e12d0
y.create.l HWIO_RPMH_VRM_HEADROOM_SETTLING_BLOCK_ENABLE_CSR_REG19_ADDR A:&base_addr+0x9e13d0
y.create.l HWIO_RPMH_VRM_HEADROOM_SETTLING_BLOCK_ENABLE_CSR_REG20_ADDR A:&base_addr+0x9e14d0
y.create.l HWIO_RPMH_VRM_HEADROOM_SETTLING_BLOCK_ENABLE_CSR_REG21_ADDR A:&base_addr+0x9e15d0
y.create.l HWIO_RPMH_VRM_HEADROOM_SETTLING_BLOCK_ENABLE_CSR_REG22_ADDR A:&base_addr+0x9e16d0
y.create.l HWIO_RPMH_VRM_HEADROOM_SETTLING_BLOCK_ENABLE_CSR_REG23_ADDR A:&base_addr+0x9e17d0
y.create.l HWIO_RPMH_VRM_HEADROOM_SETTLING_BLOCK_ENABLE_CSR_REG24_ADDR A:&base_addr+0x9e18d0
y.create.l HWIO_RPMH_VRM_HEADROOM_SETTLING_BLOCK_ENABLE_CSR_REG25_ADDR A:&base_addr+0x9e19d0
y.create.l HWIO_RPMH_VRM_HEADROOM_SETTLING_BLOCK_ENABLE_CSR_REG26_ADDR A:&base_addr+0x9e1ad0
y.create.l HWIO_RPMH_VRM_HEADROOM_SETTLING_BLOCK_ENABLE_CSR_REG27_ADDR A:&base_addr+0x9e1bd0
y.create.l HWIO_RPMH_VRM_HEADROOM_SETTLING_BLOCK_ENABLE_CSR_REG28_ADDR A:&base_addr+0x9e1cd0
y.create.l HWIO_RPMH_VRM_HEADROOM_SETTLING_BLOCK_ENABLE_CSR_REG29_ADDR A:&base_addr+0x9e1dd0
y.create.l HWIO_RPMH_VRM_HEADROOM_SETTLING_BLOCK_ENABLE_CSR_REG30_ADDR A:&base_addr+0x9e1ed0
y.create.l HWIO_RPMH_VRM_HEADROOM_SETTLING_BLOCK_ENABLE_CSR_REG31_ADDR A:&base_addr+0x9e1fd0
y.create.l HWIO_RPMH_VRM_HEADROOM_SETTLING_BLOCK_ENABLE_CSR_REG32_ADDR A:&base_addr+0x9e20d0
y.create.l HWIO_RPMH_VRM_HEADROOM_SETTLING_BLOCK_ENABLE_CSR_REG33_ADDR A:&base_addr+0x9e21d0
y.create.l HWIO_RPMH_VRM_HEADROOM_SETTLING_BLOCK_ENABLE_CSR_REG34_ADDR A:&base_addr+0x9e22d0
y.create.l HWIO_RPMH_VRM_HEADROOM_SETTLING_BLOCK_ENABLE_CSR_REG35_ADDR A:&base_addr+0x9e23d0
y.create.l HWIO_RPMH_VRM_HEADROOM_SETTLING_BLOCK_ENABLE_CSR_REG36_ADDR A:&base_addr+0x9e24d0
y.create.l HWIO_RPMH_VRM_HEADROOM_SETTLING_BLOCK_ENABLE_CSR_REG37_ADDR A:&base_addr+0x9e25d0
y.create.l HWIO_RPMH_VRM_HEADROOM_SETTLING_BLOCK_ENABLE_CSR_REG38_ADDR A:&base_addr+0x9e26d0
y.create.l HWIO_RPMH_VRM_HEADROOM_SETTLING_BLOCK_ENABLE_CSR_REG39_ADDR A:&base_addr+0x9e27d0
y.create.l HWIO_RPMH_VRM_HEADROOM_SETTLING_BLOCK_ENABLE_CSR_REG40_ADDR A:&base_addr+0x9e28d0
y.create.l HWIO_RPMH_VRM_HEADROOM_SETTLING_BLOCK_ENABLE_CSR_REG41_ADDR A:&base_addr+0x9e29d0
y.create.l HWIO_RPMH_VRM_HEADROOM_SETTLING_BLOCK_ENABLE_CSR_REG42_ADDR A:&base_addr+0x9e2ad0
y.create.l HWIO_RPMH_VRM_HEADROOM_SETTLING_BLOCK_ENABLE_CSR_REG43_ADDR A:&base_addr+0x9e2bd0
y.create.l HWIO_RPMH_VRM_HEADROOM_SETTLING_BLOCK_ENABLE_CSR_REG44_ADDR A:&base_addr+0x9e2cd0
y.create.l HWIO_RPMH_VRM_HEADROOM_SETTLING_BLOCK_ENABLE_CSR_REG45_ADDR A:&base_addr+0x9e2dd0
y.create.l HWIO_RPMH_VRM_VREG_READY_ENABLE_CSR_REG0_ADDR A:&base_addr+0x9e00d4
y.create.l HWIO_RPMH_VRM_VREG_READY_ENABLE_CSR_REG1_ADDR A:&base_addr+0x9e01d4
y.create.l HWIO_RPMH_VRM_VREG_READY_ENABLE_CSR_REG2_ADDR A:&base_addr+0x9e02d4
y.create.l HWIO_RPMH_VRM_VREG_READY_ENABLE_CSR_REG3_ADDR A:&base_addr+0x9e03d4
y.create.l HWIO_RPMH_VRM_VREG_READY_ENABLE_CSR_REG4_ADDR A:&base_addr+0x9e04d4
y.create.l HWIO_RPMH_VRM_VREG_READY_ENABLE_CSR_REG5_ADDR A:&base_addr+0x9e05d4
y.create.l HWIO_RPMH_VRM_VREG_READY_ENABLE_CSR_REG6_ADDR A:&base_addr+0x9e06d4
y.create.l HWIO_RPMH_VRM_VREG_READY_ENABLE_CSR_REG7_ADDR A:&base_addr+0x9e07d4
y.create.l HWIO_RPMH_VRM_VREG_READY_ENABLE_CSR_REG8_ADDR A:&base_addr+0x9e08d4
y.create.l HWIO_RPMH_VRM_VREG_READY_ENABLE_CSR_REG9_ADDR A:&base_addr+0x9e09d4
y.create.l HWIO_RPMH_VRM_VREG_READY_ENABLE_CSR_REG10_ADDR A:&base_addr+0x9e0ad4
y.create.l HWIO_RPMH_VRM_VREG_READY_ENABLE_CSR_REG11_ADDR A:&base_addr+0x9e0bd4
y.create.l HWIO_RPMH_VRM_VREG_READY_ENABLE_CSR_REG12_ADDR A:&base_addr+0x9e0cd4
y.create.l HWIO_RPMH_VRM_VREG_READY_ENABLE_CSR_REG13_ADDR A:&base_addr+0x9e0dd4
y.create.l HWIO_RPMH_VRM_VREG_READY_ENABLE_CSR_REG14_ADDR A:&base_addr+0x9e0ed4
y.create.l HWIO_RPMH_VRM_VREG_READY_ENABLE_CSR_REG15_ADDR A:&base_addr+0x9e0fd4
y.create.l HWIO_RPMH_VRM_VREG_READY_ENABLE_CSR_REG16_ADDR A:&base_addr+0x9e10d4
y.create.l HWIO_RPMH_VRM_VREG_READY_ENABLE_CSR_REG17_ADDR A:&base_addr+0x9e11d4
y.create.l HWIO_RPMH_VRM_VREG_READY_ENABLE_CSR_REG18_ADDR A:&base_addr+0x9e12d4
y.create.l HWIO_RPMH_VRM_VREG_READY_ENABLE_CSR_REG19_ADDR A:&base_addr+0x9e13d4
y.create.l HWIO_RPMH_VRM_VREG_READY_ENABLE_CSR_REG20_ADDR A:&base_addr+0x9e14d4
y.create.l HWIO_RPMH_VRM_VREG_READY_ENABLE_CSR_REG21_ADDR A:&base_addr+0x9e15d4
y.create.l HWIO_RPMH_VRM_VREG_READY_ENABLE_CSR_REG22_ADDR A:&base_addr+0x9e16d4
y.create.l HWIO_RPMH_VRM_VREG_READY_ENABLE_CSR_REG23_ADDR A:&base_addr+0x9e17d4
y.create.l HWIO_RPMH_VRM_VREG_READY_ENABLE_CSR_REG24_ADDR A:&base_addr+0x9e18d4
y.create.l HWIO_RPMH_VRM_VREG_READY_ENABLE_CSR_REG25_ADDR A:&base_addr+0x9e19d4
y.create.l HWIO_RPMH_VRM_VREG_READY_ENABLE_CSR_REG26_ADDR A:&base_addr+0x9e1ad4
y.create.l HWIO_RPMH_VRM_VREG_READY_ENABLE_CSR_REG27_ADDR A:&base_addr+0x9e1bd4
y.create.l HWIO_RPMH_VRM_VREG_READY_ENABLE_CSR_REG28_ADDR A:&base_addr+0x9e1cd4
y.create.l HWIO_RPMH_VRM_VREG_READY_ENABLE_CSR_REG29_ADDR A:&base_addr+0x9e1dd4
y.create.l HWIO_RPMH_VRM_VREG_READY_ENABLE_CSR_REG30_ADDR A:&base_addr+0x9e1ed4
y.create.l HWIO_RPMH_VRM_VREG_READY_ENABLE_CSR_REG31_ADDR A:&base_addr+0x9e1fd4
y.create.l HWIO_RPMH_VRM_VREG_READY_ENABLE_CSR_REG32_ADDR A:&base_addr+0x9e20d4
y.create.l HWIO_RPMH_VRM_VREG_READY_ENABLE_CSR_REG33_ADDR A:&base_addr+0x9e21d4
y.create.l HWIO_RPMH_VRM_VREG_READY_ENABLE_CSR_REG34_ADDR A:&base_addr+0x9e22d4
y.create.l HWIO_RPMH_VRM_VREG_READY_ENABLE_CSR_REG35_ADDR A:&base_addr+0x9e23d4
y.create.l HWIO_RPMH_VRM_VREG_READY_ENABLE_CSR_REG36_ADDR A:&base_addr+0x9e24d4
y.create.l HWIO_RPMH_VRM_VREG_READY_ENABLE_CSR_REG37_ADDR A:&base_addr+0x9e25d4
y.create.l HWIO_RPMH_VRM_VREG_READY_ENABLE_CSR_REG38_ADDR A:&base_addr+0x9e26d4
y.create.l HWIO_RPMH_VRM_VREG_READY_ENABLE_CSR_REG39_ADDR A:&base_addr+0x9e27d4
y.create.l HWIO_RPMH_VRM_VREG_READY_ENABLE_CSR_REG40_ADDR A:&base_addr+0x9e28d4
y.create.l HWIO_RPMH_VRM_VREG_READY_ENABLE_CSR_REG41_ADDR A:&base_addr+0x9e29d4
y.create.l HWIO_RPMH_VRM_VREG_READY_ENABLE_CSR_REG42_ADDR A:&base_addr+0x9e2ad4
y.create.l HWIO_RPMH_VRM_VREG_READY_ENABLE_CSR_REG43_ADDR A:&base_addr+0x9e2bd4
y.create.l HWIO_RPMH_VRM_VREG_READY_ENABLE_CSR_REG44_ADDR A:&base_addr+0x9e2cd4
y.create.l HWIO_RPMH_VRM_VREG_READY_ENABLE_CSR_REG45_ADDR A:&base_addr+0x9e2dd4
y.create.l HWIO_RPMH_VRM_VREG_READY_WDOG_ERROR_ENABLE_CSR_REG0_ADDR A:&base_addr+0x9e00d8
y.create.l HWIO_RPMH_VRM_VREG_READY_WDOG_ERROR_ENABLE_CSR_REG1_ADDR A:&base_addr+0x9e01d8
y.create.l HWIO_RPMH_VRM_VREG_READY_WDOG_ERROR_ENABLE_CSR_REG2_ADDR A:&base_addr+0x9e02d8
y.create.l HWIO_RPMH_VRM_VREG_READY_WDOG_ERROR_ENABLE_CSR_REG3_ADDR A:&base_addr+0x9e03d8
y.create.l HWIO_RPMH_VRM_VREG_READY_WDOG_ERROR_ENABLE_CSR_REG4_ADDR A:&base_addr+0x9e04d8
y.create.l HWIO_RPMH_VRM_VREG_READY_WDOG_ERROR_ENABLE_CSR_REG5_ADDR A:&base_addr+0x9e05d8
y.create.l HWIO_RPMH_VRM_VREG_READY_WDOG_ERROR_ENABLE_CSR_REG6_ADDR A:&base_addr+0x9e06d8
y.create.l HWIO_RPMH_VRM_VREG_READY_WDOG_ERROR_ENABLE_CSR_REG7_ADDR A:&base_addr+0x9e07d8
y.create.l HWIO_RPMH_VRM_VREG_READY_WDOG_ERROR_ENABLE_CSR_REG8_ADDR A:&base_addr+0x9e08d8
y.create.l HWIO_RPMH_VRM_VREG_READY_WDOG_ERROR_ENABLE_CSR_REG9_ADDR A:&base_addr+0x9e09d8
y.create.l HWIO_RPMH_VRM_VREG_READY_WDOG_ERROR_ENABLE_CSR_REG10_ADDR A:&base_addr+0x9e0ad8
y.create.l HWIO_RPMH_VRM_VREG_READY_WDOG_ERROR_ENABLE_CSR_REG11_ADDR A:&base_addr+0x9e0bd8
y.create.l HWIO_RPMH_VRM_VREG_READY_WDOG_ERROR_ENABLE_CSR_REG12_ADDR A:&base_addr+0x9e0cd8
y.create.l HWIO_RPMH_VRM_VREG_READY_WDOG_ERROR_ENABLE_CSR_REG13_ADDR A:&base_addr+0x9e0dd8
y.create.l HWIO_RPMH_VRM_VREG_READY_WDOG_ERROR_ENABLE_CSR_REG14_ADDR A:&base_addr+0x9e0ed8
y.create.l HWIO_RPMH_VRM_VREG_READY_WDOG_ERROR_ENABLE_CSR_REG15_ADDR A:&base_addr+0x9e0fd8
y.create.l HWIO_RPMH_VRM_VREG_READY_WDOG_ERROR_ENABLE_CSR_REG16_ADDR A:&base_addr+0x9e10d8
y.create.l HWIO_RPMH_VRM_VREG_READY_WDOG_ERROR_ENABLE_CSR_REG17_ADDR A:&base_addr+0x9e11d8
y.create.l HWIO_RPMH_VRM_VREG_READY_WDOG_ERROR_ENABLE_CSR_REG18_ADDR A:&base_addr+0x9e12d8
y.create.l HWIO_RPMH_VRM_VREG_READY_WDOG_ERROR_ENABLE_CSR_REG19_ADDR A:&base_addr+0x9e13d8
y.create.l HWIO_RPMH_VRM_VREG_READY_WDOG_ERROR_ENABLE_CSR_REG20_ADDR A:&base_addr+0x9e14d8
y.create.l HWIO_RPMH_VRM_VREG_READY_WDOG_ERROR_ENABLE_CSR_REG21_ADDR A:&base_addr+0x9e15d8
y.create.l HWIO_RPMH_VRM_VREG_READY_WDOG_ERROR_ENABLE_CSR_REG22_ADDR A:&base_addr+0x9e16d8
y.create.l HWIO_RPMH_VRM_VREG_READY_WDOG_ERROR_ENABLE_CSR_REG23_ADDR A:&base_addr+0x9e17d8
y.create.l HWIO_RPMH_VRM_VREG_READY_WDOG_ERROR_ENABLE_CSR_REG24_ADDR A:&base_addr+0x9e18d8
y.create.l HWIO_RPMH_VRM_VREG_READY_WDOG_ERROR_ENABLE_CSR_REG25_ADDR A:&base_addr+0x9e19d8
y.create.l HWIO_RPMH_VRM_VREG_READY_WDOG_ERROR_ENABLE_CSR_REG26_ADDR A:&base_addr+0x9e1ad8
y.create.l HWIO_RPMH_VRM_VREG_READY_WDOG_ERROR_ENABLE_CSR_REG27_ADDR A:&base_addr+0x9e1bd8
y.create.l HWIO_RPMH_VRM_VREG_READY_WDOG_ERROR_ENABLE_CSR_REG28_ADDR A:&base_addr+0x9e1cd8
y.create.l HWIO_RPMH_VRM_VREG_READY_WDOG_ERROR_ENABLE_CSR_REG29_ADDR A:&base_addr+0x9e1dd8
y.create.l HWIO_RPMH_VRM_VREG_READY_WDOG_ERROR_ENABLE_CSR_REG30_ADDR A:&base_addr+0x9e1ed8
y.create.l HWIO_RPMH_VRM_VREG_READY_WDOG_ERROR_ENABLE_CSR_REG31_ADDR A:&base_addr+0x9e1fd8
y.create.l HWIO_RPMH_VRM_VREG_READY_WDOG_ERROR_ENABLE_CSR_REG32_ADDR A:&base_addr+0x9e20d8
y.create.l HWIO_RPMH_VRM_VREG_READY_WDOG_ERROR_ENABLE_CSR_REG33_ADDR A:&base_addr+0x9e21d8
y.create.l HWIO_RPMH_VRM_VREG_READY_WDOG_ERROR_ENABLE_CSR_REG34_ADDR A:&base_addr+0x9e22d8
y.create.l HWIO_RPMH_VRM_VREG_READY_WDOG_ERROR_ENABLE_CSR_REG35_ADDR A:&base_addr+0x9e23d8
y.create.l HWIO_RPMH_VRM_VREG_READY_WDOG_ERROR_ENABLE_CSR_REG36_ADDR A:&base_addr+0x9e24d8
y.create.l HWIO_RPMH_VRM_VREG_READY_WDOG_ERROR_ENABLE_CSR_REG37_ADDR A:&base_addr+0x9e25d8
y.create.l HWIO_RPMH_VRM_VREG_READY_WDOG_ERROR_ENABLE_CSR_REG38_ADDR A:&base_addr+0x9e26d8
y.create.l HWIO_RPMH_VRM_VREG_READY_WDOG_ERROR_ENABLE_CSR_REG39_ADDR A:&base_addr+0x9e27d8
y.create.l HWIO_RPMH_VRM_VREG_READY_WDOG_ERROR_ENABLE_CSR_REG40_ADDR A:&base_addr+0x9e28d8
y.create.l HWIO_RPMH_VRM_VREG_READY_WDOG_ERROR_ENABLE_CSR_REG41_ADDR A:&base_addr+0x9e29d8
y.create.l HWIO_RPMH_VRM_VREG_READY_WDOG_ERROR_ENABLE_CSR_REG42_ADDR A:&base_addr+0x9e2ad8
y.create.l HWIO_RPMH_VRM_VREG_READY_WDOG_ERROR_ENABLE_CSR_REG43_ADDR A:&base_addr+0x9e2bd8
y.create.l HWIO_RPMH_VRM_VREG_READY_WDOG_ERROR_ENABLE_CSR_REG44_ADDR A:&base_addr+0x9e2cd8
y.create.l HWIO_RPMH_VRM_VREG_READY_WDOG_ERROR_ENABLE_CSR_REG45_ADDR A:&base_addr+0x9e2dd8
y.create.l HWIO_RPMH_VRM_TYPE_CSR_XOB0_ADDR A:&base_addr+0x9ec080
y.create.l HWIO_RPMH_VRM_TYPE_CSR_XOB1_ADDR A:&base_addr+0x9ec180
y.create.l HWIO_RPMH_VRM_TYPE_CSR_XOB2_ADDR A:&base_addr+0x9ec280
y.create.l HWIO_RPMH_VRM_TYPE_CSR_XOB3_ADDR A:&base_addr+0x9ec380
y.create.l HWIO_RPMH_VRM_TYPE_CSR_XOB4_ADDR A:&base_addr+0x9ec480
y.create.l HWIO_RPMH_VRM_TYPE_CSR_XOB5_ADDR A:&base_addr+0x9ec580
y.create.l HWIO_RPMH_VRM_TYPE_CSR_XOB6_ADDR A:&base_addr+0x9ec680
y.create.l HWIO_RPMH_VRM_TYPE_CSR_XOB7_ADDR A:&base_addr+0x9ec780
y.create.l HWIO_RPMH_VRM_BASE_ADDR_CSR_XOB0_ADDR A:&base_addr+0x9ec084
y.create.l HWIO_RPMH_VRM_BASE_ADDR_CSR_XOB1_ADDR A:&base_addr+0x9ec184
y.create.l HWIO_RPMH_VRM_BASE_ADDR_CSR_XOB2_ADDR A:&base_addr+0x9ec284
y.create.l HWIO_RPMH_VRM_BASE_ADDR_CSR_XOB3_ADDR A:&base_addr+0x9ec384
y.create.l HWIO_RPMH_VRM_BASE_ADDR_CSR_XOB4_ADDR A:&base_addr+0x9ec484
y.create.l HWIO_RPMH_VRM_BASE_ADDR_CSR_XOB5_ADDR A:&base_addr+0x9ec584
y.create.l HWIO_RPMH_VRM_BASE_ADDR_CSR_XOB6_ADDR A:&base_addr+0x9ec684
y.create.l HWIO_RPMH_VRM_BASE_ADDR_CSR_XOB7_ADDR A:&base_addr+0x9ec784
y.create.l HWIO_RPMH_VRM_ENABLE_SEQ_ID_CSR_XOB0_ADDR A:&base_addr+0x9ec090
y.create.l HWIO_RPMH_VRM_ENABLE_SEQ_ID_CSR_XOB1_ADDR A:&base_addr+0x9ec190
y.create.l HWIO_RPMH_VRM_ENABLE_SEQ_ID_CSR_XOB2_ADDR A:&base_addr+0x9ec290
y.create.l HWIO_RPMH_VRM_ENABLE_SEQ_ID_CSR_XOB3_ADDR A:&base_addr+0x9ec390
y.create.l HWIO_RPMH_VRM_ENABLE_SEQ_ID_CSR_XOB4_ADDR A:&base_addr+0x9ec490
y.create.l HWIO_RPMH_VRM_ENABLE_SEQ_ID_CSR_XOB5_ADDR A:&base_addr+0x9ec590
y.create.l HWIO_RPMH_VRM_ENABLE_SEQ_ID_CSR_XOB6_ADDR A:&base_addr+0x9ec690
y.create.l HWIO_RPMH_VRM_ENABLE_SEQ_ID_CSR_XOB7_ADDR A:&base_addr+0x9ec790
y.create.l HWIO_RPMH_VRM_ENABLE_DEP_ENABLE_CSR_XOB0_ADDR A:&base_addr+0x9ec0ac
y.create.l HWIO_RPMH_VRM_ENABLE_DEP_ENABLE_CSR_XOB1_ADDR A:&base_addr+0x9ec1ac
y.create.l HWIO_RPMH_VRM_ENABLE_DEP_ENABLE_CSR_XOB2_ADDR A:&base_addr+0x9ec2ac
y.create.l HWIO_RPMH_VRM_ENABLE_DEP_ENABLE_CSR_XOB3_ADDR A:&base_addr+0x9ec3ac
y.create.l HWIO_RPMH_VRM_ENABLE_DEP_ENABLE_CSR_XOB4_ADDR A:&base_addr+0x9ec4ac
y.create.l HWIO_RPMH_VRM_ENABLE_DEP_ENABLE_CSR_XOB5_ADDR A:&base_addr+0x9ec5ac
y.create.l HWIO_RPMH_VRM_ENABLE_DEP_ENABLE_CSR_XOB6_ADDR A:&base_addr+0x9ec6ac
y.create.l HWIO_RPMH_VRM_ENABLE_DEP_ENABLE_CSR_XOB7_ADDR A:&base_addr+0x9ec7ac
y.create.l HWIO_RPMH_VRM_ENABLE_SETTLING_BLOCK_ENABLE_CSR_XOB0_ADDR A:&base_addr+0x9ec0c8
y.create.l HWIO_RPMH_VRM_ENABLE_SETTLING_BLOCK_ENABLE_CSR_XOB1_ADDR A:&base_addr+0x9ec1c8
y.create.l HWIO_RPMH_VRM_ENABLE_SETTLING_BLOCK_ENABLE_CSR_XOB2_ADDR A:&base_addr+0x9ec2c8
y.create.l HWIO_RPMH_VRM_ENABLE_SETTLING_BLOCK_ENABLE_CSR_XOB3_ADDR A:&base_addr+0x9ec3c8
y.create.l HWIO_RPMH_VRM_ENABLE_SETTLING_BLOCK_ENABLE_CSR_XOB4_ADDR A:&base_addr+0x9ec4c8
y.create.l HWIO_RPMH_VRM_ENABLE_SETTLING_BLOCK_ENABLE_CSR_XOB5_ADDR A:&base_addr+0x9ec5c8
y.create.l HWIO_RPMH_VRM_ENABLE_SETTLING_BLOCK_ENABLE_CSR_XOB6_ADDR A:&base_addr+0x9ec6c8
y.create.l HWIO_RPMH_VRM_ENABLE_SETTLING_BLOCK_ENABLE_CSR_XOB7_ADDR A:&base_addr+0x9ec7c8
y.create.l HWIO_RPMH_VRM_TYPE_CSR_XO0_ADDR A:&base_addr+0x9ec880
y.create.l HWIO_RPMH_VRM_BASE_ADDR_CSR_XO0_ADDR A:&base_addr+0x9ec884
y.create.l HWIO_RPMH_VRM_ENABLE_SEQ_ID_CSR_XO0_ADDR A:&base_addr+0x9ec890
y.create.l HWIO_RPMH_VRM_ENABLE_DEP_ENABLE_CSR_XO0_ADDR A:&base_addr+0x9ec8ac
y.create.l HWIO_RPMH_VRM_ENABLE_SETTLING_BLOCK_ENABLE_CSR_XO0_ADDR A:&base_addr+0x9ec8c8
y.create.l HWIO_RPMH_VRM_VOLTAGE_ENABLE_SETTLING_DEP_ENABLE_CSR_REG0_ADDR A:&base_addr+0x9ec8e4
y.create.l HWIO_RPMH_VRM_VOLTAGE_ENABLE_SETTLING_DEP_ENABLE_CSR_REG1_ADDR A:&base_addr+0x9ec9e4
y.create.l HWIO_RPMH_VRM_VOLTAGE_ENABLE_SETTLING_DEP_ENABLE_CSR_REG2_ADDR A:&base_addr+0x9ecae4
y.create.l HWIO_RPMH_VRM_VOLTAGE_ENABLE_SETTLING_DEP_ENABLE_CSR_REG3_ADDR A:&base_addr+0x9ecbe4
y.create.l HWIO_RPMH_VRM_VOLTAGE_ENABLE_SETTLING_DEP_ENABLE_CSR_REG4_ADDR A:&base_addr+0x9ecce4
y.create.l HWIO_RPMH_VRM_VOLTAGE_ENABLE_SETTLING_DEP_ENABLE_CSR_REG5_ADDR A:&base_addr+0x9ecde4
y.create.l HWIO_RPMH_VRM_VOLTAGE_ENABLE_SETTLING_DEP_ENABLE_CSR_REG6_ADDR A:&base_addr+0x9ecee4
y.create.l HWIO_RPMH_VRM_VOLTAGE_ENABLE_SETTLING_DEP_ENABLE_CSR_REG7_ADDR A:&base_addr+0x9ecfe4
y.create.l HWIO_RPMH_VRM_VOLTAGE_ENABLE_SETTLING_DEP_ENABLE_CSR_REG8_ADDR A:&base_addr+0x9ed0e4
y.create.l HWIO_RPMH_VRM_VOLTAGE_ENABLE_SETTLING_DEP_ENABLE_CSR_REG9_ADDR A:&base_addr+0x9ed1e4
y.create.l HWIO_RPMH_VRM_VOLTAGE_ENABLE_SETTLING_DEP_ENABLE_CSR_REG10_ADDR A:&base_addr+0x9ed2e4
y.create.l HWIO_RPMH_VRM_VOLTAGE_ENABLE_SETTLING_DEP_ENABLE_CSR_REG11_ADDR A:&base_addr+0x9ed3e4
y.create.l HWIO_RPMH_VRM_VOLTAGE_ENABLE_SETTLING_DEP_ENABLE_CSR_REG12_ADDR A:&base_addr+0x9ed4e4
y.create.l HWIO_RPMH_VRM_VOLTAGE_ENABLE_SETTLING_DEP_ENABLE_CSR_REG13_ADDR A:&base_addr+0x9ed5e4
y.create.l HWIO_RPMH_VRM_VOLTAGE_ENABLE_SETTLING_DEP_ENABLE_CSR_REG14_ADDR A:&base_addr+0x9ed6e4
y.create.l HWIO_RPMH_VRM_VOLTAGE_ENABLE_SETTLING_DEP_ENABLE_CSR_REG15_ADDR A:&base_addr+0x9ed7e4
y.create.l HWIO_RPMH_VRM_VOLTAGE_ENABLE_SETTLING_DEP_ENABLE_CSR_REG16_ADDR A:&base_addr+0x9ed8e4
y.create.l HWIO_RPMH_VRM_VOLTAGE_ENABLE_SETTLING_DEP_ENABLE_CSR_REG17_ADDR A:&base_addr+0x9ed9e4
y.create.l HWIO_RPMH_VRM_VOLTAGE_ENABLE_SETTLING_DEP_ENABLE_CSR_REG18_ADDR A:&base_addr+0x9edae4
y.create.l HWIO_RPMH_VRM_VOLTAGE_ENABLE_SETTLING_DEP_ENABLE_CSR_REG19_ADDR A:&base_addr+0x9edbe4
y.create.l HWIO_RPMH_VRM_VOLTAGE_ENABLE_SETTLING_DEP_ENABLE_CSR_REG20_ADDR A:&base_addr+0x9edce4
y.create.l HWIO_RPMH_VRM_VOLTAGE_ENABLE_SETTLING_DEP_ENABLE_CSR_REG21_ADDR A:&base_addr+0x9edde4
y.create.l HWIO_RPMH_VRM_VOLTAGE_ENABLE_SETTLING_DEP_ENABLE_CSR_REG22_ADDR A:&base_addr+0x9edee4
y.create.l HWIO_RPMH_VRM_VOLTAGE_ENABLE_SETTLING_DEP_ENABLE_CSR_REG23_ADDR A:&base_addr+0x9edfe4
y.create.l HWIO_RPMH_VRM_VOLTAGE_ENABLE_SETTLING_DEP_ENABLE_CSR_REG24_ADDR A:&base_addr+0x9ee0e4
y.create.l HWIO_RPMH_VRM_VOLTAGE_ENABLE_SETTLING_DEP_ENABLE_CSR_REG25_ADDR A:&base_addr+0x9ee1e4
y.create.l HWIO_RPMH_VRM_VOLTAGE_ENABLE_SETTLING_DEP_ENABLE_CSR_REG26_ADDR A:&base_addr+0x9ee2e4
y.create.l HWIO_RPMH_VRM_VOLTAGE_ENABLE_SETTLING_DEP_ENABLE_CSR_REG27_ADDR A:&base_addr+0x9ee3e4
y.create.l HWIO_RPMH_VRM_VOLTAGE_ENABLE_SETTLING_DEP_ENABLE_CSR_REG28_ADDR A:&base_addr+0x9ee4e4
y.create.l HWIO_RPMH_VRM_VOLTAGE_ENABLE_SETTLING_DEP_ENABLE_CSR_REG29_ADDR A:&base_addr+0x9ee5e4
y.create.l HWIO_RPMH_VRM_VOLTAGE_ENABLE_SETTLING_DEP_ENABLE_CSR_REG30_ADDR A:&base_addr+0x9ee6e4
y.create.l HWIO_RPMH_VRM_VOLTAGE_ENABLE_SETTLING_DEP_ENABLE_CSR_REG31_ADDR A:&base_addr+0x9ee7e4
y.create.l HWIO_RPMH_VRM_VOLTAGE_ENABLE_SETTLING_DEP_ENABLE_CSR_REG32_ADDR A:&base_addr+0x9ee8e4
y.create.l HWIO_RPMH_VRM_VOLTAGE_ENABLE_SETTLING_DEP_ENABLE_CSR_REG33_ADDR A:&base_addr+0x9ee9e4
y.create.l HWIO_RPMH_VRM_VOLTAGE_ENABLE_SETTLING_DEP_ENABLE_CSR_REG34_ADDR A:&base_addr+0x9eeae4
y.create.l HWIO_RPMH_VRM_VOLTAGE_ENABLE_SETTLING_DEP_ENABLE_CSR_REG35_ADDR A:&base_addr+0x9eebe4
y.create.l HWIO_RPMH_VRM_VOLTAGE_ENABLE_SETTLING_DEP_ENABLE_CSR_REG36_ADDR A:&base_addr+0x9eece4
y.create.l HWIO_RPMH_VRM_VOLTAGE_ENABLE_SETTLING_DEP_ENABLE_CSR_REG37_ADDR A:&base_addr+0x9eede4
y.create.l HWIO_RPMH_VRM_VOLTAGE_ENABLE_SETTLING_DEP_ENABLE_CSR_REG38_ADDR A:&base_addr+0x9eeee4
y.create.l HWIO_RPMH_VRM_VOLTAGE_ENABLE_SETTLING_DEP_ENABLE_CSR_REG39_ADDR A:&base_addr+0x9eefe4
y.create.l HWIO_RPMH_VRM_VOLTAGE_ENABLE_SETTLING_DEP_ENABLE_CSR_REG40_ADDR A:&base_addr+0x9ef0e4
y.create.l HWIO_RPMH_VRM_VOLTAGE_ENABLE_SETTLING_DEP_ENABLE_CSR_REG41_ADDR A:&base_addr+0x9ef1e4
y.create.l HWIO_RPMH_VRM_VOLTAGE_ENABLE_SETTLING_DEP_ENABLE_CSR_REG42_ADDR A:&base_addr+0x9ef2e4
y.create.l HWIO_RPMH_VRM_VOLTAGE_ENABLE_SETTLING_DEP_ENABLE_CSR_REG43_ADDR A:&base_addr+0x9ef3e4
y.create.l HWIO_RPMH_VRM_VOLTAGE_ENABLE_SETTLING_DEP_ENABLE_CSR_REG44_ADDR A:&base_addr+0x9ef4e4
y.create.l HWIO_RPMH_VRM_VOLTAGE_ENABLE_SETTLING_DEP_ENABLE_CSR_REG45_ADDR A:&base_addr+0x9ef5e4
y.create.l HWIO_RPMH_VRM_SW_WORKAROUND_CSR_REG0_ADDR A:&base_addr+0x9e00fc
y.create.l HWIO_RPMH_VRM_SW_WORKAROUND_CSR_REG1_ADDR A:&base_addr+0x9e01fc
y.create.l HWIO_RPMH_VRM_SW_WORKAROUND_CSR_REG2_ADDR A:&base_addr+0x9e02fc
y.create.l HWIO_RPMH_VRM_SW_WORKAROUND_CSR_REG3_ADDR A:&base_addr+0x9e03fc
y.create.l HWIO_RPMH_VRM_SW_WORKAROUND_CSR_REG4_ADDR A:&base_addr+0x9e04fc
y.create.l HWIO_RPMH_VRM_SW_WORKAROUND_CSR_REG5_ADDR A:&base_addr+0x9e05fc
y.create.l HWIO_RPMH_VRM_SW_WORKAROUND_CSR_REG6_ADDR A:&base_addr+0x9e06fc
y.create.l HWIO_RPMH_VRM_SW_WORKAROUND_CSR_REG7_ADDR A:&base_addr+0x9e07fc
y.create.l HWIO_RPMH_VRM_SW_WORKAROUND_CSR_REG8_ADDR A:&base_addr+0x9e08fc
y.create.l HWIO_RPMH_VRM_SW_WORKAROUND_CSR_REG9_ADDR A:&base_addr+0x9e09fc
y.create.l HWIO_RPMH_VRM_SW_WORKAROUND_CSR_REG10_ADDR A:&base_addr+0x9e0afc
y.create.l HWIO_RPMH_VRM_SW_WORKAROUND_CSR_REG11_ADDR A:&base_addr+0x9e0bfc
y.create.l HWIO_RPMH_VRM_SW_WORKAROUND_CSR_REG12_ADDR A:&base_addr+0x9e0cfc
y.create.l HWIO_RPMH_VRM_SW_WORKAROUND_CSR_REG13_ADDR A:&base_addr+0x9e0dfc
y.create.l HWIO_RPMH_VRM_SW_WORKAROUND_CSR_REG14_ADDR A:&base_addr+0x9e0efc
y.create.l HWIO_RPMH_VRM_SW_WORKAROUND_CSR_REG15_ADDR A:&base_addr+0x9e0ffc
y.create.l HWIO_RPMH_VRM_SW_WORKAROUND_CSR_REG16_ADDR A:&base_addr+0x9e10fc
y.create.l HWIO_RPMH_VRM_SW_WORKAROUND_CSR_REG17_ADDR A:&base_addr+0x9e11fc
y.create.l HWIO_RPMH_VRM_SW_WORKAROUND_CSR_REG18_ADDR A:&base_addr+0x9e12fc
y.create.l HWIO_RPMH_VRM_SW_WORKAROUND_CSR_REG19_ADDR A:&base_addr+0x9e13fc
y.create.l HWIO_RPMH_VRM_SW_WORKAROUND_CSR_REG20_ADDR A:&base_addr+0x9e14fc
y.create.l HWIO_RPMH_VRM_SW_WORKAROUND_CSR_REG21_ADDR A:&base_addr+0x9e15fc
y.create.l HWIO_RPMH_VRM_SW_WORKAROUND_CSR_REG22_ADDR A:&base_addr+0x9e16fc
y.create.l HWIO_RPMH_VRM_SW_WORKAROUND_CSR_REG23_ADDR A:&base_addr+0x9e17fc
y.create.l HWIO_RPMH_VRM_SW_WORKAROUND_CSR_REG24_ADDR A:&base_addr+0x9e18fc
y.create.l HWIO_RPMH_VRM_SW_WORKAROUND_CSR_REG25_ADDR A:&base_addr+0x9e19fc
y.create.l HWIO_RPMH_VRM_SW_WORKAROUND_CSR_REG26_ADDR A:&base_addr+0x9e1afc
y.create.l HWIO_RPMH_VRM_SW_WORKAROUND_CSR_REG27_ADDR A:&base_addr+0x9e1bfc
y.create.l HWIO_RPMH_VRM_SW_WORKAROUND_CSR_REG28_ADDR A:&base_addr+0x9e1cfc
y.create.l HWIO_RPMH_VRM_SW_WORKAROUND_CSR_REG29_ADDR A:&base_addr+0x9e1dfc
y.create.l HWIO_RPMH_VRM_SW_WORKAROUND_CSR_REG30_ADDR A:&base_addr+0x9e1efc
y.create.l HWIO_RPMH_VRM_SW_WORKAROUND_CSR_REG31_ADDR A:&base_addr+0x9e1ffc
y.create.l HWIO_RPMH_VRM_SW_WORKAROUND_CSR_REG32_ADDR A:&base_addr+0x9e20fc
y.create.l HWIO_RPMH_VRM_SW_WORKAROUND_CSR_REG33_ADDR A:&base_addr+0x9e21fc
y.create.l HWIO_RPMH_VRM_SW_WORKAROUND_CSR_REG34_ADDR A:&base_addr+0x9e22fc
y.create.l HWIO_RPMH_VRM_SW_WORKAROUND_CSR_REG35_ADDR A:&base_addr+0x9e23fc
y.create.l HWIO_RPMH_VRM_SW_WORKAROUND_CSR_REG36_ADDR A:&base_addr+0x9e24fc
y.create.l HWIO_RPMH_VRM_SW_WORKAROUND_CSR_REG37_ADDR A:&base_addr+0x9e25fc
y.create.l HWIO_RPMH_VRM_SW_WORKAROUND_CSR_REG38_ADDR A:&base_addr+0x9e26fc
y.create.l HWIO_RPMH_VRM_SW_WORKAROUND_CSR_REG39_ADDR A:&base_addr+0x9e27fc
y.create.l HWIO_RPMH_VRM_SW_WORKAROUND_CSR_REG40_ADDR A:&base_addr+0x9e28fc
y.create.l HWIO_RPMH_VRM_SW_WORKAROUND_CSR_REG41_ADDR A:&base_addr+0x9e29fc
y.create.l HWIO_RPMH_VRM_SW_WORKAROUND_CSR_REG42_ADDR A:&base_addr+0x9e2afc
y.create.l HWIO_RPMH_VRM_SW_WORKAROUND_CSR_REG43_ADDR A:&base_addr+0x9e2bfc
y.create.l HWIO_RPMH_VRM_SW_WORKAROUND_CSR_REG44_ADDR A:&base_addr+0x9e2cfc
y.create.l HWIO_RPMH_VRM_SW_WORKAROUND_CSR_REG45_ADDR A:&base_addr+0x9e2dfc
y.create.l HWIO_RPMH_VRM_XO_SETTLING_TIME_CSR_RES0_ADDR A:&base_addr+0x9ef000
y.create.l HWIO_RPMH_VRM_XOB_SETTLING_TIME_CSR_RES0_ADDR A:&base_addr+0x9ef108
y.create.l HWIO_RPMH_VRM_XOB_SETTLING_TIME_CSR_RES1_ADDR A:&base_addr+0x9ef10c
y.create.l HWIO_RPMH_VRM_XOB_SETTLING_TIME_CSR_RES2_ADDR A:&base_addr+0x9ef110
y.create.l HWIO_RPMH_VRM_XOB_SETTLING_TIME_CSR_RES3_ADDR A:&base_addr+0x9ef114
y.create.l HWIO_RPMH_VRM_XOB_SETTLING_TIME_CSR_RES4_ADDR A:&base_addr+0x9ef118
y.create.l HWIO_RPMH_VRM_XOB_SETTLING_TIME_CSR_RES5_ADDR A:&base_addr+0x9ef11c
y.create.l HWIO_RPMH_VRM_XOB_SETTLING_TIME_CSR_RES6_ADDR A:&base_addr+0x9ef120
y.create.l HWIO_RPMH_VRM_XOB_SETTLING_TIME_CSR_RES7_ADDR A:&base_addr+0x9ef124
y.create.l HWIO_RPMH_VRM_VOLTAGE_ADDR_OFFSET_CSR_TYPE0_ADDR A:&base_addr+0x9f0000
y.create.l HWIO_RPMH_VRM_VOLTAGE_ADDR_OFFSET_CSR_TYPE1_ADDR A:&base_addr+0x9f0060
y.create.l HWIO_RPMH_VRM_VOLTAGE_ADDR_OFFSET_CSR_TYPE2_ADDR A:&base_addr+0x9f00c0
y.create.l HWIO_RPMH_VRM_VOLTAGE_ADDR_OFFSET_CSR_TYPE3_ADDR A:&base_addr+0x9f0120
y.create.l HWIO_RPMH_VRM_VOLTAGE_ADDR_OFFSET_CSR_TYPE4_ADDR A:&base_addr+0x9f0180
y.create.l HWIO_RPMH_VRM_VOLTAGE_ADDR_OFFSET_CSR_TYPE5_ADDR A:&base_addr+0x9f01e0
y.create.l HWIO_RPMH_VRM_VOLTAGE_ADDR_OFFSET_CSR_TYPE6_ADDR A:&base_addr+0x9f0240
y.create.l HWIO_RPMH_VRM_VOLTAGE_ADDR_OFFSET_CSR_TYPE7_ADDR A:&base_addr+0x9f02a0
y.create.l HWIO_RPMH_VRM_VOLTAGE_ADDR_OFFSET_CSR_TYPE8_ADDR A:&base_addr+0x9f0300
y.create.l HWIO_RPMH_VRM_VOLTAGE_ADDR_OFFSET_CSR_TYPE9_ADDR A:&base_addr+0x9f0360
y.create.l HWIO_RPMH_VRM_VOLTAGE_ADDR_OFFSET_CSR_TYPE10_ADDR A:&base_addr+0x9f03c0
y.create.l HWIO_RPMH_VRM_VOLTAGE_ADDR_OFFSET_CSR_TYPE11_ADDR A:&base_addr+0x9f0420
y.create.l HWIO_RPMH_VRM_VOLTAGE_ADDR_OFFSET_CSR_TYPE12_ADDR A:&base_addr+0x9f0480
y.create.l HWIO_RPMH_VRM_VOLTAGE_ADDR_OFFSET_CSR_TYPE13_ADDR A:&base_addr+0x9f04e0
y.create.l HWIO_RPMH_VRM_VOLTAGE_ADDR_OFFSET_CSR_TYPE14_ADDR A:&base_addr+0x9f0540
y.create.l HWIO_RPMH_VRM_VOLTAGE_ADDR_OFFSET_CSR_TYPE15_ADDR A:&base_addr+0x9f05a0
y.create.l HWIO_RPMH_VRM_ENABLE_ADDR_OFFSET_CSR_TYPE0_ADDR A:&base_addr+0x9f0004
y.create.l HWIO_RPMH_VRM_ENABLE_ADDR_OFFSET_CSR_TYPE1_ADDR A:&base_addr+0x9f0064
y.create.l HWIO_RPMH_VRM_ENABLE_ADDR_OFFSET_CSR_TYPE2_ADDR A:&base_addr+0x9f00c4
y.create.l HWIO_RPMH_VRM_ENABLE_ADDR_OFFSET_CSR_TYPE3_ADDR A:&base_addr+0x9f0124
y.create.l HWIO_RPMH_VRM_ENABLE_ADDR_OFFSET_CSR_TYPE4_ADDR A:&base_addr+0x9f0184
y.create.l HWIO_RPMH_VRM_ENABLE_ADDR_OFFSET_CSR_TYPE5_ADDR A:&base_addr+0x9f01e4
y.create.l HWIO_RPMH_VRM_ENABLE_ADDR_OFFSET_CSR_TYPE6_ADDR A:&base_addr+0x9f0244
y.create.l HWIO_RPMH_VRM_ENABLE_ADDR_OFFSET_CSR_TYPE7_ADDR A:&base_addr+0x9f02a4
y.create.l HWIO_RPMH_VRM_ENABLE_ADDR_OFFSET_CSR_TYPE8_ADDR A:&base_addr+0x9f0304
y.create.l HWIO_RPMH_VRM_ENABLE_ADDR_OFFSET_CSR_TYPE9_ADDR A:&base_addr+0x9f0364
y.create.l HWIO_RPMH_VRM_ENABLE_ADDR_OFFSET_CSR_TYPE10_ADDR A:&base_addr+0x9f03c4
y.create.l HWIO_RPMH_VRM_ENABLE_ADDR_OFFSET_CSR_TYPE11_ADDR A:&base_addr+0x9f0424
y.create.l HWIO_RPMH_VRM_ENABLE_ADDR_OFFSET_CSR_TYPE12_ADDR A:&base_addr+0x9f0484
y.create.l HWIO_RPMH_VRM_ENABLE_ADDR_OFFSET_CSR_TYPE13_ADDR A:&base_addr+0x9f04e4
y.create.l HWIO_RPMH_VRM_ENABLE_ADDR_OFFSET_CSR_TYPE14_ADDR A:&base_addr+0x9f0544
y.create.l HWIO_RPMH_VRM_ENABLE_ADDR_OFFSET_CSR_TYPE15_ADDR A:&base_addr+0x9f05a4
y.create.l HWIO_RPMH_VRM_MODE_ADDR_OFFSET_CSR_TYPE0_ADDR A:&base_addr+0x9f0008
y.create.l HWIO_RPMH_VRM_MODE_ADDR_OFFSET_CSR_TYPE1_ADDR A:&base_addr+0x9f0068
y.create.l HWIO_RPMH_VRM_MODE_ADDR_OFFSET_CSR_TYPE2_ADDR A:&base_addr+0x9f00c8
y.create.l HWIO_RPMH_VRM_MODE_ADDR_OFFSET_CSR_TYPE3_ADDR A:&base_addr+0x9f0128
y.create.l HWIO_RPMH_VRM_MODE_ADDR_OFFSET_CSR_TYPE4_ADDR A:&base_addr+0x9f0188
y.create.l HWIO_RPMH_VRM_MODE_ADDR_OFFSET_CSR_TYPE5_ADDR A:&base_addr+0x9f01e8
y.create.l HWIO_RPMH_VRM_MODE_ADDR_OFFSET_CSR_TYPE6_ADDR A:&base_addr+0x9f0248
y.create.l HWIO_RPMH_VRM_MODE_ADDR_OFFSET_CSR_TYPE7_ADDR A:&base_addr+0x9f02a8
y.create.l HWIO_RPMH_VRM_MODE_ADDR_OFFSET_CSR_TYPE8_ADDR A:&base_addr+0x9f0308
y.create.l HWIO_RPMH_VRM_MODE_ADDR_OFFSET_CSR_TYPE9_ADDR A:&base_addr+0x9f0368
y.create.l HWIO_RPMH_VRM_MODE_ADDR_OFFSET_CSR_TYPE10_ADDR A:&base_addr+0x9f03c8
y.create.l HWIO_RPMH_VRM_MODE_ADDR_OFFSET_CSR_TYPE11_ADDR A:&base_addr+0x9f0428
y.create.l HWIO_RPMH_VRM_MODE_ADDR_OFFSET_CSR_TYPE12_ADDR A:&base_addr+0x9f0488
y.create.l HWIO_RPMH_VRM_MODE_ADDR_OFFSET_CSR_TYPE13_ADDR A:&base_addr+0x9f04e8
y.create.l HWIO_RPMH_VRM_MODE_ADDR_OFFSET_CSR_TYPE14_ADDR A:&base_addr+0x9f0548
y.create.l HWIO_RPMH_VRM_MODE_ADDR_OFFSET_CSR_TYPE15_ADDR A:&base_addr+0x9f05a8
y.create.l HWIO_RPMH_VRM_HEADROOM_ADDR_OFFSET_CSR_TYPE0_ADDR A:&base_addr+0x9f000c
y.create.l HWIO_RPMH_VRM_HEADROOM_ADDR_OFFSET_CSR_TYPE1_ADDR A:&base_addr+0x9f006c
y.create.l HWIO_RPMH_VRM_HEADROOM_ADDR_OFFSET_CSR_TYPE2_ADDR A:&base_addr+0x9f00cc
y.create.l HWIO_RPMH_VRM_HEADROOM_ADDR_OFFSET_CSR_TYPE3_ADDR A:&base_addr+0x9f012c
y.create.l HWIO_RPMH_VRM_HEADROOM_ADDR_OFFSET_CSR_TYPE4_ADDR A:&base_addr+0x9f018c
y.create.l HWIO_RPMH_VRM_HEADROOM_ADDR_OFFSET_CSR_TYPE5_ADDR A:&base_addr+0x9f01ec
y.create.l HWIO_RPMH_VRM_HEADROOM_ADDR_OFFSET_CSR_TYPE6_ADDR A:&base_addr+0x9f024c
y.create.l HWIO_RPMH_VRM_HEADROOM_ADDR_OFFSET_CSR_TYPE7_ADDR A:&base_addr+0x9f02ac
y.create.l HWIO_RPMH_VRM_HEADROOM_ADDR_OFFSET_CSR_TYPE8_ADDR A:&base_addr+0x9f030c
y.create.l HWIO_RPMH_VRM_HEADROOM_ADDR_OFFSET_CSR_TYPE9_ADDR A:&base_addr+0x9f036c
y.create.l HWIO_RPMH_VRM_HEADROOM_ADDR_OFFSET_CSR_TYPE10_ADDR A:&base_addr+0x9f03cc
y.create.l HWIO_RPMH_VRM_HEADROOM_ADDR_OFFSET_CSR_TYPE11_ADDR A:&base_addr+0x9f042c
y.create.l HWIO_RPMH_VRM_HEADROOM_ADDR_OFFSET_CSR_TYPE12_ADDR A:&base_addr+0x9f048c
y.create.l HWIO_RPMH_VRM_HEADROOM_ADDR_OFFSET_CSR_TYPE13_ADDR A:&base_addr+0x9f04ec
y.create.l HWIO_RPMH_VRM_HEADROOM_ADDR_OFFSET_CSR_TYPE14_ADDR A:&base_addr+0x9f054c
y.create.l HWIO_RPMH_VRM_HEADROOM_ADDR_OFFSET_CSR_TYPE15_ADDR A:&base_addr+0x9f05ac
y.create.l HWIO_RPMH_VRM_VOLTAGE_STEPPER_SETTLING_TIME_CSR_TYPE0_ADDR A:&base_addr+0x9f001c
y.create.l HWIO_RPMH_VRM_VOLTAGE_STEPPER_SETTLING_TIME_CSR_TYPE1_ADDR A:&base_addr+0x9f007c
y.create.l HWIO_RPMH_VRM_VOLTAGE_STEPPER_SETTLING_TIME_CSR_TYPE2_ADDR A:&base_addr+0x9f00dc
y.create.l HWIO_RPMH_VRM_VOLTAGE_STEPPER_SETTLING_TIME_CSR_TYPE3_ADDR A:&base_addr+0x9f013c
y.create.l HWIO_RPMH_VRM_VOLTAGE_STEPPER_SETTLING_TIME_CSR_TYPE4_ADDR A:&base_addr+0x9f019c
y.create.l HWIO_RPMH_VRM_VOLTAGE_STEPPER_SETTLING_TIME_CSR_TYPE5_ADDR A:&base_addr+0x9f01fc
y.create.l HWIO_RPMH_VRM_VOLTAGE_STEPPER_SETTLING_TIME_CSR_TYPE6_ADDR A:&base_addr+0x9f025c
y.create.l HWIO_RPMH_VRM_VOLTAGE_STEPPER_SETTLING_TIME_CSR_TYPE7_ADDR A:&base_addr+0x9f02bc
y.create.l HWIO_RPMH_VRM_VOLTAGE_STEPPER_SETTLING_TIME_CSR_TYPE8_ADDR A:&base_addr+0x9f031c
y.create.l HWIO_RPMH_VRM_VOLTAGE_STEPPER_SETTLING_TIME_CSR_TYPE9_ADDR A:&base_addr+0x9f037c
y.create.l HWIO_RPMH_VRM_VOLTAGE_STEPPER_SETTLING_TIME_CSR_TYPE10_ADDR A:&base_addr+0x9f03dc
y.create.l HWIO_RPMH_VRM_VOLTAGE_STEPPER_SETTLING_TIME_CSR_TYPE11_ADDR A:&base_addr+0x9f043c
y.create.l HWIO_RPMH_VRM_VOLTAGE_STEPPER_SETTLING_TIME_CSR_TYPE12_ADDR A:&base_addr+0x9f049c
y.create.l HWIO_RPMH_VRM_VOLTAGE_STEPPER_SETTLING_TIME_CSR_TYPE13_ADDR A:&base_addr+0x9f04fc
y.create.l HWIO_RPMH_VRM_VOLTAGE_STEPPER_SETTLING_TIME_CSR_TYPE14_ADDR A:&base_addr+0x9f055c
y.create.l HWIO_RPMH_VRM_VOLTAGE_STEPPER_SETTLING_TIME_CSR_TYPE15_ADDR A:&base_addr+0x9f05bc
y.create.l HWIO_RPMH_VRM_VOLTAGE_FIXED_UP_SETTLING_TIME_CSR_TYPE0_ADDR A:&base_addr+0x9f0020
y.create.l HWIO_RPMH_VRM_VOLTAGE_FIXED_UP_SETTLING_TIME_CSR_TYPE1_ADDR A:&base_addr+0x9f0080
y.create.l HWIO_RPMH_VRM_VOLTAGE_FIXED_UP_SETTLING_TIME_CSR_TYPE2_ADDR A:&base_addr+0x9f00e0
y.create.l HWIO_RPMH_VRM_VOLTAGE_FIXED_UP_SETTLING_TIME_CSR_TYPE3_ADDR A:&base_addr+0x9f0140
y.create.l HWIO_RPMH_VRM_VOLTAGE_FIXED_UP_SETTLING_TIME_CSR_TYPE4_ADDR A:&base_addr+0x9f01a0
y.create.l HWIO_RPMH_VRM_VOLTAGE_FIXED_UP_SETTLING_TIME_CSR_TYPE5_ADDR A:&base_addr+0x9f0200
y.create.l HWIO_RPMH_VRM_VOLTAGE_FIXED_UP_SETTLING_TIME_CSR_TYPE6_ADDR A:&base_addr+0x9f0260
y.create.l HWIO_RPMH_VRM_VOLTAGE_FIXED_UP_SETTLING_TIME_CSR_TYPE7_ADDR A:&base_addr+0x9f02c0
y.create.l HWIO_RPMH_VRM_VOLTAGE_FIXED_UP_SETTLING_TIME_CSR_TYPE8_ADDR A:&base_addr+0x9f0320
y.create.l HWIO_RPMH_VRM_VOLTAGE_FIXED_UP_SETTLING_TIME_CSR_TYPE9_ADDR A:&base_addr+0x9f0380
y.create.l HWIO_RPMH_VRM_VOLTAGE_FIXED_UP_SETTLING_TIME_CSR_TYPE10_ADDR A:&base_addr+0x9f03e0
y.create.l HWIO_RPMH_VRM_VOLTAGE_FIXED_UP_SETTLING_TIME_CSR_TYPE11_ADDR A:&base_addr+0x9f0440
y.create.l HWIO_RPMH_VRM_VOLTAGE_FIXED_UP_SETTLING_TIME_CSR_TYPE12_ADDR A:&base_addr+0x9f04a0
y.create.l HWIO_RPMH_VRM_VOLTAGE_FIXED_UP_SETTLING_TIME_CSR_TYPE13_ADDR A:&base_addr+0x9f0500
y.create.l HWIO_RPMH_VRM_VOLTAGE_FIXED_UP_SETTLING_TIME_CSR_TYPE14_ADDR A:&base_addr+0x9f0560
y.create.l HWIO_RPMH_VRM_VOLTAGE_FIXED_UP_SETTLING_TIME_CSR_TYPE15_ADDR A:&base_addr+0x9f05c0
y.create.l HWIO_RPMH_VRM_VOLTAGE_FIXED_DOWN_SETTLING_TIME_CSR_TYPE0_ADDR A:&base_addr+0x9f0024
y.create.l HWIO_RPMH_VRM_VOLTAGE_FIXED_DOWN_SETTLING_TIME_CSR_TYPE1_ADDR A:&base_addr+0x9f0084
y.create.l HWIO_RPMH_VRM_VOLTAGE_FIXED_DOWN_SETTLING_TIME_CSR_TYPE2_ADDR A:&base_addr+0x9f00e4
y.create.l HWIO_RPMH_VRM_VOLTAGE_FIXED_DOWN_SETTLING_TIME_CSR_TYPE3_ADDR A:&base_addr+0x9f0144
y.create.l HWIO_RPMH_VRM_VOLTAGE_FIXED_DOWN_SETTLING_TIME_CSR_TYPE4_ADDR A:&base_addr+0x9f01a4
y.create.l HWIO_RPMH_VRM_VOLTAGE_FIXED_DOWN_SETTLING_TIME_CSR_TYPE5_ADDR A:&base_addr+0x9f0204
y.create.l HWIO_RPMH_VRM_VOLTAGE_FIXED_DOWN_SETTLING_TIME_CSR_TYPE6_ADDR A:&base_addr+0x9f0264
y.create.l HWIO_RPMH_VRM_VOLTAGE_FIXED_DOWN_SETTLING_TIME_CSR_TYPE7_ADDR A:&base_addr+0x9f02c4
y.create.l HWIO_RPMH_VRM_VOLTAGE_FIXED_DOWN_SETTLING_TIME_CSR_TYPE8_ADDR A:&base_addr+0x9f0324
y.create.l HWIO_RPMH_VRM_VOLTAGE_FIXED_DOWN_SETTLING_TIME_CSR_TYPE9_ADDR A:&base_addr+0x9f0384
y.create.l HWIO_RPMH_VRM_VOLTAGE_FIXED_DOWN_SETTLING_TIME_CSR_TYPE10_ADDR A:&base_addr+0x9f03e4
y.create.l HWIO_RPMH_VRM_VOLTAGE_FIXED_DOWN_SETTLING_TIME_CSR_TYPE11_ADDR A:&base_addr+0x9f0444
y.create.l HWIO_RPMH_VRM_VOLTAGE_FIXED_DOWN_SETTLING_TIME_CSR_TYPE12_ADDR A:&base_addr+0x9f04a4
y.create.l HWIO_RPMH_VRM_VOLTAGE_FIXED_DOWN_SETTLING_TIME_CSR_TYPE13_ADDR A:&base_addr+0x9f0504
y.create.l HWIO_RPMH_VRM_VOLTAGE_FIXED_DOWN_SETTLING_TIME_CSR_TYPE14_ADDR A:&base_addr+0x9f0564
y.create.l HWIO_RPMH_VRM_VOLTAGE_FIXED_DOWN_SETTLING_TIME_CSR_TYPE15_ADDR A:&base_addr+0x9f05c4
y.create.l HWIO_RPMH_VRM_VOLTAGE_UP_SETTLING_TIME_SEL_ADDR A:&base_addr+0x9f0ff0
y.create.l HWIO_RPMH_VRM_VOLTAGE_DOWN_SETTLING_TIME_SEL_ADDR A:&base_addr+0x9f0ff4
y.create.l HWIO_RPMH_VRM_ENABLE_STEPPER_SETTLING_TIME_CSR_TYPE0_ADDR A:&base_addr+0x9f0028
y.create.l HWIO_RPMH_VRM_ENABLE_STEPPER_SETTLING_TIME_CSR_TYPE1_ADDR A:&base_addr+0x9f0088
y.create.l HWIO_RPMH_VRM_ENABLE_STEPPER_SETTLING_TIME_CSR_TYPE2_ADDR A:&base_addr+0x9f00e8
y.create.l HWIO_RPMH_VRM_ENABLE_STEPPER_SETTLING_TIME_CSR_TYPE3_ADDR A:&base_addr+0x9f0148
y.create.l HWIO_RPMH_VRM_ENABLE_STEPPER_SETTLING_TIME_CSR_TYPE4_ADDR A:&base_addr+0x9f01a8
y.create.l HWIO_RPMH_VRM_ENABLE_STEPPER_SETTLING_TIME_CSR_TYPE5_ADDR A:&base_addr+0x9f0208
y.create.l HWIO_RPMH_VRM_ENABLE_STEPPER_SETTLING_TIME_CSR_TYPE6_ADDR A:&base_addr+0x9f0268
y.create.l HWIO_RPMH_VRM_ENABLE_STEPPER_SETTLING_TIME_CSR_TYPE7_ADDR A:&base_addr+0x9f02c8
y.create.l HWIO_RPMH_VRM_ENABLE_STEPPER_SETTLING_TIME_CSR_TYPE8_ADDR A:&base_addr+0x9f0328
y.create.l HWIO_RPMH_VRM_ENABLE_STEPPER_SETTLING_TIME_CSR_TYPE9_ADDR A:&base_addr+0x9f0388
y.create.l HWIO_RPMH_VRM_ENABLE_STEPPER_SETTLING_TIME_CSR_TYPE10_ADDR A:&base_addr+0x9f03e8
y.create.l HWIO_RPMH_VRM_ENABLE_STEPPER_SETTLING_TIME_CSR_TYPE11_ADDR A:&base_addr+0x9f0448
y.create.l HWIO_RPMH_VRM_ENABLE_STEPPER_SETTLING_TIME_CSR_TYPE12_ADDR A:&base_addr+0x9f04a8
y.create.l HWIO_RPMH_VRM_ENABLE_STEPPER_SETTLING_TIME_CSR_TYPE13_ADDR A:&base_addr+0x9f0508
y.create.l HWIO_RPMH_VRM_ENABLE_STEPPER_SETTLING_TIME_CSR_TYPE14_ADDR A:&base_addr+0x9f0568
y.create.l HWIO_RPMH_VRM_ENABLE_STEPPER_SETTLING_TIME_CSR_TYPE15_ADDR A:&base_addr+0x9f05c8
y.create.l HWIO_RPMH_VRM_ENABLE_FIXED_SETTLING_TIME_CSR_TYPE0_ADDR A:&base_addr+0x9f002c
y.create.l HWIO_RPMH_VRM_ENABLE_FIXED_SETTLING_TIME_CSR_TYPE1_ADDR A:&base_addr+0x9f008c
y.create.l HWIO_RPMH_VRM_ENABLE_FIXED_SETTLING_TIME_CSR_TYPE2_ADDR A:&base_addr+0x9f00ec
y.create.l HWIO_RPMH_VRM_ENABLE_FIXED_SETTLING_TIME_CSR_TYPE3_ADDR A:&base_addr+0x9f014c
y.create.l HWIO_RPMH_VRM_ENABLE_FIXED_SETTLING_TIME_CSR_TYPE4_ADDR A:&base_addr+0x9f01ac
y.create.l HWIO_RPMH_VRM_ENABLE_FIXED_SETTLING_TIME_CSR_TYPE5_ADDR A:&base_addr+0x9f020c
y.create.l HWIO_RPMH_VRM_ENABLE_FIXED_SETTLING_TIME_CSR_TYPE6_ADDR A:&base_addr+0x9f026c
y.create.l HWIO_RPMH_VRM_ENABLE_FIXED_SETTLING_TIME_CSR_TYPE7_ADDR A:&base_addr+0x9f02cc
y.create.l HWIO_RPMH_VRM_ENABLE_FIXED_SETTLING_TIME_CSR_TYPE8_ADDR A:&base_addr+0x9f032c
y.create.l HWIO_RPMH_VRM_ENABLE_FIXED_SETTLING_TIME_CSR_TYPE9_ADDR A:&base_addr+0x9f038c
y.create.l HWIO_RPMH_VRM_ENABLE_FIXED_SETTLING_TIME_CSR_TYPE10_ADDR A:&base_addr+0x9f03ec
y.create.l HWIO_RPMH_VRM_ENABLE_FIXED_SETTLING_TIME_CSR_TYPE11_ADDR A:&base_addr+0x9f044c
y.create.l HWIO_RPMH_VRM_ENABLE_FIXED_SETTLING_TIME_CSR_TYPE12_ADDR A:&base_addr+0x9f04ac
y.create.l HWIO_RPMH_VRM_ENABLE_FIXED_SETTLING_TIME_CSR_TYPE13_ADDR A:&base_addr+0x9f050c
y.create.l HWIO_RPMH_VRM_ENABLE_FIXED_SETTLING_TIME_CSR_TYPE14_ADDR A:&base_addr+0x9f056c
y.create.l HWIO_RPMH_VRM_ENABLE_FIXED_SETTLING_TIME_CSR_TYPE15_ADDR A:&base_addr+0x9f05cc
y.create.l HWIO_RPMH_VRM_ENABLE_WARM_UP_TIME_CSR_TYPE0_ADDR A:&base_addr+0x9f0030
y.create.l HWIO_RPMH_VRM_ENABLE_WARM_UP_TIME_CSR_TYPE1_ADDR A:&base_addr+0x9f0090
y.create.l HWIO_RPMH_VRM_ENABLE_WARM_UP_TIME_CSR_TYPE2_ADDR A:&base_addr+0x9f00f0
y.create.l HWIO_RPMH_VRM_ENABLE_WARM_UP_TIME_CSR_TYPE3_ADDR A:&base_addr+0x9f0150
y.create.l HWIO_RPMH_VRM_ENABLE_WARM_UP_TIME_CSR_TYPE4_ADDR A:&base_addr+0x9f01b0
y.create.l HWIO_RPMH_VRM_ENABLE_WARM_UP_TIME_CSR_TYPE5_ADDR A:&base_addr+0x9f0210
y.create.l HWIO_RPMH_VRM_ENABLE_WARM_UP_TIME_CSR_TYPE6_ADDR A:&base_addr+0x9f0270
y.create.l HWIO_RPMH_VRM_ENABLE_WARM_UP_TIME_CSR_TYPE7_ADDR A:&base_addr+0x9f02d0
y.create.l HWIO_RPMH_VRM_ENABLE_WARM_UP_TIME_CSR_TYPE8_ADDR A:&base_addr+0x9f0330
y.create.l HWIO_RPMH_VRM_ENABLE_WARM_UP_TIME_CSR_TYPE9_ADDR A:&base_addr+0x9f0390
y.create.l HWIO_RPMH_VRM_ENABLE_WARM_UP_TIME_CSR_TYPE10_ADDR A:&base_addr+0x9f03f0
y.create.l HWIO_RPMH_VRM_ENABLE_WARM_UP_TIME_CSR_TYPE11_ADDR A:&base_addr+0x9f0450
y.create.l HWIO_RPMH_VRM_ENABLE_WARM_UP_TIME_CSR_TYPE12_ADDR A:&base_addr+0x9f04b0
y.create.l HWIO_RPMH_VRM_ENABLE_WARM_UP_TIME_CSR_TYPE13_ADDR A:&base_addr+0x9f0510
y.create.l HWIO_RPMH_VRM_ENABLE_WARM_UP_TIME_CSR_TYPE14_ADDR A:&base_addr+0x9f0570
y.create.l HWIO_RPMH_VRM_ENABLE_WARM_UP_TIME_CSR_TYPE15_ADDR A:&base_addr+0x9f05d0
y.create.l HWIO_RPMH_VRM_ENABLE_UP_SETTLING_TIME_SEL_ADDR A:&base_addr+0x9f0ff8
y.create.l HWIO_RPMH_VRM_MODE_SETTLING_TIME_CSR_TYPE0_ADDR A:&base_addr+0x9f0034
y.create.l HWIO_RPMH_VRM_MODE_SETTLING_TIME_CSR_TYPE1_ADDR A:&base_addr+0x9f0094
y.create.l HWIO_RPMH_VRM_MODE_SETTLING_TIME_CSR_TYPE2_ADDR A:&base_addr+0x9f00f4
y.create.l HWIO_RPMH_VRM_MODE_SETTLING_TIME_CSR_TYPE3_ADDR A:&base_addr+0x9f0154
y.create.l HWIO_RPMH_VRM_MODE_SETTLING_TIME_CSR_TYPE4_ADDR A:&base_addr+0x9f01b4
y.create.l HWIO_RPMH_VRM_MODE_SETTLING_TIME_CSR_TYPE5_ADDR A:&base_addr+0x9f0214
y.create.l HWIO_RPMH_VRM_MODE_SETTLING_TIME_CSR_TYPE6_ADDR A:&base_addr+0x9f0274
y.create.l HWIO_RPMH_VRM_MODE_SETTLING_TIME_CSR_TYPE7_ADDR A:&base_addr+0x9f02d4
y.create.l HWIO_RPMH_VRM_MODE_SETTLING_TIME_CSR_TYPE8_ADDR A:&base_addr+0x9f0334
y.create.l HWIO_RPMH_VRM_MODE_SETTLING_TIME_CSR_TYPE9_ADDR A:&base_addr+0x9f0394
y.create.l HWIO_RPMH_VRM_MODE_SETTLING_TIME_CSR_TYPE10_ADDR A:&base_addr+0x9f03f4
y.create.l HWIO_RPMH_VRM_MODE_SETTLING_TIME_CSR_TYPE11_ADDR A:&base_addr+0x9f0454
y.create.l HWIO_RPMH_VRM_MODE_SETTLING_TIME_CSR_TYPE12_ADDR A:&base_addr+0x9f04b4
y.create.l HWIO_RPMH_VRM_MODE_SETTLING_TIME_CSR_TYPE13_ADDR A:&base_addr+0x9f0514
y.create.l HWIO_RPMH_VRM_MODE_SETTLING_TIME_CSR_TYPE14_ADDR A:&base_addr+0x9f0574
y.create.l HWIO_RPMH_VRM_MODE_SETTLING_TIME_CSR_TYPE15_ADDR A:&base_addr+0x9f05d4
y.create.l HWIO_RPMH_VRM_HEADROOM_SETTLING_TIME_CSR_TYPE0_ADDR A:&base_addr+0x9f0038
y.create.l HWIO_RPMH_VRM_HEADROOM_SETTLING_TIME_CSR_TYPE1_ADDR A:&base_addr+0x9f0098
y.create.l HWIO_RPMH_VRM_HEADROOM_SETTLING_TIME_CSR_TYPE2_ADDR A:&base_addr+0x9f00f8
y.create.l HWIO_RPMH_VRM_HEADROOM_SETTLING_TIME_CSR_TYPE3_ADDR A:&base_addr+0x9f0158
y.create.l HWIO_RPMH_VRM_HEADROOM_SETTLING_TIME_CSR_TYPE4_ADDR A:&base_addr+0x9f01b8
y.create.l HWIO_RPMH_VRM_HEADROOM_SETTLING_TIME_CSR_TYPE5_ADDR A:&base_addr+0x9f0218
y.create.l HWIO_RPMH_VRM_HEADROOM_SETTLING_TIME_CSR_TYPE6_ADDR A:&base_addr+0x9f0278
y.create.l HWIO_RPMH_VRM_HEADROOM_SETTLING_TIME_CSR_TYPE7_ADDR A:&base_addr+0x9f02d8
y.create.l HWIO_RPMH_VRM_HEADROOM_SETTLING_TIME_CSR_TYPE8_ADDR A:&base_addr+0x9f0338
y.create.l HWIO_RPMH_VRM_HEADROOM_SETTLING_TIME_CSR_TYPE9_ADDR A:&base_addr+0x9f0398
y.create.l HWIO_RPMH_VRM_HEADROOM_SETTLING_TIME_CSR_TYPE10_ADDR A:&base_addr+0x9f03f8
y.create.l HWIO_RPMH_VRM_HEADROOM_SETTLING_TIME_CSR_TYPE11_ADDR A:&base_addr+0x9f0458
y.create.l HWIO_RPMH_VRM_HEADROOM_SETTLING_TIME_CSR_TYPE12_ADDR A:&base_addr+0x9f04b8
y.create.l HWIO_RPMH_VRM_HEADROOM_SETTLING_TIME_CSR_TYPE13_ADDR A:&base_addr+0x9f0518
y.create.l HWIO_RPMH_VRM_HEADROOM_SETTLING_TIME_CSR_TYPE14_ADDR A:&base_addr+0x9f0578
y.create.l HWIO_RPMH_VRM_HEADROOM_SETTLING_TIME_CSR_TYPE15_ADDR A:&base_addr+0x9f05d8
y.create.l HWIO_RPMH_VRM_VREG_READY_WDOG_TIMER_MUL_CSR_TYPE0_ADDR A:&base_addr+0x9f003c
y.create.l HWIO_RPMH_VRM_VREG_READY_WDOG_TIMER_MUL_CSR_TYPE1_ADDR A:&base_addr+0x9f009c
y.create.l HWIO_RPMH_VRM_VREG_READY_WDOG_TIMER_MUL_CSR_TYPE2_ADDR A:&base_addr+0x9f00fc
y.create.l HWIO_RPMH_VRM_VREG_READY_WDOG_TIMER_MUL_CSR_TYPE3_ADDR A:&base_addr+0x9f015c
y.create.l HWIO_RPMH_VRM_VREG_READY_WDOG_TIMER_MUL_CSR_TYPE4_ADDR A:&base_addr+0x9f01bc
y.create.l HWIO_RPMH_VRM_VREG_READY_WDOG_TIMER_MUL_CSR_TYPE5_ADDR A:&base_addr+0x9f021c
y.create.l HWIO_RPMH_VRM_VREG_READY_WDOG_TIMER_MUL_CSR_TYPE6_ADDR A:&base_addr+0x9f027c
y.create.l HWIO_RPMH_VRM_VREG_READY_WDOG_TIMER_MUL_CSR_TYPE7_ADDR A:&base_addr+0x9f02dc
y.create.l HWIO_RPMH_VRM_VREG_READY_WDOG_TIMER_MUL_CSR_TYPE8_ADDR A:&base_addr+0x9f033c
y.create.l HWIO_RPMH_VRM_VREG_READY_WDOG_TIMER_MUL_CSR_TYPE9_ADDR A:&base_addr+0x9f039c
y.create.l HWIO_RPMH_VRM_VREG_READY_WDOG_TIMER_MUL_CSR_TYPE10_ADDR A:&base_addr+0x9f03fc
y.create.l HWIO_RPMH_VRM_VREG_READY_WDOG_TIMER_MUL_CSR_TYPE11_ADDR A:&base_addr+0x9f045c
y.create.l HWIO_RPMH_VRM_VREG_READY_WDOG_TIMER_MUL_CSR_TYPE12_ADDR A:&base_addr+0x9f04bc
y.create.l HWIO_RPMH_VRM_VREG_READY_WDOG_TIMER_MUL_CSR_TYPE13_ADDR A:&base_addr+0x9f051c
y.create.l HWIO_RPMH_VRM_VREG_READY_WDOG_TIMER_MUL_CSR_TYPE14_ADDR A:&base_addr+0x9f057c
y.create.l HWIO_RPMH_VRM_VREG_READY_WDOG_TIMER_MUL_CSR_TYPE15_ADDR A:&base_addr+0x9f05dc
y.create.l HWIO_RPMH_VRM_VOLTAGE_UP_EXTRA_TIME_TYPE0_ADDR A:&base_addr+0x9f0040
y.create.l HWIO_RPMH_VRM_VOLTAGE_UP_EXTRA_TIME_TYPE1_ADDR A:&base_addr+0x9f00a0
y.create.l HWIO_RPMH_VRM_VOLTAGE_UP_EXTRA_TIME_TYPE2_ADDR A:&base_addr+0x9f0100
y.create.l HWIO_RPMH_VRM_VOLTAGE_UP_EXTRA_TIME_TYPE3_ADDR A:&base_addr+0x9f0160
y.create.l HWIO_RPMH_VRM_VOLTAGE_UP_EXTRA_TIME_TYPE4_ADDR A:&base_addr+0x9f01c0
y.create.l HWIO_RPMH_VRM_VOLTAGE_UP_EXTRA_TIME_TYPE5_ADDR A:&base_addr+0x9f0220
y.create.l HWIO_RPMH_VRM_VOLTAGE_UP_EXTRA_TIME_TYPE6_ADDR A:&base_addr+0x9f0280
y.create.l HWIO_RPMH_VRM_VOLTAGE_UP_EXTRA_TIME_TYPE7_ADDR A:&base_addr+0x9f02e0
y.create.l HWIO_RPMH_VRM_VOLTAGE_UP_EXTRA_TIME_TYPE8_ADDR A:&base_addr+0x9f0340
y.create.l HWIO_RPMH_VRM_VOLTAGE_UP_EXTRA_TIME_TYPE9_ADDR A:&base_addr+0x9f03a0
y.create.l HWIO_RPMH_VRM_VOLTAGE_UP_EXTRA_TIME_TYPE10_ADDR A:&base_addr+0x9f0400
y.create.l HWIO_RPMH_VRM_VOLTAGE_UP_EXTRA_TIME_TYPE11_ADDR A:&base_addr+0x9f0460
y.create.l HWIO_RPMH_VRM_VOLTAGE_UP_EXTRA_TIME_TYPE12_ADDR A:&base_addr+0x9f04c0
y.create.l HWIO_RPMH_VRM_VOLTAGE_UP_EXTRA_TIME_TYPE13_ADDR A:&base_addr+0x9f0520
y.create.l HWIO_RPMH_VRM_VOLTAGE_UP_EXTRA_TIME_TYPE14_ADDR A:&base_addr+0x9f0580
y.create.l HWIO_RPMH_VRM_VOLTAGE_UP_EXTRA_TIME_TYPE15_ADDR A:&base_addr+0x9f05e0
y.create.l HWIO_RPMH_VRM_VOLTAGE_DOWN_EXTRA_TIME_TYPE0_ADDR A:&base_addr+0x9f0044
y.create.l HWIO_RPMH_VRM_VOLTAGE_DOWN_EXTRA_TIME_TYPE1_ADDR A:&base_addr+0x9f00a4
y.create.l HWIO_RPMH_VRM_VOLTAGE_DOWN_EXTRA_TIME_TYPE2_ADDR A:&base_addr+0x9f0104
y.create.l HWIO_RPMH_VRM_VOLTAGE_DOWN_EXTRA_TIME_TYPE3_ADDR A:&base_addr+0x9f0164
y.create.l HWIO_RPMH_VRM_VOLTAGE_DOWN_EXTRA_TIME_TYPE4_ADDR A:&base_addr+0x9f01c4
y.create.l HWIO_RPMH_VRM_VOLTAGE_DOWN_EXTRA_TIME_TYPE5_ADDR A:&base_addr+0x9f0224
y.create.l HWIO_RPMH_VRM_VOLTAGE_DOWN_EXTRA_TIME_TYPE6_ADDR A:&base_addr+0x9f0284
y.create.l HWIO_RPMH_VRM_VOLTAGE_DOWN_EXTRA_TIME_TYPE7_ADDR A:&base_addr+0x9f02e4
y.create.l HWIO_RPMH_VRM_VOLTAGE_DOWN_EXTRA_TIME_TYPE8_ADDR A:&base_addr+0x9f0344
y.create.l HWIO_RPMH_VRM_VOLTAGE_DOWN_EXTRA_TIME_TYPE9_ADDR A:&base_addr+0x9f03a4
y.create.l HWIO_RPMH_VRM_VOLTAGE_DOWN_EXTRA_TIME_TYPE10_ADDR A:&base_addr+0x9f0404
y.create.l HWIO_RPMH_VRM_VOLTAGE_DOWN_EXTRA_TIME_TYPE11_ADDR A:&base_addr+0x9f0464
y.create.l HWIO_RPMH_VRM_VOLTAGE_DOWN_EXTRA_TIME_TYPE12_ADDR A:&base_addr+0x9f04c4
y.create.l HWIO_RPMH_VRM_VOLTAGE_DOWN_EXTRA_TIME_TYPE13_ADDR A:&base_addr+0x9f0524
y.create.l HWIO_RPMH_VRM_VOLTAGE_DOWN_EXTRA_TIME_TYPE14_ADDR A:&base_addr+0x9f0584
y.create.l HWIO_RPMH_VRM_VOLTAGE_DOWN_EXTRA_TIME_TYPE15_ADDR A:&base_addr+0x9f05e4
y.create.l HWIO_RPMH_VRM_VREG_CLR_ADDR_OFFSET_CSR_TYPE0_ADDR A:&base_addr+0x9f004c
y.create.l HWIO_RPMH_VRM_VREG_CLR_ADDR_OFFSET_CSR_TYPE1_ADDR A:&base_addr+0x9f00ac
y.create.l HWIO_RPMH_VRM_VREG_CLR_ADDR_OFFSET_CSR_TYPE2_ADDR A:&base_addr+0x9f010c
y.create.l HWIO_RPMH_VRM_VREG_CLR_ADDR_OFFSET_CSR_TYPE3_ADDR A:&base_addr+0x9f016c
y.create.l HWIO_RPMH_VRM_VREG_CLR_ADDR_OFFSET_CSR_TYPE4_ADDR A:&base_addr+0x9f01cc
y.create.l HWIO_RPMH_VRM_VREG_CLR_ADDR_OFFSET_CSR_TYPE5_ADDR A:&base_addr+0x9f022c
y.create.l HWIO_RPMH_VRM_VREG_CLR_ADDR_OFFSET_CSR_TYPE6_ADDR A:&base_addr+0x9f028c
y.create.l HWIO_RPMH_VRM_VREG_CLR_ADDR_OFFSET_CSR_TYPE7_ADDR A:&base_addr+0x9f02ec
y.create.l HWIO_RPMH_VRM_VREG_CLR_ADDR_OFFSET_CSR_TYPE8_ADDR A:&base_addr+0x9f034c
y.create.l HWIO_RPMH_VRM_VREG_CLR_ADDR_OFFSET_CSR_TYPE9_ADDR A:&base_addr+0x9f03ac
y.create.l HWIO_RPMH_VRM_VREG_CLR_ADDR_OFFSET_CSR_TYPE10_ADDR A:&base_addr+0x9f040c
y.create.l HWIO_RPMH_VRM_VREG_CLR_ADDR_OFFSET_CSR_TYPE11_ADDR A:&base_addr+0x9f046c
y.create.l HWIO_RPMH_VRM_VREG_CLR_ADDR_OFFSET_CSR_TYPE12_ADDR A:&base_addr+0x9f04cc
y.create.l HWIO_RPMH_VRM_VREG_CLR_ADDR_OFFSET_CSR_TYPE13_ADDR A:&base_addr+0x9f052c
y.create.l HWIO_RPMH_VRM_VREG_CLR_ADDR_OFFSET_CSR_TYPE14_ADDR A:&base_addr+0x9f058c
y.create.l HWIO_RPMH_VRM_VREG_CLR_ADDR_OFFSET_CSR_TYPE15_ADDR A:&base_addr+0x9f05ec
y.create.l HWIO_RPMH_VRM_VREG_CLR_DATA_CSR_TYPE0_ADDR A:&base_addr+0x9f0050
y.create.l HWIO_RPMH_VRM_VREG_CLR_DATA_CSR_TYPE1_ADDR A:&base_addr+0x9f00b0
y.create.l HWIO_RPMH_VRM_VREG_CLR_DATA_CSR_TYPE2_ADDR A:&base_addr+0x9f0110
y.create.l HWIO_RPMH_VRM_VREG_CLR_DATA_CSR_TYPE3_ADDR A:&base_addr+0x9f0170
y.create.l HWIO_RPMH_VRM_VREG_CLR_DATA_CSR_TYPE4_ADDR A:&base_addr+0x9f01d0
y.create.l HWIO_RPMH_VRM_VREG_CLR_DATA_CSR_TYPE5_ADDR A:&base_addr+0x9f0230
y.create.l HWIO_RPMH_VRM_VREG_CLR_DATA_CSR_TYPE6_ADDR A:&base_addr+0x9f0290
y.create.l HWIO_RPMH_VRM_VREG_CLR_DATA_CSR_TYPE7_ADDR A:&base_addr+0x9f02f0
y.create.l HWIO_RPMH_VRM_VREG_CLR_DATA_CSR_TYPE8_ADDR A:&base_addr+0x9f0350
y.create.l HWIO_RPMH_VRM_VREG_CLR_DATA_CSR_TYPE9_ADDR A:&base_addr+0x9f03b0
y.create.l HWIO_RPMH_VRM_VREG_CLR_DATA_CSR_TYPE10_ADDR A:&base_addr+0x9f0410
y.create.l HWIO_RPMH_VRM_VREG_CLR_DATA_CSR_TYPE11_ADDR A:&base_addr+0x9f0470
y.create.l HWIO_RPMH_VRM_VREG_CLR_DATA_CSR_TYPE12_ADDR A:&base_addr+0x9f04d0
y.create.l HWIO_RPMH_VRM_VREG_CLR_DATA_CSR_TYPE13_ADDR A:&base_addr+0x9f0530
y.create.l HWIO_RPMH_VRM_VREG_CLR_DATA_CSR_TYPE14_ADDR A:&base_addr+0x9f0590
y.create.l HWIO_RPMH_VRM_VREG_CLR_DATA_CSR_TYPE15_ADDR A:&base_addr+0x9f05f0
y.create.l HWIO_RPMH_VRM_DISCHARGE_TIME_CSR_TYPE0_ADDR A:&base_addr+0x9f0054
y.create.l HWIO_RPMH_VRM_DISCHARGE_TIME_CSR_TYPE1_ADDR A:&base_addr+0x9f00b4
y.create.l HWIO_RPMH_VRM_DISCHARGE_TIME_CSR_TYPE2_ADDR A:&base_addr+0x9f0114
y.create.l HWIO_RPMH_VRM_DISCHARGE_TIME_CSR_TYPE3_ADDR A:&base_addr+0x9f0174
y.create.l HWIO_RPMH_VRM_DISCHARGE_TIME_CSR_TYPE4_ADDR A:&base_addr+0x9f01d4
y.create.l HWIO_RPMH_VRM_DISCHARGE_TIME_CSR_TYPE5_ADDR A:&base_addr+0x9f0234
y.create.l HWIO_RPMH_VRM_DISCHARGE_TIME_CSR_TYPE6_ADDR A:&base_addr+0x9f0294
y.create.l HWIO_RPMH_VRM_DISCHARGE_TIME_CSR_TYPE7_ADDR A:&base_addr+0x9f02f4
y.create.l HWIO_RPMH_VRM_DISCHARGE_TIME_CSR_TYPE8_ADDR A:&base_addr+0x9f0354
y.create.l HWIO_RPMH_VRM_DISCHARGE_TIME_CSR_TYPE9_ADDR A:&base_addr+0x9f03b4
y.create.l HWIO_RPMH_VRM_DISCHARGE_TIME_CSR_TYPE10_ADDR A:&base_addr+0x9f0414
y.create.l HWIO_RPMH_VRM_DISCHARGE_TIME_CSR_TYPE11_ADDR A:&base_addr+0x9f0474
y.create.l HWIO_RPMH_VRM_DISCHARGE_TIME_CSR_TYPE12_ADDR A:&base_addr+0x9f04d4
y.create.l HWIO_RPMH_VRM_DISCHARGE_TIME_CSR_TYPE13_ADDR A:&base_addr+0x9f0534
y.create.l HWIO_RPMH_VRM_DISCHARGE_TIME_CSR_TYPE14_ADDR A:&base_addr+0x9f0594
y.create.l HWIO_RPMH_VRM_DISCHARGE_TIME_CSR_TYPE15_ADDR A:&base_addr+0x9f05f4
y.create.l HWIO_RPMH_VRM_VOLTAGE_DEP_IRQ_STATUS_0_CSR_ADDR A:&base_addr+0x9f1000
y.create.l HWIO_RPMH_VRM_VOLTAGE_DEP_IRQ_STATUS_1_CSR_ADDR A:&base_addr+0x9f1004
y.create.l HWIO_RPMH_VRM_ENABLE_DEP_IRQ_STATUS_0_CSR_ADDR A:&base_addr+0x9f1018
y.create.l HWIO_RPMH_VRM_ENABLE_DEP_IRQ_STATUS_1_CSR_ADDR A:&base_addr+0x9f101c
y.create.l HWIO_RPMH_VRM_MODE_DEP_IRQ_STATUS_0_CSR_ADDR A:&base_addr+0x9f1038
y.create.l HWIO_RPMH_VRM_MODE_DEP_IRQ_STATUS_1_CSR_ADDR A:&base_addr+0x9f103c
y.create.l HWIO_RPMH_VRM_HEADROOM_DEP_IRQ_STATUS_0_CSR_ADDR A:&base_addr+0x9f1050
y.create.l HWIO_RPMH_VRM_HEADROOM_DEP_IRQ_STATUS_1_CSR_ADDR A:&base_addr+0x9f1054
y.create.l HWIO_RPMH_VRM_VOLTAGE_CHANGE_IRQ_STATUS_0_CSR_ADDR A:&base_addr+0x9f1108
y.create.l HWIO_RPMH_VRM_VOLTAGE_CHANGE_IRQ_STATUS_1_CSR_ADDR A:&base_addr+0x9f110c
y.create.l HWIO_RPMH_VRM_ENABLE_CHANGE_IRQ_STATUS_0_CSR_ADDR A:&base_addr+0x9f1120
y.create.l HWIO_RPMH_VRM_ENABLE_CHANGE_IRQ_STATUS_1_CSR_ADDR A:&base_addr+0x9f1124
y.create.l HWIO_RPMH_VRM_MODE_CHANGE_IRQ_STATUS_0_CSR_ADDR A:&base_addr+0x9f1140
y.create.l HWIO_RPMH_VRM_MODE_CHANGE_IRQ_STATUS_1_CSR_ADDR A:&base_addr+0x9f1144
y.create.l HWIO_RPMH_VRM_HEADROOM_CHANGE_IRQ_STATUS_0_CSR_ADDR A:&base_addr+0x9f1158
y.create.l HWIO_RPMH_VRM_HEADROOM_CHANGE_IRQ_STATUS_1_CSR_ADDR A:&base_addr+0x9f115c
y.create.l HWIO_RPMH_VRM_VOLTAGE_SETTLED_IRQ_STATUS_0_CSR_ADDR A:&base_addr+0x9f1170
y.create.l HWIO_RPMH_VRM_VOLTAGE_SETTLED_IRQ_STATUS_1_CSR_ADDR A:&base_addr+0x9f1174
y.create.l HWIO_RPMH_VRM_ENABLE_SETTLED_IRQ_STATUS_0_CSR_ADDR A:&base_addr+0x9f1188
y.create.l HWIO_RPMH_VRM_ENABLE_SETTLED_IRQ_STATUS_1_CSR_ADDR A:&base_addr+0x9f118c
y.create.l HWIO_RPMH_VRM_MODE_SETTLED_IRQ_STATUS_0_CSR_ADDR A:&base_addr+0x9f11a0
y.create.l HWIO_RPMH_VRM_MODE_SETTLED_IRQ_STATUS_1_CSR_ADDR A:&base_addr+0x9f11a4
y.create.l HWIO_RPMH_VRM_HEADROOM_SETTLED_IRQ_STATUS_0_CSR_ADDR A:&base_addr+0x9f11b8
y.create.l HWIO_RPMH_VRM_HEADROOM_SETTLED_IRQ_STATUS_1_CSR_ADDR A:&base_addr+0x9f11bc
y.create.l HWIO_RPMH_VRM_VREG_READY_WDOG_IRQ_STATUS_0_CSR_ADDR A:&base_addr+0x9f1270
y.create.l HWIO_RPMH_VRM_VREG_READY_WDOG_IRQ_STATUS_1_CSR_ADDR A:&base_addr+0x9f1274
y.create.l HWIO_RPMH_VRM_VOLTAGE_DEP_IRQ_ENABLE_0_CSR_ADDR A:&base_addr+0x9f12c0
y.create.l HWIO_RPMH_VRM_VOLTAGE_DEP_IRQ_ENABLE_1_CSR_ADDR A:&base_addr+0x9f12c4
y.create.l HWIO_RPMH_VRM_ENABLE_DEP_IRQ_ENABLE_0_CSR_ADDR A:&base_addr+0x9f12d8
y.create.l HWIO_RPMH_VRM_ENABLE_DEP_IRQ_ENABLE_1_CSR_ADDR A:&base_addr+0x9f12dc
y.create.l HWIO_RPMH_VRM_MODE_DEP_IRQ_ENABLE_0_CSR_ADDR A:&base_addr+0x9f12f8
y.create.l HWIO_RPMH_VRM_MODE_DEP_IRQ_ENABLE_1_CSR_ADDR A:&base_addr+0x9f12fc
y.create.l HWIO_RPMH_VRM_HEADROOM_DEP_IRQ_ENABLE_0_CSR_ADDR A:&base_addr+0x9f1310
y.create.l HWIO_RPMH_VRM_HEADROOM_DEP_IRQ_ENABLE_1_CSR_ADDR A:&base_addr+0x9f1314
y.create.l HWIO_RPMH_VRM_VOLTAGE_CHANGE_IRQ_ENABLE_0_CSR_ADDR A:&base_addr+0x9f13c8
y.create.l HWIO_RPMH_VRM_VOLTAGE_CHANGE_IRQ_ENABLE_1_CSR_ADDR A:&base_addr+0x9f13cc
y.create.l HWIO_RPMH_VRM_ENABLE_CHANGE_IRQ_ENABLE_0_CSR_ADDR A:&base_addr+0x9f13e0
y.create.l HWIO_RPMH_VRM_ENABLE_CHANGE_IRQ_ENABLE_1_CSR_ADDR A:&base_addr+0x9f13e4
y.create.l HWIO_RPMH_VRM_MODE_CHANGE_IRQ_ENABLE_0_CSR_ADDR A:&base_addr+0x9f1400
y.create.l HWIO_RPMH_VRM_MODE_CHANGE_IRQ_ENABLE_1_CSR_ADDR A:&base_addr+0x9f1404
y.create.l HWIO_RPMH_VRM_HEADROOM_CHANGE_IRQ_ENABLE_0_CSR_ADDR A:&base_addr+0x9f1418
y.create.l HWIO_RPMH_VRM_HEADROOM_CHANGE_IRQ_ENABLE_1_CSR_ADDR A:&base_addr+0x9f141c
y.create.l HWIO_RPMH_VRM_VOLTAGE_SETTLED_IRQ_ENABLE_0_CSR_ADDR A:&base_addr+0x9f14d0
y.create.l HWIO_RPMH_VRM_VOLTAGE_SETTLED_IRQ_ENABLE_1_CSR_ADDR A:&base_addr+0x9f14d4
y.create.l HWIO_RPMH_VRM_ENABLE_SETTLED_IRQ_ENABLE_0_CSR_ADDR A:&base_addr+0x9f14e8
y.create.l HWIO_RPMH_VRM_ENABLE_SETTLED_IRQ_ENABLE_1_CSR_ADDR A:&base_addr+0x9f14ec
y.create.l HWIO_RPMH_VRM_MODE_SETTLED_IRQ_ENABLE_0_CSR_ADDR A:&base_addr+0x9f1508
y.create.l HWIO_RPMH_VRM_MODE_SETTLED_IRQ_ENABLE_1_CSR_ADDR A:&base_addr+0x9f150c
y.create.l HWIO_RPMH_VRM_HEADROOM_SETTLED_IRQ_ENABLE_0_CSR_ADDR A:&base_addr+0x9f1520
y.create.l HWIO_RPMH_VRM_HEADROOM_SETTLED_IRQ_ENABLE_1_CSR_ADDR A:&base_addr+0x9f1524
y.create.l HWIO_RPMH_VRM_VREG_READY_WDOG_IRQ_ENABLE_0_CSR_ADDR A:&base_addr+0x9f1538
y.create.l HWIO_RPMH_VRM_VREG_READY_WDOG_IRQ_ENABLE_1_CSR_ADDR A:&base_addr+0x9f153c
y.create.l HWIO_RPMH_VRM_VOLTAGE_CHANGE_IRQ_CLEAR_0_CSR_ADDR A:&base_addr+0x9f1588
y.create.l HWIO_RPMH_VRM_VOLTAGE_CHANGE_IRQ_CLEAR_1_CSR_ADDR A:&base_addr+0x9f158c
y.create.l HWIO_RPMH_VRM_ENABLE_CHANGE_IRQ_CLEAR_0_CSR_ADDR A:&base_addr+0x9f15a0
y.create.l HWIO_RPMH_VRM_ENABLE_CHANGE_IRQ_CLEAR_1_CSR_ADDR A:&base_addr+0x9f15a4
y.create.l HWIO_RPMH_VRM_MODE_CHANGE_IRQ_CLEAR_0_CSR_ADDR A:&base_addr+0x9f15c0
y.create.l HWIO_RPMH_VRM_MODE_CHANGE_IRQ_CLEAR_1_CSR_ADDR A:&base_addr+0x9f15c4
y.create.l HWIO_RPMH_VRM_HEADROOM_CHANGE_IRQ_CLEAR_0_CSR_ADDR A:&base_addr+0x9f15d8
y.create.l HWIO_RPMH_VRM_HEADROOM_CHANGE_IRQ_CLEAR_1_CSR_ADDR A:&base_addr+0x9f15dc
y.create.l HWIO_RPMH_VRM_VOLTAGE_SETTLED_IRQ_CLEAR_0_CSR_ADDR A:&base_addr+0x9f1690
y.create.l HWIO_RPMH_VRM_VOLTAGE_SETTLED_IRQ_CLEAR_1_CSR_ADDR A:&base_addr+0x9f1694
y.create.l HWIO_RPMH_VRM_ENABLE_SETTLED_IRQ_CLEAR_0_CSR_ADDR A:&base_addr+0x9f16a8
y.create.l HWIO_RPMH_VRM_ENABLE_SETTLED_IRQ_CLEAR_1_CSR_ADDR A:&base_addr+0x9f16ac
y.create.l HWIO_RPMH_VRM_MODE_SETTLED_IRQ_CLEAR_0_CSR_ADDR A:&base_addr+0x9f16c8
y.create.l HWIO_RPMH_VRM_MODE_SETTLED_IRQ_CLEAR_1_CSR_ADDR A:&base_addr+0x9f16cc
y.create.l HWIO_RPMH_VRM_HEADROOM_SETTLED_IRQ_CLEAR_0_CSR_ADDR A:&base_addr+0x9f16e0
y.create.l HWIO_RPMH_VRM_HEADROOM_SETTLED_IRQ_CLEAR_1_CSR_ADDR A:&base_addr+0x9f16e4
y.create.l HWIO_RPMH_VRM_VREG_READY_WDOG_IRQ_CLEAR_0_CSR_ADDR A:&base_addr+0x9f1798
y.create.l HWIO_RPMH_VRM_VREG_READY_WDOG_IRQ_CLEAR_1_CSR_ADDR A:&base_addr+0x9f179c
y.create.l HWIO_RPMH_VRM_MAX_VOLTAGE_VIOLATION_IRQ_STATUS_0_CSR_ADDR A:&base_addr+0x9f17b4
y.create.l HWIO_RPMH_VRM_MAX_VOLTAGE_VIOLATION_IRQ_STATUS_1_CSR_ADDR A:&base_addr+0x9f17b8
y.create.l HWIO_RPMH_VRM_MAX_VOLTAGE_VIOLATION_IRQ_ENABLE_0_CSR_ADDR A:&base_addr+0x9f17c0
y.create.l HWIO_RPMH_VRM_MAX_VOLTAGE_VIOLATION_IRQ_ENABLE_1_CSR_ADDR A:&base_addr+0x9f17c4
y.create.l HWIO_RPMH_VRM_MAX_VOLTAGE_VIOLATION_IRQ_CLEAR_0_CSR_ADDR A:&base_addr+0x9f18c0
y.create.l HWIO_RPMH_VRM_MAX_VOLTAGE_VIOLATION_IRQ_CLEAR_1_CSR_ADDR A:&base_addr+0x9f18c4
y.create.l HWIO_RPMH_VRM_CTT_OVERFLOW_IRQ_STATUS_CSR_ADDR A:&base_addr+0x9f18cc
y.create.l HWIO_RPMH_VRM_CTT_OVERFLOW_IRQ_ENABLE_CSR_ADDR A:&base_addr+0x9f18d0
y.create.l HWIO_RPMH_VRM_CTT_OVERFLOW_IRQ_CLEAR_CSR_ADDR A:&base_addr+0x9f18d4
y.create.l HWIO_RPMH_VRM_S_PORT_FAILURE_IRQ_STATUS_CSR_ADDR A:&base_addr+0x9f18d8
y.create.l HWIO_RPMH_VRM_S_PORT_FAILURE_IRQ_ENABLE_CSR_ADDR A:&base_addr+0x9f18dc
y.create.l HWIO_RPMH_VRM_S_PORT_FAILURE_IRQ_CLEAR_CSR_ADDR A:&base_addr+0x9f18e0
y.create.l HWIO_RPMH_VRM_SW_UNBLOCK_SEQ_PRE_CSR_ADDR A:&base_addr+0x9f18e4
y.create.l HWIO_RPMH_VRM_SW_UNBLOCK_SEQ_POST_CSR_ADDR A:&base_addr+0x9f18e8
y.create.l HWIO_RPMH_VRM_SEQUENCER_IRQ_CLEAR_PRE_CSR_ADDR A:&base_addr+0x9f18ec
y.create.l HWIO_RPMH_VRM_SEQUENCER_IRQ_CLEAR_POST_CSR_ADDR A:&base_addr+0x9f18f0
y.create.l HWIO_RPMH_VRM_SEQUENCER_IRQ_ENABLE_PRE_CSR_ADDR A:&base_addr+0x9f18f4
y.create.l HWIO_RPMH_VRM_SEQUENCER_IRQ_ENABLE_POST_CSR_ADDR A:&base_addr+0x9f18f8
y.create.l HWIO_RPMH_VRM_SEQUENCER_IRQ_STATUS_PRE_CSR_ADDR A:&base_addr+0x9f18fc
y.create.l HWIO_RPMH_VRM_SEQUENCER_IRQ_STATUS_POST_CSR_ADDR A:&base_addr+0x9f1900
y.create.l HWIO_RPMH_VRM_SEQUENCER0_STATUS_CSR_ADDR A:&base_addr+0x9f2000
y.create.l HWIO_RPMH_VRM_SEQUENCER1_STATUS_CSR_ADDR A:&base_addr+0x9f2004
y.create.l HWIO_RPMH_VRM_SEQUENCER2_STATUS_CSR_ADDR A:&base_addr+0x9f2008
y.create.l HWIO_RPMH_VRM_SEQUENCER3_STATUS_CSR_ADDR A:&base_addr+0x9f200c
y.create.l HWIO_RPMH_VRM_SEQUENCER4_STATUS_CSR_ADDR A:&base_addr+0x9f2010
y.create.l HWIO_RPMH_VRM_SEQUENCER5_STATUS_CSR_ADDR A:&base_addr+0x9f2014
y.create.l HWIO_RPMH_VRM_SEQUENCER6_STATUS_CSR_ADDR A:&base_addr+0x9f2018
y.create.l HWIO_RPMH_VRM_SEQUENCER7_STATUS_CSR_ADDR A:&base_addr+0x9f201c
y.create.l HWIO_RPMH_VRM_SEQUENCER8_STATUS_CSR_ADDR A:&base_addr+0x9f2020
y.create.l HWIO_RPMH_VRM_SEQUENCER9_STATUS_CSR_ADDR A:&base_addr+0x9f2024
y.create.l HWIO_RPMH_VRM_SEQUENCER10_STATUS_CSR_ADDR A:&base_addr+0x9f2028
y.create.l HWIO_RPMH_VRM_SEQUENCER11_STATUS_CSR_ADDR A:&base_addr+0x9f202c
y.create.l HWIO_RPMH_VRM_SEQUENCER12_STATUS_CSR_ADDR A:&base_addr+0x9f2030
y.create.l HWIO_RPMH_VRM_SEQUENCER13_STATUS_CSR_ADDR A:&base_addr+0x9f2034
y.create.l HWIO_RPMH_VRM_SEQUENCER14_STATUS_CSR_ADDR A:&base_addr+0x9f2038
y.create.l HWIO_RPMH_VRM_SEQUENCER15_STATUS_CSR_ADDR A:&base_addr+0x9f203c
y.create.l HWIO_RPMH_VRM_SEQUENCER16_STATUS_CSR_ADDR A:&base_addr+0x9f2040
y.create.l HWIO_RPMH_VRM_SEQUENCER17_STATUS_CSR_ADDR A:&base_addr+0x9f2044
y.create.l HWIO_RPMH_VRM_SEQUENCER18_STATUS_CSR_ADDR A:&base_addr+0x9f2048
y.create.l HWIO_RPMH_VRM_SEQUENCER19_STATUS_CSR_ADDR A:&base_addr+0x9f204c
y.create.l HWIO_RPMH_VRM_SEQUENCER20_STATUS_CSR_ADDR A:&base_addr+0x9f2050
y.create.l HWIO_RPMH_VRM_SEQUENCER21_STATUS_CSR_ADDR A:&base_addr+0x9f2054
y.create.l HWIO_RPMH_VRM_SEQUENCER22_STATUS_CSR_ADDR A:&base_addr+0x9f2058
y.create.l HWIO_RPMH_VRM_SEQUENCER23_STATUS_CSR_ADDR A:&base_addr+0x9f205c
y.create.l HWIO_RPMH_VRM_SEQUENCER24_STATUS_CSR_ADDR A:&base_addr+0x9f2060
y.create.l HWIO_RPMH_VRM_SEQUENCER25_STATUS_CSR_ADDR A:&base_addr+0x9f2064
y.create.l HWIO_RPMH_VRM_SEQUENCER26_STATUS_CSR_ADDR A:&base_addr+0x9f2068
y.create.l HWIO_RPMH_VRM_SEQUENCER27_STATUS_CSR_ADDR A:&base_addr+0x9f206c
y.create.l HWIO_RPMH_VRM_SEQUENCER28_STATUS_CSR_ADDR A:&base_addr+0x9f2070
y.create.l HWIO_RPMH_VRM_SEQUENCER29_STATUS_CSR_ADDR A:&base_addr+0x9f2074
y.create.l HWIO_RPMH_VRM_SEQUENCER30_STATUS_CSR_ADDR A:&base_addr+0x9f2078
y.create.l HWIO_RPMH_VRM_SEQUENCER31_STATUS_CSR_ADDR A:&base_addr+0x9f207c
y.create.l HWIO_RPMH_VRM_VRM_IDLE_STATUS_CSR_ADDR A:&base_addr+0x9f2100
y.create.l HWIO_RPMH_VRM_SEQ_START_ADDR0_ADDR A:&base_addr+0x9f3190
y.create.l HWIO_RPMH_VRM_SEQ_START_ADDR1_ADDR A:&base_addr+0x9f3194
y.create.l HWIO_RPMH_VRM_SEQ_START_ADDR2_ADDR A:&base_addr+0x9f3198
y.create.l HWIO_RPMH_VRM_SEQ_START_ADDR3_ADDR A:&base_addr+0x9f319c
y.create.l HWIO_RPMH_VRM_SEQ_START_ADDR4_ADDR A:&base_addr+0x9f31a0
y.create.l HWIO_RPMH_VRM_SEQ_START_ADDR5_ADDR A:&base_addr+0x9f31a4
y.create.l HWIO_RPMH_VRM_SEQ_START_ADDR6_ADDR A:&base_addr+0x9f31a8
y.create.l HWIO_RPMH_VRM_SEQ_START_ADDR7_ADDR A:&base_addr+0x9f31ac
y.create.l HWIO_RPMH_VRM_SEQ_WORD0_ADDR A:&base_addr+0x9f31f4
y.create.l HWIO_RPMH_VRM_SEQ_WORD1_ADDR A:&base_addr+0x9f31f8
y.create.l HWIO_RPMH_VRM_SEQ_WORD2_ADDR A:&base_addr+0x9f31fc
y.create.l HWIO_RPMH_VRM_SEQ_WORD3_ADDR A:&base_addr+0x9f3200
y.create.l HWIO_RPMH_VRM_SEQ_WORD4_ADDR A:&base_addr+0x9f3204
y.create.l HWIO_RPMH_VRM_SEQ_WORD5_ADDR A:&base_addr+0x9f3208
y.create.l HWIO_RPMH_VRM_SEQ_WORD6_ADDR A:&base_addr+0x9f320c
y.create.l HWIO_RPMH_VRM_SEQ_WORD7_ADDR A:&base_addr+0x9f3210
y.create.l HWIO_RPMH_VRM_SEQ_WORD8_ADDR A:&base_addr+0x9f3214
y.create.l HWIO_RPMH_VRM_SEQ_WORD9_ADDR A:&base_addr+0x9f3218
y.create.l HWIO_RPMH_VRM_SEQ_WORD10_ADDR A:&base_addr+0x9f321c
y.create.l HWIO_RPMH_VRM_SEQ_WORD11_ADDR A:&base_addr+0x9f3220
y.create.l HWIO_RPMH_VRM_SEQ_WORD12_ADDR A:&base_addr+0x9f3224
y.create.l HWIO_RPMH_VRM_SEQ_WORD13_ADDR A:&base_addr+0x9f3228
y.create.l HWIO_RPMH_VRM_SEQ_WORD14_ADDR A:&base_addr+0x9f322c
y.create.l HWIO_RPMH_VRM_SEQ_WORD15_ADDR A:&base_addr+0x9f3230
y.create.l HWIO_RPMH_VRM_SEQ_WORD16_ADDR A:&base_addr+0x9f3234
y.create.l HWIO_RPMH_VRM_SEQ_WORD17_ADDR A:&base_addr+0x9f3238
y.create.l HWIO_RPMH_VRM_SEQ_WORD18_ADDR A:&base_addr+0x9f323c
y.create.l HWIO_RPMH_VRM_SEQ_WORD19_ADDR A:&base_addr+0x9f3240
y.create.l HWIO_RPMH_VRM_SEQ_WORD20_ADDR A:&base_addr+0x9f3244
y.create.l HWIO_RPMH_VRM_SEQ_WORD21_ADDR A:&base_addr+0x9f3248
y.create.l HWIO_RPMH_VRM_SEQ_WORD22_ADDR A:&base_addr+0x9f324c
y.create.l HWIO_RPMH_VRM_SEQ_WORD23_ADDR A:&base_addr+0x9f3250
y.create.l HWIO_RPMH_VRM_SEQ_WORD24_ADDR A:&base_addr+0x9f3254
y.create.l HWIO_RPMH_VRM_SEQ_WORD25_ADDR A:&base_addr+0x9f3258
y.create.l HWIO_RPMH_VRM_SEQ_WORD26_ADDR A:&base_addr+0x9f325c
y.create.l HWIO_RPMH_VRM_SEQ_WORD27_ADDR A:&base_addr+0x9f3260
y.create.l HWIO_RPMH_VRM_SEQ_WORD28_ADDR A:&base_addr+0x9f3264
y.create.l HWIO_RPMH_VRM_SEQ_WORD29_ADDR A:&base_addr+0x9f3268
y.create.l HWIO_RPMH_VRM_SEQ_WORD30_ADDR A:&base_addr+0x9f326c
y.create.l HWIO_RPMH_VRM_SEQ_WORD31_ADDR A:&base_addr+0x9f3270
y.create.l HWIO_RPMH_VRM_SEQ_DATA_0_SEQCERS0_ADDR A:&base_addr+0x9f35f4
y.create.l HWIO_RPMH_VRM_SEQ_DATA_0_SEQCERS1_ADDR A:&base_addr+0x9f3600
y.create.l HWIO_RPMH_VRM_SEQ_DATA_0_SEQCERS2_ADDR A:&base_addr+0x9f360c
y.create.l HWIO_RPMH_VRM_SEQ_DATA_0_SEQCERS3_ADDR A:&base_addr+0x9f3618
y.create.l HWIO_RPMH_VRM_SEQ_DATA_0_SEQCERS4_ADDR A:&base_addr+0x9f3624
y.create.l HWIO_RPMH_VRM_SEQ_DATA_0_SEQCERS5_ADDR A:&base_addr+0x9f3630
y.create.l HWIO_RPMH_VRM_SEQ_DATA_0_SEQCERS6_ADDR A:&base_addr+0x9f363c
y.create.l HWIO_RPMH_VRM_SEQ_DATA_0_SEQCERS7_ADDR A:&base_addr+0x9f3648
y.create.l HWIO_RPMH_VRM_SEQ_DATA_0_SEQCERS8_ADDR A:&base_addr+0x9f3654
y.create.l HWIO_RPMH_VRM_SEQ_DATA_0_SEQCERS9_ADDR A:&base_addr+0x9f3660
y.create.l HWIO_RPMH_VRM_SEQ_DATA_0_SEQCERS10_ADDR A:&base_addr+0x9f366c
y.create.l HWIO_RPMH_VRM_SEQ_DATA_0_SEQCERS11_ADDR A:&base_addr+0x9f3678
y.create.l HWIO_RPMH_VRM_SEQ_DATA_0_SEQCERS12_ADDR A:&base_addr+0x9f3684
y.create.l HWIO_RPMH_VRM_SEQ_DATA_0_SEQCERS13_ADDR A:&base_addr+0x9f3690
y.create.l HWIO_RPMH_VRM_SEQ_DATA_0_SEQCERS14_ADDR A:&base_addr+0x9f369c
y.create.l HWIO_RPMH_VRM_SEQ_DATA_0_SEQCERS15_ADDR A:&base_addr+0x9f36a8
y.create.l HWIO_RPMH_VRM_SEQ_DATA_0_SEQCERS16_ADDR A:&base_addr+0x9f36b4
y.create.l HWIO_RPMH_VRM_SEQ_DATA_0_SEQCERS17_ADDR A:&base_addr+0x9f36c0
y.create.l HWIO_RPMH_VRM_SEQ_DATA_0_SEQCERS18_ADDR A:&base_addr+0x9f36cc
y.create.l HWIO_RPMH_VRM_SEQ_DATA_0_SEQCERS19_ADDR A:&base_addr+0x9f36d8
y.create.l HWIO_RPMH_VRM_SEQ_DATA_0_SEQCERS20_ADDR A:&base_addr+0x9f36e4
y.create.l HWIO_RPMH_VRM_SEQ_DATA_0_SEQCERS21_ADDR A:&base_addr+0x9f36f0
y.create.l HWIO_RPMH_VRM_SEQ_DATA_0_SEQCERS22_ADDR A:&base_addr+0x9f36fc
y.create.l HWIO_RPMH_VRM_SEQ_DATA_0_SEQCERS23_ADDR A:&base_addr+0x9f3708
y.create.l HWIO_RPMH_VRM_SEQ_DATA_0_SEQCERS24_ADDR A:&base_addr+0x9f3714
y.create.l HWIO_RPMH_VRM_SEQ_DATA_0_SEQCERS25_ADDR A:&base_addr+0x9f3720
y.create.l HWIO_RPMH_VRM_SEQ_DATA_0_SEQCERS26_ADDR A:&base_addr+0x9f372c
y.create.l HWIO_RPMH_VRM_SEQ_DATA_0_SEQCERS27_ADDR A:&base_addr+0x9f3738
y.create.l HWIO_RPMH_VRM_SEQ_DATA_0_SEQCERS28_ADDR A:&base_addr+0x9f3744
y.create.l HWIO_RPMH_VRM_SEQ_DATA_0_SEQCERS29_ADDR A:&base_addr+0x9f3750
y.create.l HWIO_RPMH_VRM_SEQ_DATA_0_SEQCERS30_ADDR A:&base_addr+0x9f375c
y.create.l HWIO_RPMH_VRM_SEQ_DATA_0_SEQCERS31_ADDR A:&base_addr+0x9f3768
y.create.l HWIO_RPMH_VRM_SEQ_DATA_1_SEQCERS0_ADDR A:&base_addr+0x9f35f8
y.create.l HWIO_RPMH_VRM_SEQ_DATA_1_SEQCERS1_ADDR A:&base_addr+0x9f3604
y.create.l HWIO_RPMH_VRM_SEQ_DATA_1_SEQCERS2_ADDR A:&base_addr+0x9f3610
y.create.l HWIO_RPMH_VRM_SEQ_DATA_1_SEQCERS3_ADDR A:&base_addr+0x9f361c
y.create.l HWIO_RPMH_VRM_SEQ_DATA_1_SEQCERS4_ADDR A:&base_addr+0x9f3628
y.create.l HWIO_RPMH_VRM_SEQ_DATA_1_SEQCERS5_ADDR A:&base_addr+0x9f3634
y.create.l HWIO_RPMH_VRM_SEQ_DATA_1_SEQCERS6_ADDR A:&base_addr+0x9f3640
y.create.l HWIO_RPMH_VRM_SEQ_DATA_1_SEQCERS7_ADDR A:&base_addr+0x9f364c
y.create.l HWIO_RPMH_VRM_SEQ_DATA_1_SEQCERS8_ADDR A:&base_addr+0x9f3658
y.create.l HWIO_RPMH_VRM_SEQ_DATA_1_SEQCERS9_ADDR A:&base_addr+0x9f3664
y.create.l HWIO_RPMH_VRM_SEQ_DATA_1_SEQCERS10_ADDR A:&base_addr+0x9f3670
y.create.l HWIO_RPMH_VRM_SEQ_DATA_1_SEQCERS11_ADDR A:&base_addr+0x9f367c
y.create.l HWIO_RPMH_VRM_SEQ_DATA_1_SEQCERS12_ADDR A:&base_addr+0x9f3688
y.create.l HWIO_RPMH_VRM_SEQ_DATA_1_SEQCERS13_ADDR A:&base_addr+0x9f3694
y.create.l HWIO_RPMH_VRM_SEQ_DATA_1_SEQCERS14_ADDR A:&base_addr+0x9f36a0
y.create.l HWIO_RPMH_VRM_SEQ_DATA_1_SEQCERS15_ADDR A:&base_addr+0x9f36ac
y.create.l HWIO_RPMH_VRM_SEQ_DATA_1_SEQCERS16_ADDR A:&base_addr+0x9f36b8
y.create.l HWIO_RPMH_VRM_SEQ_DATA_1_SEQCERS17_ADDR A:&base_addr+0x9f36c4
y.create.l HWIO_RPMH_VRM_SEQ_DATA_1_SEQCERS18_ADDR A:&base_addr+0x9f36d0
y.create.l HWIO_RPMH_VRM_SEQ_DATA_1_SEQCERS19_ADDR A:&base_addr+0x9f36dc
y.create.l HWIO_RPMH_VRM_SEQ_DATA_1_SEQCERS20_ADDR A:&base_addr+0x9f36e8
y.create.l HWIO_RPMH_VRM_SEQ_DATA_1_SEQCERS21_ADDR A:&base_addr+0x9f36f4
y.create.l HWIO_RPMH_VRM_SEQ_DATA_1_SEQCERS22_ADDR A:&base_addr+0x9f3700
y.create.l HWIO_RPMH_VRM_SEQ_DATA_1_SEQCERS23_ADDR A:&base_addr+0x9f370c
y.create.l HWIO_RPMH_VRM_SEQ_DATA_1_SEQCERS24_ADDR A:&base_addr+0x9f3718
y.create.l HWIO_RPMH_VRM_SEQ_DATA_1_SEQCERS25_ADDR A:&base_addr+0x9f3724
y.create.l HWIO_RPMH_VRM_SEQ_DATA_1_SEQCERS26_ADDR A:&base_addr+0x9f3730
y.create.l HWIO_RPMH_VRM_SEQ_DATA_1_SEQCERS27_ADDR A:&base_addr+0x9f373c
y.create.l HWIO_RPMH_VRM_SEQ_DATA_1_SEQCERS28_ADDR A:&base_addr+0x9f3748
y.create.l HWIO_RPMH_VRM_SEQ_DATA_1_SEQCERS29_ADDR A:&base_addr+0x9f3754
y.create.l HWIO_RPMH_VRM_SEQ_DATA_1_SEQCERS30_ADDR A:&base_addr+0x9f3760
y.create.l HWIO_RPMH_VRM_SEQ_DATA_1_SEQCERS31_ADDR A:&base_addr+0x9f376c
y.create.l HWIO_RPMH_VRM_SEQ_DATA_2_SEQCERS0_ADDR A:&base_addr+0x9f35fc
y.create.l HWIO_RPMH_VRM_SEQ_DATA_2_SEQCERS1_ADDR A:&base_addr+0x9f3608
y.create.l HWIO_RPMH_VRM_SEQ_DATA_2_SEQCERS2_ADDR A:&base_addr+0x9f3614
y.create.l HWIO_RPMH_VRM_SEQ_DATA_2_SEQCERS3_ADDR A:&base_addr+0x9f3620
y.create.l HWIO_RPMH_VRM_SEQ_DATA_2_SEQCERS4_ADDR A:&base_addr+0x9f362c
y.create.l HWIO_RPMH_VRM_SEQ_DATA_2_SEQCERS5_ADDR A:&base_addr+0x9f3638
y.create.l HWIO_RPMH_VRM_SEQ_DATA_2_SEQCERS6_ADDR A:&base_addr+0x9f3644
y.create.l HWIO_RPMH_VRM_SEQ_DATA_2_SEQCERS7_ADDR A:&base_addr+0x9f3650
y.create.l HWIO_RPMH_VRM_SEQ_DATA_2_SEQCERS8_ADDR A:&base_addr+0x9f365c
y.create.l HWIO_RPMH_VRM_SEQ_DATA_2_SEQCERS9_ADDR A:&base_addr+0x9f3668
y.create.l HWIO_RPMH_VRM_SEQ_DATA_2_SEQCERS10_ADDR A:&base_addr+0x9f3674
y.create.l HWIO_RPMH_VRM_SEQ_DATA_2_SEQCERS11_ADDR A:&base_addr+0x9f3680
y.create.l HWIO_RPMH_VRM_SEQ_DATA_2_SEQCERS12_ADDR A:&base_addr+0x9f368c
y.create.l HWIO_RPMH_VRM_SEQ_DATA_2_SEQCERS13_ADDR A:&base_addr+0x9f3698
y.create.l HWIO_RPMH_VRM_SEQ_DATA_2_SEQCERS14_ADDR A:&base_addr+0x9f36a4
y.create.l HWIO_RPMH_VRM_SEQ_DATA_2_SEQCERS15_ADDR A:&base_addr+0x9f36b0
y.create.l HWIO_RPMH_VRM_SEQ_DATA_2_SEQCERS16_ADDR A:&base_addr+0x9f36bc
y.create.l HWIO_RPMH_VRM_SEQ_DATA_2_SEQCERS17_ADDR A:&base_addr+0x9f36c8
y.create.l HWIO_RPMH_VRM_SEQ_DATA_2_SEQCERS18_ADDR A:&base_addr+0x9f36d4
y.create.l HWIO_RPMH_VRM_SEQ_DATA_2_SEQCERS19_ADDR A:&base_addr+0x9f36e0
y.create.l HWIO_RPMH_VRM_SEQ_DATA_2_SEQCERS20_ADDR A:&base_addr+0x9f36ec
y.create.l HWIO_RPMH_VRM_SEQ_DATA_2_SEQCERS21_ADDR A:&base_addr+0x9f36f8
y.create.l HWIO_RPMH_VRM_SEQ_DATA_2_SEQCERS22_ADDR A:&base_addr+0x9f3704
y.create.l HWIO_RPMH_VRM_SEQ_DATA_2_SEQCERS23_ADDR A:&base_addr+0x9f3710
y.create.l HWIO_RPMH_VRM_SEQ_DATA_2_SEQCERS24_ADDR A:&base_addr+0x9f371c
y.create.l HWIO_RPMH_VRM_SEQ_DATA_2_SEQCERS25_ADDR A:&base_addr+0x9f3728
y.create.l HWIO_RPMH_VRM_SEQ_DATA_2_SEQCERS26_ADDR A:&base_addr+0x9f3734
y.create.l HWIO_RPMH_VRM_SEQ_DATA_2_SEQCERS27_ADDR A:&base_addr+0x9f3740
y.create.l HWIO_RPMH_VRM_SEQ_DATA_2_SEQCERS28_ADDR A:&base_addr+0x9f374c
y.create.l HWIO_RPMH_VRM_SEQ_DATA_2_SEQCERS29_ADDR A:&base_addr+0x9f3758
y.create.l HWIO_RPMH_VRM_SEQ_DATA_2_SEQCERS30_ADDR A:&base_addr+0x9f3764
y.create.l HWIO_RPMH_VRM_SEQ_DATA_2_SEQCERS31_ADDR A:&base_addr+0x9f3770
y.create.l HWIO_RPMH_VRM_VRM_VERSION_ADDR A:&base_addr+0x9f5000
y.create.l HWIO_RPMH_VRM_VREG_READY_EXTRA_TIME_ADDR A:&base_addr+0x9f5004
y.create.l HWIO_RPMH_VRM_VREG_READY_WDOG_ERROR_ENABLE_ADDR A:&base_addr+0x9f5008
y.create.l HWIO_RPMH_VRM_VREG_READY_CLR_BR_ADDR_CSR_REG_ADDR A:&base_addr+0x9f500c
y.create.l HWIO_RPMH_VRM_CMD_SYN_UNBLOCK_ADDR A:&base_addr+0x9f5010
y.create.l HWIO_RPMH_VRM_MIN_SETTLING_TIME_CSR_REG_ADDR A:&base_addr+0x9f5014
y.create.l HWIO_RPMH_VRM_RESP_ADDR_DRV0_ADDR A:&base_addr+0x9f5090
y.create.l HWIO_RPMH_VRM_RESP_ADDR_DRV1_ADDR A:&base_addr+0x9f5094
y.create.l HWIO_RPMH_VRM_RESP_ADDR_DRV2_ADDR A:&base_addr+0x9f5098
y.create.l HWIO_RPMH_VRM_RESP_ADDR_DRV3_ADDR A:&base_addr+0x9f509c
y.create.l HWIO_RPMH_VRM_RESP_ADDR_DRV4_ADDR A:&base_addr+0x9f50a0
y.create.l HWIO_RPMH_VRM_RESP_ADDR_DRV5_ADDR A:&base_addr+0x9f50a4
y.create.l HWIO_RPMH_VRM_RESP_ADDR_DRV6_ADDR A:&base_addr+0x9f50a8
y.create.l HWIO_RPMH_VRM_RESP_ADDR_DRV7_ADDR A:&base_addr+0x9f50ac
y.create.l HWIO_RPMH_VRM_RESP_ADDR_DRV8_ADDR A:&base_addr+0x9f50b0
y.create.l HWIO_RPMH_VRM_RESP_ADDR_DRV9_ADDR A:&base_addr+0x9f50b4
y.create.l HWIO_RPMH_VRM_RESP_ADDR_DRV10_ADDR A:&base_addr+0x9f50b8
y.create.l HWIO_RPMH_VRM_RESP_ADDR_DRV11_ADDR A:&base_addr+0x9f50bc
y.create.l HWIO_RPMH_VRM_RESP_ADDR_DRV12_ADDR A:&base_addr+0x9f50c0
y.create.l HWIO_RPMH_VRM_RESP_ADDR_DRV13_ADDR A:&base_addr+0x9f50c4
y.create.l HWIO_RPMH_VRM_RESP_ADDR_DRV14_ADDR A:&base_addr+0x9f50c8
y.create.l HWIO_RPMH_VRM_RESP_ADDR2_DRV0_ADDR A:&base_addr+0x9f5100
y.create.l HWIO_RPMH_VRM_RESP_ADDR2_DRV1_ADDR A:&base_addr+0x9f5104
y.create.l HWIO_RPMH_VRM_RESP_ADDR2_DRV2_ADDR A:&base_addr+0x9f5108
y.create.l HWIO_RPMH_VRM_RESP_ADDR2_DRV3_ADDR A:&base_addr+0x9f510c
y.create.l HWIO_RPMH_VRM_RESP_ADDR2_DRV4_ADDR A:&base_addr+0x9f5110
y.create.l HWIO_RPMH_VRM_RESP_ADDR2_DRV5_ADDR A:&base_addr+0x9f5114
y.create.l HWIO_RPMH_VRM_RESP_ADDR2_DRV6_ADDR A:&base_addr+0x9f5118
y.create.l HWIO_RPMH_VRM_RESP_ADDR2_DRV7_ADDR A:&base_addr+0x9f511c
y.create.l HWIO_RPMH_VRM_RESP_ADDR2_DRV8_ADDR A:&base_addr+0x9f5120
y.create.l HWIO_RPMH_VRM_RESP_ADDR2_DRV9_ADDR A:&base_addr+0x9f5124
y.create.l HWIO_RPMH_VRM_RESP_ADDR2_DRV10_ADDR A:&base_addr+0x9f5128
y.create.l HWIO_RPMH_VRM_RESP_ADDR2_DRV11_ADDR A:&base_addr+0x9f512c
y.create.l HWIO_RPMH_VRM_RESP_ADDR2_DRV12_ADDR A:&base_addr+0x9f5130
y.create.l HWIO_RPMH_VRM_RESP_ADDR2_DRV13_ADDR A:&base_addr+0x9f5134
y.create.l HWIO_RPMH_VRM_RESP_ADDR2_DRV14_ADDR A:&base_addr+0x9f5138
y.create.l HWIO_RPMH_VRM_VRM_CFG_ADDR A:&base_addr+0x9f54a8
y.create.l HWIO_RPMH_VRM_CMD_SYN_CFG_ADDR A:&base_addr+0x9f54ac
y.create.l HWIO_RPMH_VRM_SW_WORKAROUND_BR_ADDR0_CSR_REG_ADDR A:&base_addr+0x9f54b0
y.create.l HWIO_RPMH_VRM_SW_WORKAROUND_BR_ADDR1_CSR_REG_ADDR A:&base_addr+0x9f54b4
y.create.l HWIO_RPMH_VRM_SW_WORKAROUND_BR_ADDR2_CSR_REG_ADDR A:&base_addr+0x9f54b8
y.create.l HWIO_RPMH_VRM_VRM_CLK_GATING_EN_CFG_ADDR A:&base_addr+0x9f54bc
y.create.l HWIO_RPMH_VRM_VRM_DEBUG_BUS_EN_CFG_ADDR A:&base_addr+0x9f54c0
y.create.l HWIO_RPMH_VRM_VRM_DEBUG_BUS_CFG_ADDR A:&base_addr+0x9f54c4
y.create.l HWIO_RPMH_BCM_BCM_CFG_DRV_ID_FOR_VRM_VOTE_ADDR A:&base_addr+0xbe7088
y.create.l HWIO_RPMH_CPRF_VRM_COMPLETION_WA_ADDR A:&base_addr+0x120000c
y.create.l HWIO_RPMH_CPRF_VRM_BRCST_WA_ADDR A:&base_addr+0x1200010
y.create.l HWIO_RPMH_CPRF_VRM_BRCST_ENDIANNESS_ADDR A:&base_addr+0x1200030
y.create.l HWIO_RPMH_CPRF_CPRF0_VRM_SETTINGS_ADDR A:&base_addr+0x1201008
y.create.l HWIO_RPMH_CPRF_CPRF1_VRM_SETTINGS_ADDR A:&base_addr+0x1202008
y.create.l HWIO_RPMH_CPRF_CPRF2_VRM_SETTINGS_ADDR A:&base_addr+0x1203008
y.create.l HWIO_RPMH_CPRF_CPRF3_VRM_SETTINGS_ADDR A:&base_addr+0x1204008
y.create.l HWIO_RPMH_CPRF_CPRF4_VRM_SETTINGS_ADDR A:&base_addr+0x1205008
y.create.l HWIO_RPMH_CPRF_CPRF5_VRM_SETTINGS_ADDR A:&base_addr+0x1206008
y.create.l HWIO_RPMH_CPRF_CPRF6_VRM_SETTINGS_ADDR A:&base_addr+0x1207008
y.create.l HWIO_RPMH_CPRF_VRM_MESSAGE_ADDR A:&base_addr+0x120f000
y.create.l HWIO_PMIC_ARB_VRM_S_INTF_CTL_ADDR A:&base_addr+0x1442200
y.create.l HWIO_PMIC_ARB_VRM_S_INTF_STATUS_ADDR A:&base_addr+0x1442204
y.create.l HWIO_PMIC_ARB_VRM_S_PORT_CTL_ADDR A:&base_addr+0x1442208
y.create.l HWIO_PMIC_ARB_VRM_S_PORT_STATUS_ADDR A:&base_addr+0x144220c
y.create.l HWIO_PMIC_ARB_VRM_S_ADDR0_ADDR A:&base_addr+0x1442300
y.create.l HWIO_PMIC_ARB_VRM_S_ADDR1_ADDR A:&base_addr+0x1442304
y.create.l HWIO_PMIC_ARB_VRM_S_ADDR2_ADDR A:&base_addr+0x1442308
y.create.l HWIO_PMIC_ARB_VRM_S_ADDR3_ADDR A:&base_addr+0x144230c
y.create.l HWIO_PMIC_ARB_VRM_S_ADDR4_ADDR A:&base_addr+0x1442310
y.create.l HWIO_PMIC_ARB_VRM_S_ADDR5_ADDR A:&base_addr+0x1442314
y.create.l HWIO_PMIC_ARB_VRM_S_ADDR6_ADDR A:&base_addr+0x1442318
y.create.l HWIO_PMIC_ARB_VRM_S_ADDR7_ADDR A:&base_addr+0x144231c
y.create.l HWIO_PMIC_ARB_VRM_S_ADDR8_ADDR A:&base_addr+0x1442320
y.create.l HWIO_PMIC_ARB_VRM_S_ADDR9_ADDR A:&base_addr+0x1442324
y.create.l HWIO_PMIC_ARB_VRM_S_ADDR10_ADDR A:&base_addr+0x1442328
y.create.l HWIO_PMIC_ARB_VRM_S_ADDR11_ADDR A:&base_addr+0x144232c
y.create.l HWIO_PMIC_ARB_VRM_S_ADDR12_ADDR A:&base_addr+0x1442330
y.create.l HWIO_PMIC_ARB_VRM_S_ADDR13_ADDR A:&base_addr+0x1442334
y.create.l HWIO_PMIC_ARB_VRM_S_ADDR14_ADDR A:&base_addr+0x1442338
y.create.l HWIO_PMIC_ARB_VRM_S_ADDR15_ADDR A:&base_addr+0x144233c
y.create.l HWIO_PMIC_ARB_VRM_S_ADDR16_ADDR A:&base_addr+0x1442340
y.create.l HWIO_PMIC_ARB_VRM_S_ADDR17_ADDR A:&base_addr+0x1442344
y.create.l HWIO_PMIC_ARB_VRM_S_ADDR18_ADDR A:&base_addr+0x1442348
y.create.l HWIO_PMIC_ARB_VRM_S_ADDR19_ADDR A:&base_addr+0x144234c
y.create.l HWIO_PMIC_ARB_VRM_S_ADDR20_ADDR A:&base_addr+0x1442350
y.create.l HWIO_PMIC_ARB_VRM_S_ADDR21_ADDR A:&base_addr+0x1442354
y.create.l HWIO_PMIC_ARB_VRM_S_ADDR22_ADDR A:&base_addr+0x1442358
y.create.l HWIO_PMIC_ARB_VRM_S_ADDR23_ADDR A:&base_addr+0x144235c
y.create.l HWIO_PMIC_ARB_VRM_S_ADDR24_ADDR A:&base_addr+0x1442360
y.create.l HWIO_PMIC_ARB_VRM_S_ADDR25_ADDR A:&base_addr+0x1442364
y.create.l HWIO_PMIC_ARB_VRM_S_ADDR26_ADDR A:&base_addr+0x1442368
y.create.l HWIO_PMIC_ARB_VRM_S_ADDR27_ADDR A:&base_addr+0x144236c
y.create.l HWIO_PMIC_ARB_VRM_S_ADDR28_ADDR A:&base_addr+0x1442370
y.create.l HWIO_PMIC_ARB_VRM_S_ADDR29_ADDR A:&base_addr+0x1442374
y.create.l HWIO_PMIC_ARB_VRM_S_ADDR30_ADDR A:&base_addr+0x1442378
y.create.l HWIO_PMIC_ARB_VRM_S_ADDR31_ADDR A:&base_addr+0x144237c
y.create.l HWIO_PMIC_ARB_VRM_S_ADDR32_ADDR A:&base_addr+0x1442380
y.create.l HWIO_PMIC_ARB_VRM_S_ADDR33_ADDR A:&base_addr+0x1442384
y.create.l HWIO_PMIC_ARB_VRM_S_ADDR34_ADDR A:&base_addr+0x1442388
y.create.l HWIO_PMIC_ARB_VRM_S_ADDR35_ADDR A:&base_addr+0x144238c
y.create.l HWIO_PMIC_ARB_VRM_S_ADDR36_ADDR A:&base_addr+0x1442390
y.create.l HWIO_PMIC_ARB_VRM_S_ADDR37_ADDR A:&base_addr+0x1442394
y.create.l HWIO_PMIC_ARB_VRM_S_ADDR38_ADDR A:&base_addr+0x1442398
y.create.l HWIO_PMIC_ARB_VRM_S_ADDR39_ADDR A:&base_addr+0x144239c
y.create.l HWIO_PMIC_ARB_VRM_S_ADDR40_ADDR A:&base_addr+0x14423a0
y.create.l HWIO_PMIC_ARB_VRM_S_ADDR41_ADDR A:&base_addr+0x14423a4
y.create.l HWIO_PMIC_ARB_VRM_S_ADDR42_ADDR A:&base_addr+0x14423a8
y.create.l HWIO_PMIC_ARB_VRM_S_ADDR43_ADDR A:&base_addr+0x14423ac
y.create.l HWIO_PMIC_ARB_VRM_S_ADDR44_ADDR A:&base_addr+0x14423b0
y.create.l HWIO_PMIC_ARB_VRM_S_ADDR45_ADDR A:&base_addr+0x14423b4
y.create.l HWIO_PMIC_ARB_VRM_S_ADDR46_ADDR A:&base_addr+0x14423b8
y.create.l HWIO_PMIC_ARB_VRM_S_ADDR47_ADDR A:&base_addr+0x14423bc
y.create.l HWIO_PMIC_ARB_VRM_S_ADDR48_ADDR A:&base_addr+0x14423c0
y.create.l HWIO_PMIC_ARB_VRM_S_ADDR49_ADDR A:&base_addr+0x14423c4
y.create.l HWIO_PMIC_ARB_VRM_S_ADDR50_ADDR A:&base_addr+0x14423c8
y.create.l HWIO_PMIC_ARB_VRM_S_ADDR51_ADDR A:&base_addr+0x14423cc
y.create.l HWIO_PMIC_ARB_VRM_S_ADDR52_ADDR A:&base_addr+0x14423d0
y.create.l HWIO_PMIC_ARB_VRM_S_ADDR53_ADDR A:&base_addr+0x14423d4
y.create.l HWIO_PMIC_ARB_VRM_S_ADDR54_ADDR A:&base_addr+0x14423d8
y.create.l HWIO_PMIC_ARB_VRM_S_ADDR55_ADDR A:&base_addr+0x14423dc
y.create.l HWIO_PMIC_ARB_VRM_S_ADDR56_ADDR A:&base_addr+0x14423e0
y.create.l HWIO_PMIC_ARB_VRM_S_ADDR57_ADDR A:&base_addr+0x14423e4
y.create.l HWIO_PMIC_ARB_VRM_S_ADDR58_ADDR A:&base_addr+0x14423e8
y.create.l HWIO_PMIC_ARB_VRM_S_ADDR59_ADDR A:&base_addr+0x14423ec
y.create.l HWIO_PMIC_ARB_VRM_S_ADDR60_ADDR A:&base_addr+0x14423f0
y.create.l HWIO_PMIC_ARB_VRM_S_ADDR61_ADDR A:&base_addr+0x14423f4
y.create.l HWIO_PMIC_ARB_VRM_S_ADDR62_ADDR A:&base_addr+0x14423f8
y.create.l HWIO_PMIC_ARB_VRM_S_ADDR63_ADDR A:&base_addr+0x14423fc
y.create.l HWIO_PMIC_ARB_VRM_S_ADDR64_ADDR A:&base_addr+0x1442400
y.create.l HWIO_PMIC_ARB_VRM_S_ADDR65_ADDR A:&base_addr+0x1442404
y.create.l HWIO_PMIC_ARB_VRM_S_ADDR66_ADDR A:&base_addr+0x1442408
y.create.l HWIO_PMIC_ARB_VRM_S_ADDR67_ADDR A:&base_addr+0x144240c
y.create.l HWIO_PMIC_ARB_VRM_S_ADDR68_ADDR A:&base_addr+0x1442410
y.create.l HWIO_PMIC_ARB_VRM_S_ADDR69_ADDR A:&base_addr+0x1442414
y.create.l HWIO_PMIC_ARB_VRM_S_ADDR70_ADDR A:&base_addr+0x1442418
y.create.l HWIO_PMIC_ARB_VRM_S_ADDR71_ADDR A:&base_addr+0x144241c
y.create.l HWIO_PMIC_ARB_VRM_S_ADDR72_ADDR A:&base_addr+0x1442420
y.create.l HWIO_PMIC_ARB_VRM_S_ADDR73_ADDR A:&base_addr+0x1442424
y.create.l HWIO_PMIC_ARB_VRM_S_ADDR74_ADDR A:&base_addr+0x1442428
y.create.l HWIO_PMIC_ARB_VRM_S_ADDR75_ADDR A:&base_addr+0x144242c
y.create.l HWIO_PMIC_ARB_VRM_S_ADDR76_ADDR A:&base_addr+0x1442430
y.create.l HWIO_PMIC_ARB_VRM_S_ADDR77_ADDR A:&base_addr+0x1442434
y.create.l HWIO_PMIC_ARB_VRM_S_ADDR78_ADDR A:&base_addr+0x1442438
y.create.l HWIO_PMIC_ARB_VRM_S_ADDR79_ADDR A:&base_addr+0x144243c
y.create.l HWIO_PMIC_ARB_VRM_S_ADDR80_ADDR A:&base_addr+0x1442440
y.create.l HWIO_PMIC_ARB_VRM_S_ADDR81_ADDR A:&base_addr+0x1442444
y.create.l HWIO_PMIC_ARB_VRM_S_ADDR82_ADDR A:&base_addr+0x1442448
y.create.l HWIO_PMIC_ARB_VRM_S_ADDR83_ADDR A:&base_addr+0x144244c
y.create.l HWIO_PMIC_ARB_VRM_S_ADDR84_ADDR A:&base_addr+0x1442450
y.create.l HWIO_PMIC_ARB_VRM_S_ADDR85_ADDR A:&base_addr+0x1442454
y.create.l HWIO_PMIC_ARB_VRM_S_ADDR86_ADDR A:&base_addr+0x1442458
y.create.l HWIO_PMIC_ARB_VRM_S_ADDR87_ADDR A:&base_addr+0x144245c
y.create.l HWIO_PMIC_ARB_VRM_S_ADDR88_ADDR A:&base_addr+0x1442460
y.create.l HWIO_PMIC_ARB_VRM_S_ADDR89_ADDR A:&base_addr+0x1442464
y.create.l HWIO_PMIC_ARB_VRM_S_ADDR90_ADDR A:&base_addr+0x1442468
y.create.l HWIO_PMIC_ARB_VRM_S_ADDR91_ADDR A:&base_addr+0x144246c
y.create.l HWIO_PMIC_ARB_VRM_S_ADDR92_ADDR A:&base_addr+0x1442470
y.create.l HWIO_PMIC_ARB_VRM_S_ADDR93_ADDR A:&base_addr+0x1442474
y.create.l HWIO_PMIC_ARB_VRM_S_ADDR94_ADDR A:&base_addr+0x1442478
y.create.l HWIO_PMIC_ARB_VRM_S_ADDR95_ADDR A:&base_addr+0x144247c
y.create.l HWIO_PMIC_ARB_VRM_S_ADDR96_ADDR A:&base_addr+0x1442480
y.create.l HWIO_PMIC_ARB_VRM_S_ADDR97_ADDR A:&base_addr+0x1442484
y.create.l HWIO_PMIC_ARB_VRM_S_ADDR98_ADDR A:&base_addr+0x1442488
y.create.l HWIO_PMIC_ARB_VRM_S_ADDR99_ADDR A:&base_addr+0x144248c
y.create.l HWIO_PMIC_ARB_VRM_S_ADDR100_ADDR A:&base_addr+0x1442490
y.create.l HWIO_PMIC_ARB_VRM_S_ADDR101_ADDR A:&base_addr+0x1442494
y.create.l HWIO_PMIC_ARB_VRM_S_ADDR102_ADDR A:&base_addr+0x1442498
y.create.l HWIO_PMIC_ARB_VRM_S_ADDR103_ADDR A:&base_addr+0x144249c
y.create.l HWIO_PMIC_ARB_VRM_S_ADDR104_ADDR A:&base_addr+0x14424a0
y.create.l HWIO_PMIC_ARB_VRM_S_ADDR105_ADDR A:&base_addr+0x14424a4
y.create.l HWIO_PMIC_ARB_VRM_S_ADDR106_ADDR A:&base_addr+0x14424a8
y.create.l HWIO_PMIC_ARB_VRM_S_ADDR107_ADDR A:&base_addr+0x14424ac
y.create.l HWIO_PMIC_ARB_VRM_S_ADDR108_ADDR A:&base_addr+0x14424b0
y.create.l HWIO_PMIC_ARB_VRM_S_ADDR109_ADDR A:&base_addr+0x14424b4
y.create.l HWIO_PMIC_ARB_VRM_S_ADDR110_ADDR A:&base_addr+0x14424b8
y.create.l HWIO_PMIC_ARB_VRM_S_ADDR111_ADDR A:&base_addr+0x14424bc
y.create.l HWIO_PMIC_ARB_VRM_S_ADDR112_ADDR A:&base_addr+0x14424c0
y.create.l HWIO_PMIC_ARB_VRM_S_ADDR113_ADDR A:&base_addr+0x14424c4
y.create.l HWIO_PMIC_ARB_VRM_S_ADDR114_ADDR A:&base_addr+0x14424c8
y.create.l HWIO_PMIC_ARB_VRM_S_ADDR115_ADDR A:&base_addr+0x14424cc
y.create.l HWIO_PMIC_ARB_VRM_S_ADDR116_ADDR A:&base_addr+0x14424d0
y.create.l HWIO_PMIC_ARB_VRM_S_ADDR117_ADDR A:&base_addr+0x14424d4
y.create.l HWIO_PMIC_ARB_VRM_S_ADDR118_ADDR A:&base_addr+0x14424d8
y.create.l HWIO_PMIC_ARB_VRM_S_ADDR119_ADDR A:&base_addr+0x14424dc
y.create.l HWIO_PMIC_ARB_VRM_S_ADDR120_ADDR A:&base_addr+0x14424e0
y.create.l HWIO_PMIC_ARB_VRM_S_ADDR121_ADDR A:&base_addr+0x14424e4
y.create.l HWIO_PMIC_ARB_VRM_S_ADDR122_ADDR A:&base_addr+0x14424e8
y.create.l HWIO_PMIC_ARB_VRM_S_ADDR123_ADDR A:&base_addr+0x14424ec
y.create.l HWIO_PMIC_ARB_VRM_S_ADDR124_ADDR A:&base_addr+0x14424f0
y.create.l HWIO_PMIC_ARB_VRM_S_ADDR125_ADDR A:&base_addr+0x14424f4
y.create.l HWIO_PMIC_ARB_VRM_S_ADDR126_ADDR A:&base_addr+0x14424f8
y.create.l HWIO_PMIC_ARB_VRM_S_ADDR127_ADDR A:&base_addr+0x14424fc
y.create.l HWIO_PMIC_ARB_VRM_S_ADDR128_ADDR A:&base_addr+0x1442500
y.create.l HWIO_PMIC_ARB_VRM_S_ADDR129_ADDR A:&base_addr+0x1442504
y.create.l HWIO_PMIC_ARB_VRM_S_ADDR130_ADDR A:&base_addr+0x1442508
y.create.l HWIO_PMIC_ARB_VRM_S_ADDR131_ADDR A:&base_addr+0x144250c
y.create.l HWIO_PMIC_ARB_VRM_S_ADDR132_ADDR A:&base_addr+0x1442510
y.create.l HWIO_PMIC_ARB_VRM_S_ADDR133_ADDR A:&base_addr+0x1442514
y.create.l HWIO_PMIC_ARB_VRM_S_ADDR134_ADDR A:&base_addr+0x1442518
y.create.l HWIO_PMIC_ARB_VRM_S_ADDR135_ADDR A:&base_addr+0x144251c
y.create.l HWIO_PMIC_ARB_VRM_S_ADDR136_ADDR A:&base_addr+0x1442520
y.create.l HWIO_PMIC_ARB_VRM_S_ADDR137_ADDR A:&base_addr+0x1442524
y.create.l HWIO_PMIC_ARB_VRM_S_ADDR138_ADDR A:&base_addr+0x1442528
y.create.l HWIO_PMIC_ARB_VRM_S_ADDR139_ADDR A:&base_addr+0x144252c
y.create.l HWIO_PMIC_ARB_VRM_S_ADDR140_ADDR A:&base_addr+0x1442530
y.create.l HWIO_PMIC_ARB_VRM_S_ADDR141_ADDR A:&base_addr+0x1442534
y.create.l HWIO_PMIC_ARB_VRM_S_ADDR142_ADDR A:&base_addr+0x1442538
y.create.l HWIO_PMIC_ARB_VRM_S_ADDR143_ADDR A:&base_addr+0x144253c
y.create.l HWIO_PMIC_ARB_VRM_S_ADDR144_ADDR A:&base_addr+0x1442540
y.create.l HWIO_PMIC_ARB_VRM_S_ADDR145_ADDR A:&base_addr+0x1442544
y.create.l HWIO_PMIC_ARB_VRM_S_ADDR146_ADDR A:&base_addr+0x1442548
y.create.l HWIO_PMIC_ARB_VRM_S_ADDR147_ADDR A:&base_addr+0x144254c
y.create.l HWIO_PMIC_ARB_VRM_S_ADDR148_ADDR A:&base_addr+0x1442550
y.create.l HWIO_PMIC_ARB_VRM_S_ADDR149_ADDR A:&base_addr+0x1442554
y.create.l HWIO_PMIC_ARB_VRM_S_ADDR150_ADDR A:&base_addr+0x1442558
y.create.l HWIO_PMIC_ARB_VRM_S_ADDR151_ADDR A:&base_addr+0x144255c
y.create.l HWIO_PMIC_ARB_VRM_S_ADDR152_ADDR A:&base_addr+0x1442560
y.create.l HWIO_PMIC_ARB_VRM_S_ADDR153_ADDR A:&base_addr+0x1442564
y.create.l HWIO_PMIC_ARB_VRM_S_ADDR154_ADDR A:&base_addr+0x1442568
y.create.l HWIO_PMIC_ARB_VRM_S_ADDR155_ADDR A:&base_addr+0x144256c
y.create.l HWIO_PMIC_ARB_VRM_S_ADDR156_ADDR A:&base_addr+0x1442570
y.create.l HWIO_PMIC_ARB_VRM_S_ADDR157_ADDR A:&base_addr+0x1442574
y.create.l HWIO_PMIC_ARB_VRM_S_ADDR158_ADDR A:&base_addr+0x1442578
y.create.l HWIO_PMIC_ARB_VRM_S_ADDR159_ADDR A:&base_addr+0x144257c
y.create.l HWIO_PMIC_ARB_VRM_S_ADDR160_ADDR A:&base_addr+0x1442580
y.create.l HWIO_PMIC_ARB_VRM_S_ADDR161_ADDR A:&base_addr+0x1442584
y.create.l HWIO_PMIC_ARB_VRM_S_ADDR162_ADDR A:&base_addr+0x1442588
y.create.l HWIO_PMIC_ARB_VRM_S_ADDR163_ADDR A:&base_addr+0x144258c
y.create.l HWIO_PMIC_ARB_VRM_S_ADDR164_ADDR A:&base_addr+0x1442590
y.create.l HWIO_PMIC_ARB_VRM_S_ADDR165_ADDR A:&base_addr+0x1442594
y.create.l HWIO_PMIC_ARB_VRM_S_ADDR166_ADDR A:&base_addr+0x1442598
y.create.l HWIO_PMIC_ARB_VRM_S_ADDR167_ADDR A:&base_addr+0x144259c
y.create.l HWIO_PMIC_ARB_VRM_S_ADDR168_ADDR A:&base_addr+0x14425a0
y.create.l HWIO_PMIC_ARB_VRM_S_ADDR169_ADDR A:&base_addr+0x14425a4
y.create.l HWIO_PMIC_ARB_VRM_S_ADDR170_ADDR A:&base_addr+0x14425a8
y.create.l HWIO_PMIC_ARB_VRM_S_ADDR171_ADDR A:&base_addr+0x14425ac
y.create.l HWIO_PMIC_ARB_VRM_S_ADDR172_ADDR A:&base_addr+0x14425b0
y.create.l HWIO_PMIC_ARB_VRM_S_ADDR173_ADDR A:&base_addr+0x14425b4
y.create.l HWIO_PMIC_ARB_VRM_S_ADDR174_ADDR A:&base_addr+0x14425b8
y.create.l HWIO_PMIC_ARB_VRM_S_ADDR175_ADDR A:&base_addr+0x14425bc
y.create.l HWIO_PMIC_ARB_VRM_S_ADDR176_ADDR A:&base_addr+0x14425c0
y.create.l HWIO_PMIC_ARB_VRM_S_ADDR177_ADDR A:&base_addr+0x14425c4
y.create.l HWIO_PMIC_ARB_VRM_S_ADDR178_ADDR A:&base_addr+0x14425c8
y.create.l HWIO_PMIC_ARB_VRM_S_ADDR179_ADDR A:&base_addr+0x14425cc
y.create.l HWIO_PMIC_ARB_VRM_S_ADDR180_ADDR A:&base_addr+0x14425d0
y.create.l HWIO_PMIC_ARB_VRM_S_ADDR181_ADDR A:&base_addr+0x14425d4
y.create.l HWIO_PMIC_ARB_VRM_S_ADDR182_ADDR A:&base_addr+0x14425d8
y.create.l HWIO_PMIC_ARB_VRM_S_ADDR183_ADDR A:&base_addr+0x14425dc
y.create.l HWIO_PMIC_ARB_VRM_S_ADDR184_ADDR A:&base_addr+0x14425e0
y.create.l HWIO_PMIC_ARB_VRM_S_ADDR185_ADDR A:&base_addr+0x14425e4
y.create.l HWIO_PMIC_ARB_VRM_S_ADDR186_ADDR A:&base_addr+0x14425e8
y.create.l HWIO_PMIC_ARB_VRM_S_ADDR187_ADDR A:&base_addr+0x14425ec
y.create.l HWIO_PMIC_ARB_VRM_S_ADDR188_ADDR A:&base_addr+0x14425f0
y.create.l HWIO_PMIC_ARB_VRM_S_ADDR189_ADDR A:&base_addr+0x14425f4
y.create.l HWIO_PMIC_ARB_VRM_S_ADDR190_ADDR A:&base_addr+0x14425f8
y.create.l HWIO_PMIC_ARB_VRM_S_ADDR191_ADDR A:&base_addr+0x14425fc
y.create.l HWIO_PMIC_ARB_VRM_S_ADDR192_ADDR A:&base_addr+0x1442600
y.create.l HWIO_PMIC_ARB_VRM_S_ADDR193_ADDR A:&base_addr+0x1442604
y.create.l HWIO_PMIC_ARB_VRM_S_ADDR194_ADDR A:&base_addr+0x1442608
y.create.l HWIO_PMIC_ARB_VRM_S_ADDR195_ADDR A:&base_addr+0x144260c
y.create.l HWIO_PMIC_ARB_VRM_S_ADDR196_ADDR A:&base_addr+0x1442610
y.create.l HWIO_PMIC_ARB_VRM_S_ADDR197_ADDR A:&base_addr+0x1442614
y.create.l HWIO_PMIC_ARB_VRM_S_ADDR198_ADDR A:&base_addr+0x1442618
y.create.l HWIO_PMIC_ARB_VRM_S_ADDR199_ADDR A:&base_addr+0x144261c
y.create.l HWIO_PMIC_ARB_VRM_S_ADDR200_ADDR A:&base_addr+0x1442620
y.create.l HWIO_PMIC_ARB_VRM_S_ADDR201_ADDR A:&base_addr+0x1442624
y.create.l HWIO_PMIC_ARB_VRM_S_ADDR202_ADDR A:&base_addr+0x1442628
y.create.l HWIO_PMIC_ARB_VRM_S_ADDR203_ADDR A:&base_addr+0x144262c
y.create.l HWIO_PMIC_ARB_VRM_S_ADDR204_ADDR A:&base_addr+0x1442630
y.create.l HWIO_PMIC_ARB_VRM_S_ADDR205_ADDR A:&base_addr+0x1442634
y.create.l HWIO_PMIC_ARB_VRM_S_ADDR206_ADDR A:&base_addr+0x1442638
y.create.l HWIO_PMIC_ARB_VRM_S_ADDR207_ADDR A:&base_addr+0x144263c
y.create.l HWIO_PMIC_ARB_VRM_S_ADDR208_ADDR A:&base_addr+0x1442640
y.create.l HWIO_PMIC_ARB_VRM_S_ADDR209_ADDR A:&base_addr+0x1442644
y.create.l HWIO_PMIC_ARB_VRM_S_ADDR210_ADDR A:&base_addr+0x1442648
y.create.l HWIO_PMIC_ARB_VRM_S_ADDR211_ADDR A:&base_addr+0x144264c
y.create.l HWIO_PMIC_ARB_VRM_S_ADDR212_ADDR A:&base_addr+0x1442650
y.create.l HWIO_PMIC_ARB_VRM_S_ADDR213_ADDR A:&base_addr+0x1442654
y.create.l HWIO_PMIC_ARB_VRM_S_ADDR214_ADDR A:&base_addr+0x1442658
y.create.l HWIO_PMIC_ARB_VRM_S_ADDR215_ADDR A:&base_addr+0x144265c
y.create.l HWIO_PMIC_ARB_VRM_S_ADDR216_ADDR A:&base_addr+0x1442660
y.create.l HWIO_PMIC_ARB_VRM_S_ADDR217_ADDR A:&base_addr+0x1442664
y.create.l HWIO_PMIC_ARB_VRM_S_ADDR218_ADDR A:&base_addr+0x1442668
y.create.l HWIO_PMIC_ARB_VRM_S_ADDR219_ADDR A:&base_addr+0x144266c
y.create.l HWIO_PMIC_ARB_VRM_S_ADDR220_ADDR A:&base_addr+0x1442670
y.create.l HWIO_PMIC_ARB_VRM_S_ADDR221_ADDR A:&base_addr+0x1442674
y.create.l HWIO_PMIC_ARB_VRM_S_ADDR222_ADDR A:&base_addr+0x1442678
y.create.l HWIO_PMIC_ARB_VRM_S_ADDR223_ADDR A:&base_addr+0x144267c
y.create.l HWIO_PMIC_ARB_VRM_S_ADDR224_ADDR A:&base_addr+0x1442680
y.create.l HWIO_PMIC_ARB_VRM_S_ADDR225_ADDR A:&base_addr+0x1442684
y.create.l HWIO_PMIC_ARB_VRM_S_ADDR226_ADDR A:&base_addr+0x1442688
y.create.l HWIO_PMIC_ARB_VRM_S_ADDR227_ADDR A:&base_addr+0x144268c
y.create.l HWIO_PMIC_ARB_VRM_S_ADDR228_ADDR A:&base_addr+0x1442690
y.create.l HWIO_PMIC_ARB_VRM_S_ADDR229_ADDR A:&base_addr+0x1442694
y.create.l HWIO_PMIC_ARB_VRM_S_ADDR230_ADDR A:&base_addr+0x1442698
y.create.l HWIO_PMIC_ARB_VRM_S_ADDR231_ADDR A:&base_addr+0x144269c
y.create.l HWIO_PMIC_ARB_VRM_S_ADDR232_ADDR A:&base_addr+0x14426a0
y.create.l HWIO_PMIC_ARB_VRM_S_ADDR233_ADDR A:&base_addr+0x14426a4
y.create.l HWIO_PMIC_ARB_VRM_S_ADDR234_ADDR A:&base_addr+0x14426a8
y.create.l HWIO_PMIC_ARB_VRM_S_ADDR235_ADDR A:&base_addr+0x14426ac
y.create.l HWIO_PMIC_ARB_VRM_S_ADDR236_ADDR A:&base_addr+0x14426b0
y.create.l HWIO_PMIC_ARB_VRM_S_ADDR237_ADDR A:&base_addr+0x14426b4
y.create.l HWIO_PMIC_ARB_VRM_S_ADDR238_ADDR A:&base_addr+0x14426b8
y.create.l HWIO_PMIC_ARB_VRM_S_ADDR239_ADDR A:&base_addr+0x14426bc
y.create.l HWIO_PMIC_ARB_VRM_S_ADDR240_ADDR A:&base_addr+0x14426c0
y.create.l HWIO_PMIC_ARB_VRM_S_ADDR241_ADDR A:&base_addr+0x14426c4
y.create.l HWIO_PMIC_ARB_VRM_S_ADDR242_ADDR A:&base_addr+0x14426c8
y.create.l HWIO_PMIC_ARB_VRM_S_ADDR243_ADDR A:&base_addr+0x14426cc
y.create.l HWIO_PMIC_ARB_VRM_S_ADDR244_ADDR A:&base_addr+0x14426d0
y.create.l HWIO_PMIC_ARB_VRM_S_ADDR245_ADDR A:&base_addr+0x14426d4
y.create.l HWIO_PMIC_ARB_VRM_S_ADDR246_ADDR A:&base_addr+0x14426d8
y.create.l HWIO_PMIC_ARB_VRM_S_ADDR247_ADDR A:&base_addr+0x14426dc
y.create.l HWIO_PMIC_ARB_VRM_S_ADDR248_ADDR A:&base_addr+0x14426e0
y.create.l HWIO_PMIC_ARB_VRM_S_ADDR249_ADDR A:&base_addr+0x14426e4
y.create.l HWIO_PMIC_ARB_VRM_S_ADDR250_ADDR A:&base_addr+0x14426e8
y.create.l HWIO_PMIC_ARB_VRM_S_ADDR251_ADDR A:&base_addr+0x14426ec
y.create.l HWIO_PMIC_ARB_VRM_S_ADDR252_ADDR A:&base_addr+0x14426f0
y.create.l HWIO_PMIC_ARB_VRM_S_ADDR253_ADDR A:&base_addr+0x14426f4
y.create.l HWIO_PMIC_ARB_VRM_S_ADDR254_ADDR A:&base_addr+0x14426f8
y.create.l HWIO_PMIC_ARB_VRM_S_ADDR255_ADDR A:&base_addr+0x14426fc
y.create.done


entry &base_addr

if ("&base_addr"=="")
(
  &base_addr=0xb000000 
)

y.create.l HWIO_RPMH_VRM_VOLTAGE_VOTE_DRV0_REG0_ADDR A:&base_addr+0x800000
y.create.l HWIO_RPMH_VRM_VOLTAGE_VOTE_DRV0_REG1_ADDR A:&base_addr+0x800100
y.create.l HWIO_RPMH_VRM_VOLTAGE_VOTE_DRV0_REG2_ADDR A:&base_addr+0x800200
y.create.l HWIO_RPMH_VRM_VOLTAGE_VOTE_DRV0_REG3_ADDR A:&base_addr+0x800300
y.create.l HWIO_RPMH_VRM_VOLTAGE_VOTE_DRV0_REG4_ADDR A:&base_addr+0x800400
y.create.l HWIO_RPMH_VRM_VOLTAGE_VOTE_DRV0_REG5_ADDR A:&base_addr+0x800500
y.create.l HWIO_RPMH_VRM_VOLTAGE_VOTE_DRV0_REG6_ADDR A:&base_addr+0x800600
y.create.l HWIO_RPMH_VRM_VOLTAGE_VOTE_DRV0_REG7_ADDR A:&base_addr+0x800700
y.create.l HWIO_RPMH_VRM_VOLTAGE_VOTE_DRV0_REG8_ADDR A:&base_addr+0x800800
y.create.l HWIO_RPMH_VRM_VOLTAGE_VOTE_DRV0_REG9_ADDR A:&base_addr+0x800900
y.create.l HWIO_RPMH_VRM_VOLTAGE_VOTE_DRV0_REG10_ADDR A:&base_addr+0x800a00
y.create.l HWIO_RPMH_VRM_VOLTAGE_VOTE_DRV0_REG11_ADDR A:&base_addr+0x800b00
y.create.l HWIO_RPMH_VRM_VOLTAGE_VOTE_DRV0_REG12_ADDR A:&base_addr+0x800c00
y.create.l HWIO_RPMH_VRM_VOLTAGE_VOTE_DRV0_REG13_ADDR A:&base_addr+0x800d00
y.create.l HWIO_RPMH_VRM_VOLTAGE_VOTE_DRV0_REG14_ADDR A:&base_addr+0x800e00
y.create.l HWIO_RPMH_VRM_VOLTAGE_VOTE_DRV0_REG15_ADDR A:&base_addr+0x800f00
y.create.l HWIO_RPMH_VRM_VOLTAGE_VOTE_DRV0_REG16_ADDR A:&base_addr+0x801000
y.create.l HWIO_RPMH_VRM_VOLTAGE_VOTE_DRV0_REG17_ADDR A:&base_addr+0x801100
y.create.l HWIO_RPMH_VRM_VOLTAGE_VOTE_DRV0_REG18_ADDR A:&base_addr+0x801200
y.create.l HWIO_RPMH_VRM_VOLTAGE_VOTE_DRV0_REG19_ADDR A:&base_addr+0x801300
y.create.l HWIO_RPMH_VRM_VOLTAGE_VOTE_DRV0_REG20_ADDR A:&base_addr+0x801400
y.create.l HWIO_RPMH_VRM_VOLTAGE_VOTE_DRV0_REG21_ADDR A:&base_addr+0x801500
y.create.l HWIO_RPMH_VRM_VOLTAGE_VOTE_DRV0_REG22_ADDR A:&base_addr+0x801600
y.create.l HWIO_RPMH_VRM_VOLTAGE_VOTE_DRV0_REG23_ADDR A:&base_addr+0x801700
y.create.l HWIO_RPMH_VRM_VOLTAGE_VOTE_DRV1_REG0_ADDR A:&base_addr+0x810000
y.create.l HWIO_RPMH_VRM_VOLTAGE_VOTE_DRV1_REG1_ADDR A:&base_addr+0x810100
y.create.l HWIO_RPMH_VRM_VOLTAGE_VOTE_DRV1_REG2_ADDR A:&base_addr+0x810200
y.create.l HWIO_RPMH_VRM_VOLTAGE_VOTE_DRV1_REG3_ADDR A:&base_addr+0x810300
y.create.l HWIO_RPMH_VRM_VOLTAGE_VOTE_DRV1_REG4_ADDR A:&base_addr+0x810400
y.create.l HWIO_RPMH_VRM_VOLTAGE_VOTE_DRV1_REG5_ADDR A:&base_addr+0x810500
y.create.l HWIO_RPMH_VRM_VOLTAGE_VOTE_DRV1_REG6_ADDR A:&base_addr+0x810600
y.create.l HWIO_RPMH_VRM_VOLTAGE_VOTE_DRV1_REG7_ADDR A:&base_addr+0x810700
y.create.l HWIO_RPMH_VRM_VOLTAGE_VOTE_DRV1_REG8_ADDR A:&base_addr+0x810800
y.create.l HWIO_RPMH_VRM_VOLTAGE_VOTE_DRV1_REG9_ADDR A:&base_addr+0x810900
y.create.l HWIO_RPMH_VRM_VOLTAGE_VOTE_DRV1_REG10_ADDR A:&base_addr+0x810a00
y.create.l HWIO_RPMH_VRM_VOLTAGE_VOTE_DRV1_REG11_ADDR A:&base_addr+0x810b00
y.create.l HWIO_RPMH_VRM_VOLTAGE_VOTE_DRV1_REG12_ADDR A:&base_addr+0x810c00
y.create.l HWIO_RPMH_VRM_VOLTAGE_VOTE_DRV1_REG13_ADDR A:&base_addr+0x810d00
y.create.l HWIO_RPMH_VRM_VOLTAGE_VOTE_DRV1_REG14_ADDR A:&base_addr+0x810e00
y.create.l HWIO_RPMH_VRM_VOLTAGE_VOTE_DRV1_REG15_ADDR A:&base_addr+0x810f00
y.create.l HWIO_RPMH_VRM_VOLTAGE_VOTE_DRV1_REG16_ADDR A:&base_addr+0x811000
y.create.l HWIO_RPMH_VRM_VOLTAGE_VOTE_DRV1_REG17_ADDR A:&base_addr+0x811100
y.create.l HWIO_RPMH_VRM_VOLTAGE_VOTE_DRV1_REG18_ADDR A:&base_addr+0x811200
y.create.l HWIO_RPMH_VRM_VOLTAGE_VOTE_DRV1_REG19_ADDR A:&base_addr+0x811300
y.create.l HWIO_RPMH_VRM_VOLTAGE_VOTE_DRV1_REG20_ADDR A:&base_addr+0x811400
y.create.l HWIO_RPMH_VRM_VOLTAGE_VOTE_DRV1_REG21_ADDR A:&base_addr+0x811500
y.create.l HWIO_RPMH_VRM_VOLTAGE_VOTE_DRV1_REG22_ADDR A:&base_addr+0x811600
y.create.l HWIO_RPMH_VRM_VOLTAGE_VOTE_DRV1_REG23_ADDR A:&base_addr+0x811700
y.create.l HWIO_RPMH_VRM_VOLTAGE_VOTE_DRV2_REG0_ADDR A:&base_addr+0x820000
y.create.l HWIO_RPMH_VRM_VOLTAGE_VOTE_DRV2_REG1_ADDR A:&base_addr+0x820100
y.create.l HWIO_RPMH_VRM_VOLTAGE_VOTE_DRV2_REG2_ADDR A:&base_addr+0x820200
y.create.l HWIO_RPMH_VRM_VOLTAGE_VOTE_DRV2_REG3_ADDR A:&base_addr+0x820300
y.create.l HWIO_RPMH_VRM_VOLTAGE_VOTE_DRV2_REG4_ADDR A:&base_addr+0x820400
y.create.l HWIO_RPMH_VRM_VOLTAGE_VOTE_DRV2_REG5_ADDR A:&base_addr+0x820500
y.create.l HWIO_RPMH_VRM_VOLTAGE_VOTE_DRV2_REG6_ADDR A:&base_addr+0x820600
y.create.l HWIO_RPMH_VRM_VOLTAGE_VOTE_DRV2_REG7_ADDR A:&base_addr+0x820700
y.create.l HWIO_RPMH_VRM_VOLTAGE_VOTE_DRV2_REG8_ADDR A:&base_addr+0x820800
y.create.l HWIO_RPMH_VRM_VOLTAGE_VOTE_DRV2_REG9_ADDR A:&base_addr+0x820900
y.create.l HWIO_RPMH_VRM_VOLTAGE_VOTE_DRV2_REG10_ADDR A:&base_addr+0x820a00
y.create.l HWIO_RPMH_VRM_VOLTAGE_VOTE_DRV2_REG11_ADDR A:&base_addr+0x820b00
y.create.l HWIO_RPMH_VRM_VOLTAGE_VOTE_DRV2_REG12_ADDR A:&base_addr+0x820c00
y.create.l HWIO_RPMH_VRM_VOLTAGE_VOTE_DRV2_REG13_ADDR A:&base_addr+0x820d00
y.create.l HWIO_RPMH_VRM_VOLTAGE_VOTE_DRV2_REG14_ADDR A:&base_addr+0x820e00
y.create.l HWIO_RPMH_VRM_VOLTAGE_VOTE_DRV2_REG15_ADDR A:&base_addr+0x820f00
y.create.l HWIO_RPMH_VRM_VOLTAGE_VOTE_DRV2_REG16_ADDR A:&base_addr+0x821000
y.create.l HWIO_RPMH_VRM_VOLTAGE_VOTE_DRV2_REG17_ADDR A:&base_addr+0x821100
y.create.l HWIO_RPMH_VRM_VOLTAGE_VOTE_DRV2_REG18_ADDR A:&base_addr+0x821200
y.create.l HWIO_RPMH_VRM_VOLTAGE_VOTE_DRV2_REG19_ADDR A:&base_addr+0x821300
y.create.l HWIO_RPMH_VRM_VOLTAGE_VOTE_DRV2_REG20_ADDR A:&base_addr+0x821400
y.create.l HWIO_RPMH_VRM_VOLTAGE_VOTE_DRV2_REG21_ADDR A:&base_addr+0x821500
y.create.l HWIO_RPMH_VRM_VOLTAGE_VOTE_DRV2_REG22_ADDR A:&base_addr+0x821600
y.create.l HWIO_RPMH_VRM_VOLTAGE_VOTE_DRV2_REG23_ADDR A:&base_addr+0x821700
y.create.l HWIO_RPMH_VRM_VOLTAGE_VOTE_DRV3_REG0_ADDR A:&base_addr+0x830000
y.create.l HWIO_RPMH_VRM_VOLTAGE_VOTE_DRV3_REG1_ADDR A:&base_addr+0x830100
y.create.l HWIO_RPMH_VRM_VOLTAGE_VOTE_DRV3_REG2_ADDR A:&base_addr+0x830200
y.create.l HWIO_RPMH_VRM_VOLTAGE_VOTE_DRV3_REG3_ADDR A:&base_addr+0x830300
y.create.l HWIO_RPMH_VRM_VOLTAGE_VOTE_DRV3_REG4_ADDR A:&base_addr+0x830400
y.create.l HWIO_RPMH_VRM_VOLTAGE_VOTE_DRV3_REG5_ADDR A:&base_addr+0x830500
y.create.l HWIO_RPMH_VRM_VOLTAGE_VOTE_DRV3_REG6_ADDR A:&base_addr+0x830600
y.create.l HWIO_RPMH_VRM_VOLTAGE_VOTE_DRV3_REG7_ADDR A:&base_addr+0x830700
y.create.l HWIO_RPMH_VRM_VOLTAGE_VOTE_DRV3_REG8_ADDR A:&base_addr+0x830800
y.create.l HWIO_RPMH_VRM_VOLTAGE_VOTE_DRV3_REG9_ADDR A:&base_addr+0x830900
y.create.l HWIO_RPMH_VRM_VOLTAGE_VOTE_DRV3_REG10_ADDR A:&base_addr+0x830a00
y.create.l HWIO_RPMH_VRM_VOLTAGE_VOTE_DRV3_REG11_ADDR A:&base_addr+0x830b00
y.create.l HWIO_RPMH_VRM_VOLTAGE_VOTE_DRV3_REG12_ADDR A:&base_addr+0x830c00
y.create.l HWIO_RPMH_VRM_VOLTAGE_VOTE_DRV3_REG13_ADDR A:&base_addr+0x830d00
y.create.l HWIO_RPMH_VRM_VOLTAGE_VOTE_DRV3_REG14_ADDR A:&base_addr+0x830e00
y.create.l HWIO_RPMH_VRM_VOLTAGE_VOTE_DRV3_REG15_ADDR A:&base_addr+0x830f00
y.create.l HWIO_RPMH_VRM_VOLTAGE_VOTE_DRV3_REG16_ADDR A:&base_addr+0x831000
y.create.l HWIO_RPMH_VRM_VOLTAGE_VOTE_DRV3_REG17_ADDR A:&base_addr+0x831100
y.create.l HWIO_RPMH_VRM_VOLTAGE_VOTE_DRV3_REG18_ADDR A:&base_addr+0x831200
y.create.l HWIO_RPMH_VRM_VOLTAGE_VOTE_DRV3_REG19_ADDR A:&base_addr+0x831300
y.create.l HWIO_RPMH_VRM_VOLTAGE_VOTE_DRV3_REG20_ADDR A:&base_addr+0x831400
y.create.l HWIO_RPMH_VRM_VOLTAGE_VOTE_DRV3_REG21_ADDR A:&base_addr+0x831500
y.create.l HWIO_RPMH_VRM_VOLTAGE_VOTE_DRV3_REG22_ADDR A:&base_addr+0x831600
y.create.l HWIO_RPMH_VRM_VOLTAGE_VOTE_DRV3_REG23_ADDR A:&base_addr+0x831700
y.create.l HWIO_RPMH_VRM_VOLTAGE_VOTE_DRV4_REG0_ADDR A:&base_addr+0x840000
y.create.l HWIO_RPMH_VRM_VOLTAGE_VOTE_DRV4_REG1_ADDR A:&base_addr+0x840100
y.create.l HWIO_RPMH_VRM_VOLTAGE_VOTE_DRV4_REG2_ADDR A:&base_addr+0x840200
y.create.l HWIO_RPMH_VRM_VOLTAGE_VOTE_DRV4_REG3_ADDR A:&base_addr+0x840300
y.create.l HWIO_RPMH_VRM_VOLTAGE_VOTE_DRV4_REG4_ADDR A:&base_addr+0x840400
y.create.l HWIO_RPMH_VRM_VOLTAGE_VOTE_DRV4_REG5_ADDR A:&base_addr+0x840500
y.create.l HWIO_RPMH_VRM_VOLTAGE_VOTE_DRV4_REG6_ADDR A:&base_addr+0x840600
y.create.l HWIO_RPMH_VRM_VOLTAGE_VOTE_DRV4_REG7_ADDR A:&base_addr+0x840700
y.create.l HWIO_RPMH_VRM_VOLTAGE_VOTE_DRV4_REG8_ADDR A:&base_addr+0x840800
y.create.l HWIO_RPMH_VRM_VOLTAGE_VOTE_DRV4_REG9_ADDR A:&base_addr+0x840900
y.create.l HWIO_RPMH_VRM_VOLTAGE_VOTE_DRV4_REG10_ADDR A:&base_addr+0x840a00
y.create.l HWIO_RPMH_VRM_VOLTAGE_VOTE_DRV4_REG11_ADDR A:&base_addr+0x840b00
y.create.l HWIO_RPMH_VRM_VOLTAGE_VOTE_DRV4_REG12_ADDR A:&base_addr+0x840c00
y.create.l HWIO_RPMH_VRM_VOLTAGE_VOTE_DRV4_REG13_ADDR A:&base_addr+0x840d00
y.create.l HWIO_RPMH_VRM_VOLTAGE_VOTE_DRV4_REG14_ADDR A:&base_addr+0x840e00
y.create.l HWIO_RPMH_VRM_VOLTAGE_VOTE_DRV4_REG15_ADDR A:&base_addr+0x840f00
y.create.l HWIO_RPMH_VRM_VOLTAGE_VOTE_DRV4_REG16_ADDR A:&base_addr+0x841000
y.create.l HWIO_RPMH_VRM_VOLTAGE_VOTE_DRV4_REG17_ADDR A:&base_addr+0x841100
y.create.l HWIO_RPMH_VRM_VOLTAGE_VOTE_DRV4_REG18_ADDR A:&base_addr+0x841200
y.create.l HWIO_RPMH_VRM_VOLTAGE_VOTE_DRV4_REG19_ADDR A:&base_addr+0x841300
y.create.l HWIO_RPMH_VRM_VOLTAGE_VOTE_DRV4_REG20_ADDR A:&base_addr+0x841400
y.create.l HWIO_RPMH_VRM_VOLTAGE_VOTE_DRV4_REG21_ADDR A:&base_addr+0x841500
y.create.l HWIO_RPMH_VRM_VOLTAGE_VOTE_DRV4_REG22_ADDR A:&base_addr+0x841600
y.create.l HWIO_RPMH_VRM_VOLTAGE_VOTE_DRV4_REG23_ADDR A:&base_addr+0x841700
y.create.l HWIO_RPMH_VRM_VOLTAGE_VOTE_DRV5_REG0_ADDR A:&base_addr+0x850000
y.create.l HWIO_RPMH_VRM_VOLTAGE_VOTE_DRV5_REG1_ADDR A:&base_addr+0x850100
y.create.l HWIO_RPMH_VRM_VOLTAGE_VOTE_DRV5_REG2_ADDR A:&base_addr+0x850200
y.create.l HWIO_RPMH_VRM_VOLTAGE_VOTE_DRV5_REG3_ADDR A:&base_addr+0x850300
y.create.l HWIO_RPMH_VRM_VOLTAGE_VOTE_DRV5_REG4_ADDR A:&base_addr+0x850400
y.create.l HWIO_RPMH_VRM_VOLTAGE_VOTE_DRV5_REG5_ADDR A:&base_addr+0x850500
y.create.l HWIO_RPMH_VRM_VOLTAGE_VOTE_DRV5_REG6_ADDR A:&base_addr+0x850600
y.create.l HWIO_RPMH_VRM_VOLTAGE_VOTE_DRV5_REG7_ADDR A:&base_addr+0x850700
y.create.l HWIO_RPMH_VRM_VOLTAGE_VOTE_DRV5_REG8_ADDR A:&base_addr+0x850800
y.create.l HWIO_RPMH_VRM_VOLTAGE_VOTE_DRV5_REG9_ADDR A:&base_addr+0x850900
y.create.l HWIO_RPMH_VRM_VOLTAGE_VOTE_DRV5_REG10_ADDR A:&base_addr+0x850a00
y.create.l HWIO_RPMH_VRM_VOLTAGE_VOTE_DRV5_REG11_ADDR A:&base_addr+0x850b00
y.create.l HWIO_RPMH_VRM_VOLTAGE_VOTE_DRV5_REG12_ADDR A:&base_addr+0x850c00
y.create.l HWIO_RPMH_VRM_VOLTAGE_VOTE_DRV5_REG13_ADDR A:&base_addr+0x850d00
y.create.l HWIO_RPMH_VRM_VOLTAGE_VOTE_DRV5_REG14_ADDR A:&base_addr+0x850e00
y.create.l HWIO_RPMH_VRM_VOLTAGE_VOTE_DRV5_REG15_ADDR A:&base_addr+0x850f00
y.create.l HWIO_RPMH_VRM_VOLTAGE_VOTE_DRV5_REG16_ADDR A:&base_addr+0x851000
y.create.l HWIO_RPMH_VRM_VOLTAGE_VOTE_DRV5_REG17_ADDR A:&base_addr+0x851100
y.create.l HWIO_RPMH_VRM_VOLTAGE_VOTE_DRV5_REG18_ADDR A:&base_addr+0x851200
y.create.l HWIO_RPMH_VRM_VOLTAGE_VOTE_DRV5_REG19_ADDR A:&base_addr+0x851300
y.create.l HWIO_RPMH_VRM_VOLTAGE_VOTE_DRV5_REG20_ADDR A:&base_addr+0x851400
y.create.l HWIO_RPMH_VRM_VOLTAGE_VOTE_DRV5_REG21_ADDR A:&base_addr+0x851500
y.create.l HWIO_RPMH_VRM_VOLTAGE_VOTE_DRV5_REG22_ADDR A:&base_addr+0x851600
y.create.l HWIO_RPMH_VRM_VOLTAGE_VOTE_DRV5_REG23_ADDR A:&base_addr+0x851700
y.create.l HWIO_RPMH_VRM_VOLTAGE_VOTE_DRV6_REG0_ADDR A:&base_addr+0x860000
y.create.l HWIO_RPMH_VRM_VOLTAGE_VOTE_DRV6_REG1_ADDR A:&base_addr+0x860100
y.create.l HWIO_RPMH_VRM_VOLTAGE_VOTE_DRV6_REG2_ADDR A:&base_addr+0x860200
y.create.l HWIO_RPMH_VRM_VOLTAGE_VOTE_DRV6_REG3_ADDR A:&base_addr+0x860300
y.create.l HWIO_RPMH_VRM_VOLTAGE_VOTE_DRV6_REG4_ADDR A:&base_addr+0x860400
y.create.l HWIO_RPMH_VRM_VOLTAGE_VOTE_DRV6_REG5_ADDR A:&base_addr+0x860500
y.create.l HWIO_RPMH_VRM_VOLTAGE_VOTE_DRV6_REG6_ADDR A:&base_addr+0x860600
y.create.l HWIO_RPMH_VRM_VOLTAGE_VOTE_DRV6_REG7_ADDR A:&base_addr+0x860700
y.create.l HWIO_RPMH_VRM_VOLTAGE_VOTE_DRV6_REG8_ADDR A:&base_addr+0x860800
y.create.l HWIO_RPMH_VRM_VOLTAGE_VOTE_DRV6_REG9_ADDR A:&base_addr+0x860900
y.create.l HWIO_RPMH_VRM_VOLTAGE_VOTE_DRV6_REG10_ADDR A:&base_addr+0x860a00
y.create.l HWIO_RPMH_VRM_VOLTAGE_VOTE_DRV6_REG11_ADDR A:&base_addr+0x860b00
y.create.l HWIO_RPMH_VRM_VOLTAGE_VOTE_DRV6_REG12_ADDR A:&base_addr+0x860c00
y.create.l HWIO_RPMH_VRM_VOLTAGE_VOTE_DRV6_REG13_ADDR A:&base_addr+0x860d00
y.create.l HWIO_RPMH_VRM_VOLTAGE_VOTE_DRV6_REG14_ADDR A:&base_addr+0x860e00
y.create.l HWIO_RPMH_VRM_VOLTAGE_VOTE_DRV6_REG15_ADDR A:&base_addr+0x860f00
y.create.l HWIO_RPMH_VRM_VOLTAGE_VOTE_DRV6_REG16_ADDR A:&base_addr+0x861000
y.create.l HWIO_RPMH_VRM_VOLTAGE_VOTE_DRV6_REG17_ADDR A:&base_addr+0x861100
y.create.l HWIO_RPMH_VRM_VOLTAGE_VOTE_DRV6_REG18_ADDR A:&base_addr+0x861200
y.create.l HWIO_RPMH_VRM_VOLTAGE_VOTE_DRV6_REG19_ADDR A:&base_addr+0x861300
y.create.l HWIO_RPMH_VRM_VOLTAGE_VOTE_DRV6_REG20_ADDR A:&base_addr+0x861400
y.create.l HWIO_RPMH_VRM_VOLTAGE_VOTE_DRV6_REG21_ADDR A:&base_addr+0x861500
y.create.l HWIO_RPMH_VRM_VOLTAGE_VOTE_DRV6_REG22_ADDR A:&base_addr+0x861600
y.create.l HWIO_RPMH_VRM_VOLTAGE_VOTE_DRV6_REG23_ADDR A:&base_addr+0x861700
y.create.l HWIO_RPMH_VRM_ENABLE_VOTE_DRV0_REG0_ADDR A:&base_addr+0x800004
y.create.l HWIO_RPMH_VRM_ENABLE_VOTE_DRV0_REG1_ADDR A:&base_addr+0x800104
y.create.l HWIO_RPMH_VRM_ENABLE_VOTE_DRV0_REG2_ADDR A:&base_addr+0x800204
y.create.l HWIO_RPMH_VRM_ENABLE_VOTE_DRV0_REG3_ADDR A:&base_addr+0x800304
y.create.l HWIO_RPMH_VRM_ENABLE_VOTE_DRV0_REG4_ADDR A:&base_addr+0x800404
y.create.l HWIO_RPMH_VRM_ENABLE_VOTE_DRV0_REG5_ADDR A:&base_addr+0x800504
y.create.l HWIO_RPMH_VRM_ENABLE_VOTE_DRV0_REG6_ADDR A:&base_addr+0x800604
y.create.l HWIO_RPMH_VRM_ENABLE_VOTE_DRV0_REG7_ADDR A:&base_addr+0x800704
y.create.l HWIO_RPMH_VRM_ENABLE_VOTE_DRV0_REG8_ADDR A:&base_addr+0x800804
y.create.l HWIO_RPMH_VRM_ENABLE_VOTE_DRV0_REG9_ADDR A:&base_addr+0x800904
y.create.l HWIO_RPMH_VRM_ENABLE_VOTE_DRV0_REG10_ADDR A:&base_addr+0x800a04
y.create.l HWIO_RPMH_VRM_ENABLE_VOTE_DRV0_REG11_ADDR A:&base_addr+0x800b04
y.create.l HWIO_RPMH_VRM_ENABLE_VOTE_DRV0_REG12_ADDR A:&base_addr+0x800c04
y.create.l HWIO_RPMH_VRM_ENABLE_VOTE_DRV0_REG13_ADDR A:&base_addr+0x800d04
y.create.l HWIO_RPMH_VRM_ENABLE_VOTE_DRV0_REG14_ADDR A:&base_addr+0x800e04
y.create.l HWIO_RPMH_VRM_ENABLE_VOTE_DRV0_REG15_ADDR A:&base_addr+0x800f04
y.create.l HWIO_RPMH_VRM_ENABLE_VOTE_DRV0_REG16_ADDR A:&base_addr+0x801004
y.create.l HWIO_RPMH_VRM_ENABLE_VOTE_DRV0_REG17_ADDR A:&base_addr+0x801104
y.create.l HWIO_RPMH_VRM_ENABLE_VOTE_DRV0_REG18_ADDR A:&base_addr+0x801204
y.create.l HWIO_RPMH_VRM_ENABLE_VOTE_DRV0_REG19_ADDR A:&base_addr+0x801304
y.create.l HWIO_RPMH_VRM_ENABLE_VOTE_DRV0_REG20_ADDR A:&base_addr+0x801404
y.create.l HWIO_RPMH_VRM_ENABLE_VOTE_DRV0_REG21_ADDR A:&base_addr+0x801504
y.create.l HWIO_RPMH_VRM_ENABLE_VOTE_DRV0_REG22_ADDR A:&base_addr+0x801604
y.create.l HWIO_RPMH_VRM_ENABLE_VOTE_DRV0_REG23_ADDR A:&base_addr+0x801704
y.create.l HWIO_RPMH_VRM_ENABLE_VOTE_DRV1_REG0_ADDR A:&base_addr+0x810004
y.create.l HWIO_RPMH_VRM_ENABLE_VOTE_DRV1_REG1_ADDR A:&base_addr+0x810104
y.create.l HWIO_RPMH_VRM_ENABLE_VOTE_DRV1_REG2_ADDR A:&base_addr+0x810204
y.create.l HWIO_RPMH_VRM_ENABLE_VOTE_DRV1_REG3_ADDR A:&base_addr+0x810304
y.create.l HWIO_RPMH_VRM_ENABLE_VOTE_DRV1_REG4_ADDR A:&base_addr+0x810404
y.create.l HWIO_RPMH_VRM_ENABLE_VOTE_DRV1_REG5_ADDR A:&base_addr+0x810504
y.create.l HWIO_RPMH_VRM_ENABLE_VOTE_DRV1_REG6_ADDR A:&base_addr+0x810604
y.create.l HWIO_RPMH_VRM_ENABLE_VOTE_DRV1_REG7_ADDR A:&base_addr+0x810704
y.create.l HWIO_RPMH_VRM_ENABLE_VOTE_DRV1_REG8_ADDR A:&base_addr+0x810804
y.create.l HWIO_RPMH_VRM_ENABLE_VOTE_DRV1_REG9_ADDR A:&base_addr+0x810904
y.create.l HWIO_RPMH_VRM_ENABLE_VOTE_DRV1_REG10_ADDR A:&base_addr+0x810a04
y.create.l HWIO_RPMH_VRM_ENABLE_VOTE_DRV1_REG11_ADDR A:&base_addr+0x810b04
y.create.l HWIO_RPMH_VRM_ENABLE_VOTE_DRV1_REG12_ADDR A:&base_addr+0x810c04
y.create.l HWIO_RPMH_VRM_ENABLE_VOTE_DRV1_REG13_ADDR A:&base_addr+0x810d04
y.create.l HWIO_RPMH_VRM_ENABLE_VOTE_DRV1_REG14_ADDR A:&base_addr+0x810e04
y.create.l HWIO_RPMH_VRM_ENABLE_VOTE_DRV1_REG15_ADDR A:&base_addr+0x810f04
y.create.l HWIO_RPMH_VRM_ENABLE_VOTE_DRV1_REG16_ADDR A:&base_addr+0x811004
y.create.l HWIO_RPMH_VRM_ENABLE_VOTE_DRV1_REG17_ADDR A:&base_addr+0x811104
y.create.l HWIO_RPMH_VRM_ENABLE_VOTE_DRV1_REG18_ADDR A:&base_addr+0x811204
y.create.l HWIO_RPMH_VRM_ENABLE_VOTE_DRV1_REG19_ADDR A:&base_addr+0x811304
y.create.l HWIO_RPMH_VRM_ENABLE_VOTE_DRV1_REG20_ADDR A:&base_addr+0x811404
y.create.l HWIO_RPMH_VRM_ENABLE_VOTE_DRV1_REG21_ADDR A:&base_addr+0x811504
y.create.l HWIO_RPMH_VRM_ENABLE_VOTE_DRV1_REG22_ADDR A:&base_addr+0x811604
y.create.l HWIO_RPMH_VRM_ENABLE_VOTE_DRV1_REG23_ADDR A:&base_addr+0x811704
y.create.l HWIO_RPMH_VRM_ENABLE_VOTE_DRV2_REG0_ADDR A:&base_addr+0x820004
y.create.l HWIO_RPMH_VRM_ENABLE_VOTE_DRV2_REG1_ADDR A:&base_addr+0x820104
y.create.l HWIO_RPMH_VRM_ENABLE_VOTE_DRV2_REG2_ADDR A:&base_addr+0x820204
y.create.l HWIO_RPMH_VRM_ENABLE_VOTE_DRV2_REG3_ADDR A:&base_addr+0x820304
y.create.l HWIO_RPMH_VRM_ENABLE_VOTE_DRV2_REG4_ADDR A:&base_addr+0x820404
y.create.l HWIO_RPMH_VRM_ENABLE_VOTE_DRV2_REG5_ADDR A:&base_addr+0x820504
y.create.l HWIO_RPMH_VRM_ENABLE_VOTE_DRV2_REG6_ADDR A:&base_addr+0x820604
y.create.l HWIO_RPMH_VRM_ENABLE_VOTE_DRV2_REG7_ADDR A:&base_addr+0x820704
y.create.l HWIO_RPMH_VRM_ENABLE_VOTE_DRV2_REG8_ADDR A:&base_addr+0x820804
y.create.l HWIO_RPMH_VRM_ENABLE_VOTE_DRV2_REG9_ADDR A:&base_addr+0x820904
y.create.l HWIO_RPMH_VRM_ENABLE_VOTE_DRV2_REG10_ADDR A:&base_addr+0x820a04
y.create.l HWIO_RPMH_VRM_ENABLE_VOTE_DRV2_REG11_ADDR A:&base_addr+0x820b04
y.create.l HWIO_RPMH_VRM_ENABLE_VOTE_DRV2_REG12_ADDR A:&base_addr+0x820c04
y.create.l HWIO_RPMH_VRM_ENABLE_VOTE_DRV2_REG13_ADDR A:&base_addr+0x820d04
y.create.l HWIO_RPMH_VRM_ENABLE_VOTE_DRV2_REG14_ADDR A:&base_addr+0x820e04
y.create.l HWIO_RPMH_VRM_ENABLE_VOTE_DRV2_REG15_ADDR A:&base_addr+0x820f04
y.create.l HWIO_RPMH_VRM_ENABLE_VOTE_DRV2_REG16_ADDR A:&base_addr+0x821004
y.create.l HWIO_RPMH_VRM_ENABLE_VOTE_DRV2_REG17_ADDR A:&base_addr+0x821104
y.create.l HWIO_RPMH_VRM_ENABLE_VOTE_DRV2_REG18_ADDR A:&base_addr+0x821204
y.create.l HWIO_RPMH_VRM_ENABLE_VOTE_DRV2_REG19_ADDR A:&base_addr+0x821304
y.create.l HWIO_RPMH_VRM_ENABLE_VOTE_DRV2_REG20_ADDR A:&base_addr+0x821404
y.create.l HWIO_RPMH_VRM_ENABLE_VOTE_DRV2_REG21_ADDR A:&base_addr+0x821504
y.create.l HWIO_RPMH_VRM_ENABLE_VOTE_DRV2_REG22_ADDR A:&base_addr+0x821604
y.create.l HWIO_RPMH_VRM_ENABLE_VOTE_DRV2_REG23_ADDR A:&base_addr+0x821704
y.create.l HWIO_RPMH_VRM_ENABLE_VOTE_DRV3_REG0_ADDR A:&base_addr+0x830004
y.create.l HWIO_RPMH_VRM_ENABLE_VOTE_DRV3_REG1_ADDR A:&base_addr+0x830104
y.create.l HWIO_RPMH_VRM_ENABLE_VOTE_DRV3_REG2_ADDR A:&base_addr+0x830204
y.create.l HWIO_RPMH_VRM_ENABLE_VOTE_DRV3_REG3_ADDR A:&base_addr+0x830304
y.create.l HWIO_RPMH_VRM_ENABLE_VOTE_DRV3_REG4_ADDR A:&base_addr+0x830404
y.create.l HWIO_RPMH_VRM_ENABLE_VOTE_DRV3_REG5_ADDR A:&base_addr+0x830504
y.create.l HWIO_RPMH_VRM_ENABLE_VOTE_DRV3_REG6_ADDR A:&base_addr+0x830604
y.create.l HWIO_RPMH_VRM_ENABLE_VOTE_DRV3_REG7_ADDR A:&base_addr+0x830704
y.create.l HWIO_RPMH_VRM_ENABLE_VOTE_DRV3_REG8_ADDR A:&base_addr+0x830804
y.create.l HWIO_RPMH_VRM_ENABLE_VOTE_DRV3_REG9_ADDR A:&base_addr+0x830904
y.create.l HWIO_RPMH_VRM_ENABLE_VOTE_DRV3_REG10_ADDR A:&base_addr+0x830a04
y.create.l HWIO_RPMH_VRM_ENABLE_VOTE_DRV3_REG11_ADDR A:&base_addr+0x830b04
y.create.l HWIO_RPMH_VRM_ENABLE_VOTE_DRV3_REG12_ADDR A:&base_addr+0x830c04
y.create.l HWIO_RPMH_VRM_ENABLE_VOTE_DRV3_REG13_ADDR A:&base_addr+0x830d04
y.create.l HWIO_RPMH_VRM_ENABLE_VOTE_DRV3_REG14_ADDR A:&base_addr+0x830e04
y.create.l HWIO_RPMH_VRM_ENABLE_VOTE_DRV3_REG15_ADDR A:&base_addr+0x830f04
y.create.l HWIO_RPMH_VRM_ENABLE_VOTE_DRV3_REG16_ADDR A:&base_addr+0x831004
y.create.l HWIO_RPMH_VRM_ENABLE_VOTE_DRV3_REG17_ADDR A:&base_addr+0x831104
y.create.l HWIO_RPMH_VRM_ENABLE_VOTE_DRV3_REG18_ADDR A:&base_addr+0x831204
y.create.l HWIO_RPMH_VRM_ENABLE_VOTE_DRV3_REG19_ADDR A:&base_addr+0x831304
y.create.l HWIO_RPMH_VRM_ENABLE_VOTE_DRV3_REG20_ADDR A:&base_addr+0x831404
y.create.l HWIO_RPMH_VRM_ENABLE_VOTE_DRV3_REG21_ADDR A:&base_addr+0x831504
y.create.l HWIO_RPMH_VRM_ENABLE_VOTE_DRV3_REG22_ADDR A:&base_addr+0x831604
y.create.l HWIO_RPMH_VRM_ENABLE_VOTE_DRV3_REG23_ADDR A:&base_addr+0x831704
y.create.l HWIO_RPMH_VRM_ENABLE_VOTE_DRV4_REG0_ADDR A:&base_addr+0x840004
y.create.l HWIO_RPMH_VRM_ENABLE_VOTE_DRV4_REG1_ADDR A:&base_addr+0x840104
y.create.l HWIO_RPMH_VRM_ENABLE_VOTE_DRV4_REG2_ADDR A:&base_addr+0x840204
y.create.l HWIO_RPMH_VRM_ENABLE_VOTE_DRV4_REG3_ADDR A:&base_addr+0x840304
y.create.l HWIO_RPMH_VRM_ENABLE_VOTE_DRV4_REG4_ADDR A:&base_addr+0x840404
y.create.l HWIO_RPMH_VRM_ENABLE_VOTE_DRV4_REG5_ADDR A:&base_addr+0x840504
y.create.l HWIO_RPMH_VRM_ENABLE_VOTE_DRV4_REG6_ADDR A:&base_addr+0x840604
y.create.l HWIO_RPMH_VRM_ENABLE_VOTE_DRV4_REG7_ADDR A:&base_addr+0x840704
y.create.l HWIO_RPMH_VRM_ENABLE_VOTE_DRV4_REG8_ADDR A:&base_addr+0x840804
y.create.l HWIO_RPMH_VRM_ENABLE_VOTE_DRV4_REG9_ADDR A:&base_addr+0x840904
y.create.l HWIO_RPMH_VRM_ENABLE_VOTE_DRV4_REG10_ADDR A:&base_addr+0x840a04
y.create.l HWIO_RPMH_VRM_ENABLE_VOTE_DRV4_REG11_ADDR A:&base_addr+0x840b04
y.create.l HWIO_RPMH_VRM_ENABLE_VOTE_DRV4_REG12_ADDR A:&base_addr+0x840c04
y.create.l HWIO_RPMH_VRM_ENABLE_VOTE_DRV4_REG13_ADDR A:&base_addr+0x840d04
y.create.l HWIO_RPMH_VRM_ENABLE_VOTE_DRV4_REG14_ADDR A:&base_addr+0x840e04
y.create.l HWIO_RPMH_VRM_ENABLE_VOTE_DRV4_REG15_ADDR A:&base_addr+0x840f04
y.create.l HWIO_RPMH_VRM_ENABLE_VOTE_DRV4_REG16_ADDR A:&base_addr+0x841004
y.create.l HWIO_RPMH_VRM_ENABLE_VOTE_DRV4_REG17_ADDR A:&base_addr+0x841104
y.create.l HWIO_RPMH_VRM_ENABLE_VOTE_DRV4_REG18_ADDR A:&base_addr+0x841204
y.create.l HWIO_RPMH_VRM_ENABLE_VOTE_DRV4_REG19_ADDR A:&base_addr+0x841304
y.create.l HWIO_RPMH_VRM_ENABLE_VOTE_DRV4_REG20_ADDR A:&base_addr+0x841404
y.create.l HWIO_RPMH_VRM_ENABLE_VOTE_DRV4_REG21_ADDR A:&base_addr+0x841504
y.create.l HWIO_RPMH_VRM_ENABLE_VOTE_DRV4_REG22_ADDR A:&base_addr+0x841604
y.create.l HWIO_RPMH_VRM_ENABLE_VOTE_DRV4_REG23_ADDR A:&base_addr+0x841704
y.create.l HWIO_RPMH_VRM_ENABLE_VOTE_DRV5_REG0_ADDR A:&base_addr+0x850004
y.create.l HWIO_RPMH_VRM_ENABLE_VOTE_DRV5_REG1_ADDR A:&base_addr+0x850104
y.create.l HWIO_RPMH_VRM_ENABLE_VOTE_DRV5_REG2_ADDR A:&base_addr+0x850204
y.create.l HWIO_RPMH_VRM_ENABLE_VOTE_DRV5_REG3_ADDR A:&base_addr+0x850304
y.create.l HWIO_RPMH_VRM_ENABLE_VOTE_DRV5_REG4_ADDR A:&base_addr+0x850404
y.create.l HWIO_RPMH_VRM_ENABLE_VOTE_DRV5_REG5_ADDR A:&base_addr+0x850504
y.create.l HWIO_RPMH_VRM_ENABLE_VOTE_DRV5_REG6_ADDR A:&base_addr+0x850604
y.create.l HWIO_RPMH_VRM_ENABLE_VOTE_DRV5_REG7_ADDR A:&base_addr+0x850704
y.create.l HWIO_RPMH_VRM_ENABLE_VOTE_DRV5_REG8_ADDR A:&base_addr+0x850804
y.create.l HWIO_RPMH_VRM_ENABLE_VOTE_DRV5_REG9_ADDR A:&base_addr+0x850904
y.create.l HWIO_RPMH_VRM_ENABLE_VOTE_DRV5_REG10_ADDR A:&base_addr+0x850a04
y.create.l HWIO_RPMH_VRM_ENABLE_VOTE_DRV5_REG11_ADDR A:&base_addr+0x850b04
y.create.l HWIO_RPMH_VRM_ENABLE_VOTE_DRV5_REG12_ADDR A:&base_addr+0x850c04
y.create.l HWIO_RPMH_VRM_ENABLE_VOTE_DRV5_REG13_ADDR A:&base_addr+0x850d04
y.create.l HWIO_RPMH_VRM_ENABLE_VOTE_DRV5_REG14_ADDR A:&base_addr+0x850e04
y.create.l HWIO_RPMH_VRM_ENABLE_VOTE_DRV5_REG15_ADDR A:&base_addr+0x850f04
y.create.l HWIO_RPMH_VRM_ENABLE_VOTE_DRV5_REG16_ADDR A:&base_addr+0x851004
y.create.l HWIO_RPMH_VRM_ENABLE_VOTE_DRV5_REG17_ADDR A:&base_addr+0x851104
y.create.l HWIO_RPMH_VRM_ENABLE_VOTE_DRV5_REG18_ADDR A:&base_addr+0x851204
y.create.l HWIO_RPMH_VRM_ENABLE_VOTE_DRV5_REG19_ADDR A:&base_addr+0x851304
y.create.l HWIO_RPMH_VRM_ENABLE_VOTE_DRV5_REG20_ADDR A:&base_addr+0x851404
y.create.l HWIO_RPMH_VRM_ENABLE_VOTE_DRV5_REG21_ADDR A:&base_addr+0x851504
y.create.l HWIO_RPMH_VRM_ENABLE_VOTE_DRV5_REG22_ADDR A:&base_addr+0x851604
y.create.l HWIO_RPMH_VRM_ENABLE_VOTE_DRV5_REG23_ADDR A:&base_addr+0x851704
y.create.l HWIO_RPMH_VRM_ENABLE_VOTE_DRV6_REG0_ADDR A:&base_addr+0x860004
y.create.l HWIO_RPMH_VRM_ENABLE_VOTE_DRV6_REG1_ADDR A:&base_addr+0x860104
y.create.l HWIO_RPMH_VRM_ENABLE_VOTE_DRV6_REG2_ADDR A:&base_addr+0x860204
y.create.l HWIO_RPMH_VRM_ENABLE_VOTE_DRV6_REG3_ADDR A:&base_addr+0x860304
y.create.l HWIO_RPMH_VRM_ENABLE_VOTE_DRV6_REG4_ADDR A:&base_addr+0x860404
y.create.l HWIO_RPMH_VRM_ENABLE_VOTE_DRV6_REG5_ADDR A:&base_addr+0x860504
y.create.l HWIO_RPMH_VRM_ENABLE_VOTE_DRV6_REG6_ADDR A:&base_addr+0x860604
y.create.l HWIO_RPMH_VRM_ENABLE_VOTE_DRV6_REG7_ADDR A:&base_addr+0x860704
y.create.l HWIO_RPMH_VRM_ENABLE_VOTE_DRV6_REG8_ADDR A:&base_addr+0x860804
y.create.l HWIO_RPMH_VRM_ENABLE_VOTE_DRV6_REG9_ADDR A:&base_addr+0x860904
y.create.l HWIO_RPMH_VRM_ENABLE_VOTE_DRV6_REG10_ADDR A:&base_addr+0x860a04
y.create.l HWIO_RPMH_VRM_ENABLE_VOTE_DRV6_REG11_ADDR A:&base_addr+0x860b04
y.create.l HWIO_RPMH_VRM_ENABLE_VOTE_DRV6_REG12_ADDR A:&base_addr+0x860c04
y.create.l HWIO_RPMH_VRM_ENABLE_VOTE_DRV6_REG13_ADDR A:&base_addr+0x860d04
y.create.l HWIO_RPMH_VRM_ENABLE_VOTE_DRV6_REG14_ADDR A:&base_addr+0x860e04
y.create.l HWIO_RPMH_VRM_ENABLE_VOTE_DRV6_REG15_ADDR A:&base_addr+0x860f04
y.create.l HWIO_RPMH_VRM_ENABLE_VOTE_DRV6_REG16_ADDR A:&base_addr+0x861004
y.create.l HWIO_RPMH_VRM_ENABLE_VOTE_DRV6_REG17_ADDR A:&base_addr+0x861104
y.create.l HWIO_RPMH_VRM_ENABLE_VOTE_DRV6_REG18_ADDR A:&base_addr+0x861204
y.create.l HWIO_RPMH_VRM_ENABLE_VOTE_DRV6_REG19_ADDR A:&base_addr+0x861304
y.create.l HWIO_RPMH_VRM_ENABLE_VOTE_DRV6_REG20_ADDR A:&base_addr+0x861404
y.create.l HWIO_RPMH_VRM_ENABLE_VOTE_DRV6_REG21_ADDR A:&base_addr+0x861504
y.create.l HWIO_RPMH_VRM_ENABLE_VOTE_DRV6_REG22_ADDR A:&base_addr+0x861604
y.create.l HWIO_RPMH_VRM_ENABLE_VOTE_DRV6_REG23_ADDR A:&base_addr+0x861704
y.create.l HWIO_RPMH_VRM_MODE_VOTE_DRV0_REG0_ADDR A:&base_addr+0x800008
y.create.l HWIO_RPMH_VRM_MODE_VOTE_DRV0_REG1_ADDR A:&base_addr+0x800108
y.create.l HWIO_RPMH_VRM_MODE_VOTE_DRV0_REG2_ADDR A:&base_addr+0x800208
y.create.l HWIO_RPMH_VRM_MODE_VOTE_DRV0_REG3_ADDR A:&base_addr+0x800308
y.create.l HWIO_RPMH_VRM_MODE_VOTE_DRV0_REG4_ADDR A:&base_addr+0x800408
y.create.l HWIO_RPMH_VRM_MODE_VOTE_DRV0_REG5_ADDR A:&base_addr+0x800508
y.create.l HWIO_RPMH_VRM_MODE_VOTE_DRV0_REG6_ADDR A:&base_addr+0x800608
y.create.l HWIO_RPMH_VRM_MODE_VOTE_DRV0_REG7_ADDR A:&base_addr+0x800708
y.create.l HWIO_RPMH_VRM_MODE_VOTE_DRV0_REG8_ADDR A:&base_addr+0x800808
y.create.l HWIO_RPMH_VRM_MODE_VOTE_DRV0_REG9_ADDR A:&base_addr+0x800908
y.create.l HWIO_RPMH_VRM_MODE_VOTE_DRV0_REG10_ADDR A:&base_addr+0x800a08
y.create.l HWIO_RPMH_VRM_MODE_VOTE_DRV0_REG11_ADDR A:&base_addr+0x800b08
y.create.l HWIO_RPMH_VRM_MODE_VOTE_DRV0_REG12_ADDR A:&base_addr+0x800c08
y.create.l HWIO_RPMH_VRM_MODE_VOTE_DRV0_REG13_ADDR A:&base_addr+0x800d08
y.create.l HWIO_RPMH_VRM_MODE_VOTE_DRV0_REG14_ADDR A:&base_addr+0x800e08
y.create.l HWIO_RPMH_VRM_MODE_VOTE_DRV0_REG15_ADDR A:&base_addr+0x800f08
y.create.l HWIO_RPMH_VRM_MODE_VOTE_DRV0_REG16_ADDR A:&base_addr+0x801008
y.create.l HWIO_RPMH_VRM_MODE_VOTE_DRV0_REG17_ADDR A:&base_addr+0x801108
y.create.l HWIO_RPMH_VRM_MODE_VOTE_DRV0_REG18_ADDR A:&base_addr+0x801208
y.create.l HWIO_RPMH_VRM_MODE_VOTE_DRV0_REG19_ADDR A:&base_addr+0x801308
y.create.l HWIO_RPMH_VRM_MODE_VOTE_DRV0_REG20_ADDR A:&base_addr+0x801408
y.create.l HWIO_RPMH_VRM_MODE_VOTE_DRV0_REG21_ADDR A:&base_addr+0x801508
y.create.l HWIO_RPMH_VRM_MODE_VOTE_DRV0_REG22_ADDR A:&base_addr+0x801608
y.create.l HWIO_RPMH_VRM_MODE_VOTE_DRV0_REG23_ADDR A:&base_addr+0x801708
y.create.l HWIO_RPMH_VRM_MODE_VOTE_DRV1_REG0_ADDR A:&base_addr+0x810008
y.create.l HWIO_RPMH_VRM_MODE_VOTE_DRV1_REG1_ADDR A:&base_addr+0x810108
y.create.l HWIO_RPMH_VRM_MODE_VOTE_DRV1_REG2_ADDR A:&base_addr+0x810208
y.create.l HWIO_RPMH_VRM_MODE_VOTE_DRV1_REG3_ADDR A:&base_addr+0x810308
y.create.l HWIO_RPMH_VRM_MODE_VOTE_DRV1_REG4_ADDR A:&base_addr+0x810408
y.create.l HWIO_RPMH_VRM_MODE_VOTE_DRV1_REG5_ADDR A:&base_addr+0x810508
y.create.l HWIO_RPMH_VRM_MODE_VOTE_DRV1_REG6_ADDR A:&base_addr+0x810608
y.create.l HWIO_RPMH_VRM_MODE_VOTE_DRV1_REG7_ADDR A:&base_addr+0x810708
y.create.l HWIO_RPMH_VRM_MODE_VOTE_DRV1_REG8_ADDR A:&base_addr+0x810808
y.create.l HWIO_RPMH_VRM_MODE_VOTE_DRV1_REG9_ADDR A:&base_addr+0x810908
y.create.l HWIO_RPMH_VRM_MODE_VOTE_DRV1_REG10_ADDR A:&base_addr+0x810a08
y.create.l HWIO_RPMH_VRM_MODE_VOTE_DRV1_REG11_ADDR A:&base_addr+0x810b08
y.create.l HWIO_RPMH_VRM_MODE_VOTE_DRV1_REG12_ADDR A:&base_addr+0x810c08
y.create.l HWIO_RPMH_VRM_MODE_VOTE_DRV1_REG13_ADDR A:&base_addr+0x810d08
y.create.l HWIO_RPMH_VRM_MODE_VOTE_DRV1_REG14_ADDR A:&base_addr+0x810e08
y.create.l HWIO_RPMH_VRM_MODE_VOTE_DRV1_REG15_ADDR A:&base_addr+0x810f08
y.create.l HWIO_RPMH_VRM_MODE_VOTE_DRV1_REG16_ADDR A:&base_addr+0x811008
y.create.l HWIO_RPMH_VRM_MODE_VOTE_DRV1_REG17_ADDR A:&base_addr+0x811108
y.create.l HWIO_RPMH_VRM_MODE_VOTE_DRV1_REG18_ADDR A:&base_addr+0x811208
y.create.l HWIO_RPMH_VRM_MODE_VOTE_DRV1_REG19_ADDR A:&base_addr+0x811308
y.create.l HWIO_RPMH_VRM_MODE_VOTE_DRV1_REG20_ADDR A:&base_addr+0x811408
y.create.l HWIO_RPMH_VRM_MODE_VOTE_DRV1_REG21_ADDR A:&base_addr+0x811508
y.create.l HWIO_RPMH_VRM_MODE_VOTE_DRV1_REG22_ADDR A:&base_addr+0x811608
y.create.l HWIO_RPMH_VRM_MODE_VOTE_DRV1_REG23_ADDR A:&base_addr+0x811708
y.create.l HWIO_RPMH_VRM_MODE_VOTE_DRV2_REG0_ADDR A:&base_addr+0x820008
y.create.l HWIO_RPMH_VRM_MODE_VOTE_DRV2_REG1_ADDR A:&base_addr+0x820108
y.create.l HWIO_RPMH_VRM_MODE_VOTE_DRV2_REG2_ADDR A:&base_addr+0x820208
y.create.l HWIO_RPMH_VRM_MODE_VOTE_DRV2_REG3_ADDR A:&base_addr+0x820308
y.create.l HWIO_RPMH_VRM_MODE_VOTE_DRV2_REG4_ADDR A:&base_addr+0x820408
y.create.l HWIO_RPMH_VRM_MODE_VOTE_DRV2_REG5_ADDR A:&base_addr+0x820508
y.create.l HWIO_RPMH_VRM_MODE_VOTE_DRV2_REG6_ADDR A:&base_addr+0x820608
y.create.l HWIO_RPMH_VRM_MODE_VOTE_DRV2_REG7_ADDR A:&base_addr+0x820708
y.create.l HWIO_RPMH_VRM_MODE_VOTE_DRV2_REG8_ADDR A:&base_addr+0x820808
y.create.l HWIO_RPMH_VRM_MODE_VOTE_DRV2_REG9_ADDR A:&base_addr+0x820908
y.create.l HWIO_RPMH_VRM_MODE_VOTE_DRV2_REG10_ADDR A:&base_addr+0x820a08
y.create.l HWIO_RPMH_VRM_MODE_VOTE_DRV2_REG11_ADDR A:&base_addr+0x820b08
y.create.l HWIO_RPMH_VRM_MODE_VOTE_DRV2_REG12_ADDR A:&base_addr+0x820c08
y.create.l HWIO_RPMH_VRM_MODE_VOTE_DRV2_REG13_ADDR A:&base_addr+0x820d08
y.create.l HWIO_RPMH_VRM_MODE_VOTE_DRV2_REG14_ADDR A:&base_addr+0x820e08
y.create.l HWIO_RPMH_VRM_MODE_VOTE_DRV2_REG15_ADDR A:&base_addr+0x820f08
y.create.l HWIO_RPMH_VRM_MODE_VOTE_DRV2_REG16_ADDR A:&base_addr+0x821008
y.create.l HWIO_RPMH_VRM_MODE_VOTE_DRV2_REG17_ADDR A:&base_addr+0x821108
y.create.l HWIO_RPMH_VRM_MODE_VOTE_DRV2_REG18_ADDR A:&base_addr+0x821208
y.create.l HWIO_RPMH_VRM_MODE_VOTE_DRV2_REG19_ADDR A:&base_addr+0x821308
y.create.l HWIO_RPMH_VRM_MODE_VOTE_DRV2_REG20_ADDR A:&base_addr+0x821408
y.create.l HWIO_RPMH_VRM_MODE_VOTE_DRV2_REG21_ADDR A:&base_addr+0x821508
y.create.l HWIO_RPMH_VRM_MODE_VOTE_DRV2_REG22_ADDR A:&base_addr+0x821608
y.create.l HWIO_RPMH_VRM_MODE_VOTE_DRV2_REG23_ADDR A:&base_addr+0x821708
y.create.l HWIO_RPMH_VRM_MODE_VOTE_DRV3_REG0_ADDR A:&base_addr+0x830008
y.create.l HWIO_RPMH_VRM_MODE_VOTE_DRV3_REG1_ADDR A:&base_addr+0x830108
y.create.l HWIO_RPMH_VRM_MODE_VOTE_DRV3_REG2_ADDR A:&base_addr+0x830208
y.create.l HWIO_RPMH_VRM_MODE_VOTE_DRV3_REG3_ADDR A:&base_addr+0x830308
y.create.l HWIO_RPMH_VRM_MODE_VOTE_DRV3_REG4_ADDR A:&base_addr+0x830408
y.create.l HWIO_RPMH_VRM_MODE_VOTE_DRV3_REG5_ADDR A:&base_addr+0x830508
y.create.l HWIO_RPMH_VRM_MODE_VOTE_DRV3_REG6_ADDR A:&base_addr+0x830608
y.create.l HWIO_RPMH_VRM_MODE_VOTE_DRV3_REG7_ADDR A:&base_addr+0x830708
y.create.l HWIO_RPMH_VRM_MODE_VOTE_DRV3_REG8_ADDR A:&base_addr+0x830808
y.create.l HWIO_RPMH_VRM_MODE_VOTE_DRV3_REG9_ADDR A:&base_addr+0x830908
y.create.l HWIO_RPMH_VRM_MODE_VOTE_DRV3_REG10_ADDR A:&base_addr+0x830a08
y.create.l HWIO_RPMH_VRM_MODE_VOTE_DRV3_REG11_ADDR A:&base_addr+0x830b08
y.create.l HWIO_RPMH_VRM_MODE_VOTE_DRV3_REG12_ADDR A:&base_addr+0x830c08
y.create.l HWIO_RPMH_VRM_MODE_VOTE_DRV3_REG13_ADDR A:&base_addr+0x830d08
y.create.l HWIO_RPMH_VRM_MODE_VOTE_DRV3_REG14_ADDR A:&base_addr+0x830e08
y.create.l HWIO_RPMH_VRM_MODE_VOTE_DRV3_REG15_ADDR A:&base_addr+0x830f08
y.create.l HWIO_RPMH_VRM_MODE_VOTE_DRV3_REG16_ADDR A:&base_addr+0x831008
y.create.l HWIO_RPMH_VRM_MODE_VOTE_DRV3_REG17_ADDR A:&base_addr+0x831108
y.create.l HWIO_RPMH_VRM_MODE_VOTE_DRV3_REG18_ADDR A:&base_addr+0x831208
y.create.l HWIO_RPMH_VRM_MODE_VOTE_DRV3_REG19_ADDR A:&base_addr+0x831308
y.create.l HWIO_RPMH_VRM_MODE_VOTE_DRV3_REG20_ADDR A:&base_addr+0x831408
y.create.l HWIO_RPMH_VRM_MODE_VOTE_DRV3_REG21_ADDR A:&base_addr+0x831508
y.create.l HWIO_RPMH_VRM_MODE_VOTE_DRV3_REG22_ADDR A:&base_addr+0x831608
y.create.l HWIO_RPMH_VRM_MODE_VOTE_DRV3_REG23_ADDR A:&base_addr+0x831708
y.create.l HWIO_RPMH_VRM_MODE_VOTE_DRV4_REG0_ADDR A:&base_addr+0x840008
y.create.l HWIO_RPMH_VRM_MODE_VOTE_DRV4_REG1_ADDR A:&base_addr+0x840108
y.create.l HWIO_RPMH_VRM_MODE_VOTE_DRV4_REG2_ADDR A:&base_addr+0x840208
y.create.l HWIO_RPMH_VRM_MODE_VOTE_DRV4_REG3_ADDR A:&base_addr+0x840308
y.create.l HWIO_RPMH_VRM_MODE_VOTE_DRV4_REG4_ADDR A:&base_addr+0x840408
y.create.l HWIO_RPMH_VRM_MODE_VOTE_DRV4_REG5_ADDR A:&base_addr+0x840508
y.create.l HWIO_RPMH_VRM_MODE_VOTE_DRV4_REG6_ADDR A:&base_addr+0x840608
y.create.l HWIO_RPMH_VRM_MODE_VOTE_DRV4_REG7_ADDR A:&base_addr+0x840708
y.create.l HWIO_RPMH_VRM_MODE_VOTE_DRV4_REG8_ADDR A:&base_addr+0x840808
y.create.l HWIO_RPMH_VRM_MODE_VOTE_DRV4_REG9_ADDR A:&base_addr+0x840908
y.create.l HWIO_RPMH_VRM_MODE_VOTE_DRV4_REG10_ADDR A:&base_addr+0x840a08
y.create.l HWIO_RPMH_VRM_MODE_VOTE_DRV4_REG11_ADDR A:&base_addr+0x840b08
y.create.l HWIO_RPMH_VRM_MODE_VOTE_DRV4_REG12_ADDR A:&base_addr+0x840c08
y.create.l HWIO_RPMH_VRM_MODE_VOTE_DRV4_REG13_ADDR A:&base_addr+0x840d08
y.create.l HWIO_RPMH_VRM_MODE_VOTE_DRV4_REG14_ADDR A:&base_addr+0x840e08
y.create.l HWIO_RPMH_VRM_MODE_VOTE_DRV4_REG15_ADDR A:&base_addr+0x840f08
y.create.l HWIO_RPMH_VRM_MODE_VOTE_DRV4_REG16_ADDR A:&base_addr+0x841008
y.create.l HWIO_RPMH_VRM_MODE_VOTE_DRV4_REG17_ADDR A:&base_addr+0x841108
y.create.l HWIO_RPMH_VRM_MODE_VOTE_DRV4_REG18_ADDR A:&base_addr+0x841208
y.create.l HWIO_RPMH_VRM_MODE_VOTE_DRV4_REG19_ADDR A:&base_addr+0x841308
y.create.l HWIO_RPMH_VRM_MODE_VOTE_DRV4_REG20_ADDR A:&base_addr+0x841408
y.create.l HWIO_RPMH_VRM_MODE_VOTE_DRV4_REG21_ADDR A:&base_addr+0x841508
y.create.l HWIO_RPMH_VRM_MODE_VOTE_DRV4_REG22_ADDR A:&base_addr+0x841608
y.create.l HWIO_RPMH_VRM_MODE_VOTE_DRV4_REG23_ADDR A:&base_addr+0x841708
y.create.l HWIO_RPMH_VRM_MODE_VOTE_DRV5_REG0_ADDR A:&base_addr+0x850008
y.create.l HWIO_RPMH_VRM_MODE_VOTE_DRV5_REG1_ADDR A:&base_addr+0x850108
y.create.l HWIO_RPMH_VRM_MODE_VOTE_DRV5_REG2_ADDR A:&base_addr+0x850208
y.create.l HWIO_RPMH_VRM_MODE_VOTE_DRV5_REG3_ADDR A:&base_addr+0x850308
y.create.l HWIO_RPMH_VRM_MODE_VOTE_DRV5_REG4_ADDR A:&base_addr+0x850408
y.create.l HWIO_RPMH_VRM_MODE_VOTE_DRV5_REG5_ADDR A:&base_addr+0x850508
y.create.l HWIO_RPMH_VRM_MODE_VOTE_DRV5_REG6_ADDR A:&base_addr+0x850608
y.create.l HWIO_RPMH_VRM_MODE_VOTE_DRV5_REG7_ADDR A:&base_addr+0x850708
y.create.l HWIO_RPMH_VRM_MODE_VOTE_DRV5_REG8_ADDR A:&base_addr+0x850808
y.create.l HWIO_RPMH_VRM_MODE_VOTE_DRV5_REG9_ADDR A:&base_addr+0x850908
y.create.l HWIO_RPMH_VRM_MODE_VOTE_DRV5_REG10_ADDR A:&base_addr+0x850a08
y.create.l HWIO_RPMH_VRM_MODE_VOTE_DRV5_REG11_ADDR A:&base_addr+0x850b08
y.create.l HWIO_RPMH_VRM_MODE_VOTE_DRV5_REG12_ADDR A:&base_addr+0x850c08
y.create.l HWIO_RPMH_VRM_MODE_VOTE_DRV5_REG13_ADDR A:&base_addr+0x850d08
y.create.l HWIO_RPMH_VRM_MODE_VOTE_DRV5_REG14_ADDR A:&base_addr+0x850e08
y.create.l HWIO_RPMH_VRM_MODE_VOTE_DRV5_REG15_ADDR A:&base_addr+0x850f08
y.create.l HWIO_RPMH_VRM_MODE_VOTE_DRV5_REG16_ADDR A:&base_addr+0x851008
y.create.l HWIO_RPMH_VRM_MODE_VOTE_DRV5_REG17_ADDR A:&base_addr+0x851108
y.create.l HWIO_RPMH_VRM_MODE_VOTE_DRV5_REG18_ADDR A:&base_addr+0x851208
y.create.l HWIO_RPMH_VRM_MODE_VOTE_DRV5_REG19_ADDR A:&base_addr+0x851308
y.create.l HWIO_RPMH_VRM_MODE_VOTE_DRV5_REG20_ADDR A:&base_addr+0x851408
y.create.l HWIO_RPMH_VRM_MODE_VOTE_DRV5_REG21_ADDR A:&base_addr+0x851508
y.create.l HWIO_RPMH_VRM_MODE_VOTE_DRV5_REG22_ADDR A:&base_addr+0x851608
y.create.l HWIO_RPMH_VRM_MODE_VOTE_DRV5_REG23_ADDR A:&base_addr+0x851708
y.create.l HWIO_RPMH_VRM_MODE_VOTE_DRV6_REG0_ADDR A:&base_addr+0x860008
y.create.l HWIO_RPMH_VRM_MODE_VOTE_DRV6_REG1_ADDR A:&base_addr+0x860108
y.create.l HWIO_RPMH_VRM_MODE_VOTE_DRV6_REG2_ADDR A:&base_addr+0x860208
y.create.l HWIO_RPMH_VRM_MODE_VOTE_DRV6_REG3_ADDR A:&base_addr+0x860308
y.create.l HWIO_RPMH_VRM_MODE_VOTE_DRV6_REG4_ADDR A:&base_addr+0x860408
y.create.l HWIO_RPMH_VRM_MODE_VOTE_DRV6_REG5_ADDR A:&base_addr+0x860508
y.create.l HWIO_RPMH_VRM_MODE_VOTE_DRV6_REG6_ADDR A:&base_addr+0x860608
y.create.l HWIO_RPMH_VRM_MODE_VOTE_DRV6_REG7_ADDR A:&base_addr+0x860708
y.create.l HWIO_RPMH_VRM_MODE_VOTE_DRV6_REG8_ADDR A:&base_addr+0x860808
y.create.l HWIO_RPMH_VRM_MODE_VOTE_DRV6_REG9_ADDR A:&base_addr+0x860908
y.create.l HWIO_RPMH_VRM_MODE_VOTE_DRV6_REG10_ADDR A:&base_addr+0x860a08
y.create.l HWIO_RPMH_VRM_MODE_VOTE_DRV6_REG11_ADDR A:&base_addr+0x860b08
y.create.l HWIO_RPMH_VRM_MODE_VOTE_DRV6_REG12_ADDR A:&base_addr+0x860c08
y.create.l HWIO_RPMH_VRM_MODE_VOTE_DRV6_REG13_ADDR A:&base_addr+0x860d08
y.create.l HWIO_RPMH_VRM_MODE_VOTE_DRV6_REG14_ADDR A:&base_addr+0x860e08
y.create.l HWIO_RPMH_VRM_MODE_VOTE_DRV6_REG15_ADDR A:&base_addr+0x860f08
y.create.l HWIO_RPMH_VRM_MODE_VOTE_DRV6_REG16_ADDR A:&base_addr+0x861008
y.create.l HWIO_RPMH_VRM_MODE_VOTE_DRV6_REG17_ADDR A:&base_addr+0x861108
y.create.l HWIO_RPMH_VRM_MODE_VOTE_DRV6_REG18_ADDR A:&base_addr+0x861208
y.create.l HWIO_RPMH_VRM_MODE_VOTE_DRV6_REG19_ADDR A:&base_addr+0x861308
y.create.l HWIO_RPMH_VRM_MODE_VOTE_DRV6_REG20_ADDR A:&base_addr+0x861408
y.create.l HWIO_RPMH_VRM_MODE_VOTE_DRV6_REG21_ADDR A:&base_addr+0x861508
y.create.l HWIO_RPMH_VRM_MODE_VOTE_DRV6_REG22_ADDR A:&base_addr+0x861608
y.create.l HWIO_RPMH_VRM_MODE_VOTE_DRV6_REG23_ADDR A:&base_addr+0x861708
y.create.l HWIO_RPMH_VRM_HEADROOM_VOTE_DRV0_REG0_ADDR A:&base_addr+0x80000c
y.create.l HWIO_RPMH_VRM_HEADROOM_VOTE_DRV0_REG1_ADDR A:&base_addr+0x80010c
y.create.l HWIO_RPMH_VRM_HEADROOM_VOTE_DRV0_REG2_ADDR A:&base_addr+0x80020c
y.create.l HWIO_RPMH_VRM_HEADROOM_VOTE_DRV0_REG3_ADDR A:&base_addr+0x80030c
y.create.l HWIO_RPMH_VRM_HEADROOM_VOTE_DRV0_REG4_ADDR A:&base_addr+0x80040c
y.create.l HWIO_RPMH_VRM_HEADROOM_VOTE_DRV0_REG5_ADDR A:&base_addr+0x80050c
y.create.l HWIO_RPMH_VRM_HEADROOM_VOTE_DRV0_REG6_ADDR A:&base_addr+0x80060c
y.create.l HWIO_RPMH_VRM_HEADROOM_VOTE_DRV0_REG7_ADDR A:&base_addr+0x80070c
y.create.l HWIO_RPMH_VRM_HEADROOM_VOTE_DRV0_REG8_ADDR A:&base_addr+0x80080c
y.create.l HWIO_RPMH_VRM_HEADROOM_VOTE_DRV0_REG9_ADDR A:&base_addr+0x80090c
y.create.l HWIO_RPMH_VRM_HEADROOM_VOTE_DRV0_REG10_ADDR A:&base_addr+0x800a0c
y.create.l HWIO_RPMH_VRM_HEADROOM_VOTE_DRV0_REG11_ADDR A:&base_addr+0x800b0c
y.create.l HWIO_RPMH_VRM_HEADROOM_VOTE_DRV0_REG12_ADDR A:&base_addr+0x800c0c
y.create.l HWIO_RPMH_VRM_HEADROOM_VOTE_DRV0_REG13_ADDR A:&base_addr+0x800d0c
y.create.l HWIO_RPMH_VRM_HEADROOM_VOTE_DRV0_REG14_ADDR A:&base_addr+0x800e0c
y.create.l HWIO_RPMH_VRM_HEADROOM_VOTE_DRV0_REG15_ADDR A:&base_addr+0x800f0c
y.create.l HWIO_RPMH_VRM_HEADROOM_VOTE_DRV0_REG16_ADDR A:&base_addr+0x80100c
y.create.l HWIO_RPMH_VRM_HEADROOM_VOTE_DRV0_REG17_ADDR A:&base_addr+0x80110c
y.create.l HWIO_RPMH_VRM_HEADROOM_VOTE_DRV0_REG18_ADDR A:&base_addr+0x80120c
y.create.l HWIO_RPMH_VRM_HEADROOM_VOTE_DRV0_REG19_ADDR A:&base_addr+0x80130c
y.create.l HWIO_RPMH_VRM_HEADROOM_VOTE_DRV0_REG20_ADDR A:&base_addr+0x80140c
y.create.l HWIO_RPMH_VRM_HEADROOM_VOTE_DRV0_REG21_ADDR A:&base_addr+0x80150c
y.create.l HWIO_RPMH_VRM_HEADROOM_VOTE_DRV0_REG22_ADDR A:&base_addr+0x80160c
y.create.l HWIO_RPMH_VRM_HEADROOM_VOTE_DRV0_REG23_ADDR A:&base_addr+0x80170c
y.create.l HWIO_RPMH_VRM_HEADROOM_VOTE_DRV1_REG0_ADDR A:&base_addr+0x81000c
y.create.l HWIO_RPMH_VRM_HEADROOM_VOTE_DRV1_REG1_ADDR A:&base_addr+0x81010c
y.create.l HWIO_RPMH_VRM_HEADROOM_VOTE_DRV1_REG2_ADDR A:&base_addr+0x81020c
y.create.l HWIO_RPMH_VRM_HEADROOM_VOTE_DRV1_REG3_ADDR A:&base_addr+0x81030c
y.create.l HWIO_RPMH_VRM_HEADROOM_VOTE_DRV1_REG4_ADDR A:&base_addr+0x81040c
y.create.l HWIO_RPMH_VRM_HEADROOM_VOTE_DRV1_REG5_ADDR A:&base_addr+0x81050c
y.create.l HWIO_RPMH_VRM_HEADROOM_VOTE_DRV1_REG6_ADDR A:&base_addr+0x81060c
y.create.l HWIO_RPMH_VRM_HEADROOM_VOTE_DRV1_REG7_ADDR A:&base_addr+0x81070c
y.create.l HWIO_RPMH_VRM_HEADROOM_VOTE_DRV1_REG8_ADDR A:&base_addr+0x81080c
y.create.l HWIO_RPMH_VRM_HEADROOM_VOTE_DRV1_REG9_ADDR A:&base_addr+0x81090c
y.create.l HWIO_RPMH_VRM_HEADROOM_VOTE_DRV1_REG10_ADDR A:&base_addr+0x810a0c
y.create.l HWIO_RPMH_VRM_HEADROOM_VOTE_DRV1_REG11_ADDR A:&base_addr+0x810b0c
y.create.l HWIO_RPMH_VRM_HEADROOM_VOTE_DRV1_REG12_ADDR A:&base_addr+0x810c0c
y.create.l HWIO_RPMH_VRM_HEADROOM_VOTE_DRV1_REG13_ADDR A:&base_addr+0x810d0c
y.create.l HWIO_RPMH_VRM_HEADROOM_VOTE_DRV1_REG14_ADDR A:&base_addr+0x810e0c
y.create.l HWIO_RPMH_VRM_HEADROOM_VOTE_DRV1_REG15_ADDR A:&base_addr+0x810f0c
y.create.l HWIO_RPMH_VRM_HEADROOM_VOTE_DRV1_REG16_ADDR A:&base_addr+0x81100c
y.create.l HWIO_RPMH_VRM_HEADROOM_VOTE_DRV1_REG17_ADDR A:&base_addr+0x81110c
y.create.l HWIO_RPMH_VRM_HEADROOM_VOTE_DRV1_REG18_ADDR A:&base_addr+0x81120c
y.create.l HWIO_RPMH_VRM_HEADROOM_VOTE_DRV1_REG19_ADDR A:&base_addr+0x81130c
y.create.l HWIO_RPMH_VRM_HEADROOM_VOTE_DRV1_REG20_ADDR A:&base_addr+0x81140c
y.create.l HWIO_RPMH_VRM_HEADROOM_VOTE_DRV1_REG21_ADDR A:&base_addr+0x81150c
y.create.l HWIO_RPMH_VRM_HEADROOM_VOTE_DRV1_REG22_ADDR A:&base_addr+0x81160c
y.create.l HWIO_RPMH_VRM_HEADROOM_VOTE_DRV1_REG23_ADDR A:&base_addr+0x81170c
y.create.l HWIO_RPMH_VRM_HEADROOM_VOTE_DRV2_REG0_ADDR A:&base_addr+0x82000c
y.create.l HWIO_RPMH_VRM_HEADROOM_VOTE_DRV2_REG1_ADDR A:&base_addr+0x82010c
y.create.l HWIO_RPMH_VRM_HEADROOM_VOTE_DRV2_REG2_ADDR A:&base_addr+0x82020c
y.create.l HWIO_RPMH_VRM_HEADROOM_VOTE_DRV2_REG3_ADDR A:&base_addr+0x82030c
y.create.l HWIO_RPMH_VRM_HEADROOM_VOTE_DRV2_REG4_ADDR A:&base_addr+0x82040c
y.create.l HWIO_RPMH_VRM_HEADROOM_VOTE_DRV2_REG5_ADDR A:&base_addr+0x82050c
y.create.l HWIO_RPMH_VRM_HEADROOM_VOTE_DRV2_REG6_ADDR A:&base_addr+0x82060c
y.create.l HWIO_RPMH_VRM_HEADROOM_VOTE_DRV2_REG7_ADDR A:&base_addr+0x82070c
y.create.l HWIO_RPMH_VRM_HEADROOM_VOTE_DRV2_REG8_ADDR A:&base_addr+0x82080c
y.create.l HWIO_RPMH_VRM_HEADROOM_VOTE_DRV2_REG9_ADDR A:&base_addr+0x82090c
y.create.l HWIO_RPMH_VRM_HEADROOM_VOTE_DRV2_REG10_ADDR A:&base_addr+0x820a0c
y.create.l HWIO_RPMH_VRM_HEADROOM_VOTE_DRV2_REG11_ADDR A:&base_addr+0x820b0c
y.create.l HWIO_RPMH_VRM_HEADROOM_VOTE_DRV2_REG12_ADDR A:&base_addr+0x820c0c
y.create.l HWIO_RPMH_VRM_HEADROOM_VOTE_DRV2_REG13_ADDR A:&base_addr+0x820d0c
y.create.l HWIO_RPMH_VRM_HEADROOM_VOTE_DRV2_REG14_ADDR A:&base_addr+0x820e0c
y.create.l HWIO_RPMH_VRM_HEADROOM_VOTE_DRV2_REG15_ADDR A:&base_addr+0x820f0c
y.create.l HWIO_RPMH_VRM_HEADROOM_VOTE_DRV2_REG16_ADDR A:&base_addr+0x82100c
y.create.l HWIO_RPMH_VRM_HEADROOM_VOTE_DRV2_REG17_ADDR A:&base_addr+0x82110c
y.create.l HWIO_RPMH_VRM_HEADROOM_VOTE_DRV2_REG18_ADDR A:&base_addr+0x82120c
y.create.l HWIO_RPMH_VRM_HEADROOM_VOTE_DRV2_REG19_ADDR A:&base_addr+0x82130c
y.create.l HWIO_RPMH_VRM_HEADROOM_VOTE_DRV2_REG20_ADDR A:&base_addr+0x82140c
y.create.l HWIO_RPMH_VRM_HEADROOM_VOTE_DRV2_REG21_ADDR A:&base_addr+0x82150c
y.create.l HWIO_RPMH_VRM_HEADROOM_VOTE_DRV2_REG22_ADDR A:&base_addr+0x82160c
y.create.l HWIO_RPMH_VRM_HEADROOM_VOTE_DRV2_REG23_ADDR A:&base_addr+0x82170c
y.create.l HWIO_RPMH_VRM_HEADROOM_VOTE_DRV3_REG0_ADDR A:&base_addr+0x83000c
y.create.l HWIO_RPMH_VRM_HEADROOM_VOTE_DRV3_REG1_ADDR A:&base_addr+0x83010c
y.create.l HWIO_RPMH_VRM_HEADROOM_VOTE_DRV3_REG2_ADDR A:&base_addr+0x83020c
y.create.l HWIO_RPMH_VRM_HEADROOM_VOTE_DRV3_REG3_ADDR A:&base_addr+0x83030c
y.create.l HWIO_RPMH_VRM_HEADROOM_VOTE_DRV3_REG4_ADDR A:&base_addr+0x83040c
y.create.l HWIO_RPMH_VRM_HEADROOM_VOTE_DRV3_REG5_ADDR A:&base_addr+0x83050c
y.create.l HWIO_RPMH_VRM_HEADROOM_VOTE_DRV3_REG6_ADDR A:&base_addr+0x83060c
y.create.l HWIO_RPMH_VRM_HEADROOM_VOTE_DRV3_REG7_ADDR A:&base_addr+0x83070c
y.create.l HWIO_RPMH_VRM_HEADROOM_VOTE_DRV3_REG8_ADDR A:&base_addr+0x83080c
y.create.l HWIO_RPMH_VRM_HEADROOM_VOTE_DRV3_REG9_ADDR A:&base_addr+0x83090c
y.create.l HWIO_RPMH_VRM_HEADROOM_VOTE_DRV3_REG10_ADDR A:&base_addr+0x830a0c
y.create.l HWIO_RPMH_VRM_HEADROOM_VOTE_DRV3_REG11_ADDR A:&base_addr+0x830b0c
y.create.l HWIO_RPMH_VRM_HEADROOM_VOTE_DRV3_REG12_ADDR A:&base_addr+0x830c0c
y.create.l HWIO_RPMH_VRM_HEADROOM_VOTE_DRV3_REG13_ADDR A:&base_addr+0x830d0c
y.create.l HWIO_RPMH_VRM_HEADROOM_VOTE_DRV3_REG14_ADDR A:&base_addr+0x830e0c
y.create.l HWIO_RPMH_VRM_HEADROOM_VOTE_DRV3_REG15_ADDR A:&base_addr+0x830f0c
y.create.l HWIO_RPMH_VRM_HEADROOM_VOTE_DRV3_REG16_ADDR A:&base_addr+0x83100c
y.create.l HWIO_RPMH_VRM_HEADROOM_VOTE_DRV3_REG17_ADDR A:&base_addr+0x83110c
y.create.l HWIO_RPMH_VRM_HEADROOM_VOTE_DRV3_REG18_ADDR A:&base_addr+0x83120c
y.create.l HWIO_RPMH_VRM_HEADROOM_VOTE_DRV3_REG19_ADDR A:&base_addr+0x83130c
y.create.l HWIO_RPMH_VRM_HEADROOM_VOTE_DRV3_REG20_ADDR A:&base_addr+0x83140c
y.create.l HWIO_RPMH_VRM_HEADROOM_VOTE_DRV3_REG21_ADDR A:&base_addr+0x83150c
y.create.l HWIO_RPMH_VRM_HEADROOM_VOTE_DRV3_REG22_ADDR A:&base_addr+0x83160c
y.create.l HWIO_RPMH_VRM_HEADROOM_VOTE_DRV3_REG23_ADDR A:&base_addr+0x83170c
y.create.l HWIO_RPMH_VRM_HEADROOM_VOTE_DRV4_REG0_ADDR A:&base_addr+0x84000c
y.create.l HWIO_RPMH_VRM_HEADROOM_VOTE_DRV4_REG1_ADDR A:&base_addr+0x84010c
y.create.l HWIO_RPMH_VRM_HEADROOM_VOTE_DRV4_REG2_ADDR A:&base_addr+0x84020c
y.create.l HWIO_RPMH_VRM_HEADROOM_VOTE_DRV4_REG3_ADDR A:&base_addr+0x84030c
y.create.l HWIO_RPMH_VRM_HEADROOM_VOTE_DRV4_REG4_ADDR A:&base_addr+0x84040c
y.create.l HWIO_RPMH_VRM_HEADROOM_VOTE_DRV4_REG5_ADDR A:&base_addr+0x84050c
y.create.l HWIO_RPMH_VRM_HEADROOM_VOTE_DRV4_REG6_ADDR A:&base_addr+0x84060c
y.create.l HWIO_RPMH_VRM_HEADROOM_VOTE_DRV4_REG7_ADDR A:&base_addr+0x84070c
y.create.l HWIO_RPMH_VRM_HEADROOM_VOTE_DRV4_REG8_ADDR A:&base_addr+0x84080c
y.create.l HWIO_RPMH_VRM_HEADROOM_VOTE_DRV4_REG9_ADDR A:&base_addr+0x84090c
y.create.l HWIO_RPMH_VRM_HEADROOM_VOTE_DRV4_REG10_ADDR A:&base_addr+0x840a0c
y.create.l HWIO_RPMH_VRM_HEADROOM_VOTE_DRV4_REG11_ADDR A:&base_addr+0x840b0c
y.create.l HWIO_RPMH_VRM_HEADROOM_VOTE_DRV4_REG12_ADDR A:&base_addr+0x840c0c
y.create.l HWIO_RPMH_VRM_HEADROOM_VOTE_DRV4_REG13_ADDR A:&base_addr+0x840d0c
y.create.l HWIO_RPMH_VRM_HEADROOM_VOTE_DRV4_REG14_ADDR A:&base_addr+0x840e0c
y.create.l HWIO_RPMH_VRM_HEADROOM_VOTE_DRV4_REG15_ADDR A:&base_addr+0x840f0c
y.create.l HWIO_RPMH_VRM_HEADROOM_VOTE_DRV4_REG16_ADDR A:&base_addr+0x84100c
y.create.l HWIO_RPMH_VRM_HEADROOM_VOTE_DRV4_REG17_ADDR A:&base_addr+0x84110c
y.create.l HWIO_RPMH_VRM_HEADROOM_VOTE_DRV4_REG18_ADDR A:&base_addr+0x84120c
y.create.l HWIO_RPMH_VRM_HEADROOM_VOTE_DRV4_REG19_ADDR A:&base_addr+0x84130c
y.create.l HWIO_RPMH_VRM_HEADROOM_VOTE_DRV4_REG20_ADDR A:&base_addr+0x84140c
y.create.l HWIO_RPMH_VRM_HEADROOM_VOTE_DRV4_REG21_ADDR A:&base_addr+0x84150c
y.create.l HWIO_RPMH_VRM_HEADROOM_VOTE_DRV4_REG22_ADDR A:&base_addr+0x84160c
y.create.l HWIO_RPMH_VRM_HEADROOM_VOTE_DRV4_REG23_ADDR A:&base_addr+0x84170c
y.create.l HWIO_RPMH_VRM_HEADROOM_VOTE_DRV5_REG0_ADDR A:&base_addr+0x85000c
y.create.l HWIO_RPMH_VRM_HEADROOM_VOTE_DRV5_REG1_ADDR A:&base_addr+0x85010c
y.create.l HWIO_RPMH_VRM_HEADROOM_VOTE_DRV5_REG2_ADDR A:&base_addr+0x85020c
y.create.l HWIO_RPMH_VRM_HEADROOM_VOTE_DRV5_REG3_ADDR A:&base_addr+0x85030c
y.create.l HWIO_RPMH_VRM_HEADROOM_VOTE_DRV5_REG4_ADDR A:&base_addr+0x85040c
y.create.l HWIO_RPMH_VRM_HEADROOM_VOTE_DRV5_REG5_ADDR A:&base_addr+0x85050c
y.create.l HWIO_RPMH_VRM_HEADROOM_VOTE_DRV5_REG6_ADDR A:&base_addr+0x85060c
y.create.l HWIO_RPMH_VRM_HEADROOM_VOTE_DRV5_REG7_ADDR A:&base_addr+0x85070c
y.create.l HWIO_RPMH_VRM_HEADROOM_VOTE_DRV5_REG8_ADDR A:&base_addr+0x85080c
y.create.l HWIO_RPMH_VRM_HEADROOM_VOTE_DRV5_REG9_ADDR A:&base_addr+0x85090c
y.create.l HWIO_RPMH_VRM_HEADROOM_VOTE_DRV5_REG10_ADDR A:&base_addr+0x850a0c
y.create.l HWIO_RPMH_VRM_HEADROOM_VOTE_DRV5_REG11_ADDR A:&base_addr+0x850b0c
y.create.l HWIO_RPMH_VRM_HEADROOM_VOTE_DRV5_REG12_ADDR A:&base_addr+0x850c0c
y.create.l HWIO_RPMH_VRM_HEADROOM_VOTE_DRV5_REG13_ADDR A:&base_addr+0x850d0c
y.create.l HWIO_RPMH_VRM_HEADROOM_VOTE_DRV5_REG14_ADDR A:&base_addr+0x850e0c
y.create.l HWIO_RPMH_VRM_HEADROOM_VOTE_DRV5_REG15_ADDR A:&base_addr+0x850f0c
y.create.l HWIO_RPMH_VRM_HEADROOM_VOTE_DRV5_REG16_ADDR A:&base_addr+0x85100c
y.create.l HWIO_RPMH_VRM_HEADROOM_VOTE_DRV5_REG17_ADDR A:&base_addr+0x85110c
y.create.l HWIO_RPMH_VRM_HEADROOM_VOTE_DRV5_REG18_ADDR A:&base_addr+0x85120c
y.create.l HWIO_RPMH_VRM_HEADROOM_VOTE_DRV5_REG19_ADDR A:&base_addr+0x85130c
y.create.l HWIO_RPMH_VRM_HEADROOM_VOTE_DRV5_REG20_ADDR A:&base_addr+0x85140c
y.create.l HWIO_RPMH_VRM_HEADROOM_VOTE_DRV5_REG21_ADDR A:&base_addr+0x85150c
y.create.l HWIO_RPMH_VRM_HEADROOM_VOTE_DRV5_REG22_ADDR A:&base_addr+0x85160c
y.create.l HWIO_RPMH_VRM_HEADROOM_VOTE_DRV5_REG23_ADDR A:&base_addr+0x85170c
y.create.l HWIO_RPMH_VRM_HEADROOM_VOTE_DRV6_REG0_ADDR A:&base_addr+0x86000c
y.create.l HWIO_RPMH_VRM_HEADROOM_VOTE_DRV6_REG1_ADDR A:&base_addr+0x86010c
y.create.l HWIO_RPMH_VRM_HEADROOM_VOTE_DRV6_REG2_ADDR A:&base_addr+0x86020c
y.create.l HWIO_RPMH_VRM_HEADROOM_VOTE_DRV6_REG3_ADDR A:&base_addr+0x86030c
y.create.l HWIO_RPMH_VRM_HEADROOM_VOTE_DRV6_REG4_ADDR A:&base_addr+0x86040c
y.create.l HWIO_RPMH_VRM_HEADROOM_VOTE_DRV6_REG5_ADDR A:&base_addr+0x86050c
y.create.l HWIO_RPMH_VRM_HEADROOM_VOTE_DRV6_REG6_ADDR A:&base_addr+0x86060c
y.create.l HWIO_RPMH_VRM_HEADROOM_VOTE_DRV6_REG7_ADDR A:&base_addr+0x86070c
y.create.l HWIO_RPMH_VRM_HEADROOM_VOTE_DRV6_REG8_ADDR A:&base_addr+0x86080c
y.create.l HWIO_RPMH_VRM_HEADROOM_VOTE_DRV6_REG9_ADDR A:&base_addr+0x86090c
y.create.l HWIO_RPMH_VRM_HEADROOM_VOTE_DRV6_REG10_ADDR A:&base_addr+0x860a0c
y.create.l HWIO_RPMH_VRM_HEADROOM_VOTE_DRV6_REG11_ADDR A:&base_addr+0x860b0c
y.create.l HWIO_RPMH_VRM_HEADROOM_VOTE_DRV6_REG12_ADDR A:&base_addr+0x860c0c
y.create.l HWIO_RPMH_VRM_HEADROOM_VOTE_DRV6_REG13_ADDR A:&base_addr+0x860d0c
y.create.l HWIO_RPMH_VRM_HEADROOM_VOTE_DRV6_REG14_ADDR A:&base_addr+0x860e0c
y.create.l HWIO_RPMH_VRM_HEADROOM_VOTE_DRV6_REG15_ADDR A:&base_addr+0x860f0c
y.create.l HWIO_RPMH_VRM_HEADROOM_VOTE_DRV6_REG16_ADDR A:&base_addr+0x86100c
y.create.l HWIO_RPMH_VRM_HEADROOM_VOTE_DRV6_REG17_ADDR A:&base_addr+0x86110c
y.create.l HWIO_RPMH_VRM_HEADROOM_VOTE_DRV6_REG18_ADDR A:&base_addr+0x86120c
y.create.l HWIO_RPMH_VRM_HEADROOM_VOTE_DRV6_REG19_ADDR A:&base_addr+0x86130c
y.create.l HWIO_RPMH_VRM_HEADROOM_VOTE_DRV6_REG20_ADDR A:&base_addr+0x86140c
y.create.l HWIO_RPMH_VRM_HEADROOM_VOTE_DRV6_REG21_ADDR A:&base_addr+0x86150c
y.create.l HWIO_RPMH_VRM_HEADROOM_VOTE_DRV6_REG22_ADDR A:&base_addr+0x86160c
y.create.l HWIO_RPMH_VRM_HEADROOM_VOTE_DRV6_REG23_ADDR A:&base_addr+0x86170c
y.create.l HWIO_RPMH_VRM_ENABLE_VOTE_DRV0_XOB0_ADDR A:&base_addr+0x801804
y.create.l HWIO_RPMH_VRM_ENABLE_VOTE_DRV0_XOB1_ADDR A:&base_addr+0x801904
y.create.l HWIO_RPMH_VRM_ENABLE_VOTE_DRV0_XOB2_ADDR A:&base_addr+0x801a04
y.create.l HWIO_RPMH_VRM_ENABLE_VOTE_DRV0_XOB3_ADDR A:&base_addr+0x801b04
y.create.l HWIO_RPMH_VRM_ENABLE_VOTE_DRV0_XOB4_ADDR A:&base_addr+0x801c04
y.create.l HWIO_RPMH_VRM_ENABLE_VOTE_DRV0_XOB5_ADDR A:&base_addr+0x801d04
y.create.l HWIO_RPMH_VRM_ENABLE_VOTE_DRV0_XOB6_ADDR A:&base_addr+0x801e04
y.create.l HWIO_RPMH_VRM_ENABLE_VOTE_DRV0_XOB7_ADDR A:&base_addr+0x801f04
y.create.l HWIO_RPMH_VRM_ENABLE_VOTE_DRV1_XOB0_ADDR A:&base_addr+0x811804
y.create.l HWIO_RPMH_VRM_ENABLE_VOTE_DRV1_XOB1_ADDR A:&base_addr+0x811904
y.create.l HWIO_RPMH_VRM_ENABLE_VOTE_DRV1_XOB2_ADDR A:&base_addr+0x811a04
y.create.l HWIO_RPMH_VRM_ENABLE_VOTE_DRV1_XOB3_ADDR A:&base_addr+0x811b04
y.create.l HWIO_RPMH_VRM_ENABLE_VOTE_DRV1_XOB4_ADDR A:&base_addr+0x811c04
y.create.l HWIO_RPMH_VRM_ENABLE_VOTE_DRV1_XOB5_ADDR A:&base_addr+0x811d04
y.create.l HWIO_RPMH_VRM_ENABLE_VOTE_DRV1_XOB6_ADDR A:&base_addr+0x811e04
y.create.l HWIO_RPMH_VRM_ENABLE_VOTE_DRV1_XOB7_ADDR A:&base_addr+0x811f04
y.create.l HWIO_RPMH_VRM_ENABLE_VOTE_DRV2_XOB0_ADDR A:&base_addr+0x821804
y.create.l HWIO_RPMH_VRM_ENABLE_VOTE_DRV2_XOB1_ADDR A:&base_addr+0x821904
y.create.l HWIO_RPMH_VRM_ENABLE_VOTE_DRV2_XOB2_ADDR A:&base_addr+0x821a04
y.create.l HWIO_RPMH_VRM_ENABLE_VOTE_DRV2_XOB3_ADDR A:&base_addr+0x821b04
y.create.l HWIO_RPMH_VRM_ENABLE_VOTE_DRV2_XOB4_ADDR A:&base_addr+0x821c04
y.create.l HWIO_RPMH_VRM_ENABLE_VOTE_DRV2_XOB5_ADDR A:&base_addr+0x821d04
y.create.l HWIO_RPMH_VRM_ENABLE_VOTE_DRV2_XOB6_ADDR A:&base_addr+0x821e04
y.create.l HWIO_RPMH_VRM_ENABLE_VOTE_DRV2_XOB7_ADDR A:&base_addr+0x821f04
y.create.l HWIO_RPMH_VRM_ENABLE_VOTE_DRV3_XOB0_ADDR A:&base_addr+0x831804
y.create.l HWIO_RPMH_VRM_ENABLE_VOTE_DRV3_XOB1_ADDR A:&base_addr+0x831904
y.create.l HWIO_RPMH_VRM_ENABLE_VOTE_DRV3_XOB2_ADDR A:&base_addr+0x831a04
y.create.l HWIO_RPMH_VRM_ENABLE_VOTE_DRV3_XOB3_ADDR A:&base_addr+0x831b04
y.create.l HWIO_RPMH_VRM_ENABLE_VOTE_DRV3_XOB4_ADDR A:&base_addr+0x831c04
y.create.l HWIO_RPMH_VRM_ENABLE_VOTE_DRV3_XOB5_ADDR A:&base_addr+0x831d04
y.create.l HWIO_RPMH_VRM_ENABLE_VOTE_DRV3_XOB6_ADDR A:&base_addr+0x831e04
y.create.l HWIO_RPMH_VRM_ENABLE_VOTE_DRV3_XOB7_ADDR A:&base_addr+0x831f04
y.create.l HWIO_RPMH_VRM_ENABLE_VOTE_DRV4_XOB0_ADDR A:&base_addr+0x841804
y.create.l HWIO_RPMH_VRM_ENABLE_VOTE_DRV4_XOB1_ADDR A:&base_addr+0x841904
y.create.l HWIO_RPMH_VRM_ENABLE_VOTE_DRV4_XOB2_ADDR A:&base_addr+0x841a04
y.create.l HWIO_RPMH_VRM_ENABLE_VOTE_DRV4_XOB3_ADDR A:&base_addr+0x841b04
y.create.l HWIO_RPMH_VRM_ENABLE_VOTE_DRV4_XOB4_ADDR A:&base_addr+0x841c04
y.create.l HWIO_RPMH_VRM_ENABLE_VOTE_DRV4_XOB5_ADDR A:&base_addr+0x841d04
y.create.l HWIO_RPMH_VRM_ENABLE_VOTE_DRV4_XOB6_ADDR A:&base_addr+0x841e04
y.create.l HWIO_RPMH_VRM_ENABLE_VOTE_DRV4_XOB7_ADDR A:&base_addr+0x841f04
y.create.l HWIO_RPMH_VRM_ENABLE_VOTE_DRV5_XOB0_ADDR A:&base_addr+0x851804
y.create.l HWIO_RPMH_VRM_ENABLE_VOTE_DRV5_XOB1_ADDR A:&base_addr+0x851904
y.create.l HWIO_RPMH_VRM_ENABLE_VOTE_DRV5_XOB2_ADDR A:&base_addr+0x851a04
y.create.l HWIO_RPMH_VRM_ENABLE_VOTE_DRV5_XOB3_ADDR A:&base_addr+0x851b04
y.create.l HWIO_RPMH_VRM_ENABLE_VOTE_DRV5_XOB4_ADDR A:&base_addr+0x851c04
y.create.l HWIO_RPMH_VRM_ENABLE_VOTE_DRV5_XOB5_ADDR A:&base_addr+0x851d04
y.create.l HWIO_RPMH_VRM_ENABLE_VOTE_DRV5_XOB6_ADDR A:&base_addr+0x851e04
y.create.l HWIO_RPMH_VRM_ENABLE_VOTE_DRV5_XOB7_ADDR A:&base_addr+0x851f04
y.create.l HWIO_RPMH_VRM_ENABLE_VOTE_DRV6_XOB0_ADDR A:&base_addr+0x861804
y.create.l HWIO_RPMH_VRM_ENABLE_VOTE_DRV6_XOB1_ADDR A:&base_addr+0x861904
y.create.l HWIO_RPMH_VRM_ENABLE_VOTE_DRV6_XOB2_ADDR A:&base_addr+0x861a04
y.create.l HWIO_RPMH_VRM_ENABLE_VOTE_DRV6_XOB3_ADDR A:&base_addr+0x861b04
y.create.l HWIO_RPMH_VRM_ENABLE_VOTE_DRV6_XOB4_ADDR A:&base_addr+0x861c04
y.create.l HWIO_RPMH_VRM_ENABLE_VOTE_DRV6_XOB5_ADDR A:&base_addr+0x861d04
y.create.l HWIO_RPMH_VRM_ENABLE_VOTE_DRV6_XOB6_ADDR A:&base_addr+0x861e04
y.create.l HWIO_RPMH_VRM_ENABLE_VOTE_DRV6_XOB7_ADDR A:&base_addr+0x861f04
y.create.l HWIO_RPMH_VRM_ENABLE_VOTE_DRV0_XO0_ADDR A:&base_addr+0x802004
y.create.l HWIO_RPMH_VRM_ENABLE_VOTE_DRV1_XO0_ADDR A:&base_addr+0x812004
y.create.l HWIO_RPMH_VRM_ENABLE_VOTE_DRV2_XO0_ADDR A:&base_addr+0x822004
y.create.l HWIO_RPMH_VRM_ENABLE_VOTE_DRV3_XO0_ADDR A:&base_addr+0x832004
y.create.l HWIO_RPMH_VRM_ENABLE_VOTE_DRV4_XO0_ADDR A:&base_addr+0x842004
y.create.l HWIO_RPMH_VRM_ENABLE_VOTE_DRV5_XO0_ADDR A:&base_addr+0x852004
y.create.l HWIO_RPMH_VRM_ENABLE_VOTE_DRV6_XO0_ADDR A:&base_addr+0x862004
y.create.l HWIO_RPMH_VRM_VOLTAGE_CRS_DRV0_REG0_ADDR A:&base_addr+0x800020
y.create.l HWIO_RPMH_VRM_VOLTAGE_CRS_DRV0_REG1_ADDR A:&base_addr+0x800120
y.create.l HWIO_RPMH_VRM_VOLTAGE_CRS_DRV0_REG2_ADDR A:&base_addr+0x800220
y.create.l HWIO_RPMH_VRM_VOLTAGE_CRS_DRV0_REG3_ADDR A:&base_addr+0x800320
y.create.l HWIO_RPMH_VRM_VOLTAGE_CRS_DRV0_REG4_ADDR A:&base_addr+0x800420
y.create.l HWIO_RPMH_VRM_VOLTAGE_CRS_DRV0_REG5_ADDR A:&base_addr+0x800520
y.create.l HWIO_RPMH_VRM_VOLTAGE_CRS_DRV0_REG6_ADDR A:&base_addr+0x800620
y.create.l HWIO_RPMH_VRM_VOLTAGE_CRS_DRV0_REG7_ADDR A:&base_addr+0x800720
y.create.l HWIO_RPMH_VRM_VOLTAGE_CRS_DRV0_REG8_ADDR A:&base_addr+0x800820
y.create.l HWIO_RPMH_VRM_VOLTAGE_CRS_DRV0_REG9_ADDR A:&base_addr+0x800920
y.create.l HWIO_RPMH_VRM_VOLTAGE_CRS_DRV0_REG10_ADDR A:&base_addr+0x800a20
y.create.l HWIO_RPMH_VRM_VOLTAGE_CRS_DRV0_REG11_ADDR A:&base_addr+0x800b20
y.create.l HWIO_RPMH_VRM_VOLTAGE_CRS_DRV0_REG12_ADDR A:&base_addr+0x800c20
y.create.l HWIO_RPMH_VRM_VOLTAGE_CRS_DRV0_REG13_ADDR A:&base_addr+0x800d20
y.create.l HWIO_RPMH_VRM_VOLTAGE_CRS_DRV0_REG14_ADDR A:&base_addr+0x800e20
y.create.l HWIO_RPMH_VRM_VOLTAGE_CRS_DRV0_REG15_ADDR A:&base_addr+0x800f20
y.create.l HWIO_RPMH_VRM_VOLTAGE_CRS_DRV0_REG16_ADDR A:&base_addr+0x801020
y.create.l HWIO_RPMH_VRM_VOLTAGE_CRS_DRV0_REG17_ADDR A:&base_addr+0x801120
y.create.l HWIO_RPMH_VRM_VOLTAGE_CRS_DRV0_REG18_ADDR A:&base_addr+0x801220
y.create.l HWIO_RPMH_VRM_VOLTAGE_CRS_DRV0_REG19_ADDR A:&base_addr+0x801320
y.create.l HWIO_RPMH_VRM_VOLTAGE_CRS_DRV0_REG20_ADDR A:&base_addr+0x801420
y.create.l HWIO_RPMH_VRM_VOLTAGE_CRS_DRV0_REG21_ADDR A:&base_addr+0x801520
y.create.l HWIO_RPMH_VRM_VOLTAGE_CRS_DRV0_REG22_ADDR A:&base_addr+0x801620
y.create.l HWIO_RPMH_VRM_VOLTAGE_CRS_DRV0_REG23_ADDR A:&base_addr+0x801720
y.create.l HWIO_RPMH_VRM_VOLTAGE_CRS_DRV1_REG0_ADDR A:&base_addr+0x810020
y.create.l HWIO_RPMH_VRM_VOLTAGE_CRS_DRV1_REG1_ADDR A:&base_addr+0x810120
y.create.l HWIO_RPMH_VRM_VOLTAGE_CRS_DRV1_REG2_ADDR A:&base_addr+0x810220
y.create.l HWIO_RPMH_VRM_VOLTAGE_CRS_DRV1_REG3_ADDR A:&base_addr+0x810320
y.create.l HWIO_RPMH_VRM_VOLTAGE_CRS_DRV1_REG4_ADDR A:&base_addr+0x810420
y.create.l HWIO_RPMH_VRM_VOLTAGE_CRS_DRV1_REG5_ADDR A:&base_addr+0x810520
y.create.l HWIO_RPMH_VRM_VOLTAGE_CRS_DRV1_REG6_ADDR A:&base_addr+0x810620
y.create.l HWIO_RPMH_VRM_VOLTAGE_CRS_DRV1_REG7_ADDR A:&base_addr+0x810720
y.create.l HWIO_RPMH_VRM_VOLTAGE_CRS_DRV1_REG8_ADDR A:&base_addr+0x810820
y.create.l HWIO_RPMH_VRM_VOLTAGE_CRS_DRV1_REG9_ADDR A:&base_addr+0x810920
y.create.l HWIO_RPMH_VRM_VOLTAGE_CRS_DRV1_REG10_ADDR A:&base_addr+0x810a20
y.create.l HWIO_RPMH_VRM_VOLTAGE_CRS_DRV1_REG11_ADDR A:&base_addr+0x810b20
y.create.l HWIO_RPMH_VRM_VOLTAGE_CRS_DRV1_REG12_ADDR A:&base_addr+0x810c20
y.create.l HWIO_RPMH_VRM_VOLTAGE_CRS_DRV1_REG13_ADDR A:&base_addr+0x810d20
y.create.l HWIO_RPMH_VRM_VOLTAGE_CRS_DRV1_REG14_ADDR A:&base_addr+0x810e20
y.create.l HWIO_RPMH_VRM_VOLTAGE_CRS_DRV1_REG15_ADDR A:&base_addr+0x810f20
y.create.l HWIO_RPMH_VRM_VOLTAGE_CRS_DRV1_REG16_ADDR A:&base_addr+0x811020
y.create.l HWIO_RPMH_VRM_VOLTAGE_CRS_DRV1_REG17_ADDR A:&base_addr+0x811120
y.create.l HWIO_RPMH_VRM_VOLTAGE_CRS_DRV1_REG18_ADDR A:&base_addr+0x811220
y.create.l HWIO_RPMH_VRM_VOLTAGE_CRS_DRV1_REG19_ADDR A:&base_addr+0x811320
y.create.l HWIO_RPMH_VRM_VOLTAGE_CRS_DRV1_REG20_ADDR A:&base_addr+0x811420
y.create.l HWIO_RPMH_VRM_VOLTAGE_CRS_DRV1_REG21_ADDR A:&base_addr+0x811520
y.create.l HWIO_RPMH_VRM_VOLTAGE_CRS_DRV1_REG22_ADDR A:&base_addr+0x811620
y.create.l HWIO_RPMH_VRM_VOLTAGE_CRS_DRV1_REG23_ADDR A:&base_addr+0x811720
y.create.l HWIO_RPMH_VRM_VOLTAGE_CRS_DRV2_REG0_ADDR A:&base_addr+0x820020
y.create.l HWIO_RPMH_VRM_VOLTAGE_CRS_DRV2_REG1_ADDR A:&base_addr+0x820120
y.create.l HWIO_RPMH_VRM_VOLTAGE_CRS_DRV2_REG2_ADDR A:&base_addr+0x820220
y.create.l HWIO_RPMH_VRM_VOLTAGE_CRS_DRV2_REG3_ADDR A:&base_addr+0x820320
y.create.l HWIO_RPMH_VRM_VOLTAGE_CRS_DRV2_REG4_ADDR A:&base_addr+0x820420
y.create.l HWIO_RPMH_VRM_VOLTAGE_CRS_DRV2_REG5_ADDR A:&base_addr+0x820520
y.create.l HWIO_RPMH_VRM_VOLTAGE_CRS_DRV2_REG6_ADDR A:&base_addr+0x820620
y.create.l HWIO_RPMH_VRM_VOLTAGE_CRS_DRV2_REG7_ADDR A:&base_addr+0x820720
y.create.l HWIO_RPMH_VRM_VOLTAGE_CRS_DRV2_REG8_ADDR A:&base_addr+0x820820
y.create.l HWIO_RPMH_VRM_VOLTAGE_CRS_DRV2_REG9_ADDR A:&base_addr+0x820920
y.create.l HWIO_RPMH_VRM_VOLTAGE_CRS_DRV2_REG10_ADDR A:&base_addr+0x820a20
y.create.l HWIO_RPMH_VRM_VOLTAGE_CRS_DRV2_REG11_ADDR A:&base_addr+0x820b20
y.create.l HWIO_RPMH_VRM_VOLTAGE_CRS_DRV2_REG12_ADDR A:&base_addr+0x820c20
y.create.l HWIO_RPMH_VRM_VOLTAGE_CRS_DRV2_REG13_ADDR A:&base_addr+0x820d20
y.create.l HWIO_RPMH_VRM_VOLTAGE_CRS_DRV2_REG14_ADDR A:&base_addr+0x820e20
y.create.l HWIO_RPMH_VRM_VOLTAGE_CRS_DRV2_REG15_ADDR A:&base_addr+0x820f20
y.create.l HWIO_RPMH_VRM_VOLTAGE_CRS_DRV2_REG16_ADDR A:&base_addr+0x821020
y.create.l HWIO_RPMH_VRM_VOLTAGE_CRS_DRV2_REG17_ADDR A:&base_addr+0x821120
y.create.l HWIO_RPMH_VRM_VOLTAGE_CRS_DRV2_REG18_ADDR A:&base_addr+0x821220
y.create.l HWIO_RPMH_VRM_VOLTAGE_CRS_DRV2_REG19_ADDR A:&base_addr+0x821320
y.create.l HWIO_RPMH_VRM_VOLTAGE_CRS_DRV2_REG20_ADDR A:&base_addr+0x821420
y.create.l HWIO_RPMH_VRM_VOLTAGE_CRS_DRV2_REG21_ADDR A:&base_addr+0x821520
y.create.l HWIO_RPMH_VRM_VOLTAGE_CRS_DRV2_REG22_ADDR A:&base_addr+0x821620
y.create.l HWIO_RPMH_VRM_VOLTAGE_CRS_DRV2_REG23_ADDR A:&base_addr+0x821720
y.create.l HWIO_RPMH_VRM_VOLTAGE_CRS_DRV3_REG0_ADDR A:&base_addr+0x830020
y.create.l HWIO_RPMH_VRM_VOLTAGE_CRS_DRV3_REG1_ADDR A:&base_addr+0x830120
y.create.l HWIO_RPMH_VRM_VOLTAGE_CRS_DRV3_REG2_ADDR A:&base_addr+0x830220
y.create.l HWIO_RPMH_VRM_VOLTAGE_CRS_DRV3_REG3_ADDR A:&base_addr+0x830320
y.create.l HWIO_RPMH_VRM_VOLTAGE_CRS_DRV3_REG4_ADDR A:&base_addr+0x830420
y.create.l HWIO_RPMH_VRM_VOLTAGE_CRS_DRV3_REG5_ADDR A:&base_addr+0x830520
y.create.l HWIO_RPMH_VRM_VOLTAGE_CRS_DRV3_REG6_ADDR A:&base_addr+0x830620
y.create.l HWIO_RPMH_VRM_VOLTAGE_CRS_DRV3_REG7_ADDR A:&base_addr+0x830720
y.create.l HWIO_RPMH_VRM_VOLTAGE_CRS_DRV3_REG8_ADDR A:&base_addr+0x830820
y.create.l HWIO_RPMH_VRM_VOLTAGE_CRS_DRV3_REG9_ADDR A:&base_addr+0x830920
y.create.l HWIO_RPMH_VRM_VOLTAGE_CRS_DRV3_REG10_ADDR A:&base_addr+0x830a20
y.create.l HWIO_RPMH_VRM_VOLTAGE_CRS_DRV3_REG11_ADDR A:&base_addr+0x830b20
y.create.l HWIO_RPMH_VRM_VOLTAGE_CRS_DRV3_REG12_ADDR A:&base_addr+0x830c20
y.create.l HWIO_RPMH_VRM_VOLTAGE_CRS_DRV3_REG13_ADDR A:&base_addr+0x830d20
y.create.l HWIO_RPMH_VRM_VOLTAGE_CRS_DRV3_REG14_ADDR A:&base_addr+0x830e20
y.create.l HWIO_RPMH_VRM_VOLTAGE_CRS_DRV3_REG15_ADDR A:&base_addr+0x830f20
y.create.l HWIO_RPMH_VRM_VOLTAGE_CRS_DRV3_REG16_ADDR A:&base_addr+0x831020
y.create.l HWIO_RPMH_VRM_VOLTAGE_CRS_DRV3_REG17_ADDR A:&base_addr+0x831120
y.create.l HWIO_RPMH_VRM_VOLTAGE_CRS_DRV3_REG18_ADDR A:&base_addr+0x831220
y.create.l HWIO_RPMH_VRM_VOLTAGE_CRS_DRV3_REG19_ADDR A:&base_addr+0x831320
y.create.l HWIO_RPMH_VRM_VOLTAGE_CRS_DRV3_REG20_ADDR A:&base_addr+0x831420
y.create.l HWIO_RPMH_VRM_VOLTAGE_CRS_DRV3_REG21_ADDR A:&base_addr+0x831520
y.create.l HWIO_RPMH_VRM_VOLTAGE_CRS_DRV3_REG22_ADDR A:&base_addr+0x831620
y.create.l HWIO_RPMH_VRM_VOLTAGE_CRS_DRV3_REG23_ADDR A:&base_addr+0x831720
y.create.l HWIO_RPMH_VRM_VOLTAGE_CRS_DRV4_REG0_ADDR A:&base_addr+0x840020
y.create.l HWIO_RPMH_VRM_VOLTAGE_CRS_DRV4_REG1_ADDR A:&base_addr+0x840120
y.create.l HWIO_RPMH_VRM_VOLTAGE_CRS_DRV4_REG2_ADDR A:&base_addr+0x840220
y.create.l HWIO_RPMH_VRM_VOLTAGE_CRS_DRV4_REG3_ADDR A:&base_addr+0x840320
y.create.l HWIO_RPMH_VRM_VOLTAGE_CRS_DRV4_REG4_ADDR A:&base_addr+0x840420
y.create.l HWIO_RPMH_VRM_VOLTAGE_CRS_DRV4_REG5_ADDR A:&base_addr+0x840520
y.create.l HWIO_RPMH_VRM_VOLTAGE_CRS_DRV4_REG6_ADDR A:&base_addr+0x840620
y.create.l HWIO_RPMH_VRM_VOLTAGE_CRS_DRV4_REG7_ADDR A:&base_addr+0x840720
y.create.l HWIO_RPMH_VRM_VOLTAGE_CRS_DRV4_REG8_ADDR A:&base_addr+0x840820
y.create.l HWIO_RPMH_VRM_VOLTAGE_CRS_DRV4_REG9_ADDR A:&base_addr+0x840920
y.create.l HWIO_RPMH_VRM_VOLTAGE_CRS_DRV4_REG10_ADDR A:&base_addr+0x840a20
y.create.l HWIO_RPMH_VRM_VOLTAGE_CRS_DRV4_REG11_ADDR A:&base_addr+0x840b20
y.create.l HWIO_RPMH_VRM_VOLTAGE_CRS_DRV4_REG12_ADDR A:&base_addr+0x840c20
y.create.l HWIO_RPMH_VRM_VOLTAGE_CRS_DRV4_REG13_ADDR A:&base_addr+0x840d20
y.create.l HWIO_RPMH_VRM_VOLTAGE_CRS_DRV4_REG14_ADDR A:&base_addr+0x840e20
y.create.l HWIO_RPMH_VRM_VOLTAGE_CRS_DRV4_REG15_ADDR A:&base_addr+0x840f20
y.create.l HWIO_RPMH_VRM_VOLTAGE_CRS_DRV4_REG16_ADDR A:&base_addr+0x841020
y.create.l HWIO_RPMH_VRM_VOLTAGE_CRS_DRV4_REG17_ADDR A:&base_addr+0x841120
y.create.l HWIO_RPMH_VRM_VOLTAGE_CRS_DRV4_REG18_ADDR A:&base_addr+0x841220
y.create.l HWIO_RPMH_VRM_VOLTAGE_CRS_DRV4_REG19_ADDR A:&base_addr+0x841320
y.create.l HWIO_RPMH_VRM_VOLTAGE_CRS_DRV4_REG20_ADDR A:&base_addr+0x841420
y.create.l HWIO_RPMH_VRM_VOLTAGE_CRS_DRV4_REG21_ADDR A:&base_addr+0x841520
y.create.l HWIO_RPMH_VRM_VOLTAGE_CRS_DRV4_REG22_ADDR A:&base_addr+0x841620
y.create.l HWIO_RPMH_VRM_VOLTAGE_CRS_DRV4_REG23_ADDR A:&base_addr+0x841720
y.create.l HWIO_RPMH_VRM_VOLTAGE_CRS_DRV5_REG0_ADDR A:&base_addr+0x850020
y.create.l HWIO_RPMH_VRM_VOLTAGE_CRS_DRV5_REG1_ADDR A:&base_addr+0x850120
y.create.l HWIO_RPMH_VRM_VOLTAGE_CRS_DRV5_REG2_ADDR A:&base_addr+0x850220
y.create.l HWIO_RPMH_VRM_VOLTAGE_CRS_DRV5_REG3_ADDR A:&base_addr+0x850320
y.create.l HWIO_RPMH_VRM_VOLTAGE_CRS_DRV5_REG4_ADDR A:&base_addr+0x850420
y.create.l HWIO_RPMH_VRM_VOLTAGE_CRS_DRV5_REG5_ADDR A:&base_addr+0x850520
y.create.l HWIO_RPMH_VRM_VOLTAGE_CRS_DRV5_REG6_ADDR A:&base_addr+0x850620
y.create.l HWIO_RPMH_VRM_VOLTAGE_CRS_DRV5_REG7_ADDR A:&base_addr+0x850720
y.create.l HWIO_RPMH_VRM_VOLTAGE_CRS_DRV5_REG8_ADDR A:&base_addr+0x850820
y.create.l HWIO_RPMH_VRM_VOLTAGE_CRS_DRV5_REG9_ADDR A:&base_addr+0x850920
y.create.l HWIO_RPMH_VRM_VOLTAGE_CRS_DRV5_REG10_ADDR A:&base_addr+0x850a20
y.create.l HWIO_RPMH_VRM_VOLTAGE_CRS_DRV5_REG11_ADDR A:&base_addr+0x850b20
y.create.l HWIO_RPMH_VRM_VOLTAGE_CRS_DRV5_REG12_ADDR A:&base_addr+0x850c20
y.create.l HWIO_RPMH_VRM_VOLTAGE_CRS_DRV5_REG13_ADDR A:&base_addr+0x850d20
y.create.l HWIO_RPMH_VRM_VOLTAGE_CRS_DRV5_REG14_ADDR A:&base_addr+0x850e20
y.create.l HWIO_RPMH_VRM_VOLTAGE_CRS_DRV5_REG15_ADDR A:&base_addr+0x850f20
y.create.l HWIO_RPMH_VRM_VOLTAGE_CRS_DRV5_REG16_ADDR A:&base_addr+0x851020
y.create.l HWIO_RPMH_VRM_VOLTAGE_CRS_DRV5_REG17_ADDR A:&base_addr+0x851120
y.create.l HWIO_RPMH_VRM_VOLTAGE_CRS_DRV5_REG18_ADDR A:&base_addr+0x851220
y.create.l HWIO_RPMH_VRM_VOLTAGE_CRS_DRV5_REG19_ADDR A:&base_addr+0x851320
y.create.l HWIO_RPMH_VRM_VOLTAGE_CRS_DRV5_REG20_ADDR A:&base_addr+0x851420
y.create.l HWIO_RPMH_VRM_VOLTAGE_CRS_DRV5_REG21_ADDR A:&base_addr+0x851520
y.create.l HWIO_RPMH_VRM_VOLTAGE_CRS_DRV5_REG22_ADDR A:&base_addr+0x851620
y.create.l HWIO_RPMH_VRM_VOLTAGE_CRS_DRV5_REG23_ADDR A:&base_addr+0x851720
y.create.l HWIO_RPMH_VRM_VOLTAGE_CRS_DRV6_REG0_ADDR A:&base_addr+0x860020
y.create.l HWIO_RPMH_VRM_VOLTAGE_CRS_DRV6_REG1_ADDR A:&base_addr+0x860120
y.create.l HWIO_RPMH_VRM_VOLTAGE_CRS_DRV6_REG2_ADDR A:&base_addr+0x860220
y.create.l HWIO_RPMH_VRM_VOLTAGE_CRS_DRV6_REG3_ADDR A:&base_addr+0x860320
y.create.l HWIO_RPMH_VRM_VOLTAGE_CRS_DRV6_REG4_ADDR A:&base_addr+0x860420
y.create.l HWIO_RPMH_VRM_VOLTAGE_CRS_DRV6_REG5_ADDR A:&base_addr+0x860520
y.create.l HWIO_RPMH_VRM_VOLTAGE_CRS_DRV6_REG6_ADDR A:&base_addr+0x860620
y.create.l HWIO_RPMH_VRM_VOLTAGE_CRS_DRV6_REG7_ADDR A:&base_addr+0x860720
y.create.l HWIO_RPMH_VRM_VOLTAGE_CRS_DRV6_REG8_ADDR A:&base_addr+0x860820
y.create.l HWIO_RPMH_VRM_VOLTAGE_CRS_DRV6_REG9_ADDR A:&base_addr+0x860920
y.create.l HWIO_RPMH_VRM_VOLTAGE_CRS_DRV6_REG10_ADDR A:&base_addr+0x860a20
y.create.l HWIO_RPMH_VRM_VOLTAGE_CRS_DRV6_REG11_ADDR A:&base_addr+0x860b20
y.create.l HWIO_RPMH_VRM_VOLTAGE_CRS_DRV6_REG12_ADDR A:&base_addr+0x860c20
y.create.l HWIO_RPMH_VRM_VOLTAGE_CRS_DRV6_REG13_ADDR A:&base_addr+0x860d20
y.create.l HWIO_RPMH_VRM_VOLTAGE_CRS_DRV6_REG14_ADDR A:&base_addr+0x860e20
y.create.l HWIO_RPMH_VRM_VOLTAGE_CRS_DRV6_REG15_ADDR A:&base_addr+0x860f20
y.create.l HWIO_RPMH_VRM_VOLTAGE_CRS_DRV6_REG16_ADDR A:&base_addr+0x861020
y.create.l HWIO_RPMH_VRM_VOLTAGE_CRS_DRV6_REG17_ADDR A:&base_addr+0x861120
y.create.l HWIO_RPMH_VRM_VOLTAGE_CRS_DRV6_REG18_ADDR A:&base_addr+0x861220
y.create.l HWIO_RPMH_VRM_VOLTAGE_CRS_DRV6_REG19_ADDR A:&base_addr+0x861320
y.create.l HWIO_RPMH_VRM_VOLTAGE_CRS_DRV6_REG20_ADDR A:&base_addr+0x861420
y.create.l HWIO_RPMH_VRM_VOLTAGE_CRS_DRV6_REG21_ADDR A:&base_addr+0x861520
y.create.l HWIO_RPMH_VRM_VOLTAGE_CRS_DRV6_REG22_ADDR A:&base_addr+0x861620
y.create.l HWIO_RPMH_VRM_VOLTAGE_CRS_DRV6_REG23_ADDR A:&base_addr+0x861720
y.create.l HWIO_RPMH_VRM_ENABLE_CRS_DRV0_REG0_ADDR A:&base_addr+0x800024
y.create.l HWIO_RPMH_VRM_ENABLE_CRS_DRV0_REG1_ADDR A:&base_addr+0x800124
y.create.l HWIO_RPMH_VRM_ENABLE_CRS_DRV0_REG2_ADDR A:&base_addr+0x800224
y.create.l HWIO_RPMH_VRM_ENABLE_CRS_DRV0_REG3_ADDR A:&base_addr+0x800324
y.create.l HWIO_RPMH_VRM_ENABLE_CRS_DRV0_REG4_ADDR A:&base_addr+0x800424
y.create.l HWIO_RPMH_VRM_ENABLE_CRS_DRV0_REG5_ADDR A:&base_addr+0x800524
y.create.l HWIO_RPMH_VRM_ENABLE_CRS_DRV0_REG6_ADDR A:&base_addr+0x800624
y.create.l HWIO_RPMH_VRM_ENABLE_CRS_DRV0_REG7_ADDR A:&base_addr+0x800724
y.create.l HWIO_RPMH_VRM_ENABLE_CRS_DRV0_REG8_ADDR A:&base_addr+0x800824
y.create.l HWIO_RPMH_VRM_ENABLE_CRS_DRV0_REG9_ADDR A:&base_addr+0x800924
y.create.l HWIO_RPMH_VRM_ENABLE_CRS_DRV0_REG10_ADDR A:&base_addr+0x800a24
y.create.l HWIO_RPMH_VRM_ENABLE_CRS_DRV0_REG11_ADDR A:&base_addr+0x800b24
y.create.l HWIO_RPMH_VRM_ENABLE_CRS_DRV0_REG12_ADDR A:&base_addr+0x800c24
y.create.l HWIO_RPMH_VRM_ENABLE_CRS_DRV0_REG13_ADDR A:&base_addr+0x800d24
y.create.l HWIO_RPMH_VRM_ENABLE_CRS_DRV0_REG14_ADDR A:&base_addr+0x800e24
y.create.l HWIO_RPMH_VRM_ENABLE_CRS_DRV0_REG15_ADDR A:&base_addr+0x800f24
y.create.l HWIO_RPMH_VRM_ENABLE_CRS_DRV0_REG16_ADDR A:&base_addr+0x801024
y.create.l HWIO_RPMH_VRM_ENABLE_CRS_DRV0_REG17_ADDR A:&base_addr+0x801124
y.create.l HWIO_RPMH_VRM_ENABLE_CRS_DRV0_REG18_ADDR A:&base_addr+0x801224
y.create.l HWIO_RPMH_VRM_ENABLE_CRS_DRV0_REG19_ADDR A:&base_addr+0x801324
y.create.l HWIO_RPMH_VRM_ENABLE_CRS_DRV0_REG20_ADDR A:&base_addr+0x801424
y.create.l HWIO_RPMH_VRM_ENABLE_CRS_DRV0_REG21_ADDR A:&base_addr+0x801524
y.create.l HWIO_RPMH_VRM_ENABLE_CRS_DRV0_REG22_ADDR A:&base_addr+0x801624
y.create.l HWIO_RPMH_VRM_ENABLE_CRS_DRV0_REG23_ADDR A:&base_addr+0x801724
y.create.l HWIO_RPMH_VRM_ENABLE_CRS_DRV1_REG0_ADDR A:&base_addr+0x810024
y.create.l HWIO_RPMH_VRM_ENABLE_CRS_DRV1_REG1_ADDR A:&base_addr+0x810124
y.create.l HWIO_RPMH_VRM_ENABLE_CRS_DRV1_REG2_ADDR A:&base_addr+0x810224
y.create.l HWIO_RPMH_VRM_ENABLE_CRS_DRV1_REG3_ADDR A:&base_addr+0x810324
y.create.l HWIO_RPMH_VRM_ENABLE_CRS_DRV1_REG4_ADDR A:&base_addr+0x810424
y.create.l HWIO_RPMH_VRM_ENABLE_CRS_DRV1_REG5_ADDR A:&base_addr+0x810524
y.create.l HWIO_RPMH_VRM_ENABLE_CRS_DRV1_REG6_ADDR A:&base_addr+0x810624
y.create.l HWIO_RPMH_VRM_ENABLE_CRS_DRV1_REG7_ADDR A:&base_addr+0x810724
y.create.l HWIO_RPMH_VRM_ENABLE_CRS_DRV1_REG8_ADDR A:&base_addr+0x810824
y.create.l HWIO_RPMH_VRM_ENABLE_CRS_DRV1_REG9_ADDR A:&base_addr+0x810924
y.create.l HWIO_RPMH_VRM_ENABLE_CRS_DRV1_REG10_ADDR A:&base_addr+0x810a24
y.create.l HWIO_RPMH_VRM_ENABLE_CRS_DRV1_REG11_ADDR A:&base_addr+0x810b24
y.create.l HWIO_RPMH_VRM_ENABLE_CRS_DRV1_REG12_ADDR A:&base_addr+0x810c24
y.create.l HWIO_RPMH_VRM_ENABLE_CRS_DRV1_REG13_ADDR A:&base_addr+0x810d24
y.create.l HWIO_RPMH_VRM_ENABLE_CRS_DRV1_REG14_ADDR A:&base_addr+0x810e24
y.create.l HWIO_RPMH_VRM_ENABLE_CRS_DRV1_REG15_ADDR A:&base_addr+0x810f24
y.create.l HWIO_RPMH_VRM_ENABLE_CRS_DRV1_REG16_ADDR A:&base_addr+0x811024
y.create.l HWIO_RPMH_VRM_ENABLE_CRS_DRV1_REG17_ADDR A:&base_addr+0x811124
y.create.l HWIO_RPMH_VRM_ENABLE_CRS_DRV1_REG18_ADDR A:&base_addr+0x811224
y.create.l HWIO_RPMH_VRM_ENABLE_CRS_DRV1_REG19_ADDR A:&base_addr+0x811324
y.create.l HWIO_RPMH_VRM_ENABLE_CRS_DRV1_REG20_ADDR A:&base_addr+0x811424
y.create.l HWIO_RPMH_VRM_ENABLE_CRS_DRV1_REG21_ADDR A:&base_addr+0x811524
y.create.l HWIO_RPMH_VRM_ENABLE_CRS_DRV1_REG22_ADDR A:&base_addr+0x811624
y.create.l HWIO_RPMH_VRM_ENABLE_CRS_DRV1_REG23_ADDR A:&base_addr+0x811724
y.create.l HWIO_RPMH_VRM_ENABLE_CRS_DRV2_REG0_ADDR A:&base_addr+0x820024
y.create.l HWIO_RPMH_VRM_ENABLE_CRS_DRV2_REG1_ADDR A:&base_addr+0x820124
y.create.l HWIO_RPMH_VRM_ENABLE_CRS_DRV2_REG2_ADDR A:&base_addr+0x820224
y.create.l HWIO_RPMH_VRM_ENABLE_CRS_DRV2_REG3_ADDR A:&base_addr+0x820324
y.create.l HWIO_RPMH_VRM_ENABLE_CRS_DRV2_REG4_ADDR A:&base_addr+0x820424
y.create.l HWIO_RPMH_VRM_ENABLE_CRS_DRV2_REG5_ADDR A:&base_addr+0x820524
y.create.l HWIO_RPMH_VRM_ENABLE_CRS_DRV2_REG6_ADDR A:&base_addr+0x820624
y.create.l HWIO_RPMH_VRM_ENABLE_CRS_DRV2_REG7_ADDR A:&base_addr+0x820724
y.create.l HWIO_RPMH_VRM_ENABLE_CRS_DRV2_REG8_ADDR A:&base_addr+0x820824
y.create.l HWIO_RPMH_VRM_ENABLE_CRS_DRV2_REG9_ADDR A:&base_addr+0x820924
y.create.l HWIO_RPMH_VRM_ENABLE_CRS_DRV2_REG10_ADDR A:&base_addr+0x820a24
y.create.l HWIO_RPMH_VRM_ENABLE_CRS_DRV2_REG11_ADDR A:&base_addr+0x820b24
y.create.l HWIO_RPMH_VRM_ENABLE_CRS_DRV2_REG12_ADDR A:&base_addr+0x820c24
y.create.l HWIO_RPMH_VRM_ENABLE_CRS_DRV2_REG13_ADDR A:&base_addr+0x820d24
y.create.l HWIO_RPMH_VRM_ENABLE_CRS_DRV2_REG14_ADDR A:&base_addr+0x820e24
y.create.l HWIO_RPMH_VRM_ENABLE_CRS_DRV2_REG15_ADDR A:&base_addr+0x820f24
y.create.l HWIO_RPMH_VRM_ENABLE_CRS_DRV2_REG16_ADDR A:&base_addr+0x821024
y.create.l HWIO_RPMH_VRM_ENABLE_CRS_DRV2_REG17_ADDR A:&base_addr+0x821124
y.create.l HWIO_RPMH_VRM_ENABLE_CRS_DRV2_REG18_ADDR A:&base_addr+0x821224
y.create.l HWIO_RPMH_VRM_ENABLE_CRS_DRV2_REG19_ADDR A:&base_addr+0x821324
y.create.l HWIO_RPMH_VRM_ENABLE_CRS_DRV2_REG20_ADDR A:&base_addr+0x821424
y.create.l HWIO_RPMH_VRM_ENABLE_CRS_DRV2_REG21_ADDR A:&base_addr+0x821524
y.create.l HWIO_RPMH_VRM_ENABLE_CRS_DRV2_REG22_ADDR A:&base_addr+0x821624
y.create.l HWIO_RPMH_VRM_ENABLE_CRS_DRV2_REG23_ADDR A:&base_addr+0x821724
y.create.l HWIO_RPMH_VRM_ENABLE_CRS_DRV3_REG0_ADDR A:&base_addr+0x830024
y.create.l HWIO_RPMH_VRM_ENABLE_CRS_DRV3_REG1_ADDR A:&base_addr+0x830124
y.create.l HWIO_RPMH_VRM_ENABLE_CRS_DRV3_REG2_ADDR A:&base_addr+0x830224
y.create.l HWIO_RPMH_VRM_ENABLE_CRS_DRV3_REG3_ADDR A:&base_addr+0x830324
y.create.l HWIO_RPMH_VRM_ENABLE_CRS_DRV3_REG4_ADDR A:&base_addr+0x830424
y.create.l HWIO_RPMH_VRM_ENABLE_CRS_DRV3_REG5_ADDR A:&base_addr+0x830524
y.create.l HWIO_RPMH_VRM_ENABLE_CRS_DRV3_REG6_ADDR A:&base_addr+0x830624
y.create.l HWIO_RPMH_VRM_ENABLE_CRS_DRV3_REG7_ADDR A:&base_addr+0x830724
y.create.l HWIO_RPMH_VRM_ENABLE_CRS_DRV3_REG8_ADDR A:&base_addr+0x830824
y.create.l HWIO_RPMH_VRM_ENABLE_CRS_DRV3_REG9_ADDR A:&base_addr+0x830924
y.create.l HWIO_RPMH_VRM_ENABLE_CRS_DRV3_REG10_ADDR A:&base_addr+0x830a24
y.create.l HWIO_RPMH_VRM_ENABLE_CRS_DRV3_REG11_ADDR A:&base_addr+0x830b24
y.create.l HWIO_RPMH_VRM_ENABLE_CRS_DRV3_REG12_ADDR A:&base_addr+0x830c24
y.create.l HWIO_RPMH_VRM_ENABLE_CRS_DRV3_REG13_ADDR A:&base_addr+0x830d24
y.create.l HWIO_RPMH_VRM_ENABLE_CRS_DRV3_REG14_ADDR A:&base_addr+0x830e24
y.create.l HWIO_RPMH_VRM_ENABLE_CRS_DRV3_REG15_ADDR A:&base_addr+0x830f24
y.create.l HWIO_RPMH_VRM_ENABLE_CRS_DRV3_REG16_ADDR A:&base_addr+0x831024
y.create.l HWIO_RPMH_VRM_ENABLE_CRS_DRV3_REG17_ADDR A:&base_addr+0x831124
y.create.l HWIO_RPMH_VRM_ENABLE_CRS_DRV3_REG18_ADDR A:&base_addr+0x831224
y.create.l HWIO_RPMH_VRM_ENABLE_CRS_DRV3_REG19_ADDR A:&base_addr+0x831324
y.create.l HWIO_RPMH_VRM_ENABLE_CRS_DRV3_REG20_ADDR A:&base_addr+0x831424
y.create.l HWIO_RPMH_VRM_ENABLE_CRS_DRV3_REG21_ADDR A:&base_addr+0x831524
y.create.l HWIO_RPMH_VRM_ENABLE_CRS_DRV3_REG22_ADDR A:&base_addr+0x831624
y.create.l HWIO_RPMH_VRM_ENABLE_CRS_DRV3_REG23_ADDR A:&base_addr+0x831724
y.create.l HWIO_RPMH_VRM_ENABLE_CRS_DRV4_REG0_ADDR A:&base_addr+0x840024
y.create.l HWIO_RPMH_VRM_ENABLE_CRS_DRV4_REG1_ADDR A:&base_addr+0x840124
y.create.l HWIO_RPMH_VRM_ENABLE_CRS_DRV4_REG2_ADDR A:&base_addr+0x840224
y.create.l HWIO_RPMH_VRM_ENABLE_CRS_DRV4_REG3_ADDR A:&base_addr+0x840324
y.create.l HWIO_RPMH_VRM_ENABLE_CRS_DRV4_REG4_ADDR A:&base_addr+0x840424
y.create.l HWIO_RPMH_VRM_ENABLE_CRS_DRV4_REG5_ADDR A:&base_addr+0x840524
y.create.l HWIO_RPMH_VRM_ENABLE_CRS_DRV4_REG6_ADDR A:&base_addr+0x840624
y.create.l HWIO_RPMH_VRM_ENABLE_CRS_DRV4_REG7_ADDR A:&base_addr+0x840724
y.create.l HWIO_RPMH_VRM_ENABLE_CRS_DRV4_REG8_ADDR A:&base_addr+0x840824
y.create.l HWIO_RPMH_VRM_ENABLE_CRS_DRV4_REG9_ADDR A:&base_addr+0x840924
y.create.l HWIO_RPMH_VRM_ENABLE_CRS_DRV4_REG10_ADDR A:&base_addr+0x840a24
y.create.l HWIO_RPMH_VRM_ENABLE_CRS_DRV4_REG11_ADDR A:&base_addr+0x840b24
y.create.l HWIO_RPMH_VRM_ENABLE_CRS_DRV4_REG12_ADDR A:&base_addr+0x840c24
y.create.l HWIO_RPMH_VRM_ENABLE_CRS_DRV4_REG13_ADDR A:&base_addr+0x840d24
y.create.l HWIO_RPMH_VRM_ENABLE_CRS_DRV4_REG14_ADDR A:&base_addr+0x840e24
y.create.l HWIO_RPMH_VRM_ENABLE_CRS_DRV4_REG15_ADDR A:&base_addr+0x840f24
y.create.l HWIO_RPMH_VRM_ENABLE_CRS_DRV4_REG16_ADDR A:&base_addr+0x841024
y.create.l HWIO_RPMH_VRM_ENABLE_CRS_DRV4_REG17_ADDR A:&base_addr+0x841124
y.create.l HWIO_RPMH_VRM_ENABLE_CRS_DRV4_REG18_ADDR A:&base_addr+0x841224
y.create.l HWIO_RPMH_VRM_ENABLE_CRS_DRV4_REG19_ADDR A:&base_addr+0x841324
y.create.l HWIO_RPMH_VRM_ENABLE_CRS_DRV4_REG20_ADDR A:&base_addr+0x841424
y.create.l HWIO_RPMH_VRM_ENABLE_CRS_DRV4_REG21_ADDR A:&base_addr+0x841524
y.create.l HWIO_RPMH_VRM_ENABLE_CRS_DRV4_REG22_ADDR A:&base_addr+0x841624
y.create.l HWIO_RPMH_VRM_ENABLE_CRS_DRV4_REG23_ADDR A:&base_addr+0x841724
y.create.l HWIO_RPMH_VRM_ENABLE_CRS_DRV5_REG0_ADDR A:&base_addr+0x850024
y.create.l HWIO_RPMH_VRM_ENABLE_CRS_DRV5_REG1_ADDR A:&base_addr+0x850124
y.create.l HWIO_RPMH_VRM_ENABLE_CRS_DRV5_REG2_ADDR A:&base_addr+0x850224
y.create.l HWIO_RPMH_VRM_ENABLE_CRS_DRV5_REG3_ADDR A:&base_addr+0x850324
y.create.l HWIO_RPMH_VRM_ENABLE_CRS_DRV5_REG4_ADDR A:&base_addr+0x850424
y.create.l HWIO_RPMH_VRM_ENABLE_CRS_DRV5_REG5_ADDR A:&base_addr+0x850524
y.create.l HWIO_RPMH_VRM_ENABLE_CRS_DRV5_REG6_ADDR A:&base_addr+0x850624
y.create.l HWIO_RPMH_VRM_ENABLE_CRS_DRV5_REG7_ADDR A:&base_addr+0x850724
y.create.l HWIO_RPMH_VRM_ENABLE_CRS_DRV5_REG8_ADDR A:&base_addr+0x850824
y.create.l HWIO_RPMH_VRM_ENABLE_CRS_DRV5_REG9_ADDR A:&base_addr+0x850924
y.create.l HWIO_RPMH_VRM_ENABLE_CRS_DRV5_REG10_ADDR A:&base_addr+0x850a24
y.create.l HWIO_RPMH_VRM_ENABLE_CRS_DRV5_REG11_ADDR A:&base_addr+0x850b24
y.create.l HWIO_RPMH_VRM_ENABLE_CRS_DRV5_REG12_ADDR A:&base_addr+0x850c24
y.create.l HWIO_RPMH_VRM_ENABLE_CRS_DRV5_REG13_ADDR A:&base_addr+0x850d24
y.create.l HWIO_RPMH_VRM_ENABLE_CRS_DRV5_REG14_ADDR A:&base_addr+0x850e24
y.create.l HWIO_RPMH_VRM_ENABLE_CRS_DRV5_REG15_ADDR A:&base_addr+0x850f24
y.create.l HWIO_RPMH_VRM_ENABLE_CRS_DRV5_REG16_ADDR A:&base_addr+0x851024
y.create.l HWIO_RPMH_VRM_ENABLE_CRS_DRV5_REG17_ADDR A:&base_addr+0x851124
y.create.l HWIO_RPMH_VRM_ENABLE_CRS_DRV5_REG18_ADDR A:&base_addr+0x851224
y.create.l HWIO_RPMH_VRM_ENABLE_CRS_DRV5_REG19_ADDR A:&base_addr+0x851324
y.create.l HWIO_RPMH_VRM_ENABLE_CRS_DRV5_REG20_ADDR A:&base_addr+0x851424
y.create.l HWIO_RPMH_VRM_ENABLE_CRS_DRV5_REG21_ADDR A:&base_addr+0x851524
y.create.l HWIO_RPMH_VRM_ENABLE_CRS_DRV5_REG22_ADDR A:&base_addr+0x851624
y.create.l HWIO_RPMH_VRM_ENABLE_CRS_DRV5_REG23_ADDR A:&base_addr+0x851724
y.create.l HWIO_RPMH_VRM_ENABLE_CRS_DRV6_REG0_ADDR A:&base_addr+0x860024
y.create.l HWIO_RPMH_VRM_ENABLE_CRS_DRV6_REG1_ADDR A:&base_addr+0x860124
y.create.l HWIO_RPMH_VRM_ENABLE_CRS_DRV6_REG2_ADDR A:&base_addr+0x860224
y.create.l HWIO_RPMH_VRM_ENABLE_CRS_DRV6_REG3_ADDR A:&base_addr+0x860324
y.create.l HWIO_RPMH_VRM_ENABLE_CRS_DRV6_REG4_ADDR A:&base_addr+0x860424
y.create.l HWIO_RPMH_VRM_ENABLE_CRS_DRV6_REG5_ADDR A:&base_addr+0x860524
y.create.l HWIO_RPMH_VRM_ENABLE_CRS_DRV6_REG6_ADDR A:&base_addr+0x860624
y.create.l HWIO_RPMH_VRM_ENABLE_CRS_DRV6_REG7_ADDR A:&base_addr+0x860724
y.create.l HWIO_RPMH_VRM_ENABLE_CRS_DRV6_REG8_ADDR A:&base_addr+0x860824
y.create.l HWIO_RPMH_VRM_ENABLE_CRS_DRV6_REG9_ADDR A:&base_addr+0x860924
y.create.l HWIO_RPMH_VRM_ENABLE_CRS_DRV6_REG10_ADDR A:&base_addr+0x860a24
y.create.l HWIO_RPMH_VRM_ENABLE_CRS_DRV6_REG11_ADDR A:&base_addr+0x860b24
y.create.l HWIO_RPMH_VRM_ENABLE_CRS_DRV6_REG12_ADDR A:&base_addr+0x860c24
y.create.l HWIO_RPMH_VRM_ENABLE_CRS_DRV6_REG13_ADDR A:&base_addr+0x860d24
y.create.l HWIO_RPMH_VRM_ENABLE_CRS_DRV6_REG14_ADDR A:&base_addr+0x860e24
y.create.l HWIO_RPMH_VRM_ENABLE_CRS_DRV6_REG15_ADDR A:&base_addr+0x860f24
y.create.l HWIO_RPMH_VRM_ENABLE_CRS_DRV6_REG16_ADDR A:&base_addr+0x861024
y.create.l HWIO_RPMH_VRM_ENABLE_CRS_DRV6_REG17_ADDR A:&base_addr+0x861124
y.create.l HWIO_RPMH_VRM_ENABLE_CRS_DRV6_REG18_ADDR A:&base_addr+0x861224
y.create.l HWIO_RPMH_VRM_ENABLE_CRS_DRV6_REG19_ADDR A:&base_addr+0x861324
y.create.l HWIO_RPMH_VRM_ENABLE_CRS_DRV6_REG20_ADDR A:&base_addr+0x861424
y.create.l HWIO_RPMH_VRM_ENABLE_CRS_DRV6_REG21_ADDR A:&base_addr+0x861524
y.create.l HWIO_RPMH_VRM_ENABLE_CRS_DRV6_REG22_ADDR A:&base_addr+0x861624
y.create.l HWIO_RPMH_VRM_ENABLE_CRS_DRV6_REG23_ADDR A:&base_addr+0x861724
y.create.l HWIO_RPMH_VRM_MODE_CRS_DRV0_REG0_ADDR A:&base_addr+0x800028
y.create.l HWIO_RPMH_VRM_MODE_CRS_DRV0_REG1_ADDR A:&base_addr+0x800128
y.create.l HWIO_RPMH_VRM_MODE_CRS_DRV0_REG2_ADDR A:&base_addr+0x800228
y.create.l HWIO_RPMH_VRM_MODE_CRS_DRV0_REG3_ADDR A:&base_addr+0x800328
y.create.l HWIO_RPMH_VRM_MODE_CRS_DRV0_REG4_ADDR A:&base_addr+0x800428
y.create.l HWIO_RPMH_VRM_MODE_CRS_DRV0_REG5_ADDR A:&base_addr+0x800528
y.create.l HWIO_RPMH_VRM_MODE_CRS_DRV0_REG6_ADDR A:&base_addr+0x800628
y.create.l HWIO_RPMH_VRM_MODE_CRS_DRV0_REG7_ADDR A:&base_addr+0x800728
y.create.l HWIO_RPMH_VRM_MODE_CRS_DRV0_REG8_ADDR A:&base_addr+0x800828
y.create.l HWIO_RPMH_VRM_MODE_CRS_DRV0_REG9_ADDR A:&base_addr+0x800928
y.create.l HWIO_RPMH_VRM_MODE_CRS_DRV0_REG10_ADDR A:&base_addr+0x800a28
y.create.l HWIO_RPMH_VRM_MODE_CRS_DRV0_REG11_ADDR A:&base_addr+0x800b28
y.create.l HWIO_RPMH_VRM_MODE_CRS_DRV0_REG12_ADDR A:&base_addr+0x800c28
y.create.l HWIO_RPMH_VRM_MODE_CRS_DRV0_REG13_ADDR A:&base_addr+0x800d28
y.create.l HWIO_RPMH_VRM_MODE_CRS_DRV0_REG14_ADDR A:&base_addr+0x800e28
y.create.l HWIO_RPMH_VRM_MODE_CRS_DRV0_REG15_ADDR A:&base_addr+0x800f28
y.create.l HWIO_RPMH_VRM_MODE_CRS_DRV0_REG16_ADDR A:&base_addr+0x801028
y.create.l HWIO_RPMH_VRM_MODE_CRS_DRV0_REG17_ADDR A:&base_addr+0x801128
y.create.l HWIO_RPMH_VRM_MODE_CRS_DRV0_REG18_ADDR A:&base_addr+0x801228
y.create.l HWIO_RPMH_VRM_MODE_CRS_DRV0_REG19_ADDR A:&base_addr+0x801328
y.create.l HWIO_RPMH_VRM_MODE_CRS_DRV0_REG20_ADDR A:&base_addr+0x801428
y.create.l HWIO_RPMH_VRM_MODE_CRS_DRV0_REG21_ADDR A:&base_addr+0x801528
y.create.l HWIO_RPMH_VRM_MODE_CRS_DRV0_REG22_ADDR A:&base_addr+0x801628
y.create.l HWIO_RPMH_VRM_MODE_CRS_DRV0_REG23_ADDR A:&base_addr+0x801728
y.create.l HWIO_RPMH_VRM_MODE_CRS_DRV1_REG0_ADDR A:&base_addr+0x810028
y.create.l HWIO_RPMH_VRM_MODE_CRS_DRV1_REG1_ADDR A:&base_addr+0x810128
y.create.l HWIO_RPMH_VRM_MODE_CRS_DRV1_REG2_ADDR A:&base_addr+0x810228
y.create.l HWIO_RPMH_VRM_MODE_CRS_DRV1_REG3_ADDR A:&base_addr+0x810328
y.create.l HWIO_RPMH_VRM_MODE_CRS_DRV1_REG4_ADDR A:&base_addr+0x810428
y.create.l HWIO_RPMH_VRM_MODE_CRS_DRV1_REG5_ADDR A:&base_addr+0x810528
y.create.l HWIO_RPMH_VRM_MODE_CRS_DRV1_REG6_ADDR A:&base_addr+0x810628
y.create.l HWIO_RPMH_VRM_MODE_CRS_DRV1_REG7_ADDR A:&base_addr+0x810728
y.create.l HWIO_RPMH_VRM_MODE_CRS_DRV1_REG8_ADDR A:&base_addr+0x810828
y.create.l HWIO_RPMH_VRM_MODE_CRS_DRV1_REG9_ADDR A:&base_addr+0x810928
y.create.l HWIO_RPMH_VRM_MODE_CRS_DRV1_REG10_ADDR A:&base_addr+0x810a28
y.create.l HWIO_RPMH_VRM_MODE_CRS_DRV1_REG11_ADDR A:&base_addr+0x810b28
y.create.l HWIO_RPMH_VRM_MODE_CRS_DRV1_REG12_ADDR A:&base_addr+0x810c28
y.create.l HWIO_RPMH_VRM_MODE_CRS_DRV1_REG13_ADDR A:&base_addr+0x810d28
y.create.l HWIO_RPMH_VRM_MODE_CRS_DRV1_REG14_ADDR A:&base_addr+0x810e28
y.create.l HWIO_RPMH_VRM_MODE_CRS_DRV1_REG15_ADDR A:&base_addr+0x810f28
y.create.l HWIO_RPMH_VRM_MODE_CRS_DRV1_REG16_ADDR A:&base_addr+0x811028
y.create.l HWIO_RPMH_VRM_MODE_CRS_DRV1_REG17_ADDR A:&base_addr+0x811128
y.create.l HWIO_RPMH_VRM_MODE_CRS_DRV1_REG18_ADDR A:&base_addr+0x811228
y.create.l HWIO_RPMH_VRM_MODE_CRS_DRV1_REG19_ADDR A:&base_addr+0x811328
y.create.l HWIO_RPMH_VRM_MODE_CRS_DRV1_REG20_ADDR A:&base_addr+0x811428
y.create.l HWIO_RPMH_VRM_MODE_CRS_DRV1_REG21_ADDR A:&base_addr+0x811528
y.create.l HWIO_RPMH_VRM_MODE_CRS_DRV1_REG22_ADDR A:&base_addr+0x811628
y.create.l HWIO_RPMH_VRM_MODE_CRS_DRV1_REG23_ADDR A:&base_addr+0x811728
y.create.l HWIO_RPMH_VRM_MODE_CRS_DRV2_REG0_ADDR A:&base_addr+0x820028
y.create.l HWIO_RPMH_VRM_MODE_CRS_DRV2_REG1_ADDR A:&base_addr+0x820128
y.create.l HWIO_RPMH_VRM_MODE_CRS_DRV2_REG2_ADDR A:&base_addr+0x820228
y.create.l HWIO_RPMH_VRM_MODE_CRS_DRV2_REG3_ADDR A:&base_addr+0x820328
y.create.l HWIO_RPMH_VRM_MODE_CRS_DRV2_REG4_ADDR A:&base_addr+0x820428
y.create.l HWIO_RPMH_VRM_MODE_CRS_DRV2_REG5_ADDR A:&base_addr+0x820528
y.create.l HWIO_RPMH_VRM_MODE_CRS_DRV2_REG6_ADDR A:&base_addr+0x820628
y.create.l HWIO_RPMH_VRM_MODE_CRS_DRV2_REG7_ADDR A:&base_addr+0x820728
y.create.l HWIO_RPMH_VRM_MODE_CRS_DRV2_REG8_ADDR A:&base_addr+0x820828
y.create.l HWIO_RPMH_VRM_MODE_CRS_DRV2_REG9_ADDR A:&base_addr+0x820928
y.create.l HWIO_RPMH_VRM_MODE_CRS_DRV2_REG10_ADDR A:&base_addr+0x820a28
y.create.l HWIO_RPMH_VRM_MODE_CRS_DRV2_REG11_ADDR A:&base_addr+0x820b28
y.create.l HWIO_RPMH_VRM_MODE_CRS_DRV2_REG12_ADDR A:&base_addr+0x820c28
y.create.l HWIO_RPMH_VRM_MODE_CRS_DRV2_REG13_ADDR A:&base_addr+0x820d28
y.create.l HWIO_RPMH_VRM_MODE_CRS_DRV2_REG14_ADDR A:&base_addr+0x820e28
y.create.l HWIO_RPMH_VRM_MODE_CRS_DRV2_REG15_ADDR A:&base_addr+0x820f28
y.create.l HWIO_RPMH_VRM_MODE_CRS_DRV2_REG16_ADDR A:&base_addr+0x821028
y.create.l HWIO_RPMH_VRM_MODE_CRS_DRV2_REG17_ADDR A:&base_addr+0x821128
y.create.l HWIO_RPMH_VRM_MODE_CRS_DRV2_REG18_ADDR A:&base_addr+0x821228
y.create.l HWIO_RPMH_VRM_MODE_CRS_DRV2_REG19_ADDR A:&base_addr+0x821328
y.create.l HWIO_RPMH_VRM_MODE_CRS_DRV2_REG20_ADDR A:&base_addr+0x821428
y.create.l HWIO_RPMH_VRM_MODE_CRS_DRV2_REG21_ADDR A:&base_addr+0x821528
y.create.l HWIO_RPMH_VRM_MODE_CRS_DRV2_REG22_ADDR A:&base_addr+0x821628
y.create.l HWIO_RPMH_VRM_MODE_CRS_DRV2_REG23_ADDR A:&base_addr+0x821728
y.create.l HWIO_RPMH_VRM_MODE_CRS_DRV3_REG0_ADDR A:&base_addr+0x830028
y.create.l HWIO_RPMH_VRM_MODE_CRS_DRV3_REG1_ADDR A:&base_addr+0x830128
y.create.l HWIO_RPMH_VRM_MODE_CRS_DRV3_REG2_ADDR A:&base_addr+0x830228
y.create.l HWIO_RPMH_VRM_MODE_CRS_DRV3_REG3_ADDR A:&base_addr+0x830328
y.create.l HWIO_RPMH_VRM_MODE_CRS_DRV3_REG4_ADDR A:&base_addr+0x830428
y.create.l HWIO_RPMH_VRM_MODE_CRS_DRV3_REG5_ADDR A:&base_addr+0x830528
y.create.l HWIO_RPMH_VRM_MODE_CRS_DRV3_REG6_ADDR A:&base_addr+0x830628
y.create.l HWIO_RPMH_VRM_MODE_CRS_DRV3_REG7_ADDR A:&base_addr+0x830728
y.create.l HWIO_RPMH_VRM_MODE_CRS_DRV3_REG8_ADDR A:&base_addr+0x830828
y.create.l HWIO_RPMH_VRM_MODE_CRS_DRV3_REG9_ADDR A:&base_addr+0x830928
y.create.l HWIO_RPMH_VRM_MODE_CRS_DRV3_REG10_ADDR A:&base_addr+0x830a28
y.create.l HWIO_RPMH_VRM_MODE_CRS_DRV3_REG11_ADDR A:&base_addr+0x830b28
y.create.l HWIO_RPMH_VRM_MODE_CRS_DRV3_REG12_ADDR A:&base_addr+0x830c28
y.create.l HWIO_RPMH_VRM_MODE_CRS_DRV3_REG13_ADDR A:&base_addr+0x830d28
y.create.l HWIO_RPMH_VRM_MODE_CRS_DRV3_REG14_ADDR A:&base_addr+0x830e28
y.create.l HWIO_RPMH_VRM_MODE_CRS_DRV3_REG15_ADDR A:&base_addr+0x830f28
y.create.l HWIO_RPMH_VRM_MODE_CRS_DRV3_REG16_ADDR A:&base_addr+0x831028
y.create.l HWIO_RPMH_VRM_MODE_CRS_DRV3_REG17_ADDR A:&base_addr+0x831128
y.create.l HWIO_RPMH_VRM_MODE_CRS_DRV3_REG18_ADDR A:&base_addr+0x831228
y.create.l HWIO_RPMH_VRM_MODE_CRS_DRV3_REG19_ADDR A:&base_addr+0x831328
y.create.l HWIO_RPMH_VRM_MODE_CRS_DRV3_REG20_ADDR A:&base_addr+0x831428
y.create.l HWIO_RPMH_VRM_MODE_CRS_DRV3_REG21_ADDR A:&base_addr+0x831528
y.create.l HWIO_RPMH_VRM_MODE_CRS_DRV3_REG22_ADDR A:&base_addr+0x831628
y.create.l HWIO_RPMH_VRM_MODE_CRS_DRV3_REG23_ADDR A:&base_addr+0x831728
y.create.l HWIO_RPMH_VRM_MODE_CRS_DRV4_REG0_ADDR A:&base_addr+0x840028
y.create.l HWIO_RPMH_VRM_MODE_CRS_DRV4_REG1_ADDR A:&base_addr+0x840128
y.create.l HWIO_RPMH_VRM_MODE_CRS_DRV4_REG2_ADDR A:&base_addr+0x840228
y.create.l HWIO_RPMH_VRM_MODE_CRS_DRV4_REG3_ADDR A:&base_addr+0x840328
y.create.l HWIO_RPMH_VRM_MODE_CRS_DRV4_REG4_ADDR A:&base_addr+0x840428
y.create.l HWIO_RPMH_VRM_MODE_CRS_DRV4_REG5_ADDR A:&base_addr+0x840528
y.create.l HWIO_RPMH_VRM_MODE_CRS_DRV4_REG6_ADDR A:&base_addr+0x840628
y.create.l HWIO_RPMH_VRM_MODE_CRS_DRV4_REG7_ADDR A:&base_addr+0x840728
y.create.l HWIO_RPMH_VRM_MODE_CRS_DRV4_REG8_ADDR A:&base_addr+0x840828
y.create.l HWIO_RPMH_VRM_MODE_CRS_DRV4_REG9_ADDR A:&base_addr+0x840928
y.create.l HWIO_RPMH_VRM_MODE_CRS_DRV4_REG10_ADDR A:&base_addr+0x840a28
y.create.l HWIO_RPMH_VRM_MODE_CRS_DRV4_REG11_ADDR A:&base_addr+0x840b28
y.create.l HWIO_RPMH_VRM_MODE_CRS_DRV4_REG12_ADDR A:&base_addr+0x840c28
y.create.l HWIO_RPMH_VRM_MODE_CRS_DRV4_REG13_ADDR A:&base_addr+0x840d28
y.create.l HWIO_RPMH_VRM_MODE_CRS_DRV4_REG14_ADDR A:&base_addr+0x840e28
y.create.l HWIO_RPMH_VRM_MODE_CRS_DRV4_REG15_ADDR A:&base_addr+0x840f28
y.create.l HWIO_RPMH_VRM_MODE_CRS_DRV4_REG16_ADDR A:&base_addr+0x841028
y.create.l HWIO_RPMH_VRM_MODE_CRS_DRV4_REG17_ADDR A:&base_addr+0x841128
y.create.l HWIO_RPMH_VRM_MODE_CRS_DRV4_REG18_ADDR A:&base_addr+0x841228
y.create.l HWIO_RPMH_VRM_MODE_CRS_DRV4_REG19_ADDR A:&base_addr+0x841328
y.create.l HWIO_RPMH_VRM_MODE_CRS_DRV4_REG20_ADDR A:&base_addr+0x841428
y.create.l HWIO_RPMH_VRM_MODE_CRS_DRV4_REG21_ADDR A:&base_addr+0x841528
y.create.l HWIO_RPMH_VRM_MODE_CRS_DRV4_REG22_ADDR A:&base_addr+0x841628
y.create.l HWIO_RPMH_VRM_MODE_CRS_DRV4_REG23_ADDR A:&base_addr+0x841728
y.create.l HWIO_RPMH_VRM_MODE_CRS_DRV5_REG0_ADDR A:&base_addr+0x850028
y.create.l HWIO_RPMH_VRM_MODE_CRS_DRV5_REG1_ADDR A:&base_addr+0x850128
y.create.l HWIO_RPMH_VRM_MODE_CRS_DRV5_REG2_ADDR A:&base_addr+0x850228
y.create.l HWIO_RPMH_VRM_MODE_CRS_DRV5_REG3_ADDR A:&base_addr+0x850328
y.create.l HWIO_RPMH_VRM_MODE_CRS_DRV5_REG4_ADDR A:&base_addr+0x850428
y.create.l HWIO_RPMH_VRM_MODE_CRS_DRV5_REG5_ADDR A:&base_addr+0x850528
y.create.l HWIO_RPMH_VRM_MODE_CRS_DRV5_REG6_ADDR A:&base_addr+0x850628
y.create.l HWIO_RPMH_VRM_MODE_CRS_DRV5_REG7_ADDR A:&base_addr+0x850728
y.create.l HWIO_RPMH_VRM_MODE_CRS_DRV5_REG8_ADDR A:&base_addr+0x850828
y.create.l HWIO_RPMH_VRM_MODE_CRS_DRV5_REG9_ADDR A:&base_addr+0x850928
y.create.l HWIO_RPMH_VRM_MODE_CRS_DRV5_REG10_ADDR A:&base_addr+0x850a28
y.create.l HWIO_RPMH_VRM_MODE_CRS_DRV5_REG11_ADDR A:&base_addr+0x850b28
y.create.l HWIO_RPMH_VRM_MODE_CRS_DRV5_REG12_ADDR A:&base_addr+0x850c28
y.create.l HWIO_RPMH_VRM_MODE_CRS_DRV5_REG13_ADDR A:&base_addr+0x850d28
y.create.l HWIO_RPMH_VRM_MODE_CRS_DRV5_REG14_ADDR A:&base_addr+0x850e28
y.create.l HWIO_RPMH_VRM_MODE_CRS_DRV5_REG15_ADDR A:&base_addr+0x850f28
y.create.l HWIO_RPMH_VRM_MODE_CRS_DRV5_REG16_ADDR A:&base_addr+0x851028
y.create.l HWIO_RPMH_VRM_MODE_CRS_DRV5_REG17_ADDR A:&base_addr+0x851128
y.create.l HWIO_RPMH_VRM_MODE_CRS_DRV5_REG18_ADDR A:&base_addr+0x851228
y.create.l HWIO_RPMH_VRM_MODE_CRS_DRV5_REG19_ADDR A:&base_addr+0x851328
y.create.l HWIO_RPMH_VRM_MODE_CRS_DRV5_REG20_ADDR A:&base_addr+0x851428
y.create.l HWIO_RPMH_VRM_MODE_CRS_DRV5_REG21_ADDR A:&base_addr+0x851528
y.create.l HWIO_RPMH_VRM_MODE_CRS_DRV5_REG22_ADDR A:&base_addr+0x851628
y.create.l HWIO_RPMH_VRM_MODE_CRS_DRV5_REG23_ADDR A:&base_addr+0x851728
y.create.l HWIO_RPMH_VRM_MODE_CRS_DRV6_REG0_ADDR A:&base_addr+0x860028
y.create.l HWIO_RPMH_VRM_MODE_CRS_DRV6_REG1_ADDR A:&base_addr+0x860128
y.create.l HWIO_RPMH_VRM_MODE_CRS_DRV6_REG2_ADDR A:&base_addr+0x860228
y.create.l HWIO_RPMH_VRM_MODE_CRS_DRV6_REG3_ADDR A:&base_addr+0x860328
y.create.l HWIO_RPMH_VRM_MODE_CRS_DRV6_REG4_ADDR A:&base_addr+0x860428
y.create.l HWIO_RPMH_VRM_MODE_CRS_DRV6_REG5_ADDR A:&base_addr+0x860528
y.create.l HWIO_RPMH_VRM_MODE_CRS_DRV6_REG6_ADDR A:&base_addr+0x860628
y.create.l HWIO_RPMH_VRM_MODE_CRS_DRV6_REG7_ADDR A:&base_addr+0x860728
y.create.l HWIO_RPMH_VRM_MODE_CRS_DRV6_REG8_ADDR A:&base_addr+0x860828
y.create.l HWIO_RPMH_VRM_MODE_CRS_DRV6_REG9_ADDR A:&base_addr+0x860928
y.create.l HWIO_RPMH_VRM_MODE_CRS_DRV6_REG10_ADDR A:&base_addr+0x860a28
y.create.l HWIO_RPMH_VRM_MODE_CRS_DRV6_REG11_ADDR A:&base_addr+0x860b28
y.create.l HWIO_RPMH_VRM_MODE_CRS_DRV6_REG12_ADDR A:&base_addr+0x860c28
y.create.l HWIO_RPMH_VRM_MODE_CRS_DRV6_REG13_ADDR A:&base_addr+0x860d28
y.create.l HWIO_RPMH_VRM_MODE_CRS_DRV6_REG14_ADDR A:&base_addr+0x860e28
y.create.l HWIO_RPMH_VRM_MODE_CRS_DRV6_REG15_ADDR A:&base_addr+0x860f28
y.create.l HWIO_RPMH_VRM_MODE_CRS_DRV6_REG16_ADDR A:&base_addr+0x861028
y.create.l HWIO_RPMH_VRM_MODE_CRS_DRV6_REG17_ADDR A:&base_addr+0x861128
y.create.l HWIO_RPMH_VRM_MODE_CRS_DRV6_REG18_ADDR A:&base_addr+0x861228
y.create.l HWIO_RPMH_VRM_MODE_CRS_DRV6_REG19_ADDR A:&base_addr+0x861328
y.create.l HWIO_RPMH_VRM_MODE_CRS_DRV6_REG20_ADDR A:&base_addr+0x861428
y.create.l HWIO_RPMH_VRM_MODE_CRS_DRV6_REG21_ADDR A:&base_addr+0x861528
y.create.l HWIO_RPMH_VRM_MODE_CRS_DRV6_REG22_ADDR A:&base_addr+0x861628
y.create.l HWIO_RPMH_VRM_MODE_CRS_DRV6_REG23_ADDR A:&base_addr+0x861728
y.create.l HWIO_RPMH_VRM_HEADROOM_CRS_DRV0_REG0_ADDR A:&base_addr+0x80002c
y.create.l HWIO_RPMH_VRM_HEADROOM_CRS_DRV0_REG1_ADDR A:&base_addr+0x80012c
y.create.l HWIO_RPMH_VRM_HEADROOM_CRS_DRV0_REG2_ADDR A:&base_addr+0x80022c
y.create.l HWIO_RPMH_VRM_HEADROOM_CRS_DRV0_REG3_ADDR A:&base_addr+0x80032c
y.create.l HWIO_RPMH_VRM_HEADROOM_CRS_DRV0_REG4_ADDR A:&base_addr+0x80042c
y.create.l HWIO_RPMH_VRM_HEADROOM_CRS_DRV0_REG5_ADDR A:&base_addr+0x80052c
y.create.l HWIO_RPMH_VRM_HEADROOM_CRS_DRV0_REG6_ADDR A:&base_addr+0x80062c
y.create.l HWIO_RPMH_VRM_HEADROOM_CRS_DRV0_REG7_ADDR A:&base_addr+0x80072c
y.create.l HWIO_RPMH_VRM_HEADROOM_CRS_DRV0_REG8_ADDR A:&base_addr+0x80082c
y.create.l HWIO_RPMH_VRM_HEADROOM_CRS_DRV0_REG9_ADDR A:&base_addr+0x80092c
y.create.l HWIO_RPMH_VRM_HEADROOM_CRS_DRV0_REG10_ADDR A:&base_addr+0x800a2c
y.create.l HWIO_RPMH_VRM_HEADROOM_CRS_DRV0_REG11_ADDR A:&base_addr+0x800b2c
y.create.l HWIO_RPMH_VRM_HEADROOM_CRS_DRV0_REG12_ADDR A:&base_addr+0x800c2c
y.create.l HWIO_RPMH_VRM_HEADROOM_CRS_DRV0_REG13_ADDR A:&base_addr+0x800d2c
y.create.l HWIO_RPMH_VRM_HEADROOM_CRS_DRV0_REG14_ADDR A:&base_addr+0x800e2c
y.create.l HWIO_RPMH_VRM_HEADROOM_CRS_DRV0_REG15_ADDR A:&base_addr+0x800f2c
y.create.l HWIO_RPMH_VRM_HEADROOM_CRS_DRV0_REG16_ADDR A:&base_addr+0x80102c
y.create.l HWIO_RPMH_VRM_HEADROOM_CRS_DRV0_REG17_ADDR A:&base_addr+0x80112c
y.create.l HWIO_RPMH_VRM_HEADROOM_CRS_DRV0_REG18_ADDR A:&base_addr+0x80122c
y.create.l HWIO_RPMH_VRM_HEADROOM_CRS_DRV0_REG19_ADDR A:&base_addr+0x80132c
y.create.l HWIO_RPMH_VRM_HEADROOM_CRS_DRV0_REG20_ADDR A:&base_addr+0x80142c
y.create.l HWIO_RPMH_VRM_HEADROOM_CRS_DRV0_REG21_ADDR A:&base_addr+0x80152c
y.create.l HWIO_RPMH_VRM_HEADROOM_CRS_DRV0_REG22_ADDR A:&base_addr+0x80162c
y.create.l HWIO_RPMH_VRM_HEADROOM_CRS_DRV0_REG23_ADDR A:&base_addr+0x80172c
y.create.l HWIO_RPMH_VRM_HEADROOM_CRS_DRV1_REG0_ADDR A:&base_addr+0x81002c
y.create.l HWIO_RPMH_VRM_HEADROOM_CRS_DRV1_REG1_ADDR A:&base_addr+0x81012c
y.create.l HWIO_RPMH_VRM_HEADROOM_CRS_DRV1_REG2_ADDR A:&base_addr+0x81022c
y.create.l HWIO_RPMH_VRM_HEADROOM_CRS_DRV1_REG3_ADDR A:&base_addr+0x81032c
y.create.l HWIO_RPMH_VRM_HEADROOM_CRS_DRV1_REG4_ADDR A:&base_addr+0x81042c
y.create.l HWIO_RPMH_VRM_HEADROOM_CRS_DRV1_REG5_ADDR A:&base_addr+0x81052c
y.create.l HWIO_RPMH_VRM_HEADROOM_CRS_DRV1_REG6_ADDR A:&base_addr+0x81062c
y.create.l HWIO_RPMH_VRM_HEADROOM_CRS_DRV1_REG7_ADDR A:&base_addr+0x81072c
y.create.l HWIO_RPMH_VRM_HEADROOM_CRS_DRV1_REG8_ADDR A:&base_addr+0x81082c
y.create.l HWIO_RPMH_VRM_HEADROOM_CRS_DRV1_REG9_ADDR A:&base_addr+0x81092c
y.create.l HWIO_RPMH_VRM_HEADROOM_CRS_DRV1_REG10_ADDR A:&base_addr+0x810a2c
y.create.l HWIO_RPMH_VRM_HEADROOM_CRS_DRV1_REG11_ADDR A:&base_addr+0x810b2c
y.create.l HWIO_RPMH_VRM_HEADROOM_CRS_DRV1_REG12_ADDR A:&base_addr+0x810c2c
y.create.l HWIO_RPMH_VRM_HEADROOM_CRS_DRV1_REG13_ADDR A:&base_addr+0x810d2c
y.create.l HWIO_RPMH_VRM_HEADROOM_CRS_DRV1_REG14_ADDR A:&base_addr+0x810e2c
y.create.l HWIO_RPMH_VRM_HEADROOM_CRS_DRV1_REG15_ADDR A:&base_addr+0x810f2c
y.create.l HWIO_RPMH_VRM_HEADROOM_CRS_DRV1_REG16_ADDR A:&base_addr+0x81102c
y.create.l HWIO_RPMH_VRM_HEADROOM_CRS_DRV1_REG17_ADDR A:&base_addr+0x81112c
y.create.l HWIO_RPMH_VRM_HEADROOM_CRS_DRV1_REG18_ADDR A:&base_addr+0x81122c
y.create.l HWIO_RPMH_VRM_HEADROOM_CRS_DRV1_REG19_ADDR A:&base_addr+0x81132c
y.create.l HWIO_RPMH_VRM_HEADROOM_CRS_DRV1_REG20_ADDR A:&base_addr+0x81142c
y.create.l HWIO_RPMH_VRM_HEADROOM_CRS_DRV1_REG21_ADDR A:&base_addr+0x81152c
y.create.l HWIO_RPMH_VRM_HEADROOM_CRS_DRV1_REG22_ADDR A:&base_addr+0x81162c
y.create.l HWIO_RPMH_VRM_HEADROOM_CRS_DRV1_REG23_ADDR A:&base_addr+0x81172c
y.create.l HWIO_RPMH_VRM_HEADROOM_CRS_DRV2_REG0_ADDR A:&base_addr+0x82002c
y.create.l HWIO_RPMH_VRM_HEADROOM_CRS_DRV2_REG1_ADDR A:&base_addr+0x82012c
y.create.l HWIO_RPMH_VRM_HEADROOM_CRS_DRV2_REG2_ADDR A:&base_addr+0x82022c
y.create.l HWIO_RPMH_VRM_HEADROOM_CRS_DRV2_REG3_ADDR A:&base_addr+0x82032c
y.create.l HWIO_RPMH_VRM_HEADROOM_CRS_DRV2_REG4_ADDR A:&base_addr+0x82042c
y.create.l HWIO_RPMH_VRM_HEADROOM_CRS_DRV2_REG5_ADDR A:&base_addr+0x82052c
y.create.l HWIO_RPMH_VRM_HEADROOM_CRS_DRV2_REG6_ADDR A:&base_addr+0x82062c
y.create.l HWIO_RPMH_VRM_HEADROOM_CRS_DRV2_REG7_ADDR A:&base_addr+0x82072c
y.create.l HWIO_RPMH_VRM_HEADROOM_CRS_DRV2_REG8_ADDR A:&base_addr+0x82082c
y.create.l HWIO_RPMH_VRM_HEADROOM_CRS_DRV2_REG9_ADDR A:&base_addr+0x82092c
y.create.l HWIO_RPMH_VRM_HEADROOM_CRS_DRV2_REG10_ADDR A:&base_addr+0x820a2c
y.create.l HWIO_RPMH_VRM_HEADROOM_CRS_DRV2_REG11_ADDR A:&base_addr+0x820b2c
y.create.l HWIO_RPMH_VRM_HEADROOM_CRS_DRV2_REG12_ADDR A:&base_addr+0x820c2c
y.create.l HWIO_RPMH_VRM_HEADROOM_CRS_DRV2_REG13_ADDR A:&base_addr+0x820d2c
y.create.l HWIO_RPMH_VRM_HEADROOM_CRS_DRV2_REG14_ADDR A:&base_addr+0x820e2c
y.create.l HWIO_RPMH_VRM_HEADROOM_CRS_DRV2_REG15_ADDR A:&base_addr+0x820f2c
y.create.l HWIO_RPMH_VRM_HEADROOM_CRS_DRV2_REG16_ADDR A:&base_addr+0x82102c
y.create.l HWIO_RPMH_VRM_HEADROOM_CRS_DRV2_REG17_ADDR A:&base_addr+0x82112c
y.create.l HWIO_RPMH_VRM_HEADROOM_CRS_DRV2_REG18_ADDR A:&base_addr+0x82122c
y.create.l HWIO_RPMH_VRM_HEADROOM_CRS_DRV2_REG19_ADDR A:&base_addr+0x82132c
y.create.l HWIO_RPMH_VRM_HEADROOM_CRS_DRV2_REG20_ADDR A:&base_addr+0x82142c
y.create.l HWIO_RPMH_VRM_HEADROOM_CRS_DRV2_REG21_ADDR A:&base_addr+0x82152c
y.create.l HWIO_RPMH_VRM_HEADROOM_CRS_DRV2_REG22_ADDR A:&base_addr+0x82162c
y.create.l HWIO_RPMH_VRM_HEADROOM_CRS_DRV2_REG23_ADDR A:&base_addr+0x82172c
y.create.l HWIO_RPMH_VRM_HEADROOM_CRS_DRV3_REG0_ADDR A:&base_addr+0x83002c
y.create.l HWIO_RPMH_VRM_HEADROOM_CRS_DRV3_REG1_ADDR A:&base_addr+0x83012c
y.create.l HWIO_RPMH_VRM_HEADROOM_CRS_DRV3_REG2_ADDR A:&base_addr+0x83022c
y.create.l HWIO_RPMH_VRM_HEADROOM_CRS_DRV3_REG3_ADDR A:&base_addr+0x83032c
y.create.l HWIO_RPMH_VRM_HEADROOM_CRS_DRV3_REG4_ADDR A:&base_addr+0x83042c
y.create.l HWIO_RPMH_VRM_HEADROOM_CRS_DRV3_REG5_ADDR A:&base_addr+0x83052c
y.create.l HWIO_RPMH_VRM_HEADROOM_CRS_DRV3_REG6_ADDR A:&base_addr+0x83062c
y.create.l HWIO_RPMH_VRM_HEADROOM_CRS_DRV3_REG7_ADDR A:&base_addr+0x83072c
y.create.l HWIO_RPMH_VRM_HEADROOM_CRS_DRV3_REG8_ADDR A:&base_addr+0x83082c
y.create.l HWIO_RPMH_VRM_HEADROOM_CRS_DRV3_REG9_ADDR A:&base_addr+0x83092c
y.create.l HWIO_RPMH_VRM_HEADROOM_CRS_DRV3_REG10_ADDR A:&base_addr+0x830a2c
y.create.l HWIO_RPMH_VRM_HEADROOM_CRS_DRV3_REG11_ADDR A:&base_addr+0x830b2c
y.create.l HWIO_RPMH_VRM_HEADROOM_CRS_DRV3_REG12_ADDR A:&base_addr+0x830c2c
y.create.l HWIO_RPMH_VRM_HEADROOM_CRS_DRV3_REG13_ADDR A:&base_addr+0x830d2c
y.create.l HWIO_RPMH_VRM_HEADROOM_CRS_DRV3_REG14_ADDR A:&base_addr+0x830e2c
y.create.l HWIO_RPMH_VRM_HEADROOM_CRS_DRV3_REG15_ADDR A:&base_addr+0x830f2c
y.create.l HWIO_RPMH_VRM_HEADROOM_CRS_DRV3_REG16_ADDR A:&base_addr+0x83102c
y.create.l HWIO_RPMH_VRM_HEADROOM_CRS_DRV3_REG17_ADDR A:&base_addr+0x83112c
y.create.l HWIO_RPMH_VRM_HEADROOM_CRS_DRV3_REG18_ADDR A:&base_addr+0x83122c
y.create.l HWIO_RPMH_VRM_HEADROOM_CRS_DRV3_REG19_ADDR A:&base_addr+0x83132c
y.create.l HWIO_RPMH_VRM_HEADROOM_CRS_DRV3_REG20_ADDR A:&base_addr+0x83142c
y.create.l HWIO_RPMH_VRM_HEADROOM_CRS_DRV3_REG21_ADDR A:&base_addr+0x83152c
y.create.l HWIO_RPMH_VRM_HEADROOM_CRS_DRV3_REG22_ADDR A:&base_addr+0x83162c
y.create.l HWIO_RPMH_VRM_HEADROOM_CRS_DRV3_REG23_ADDR A:&base_addr+0x83172c
y.create.l HWIO_RPMH_VRM_HEADROOM_CRS_DRV4_REG0_ADDR A:&base_addr+0x84002c
y.create.l HWIO_RPMH_VRM_HEADROOM_CRS_DRV4_REG1_ADDR A:&base_addr+0x84012c
y.create.l HWIO_RPMH_VRM_HEADROOM_CRS_DRV4_REG2_ADDR A:&base_addr+0x84022c
y.create.l HWIO_RPMH_VRM_HEADROOM_CRS_DRV4_REG3_ADDR A:&base_addr+0x84032c
y.create.l HWIO_RPMH_VRM_HEADROOM_CRS_DRV4_REG4_ADDR A:&base_addr+0x84042c
y.create.l HWIO_RPMH_VRM_HEADROOM_CRS_DRV4_REG5_ADDR A:&base_addr+0x84052c
y.create.l HWIO_RPMH_VRM_HEADROOM_CRS_DRV4_REG6_ADDR A:&base_addr+0x84062c
y.create.l HWIO_RPMH_VRM_HEADROOM_CRS_DRV4_REG7_ADDR A:&base_addr+0x84072c
y.create.l HWIO_RPMH_VRM_HEADROOM_CRS_DRV4_REG8_ADDR A:&base_addr+0x84082c
y.create.l HWIO_RPMH_VRM_HEADROOM_CRS_DRV4_REG9_ADDR A:&base_addr+0x84092c
y.create.l HWIO_RPMH_VRM_HEADROOM_CRS_DRV4_REG10_ADDR A:&base_addr+0x840a2c
y.create.l HWIO_RPMH_VRM_HEADROOM_CRS_DRV4_REG11_ADDR A:&base_addr+0x840b2c
y.create.l HWIO_RPMH_VRM_HEADROOM_CRS_DRV4_REG12_ADDR A:&base_addr+0x840c2c
y.create.l HWIO_RPMH_VRM_HEADROOM_CRS_DRV4_REG13_ADDR A:&base_addr+0x840d2c
y.create.l HWIO_RPMH_VRM_HEADROOM_CRS_DRV4_REG14_ADDR A:&base_addr+0x840e2c
y.create.l HWIO_RPMH_VRM_HEADROOM_CRS_DRV4_REG15_ADDR A:&base_addr+0x840f2c
y.create.l HWIO_RPMH_VRM_HEADROOM_CRS_DRV4_REG16_ADDR A:&base_addr+0x84102c
y.create.l HWIO_RPMH_VRM_HEADROOM_CRS_DRV4_REG17_ADDR A:&base_addr+0x84112c
y.create.l HWIO_RPMH_VRM_HEADROOM_CRS_DRV4_REG18_ADDR A:&base_addr+0x84122c
y.create.l HWIO_RPMH_VRM_HEADROOM_CRS_DRV4_REG19_ADDR A:&base_addr+0x84132c
y.create.l HWIO_RPMH_VRM_HEADROOM_CRS_DRV4_REG20_ADDR A:&base_addr+0x84142c
y.create.l HWIO_RPMH_VRM_HEADROOM_CRS_DRV4_REG21_ADDR A:&base_addr+0x84152c
y.create.l HWIO_RPMH_VRM_HEADROOM_CRS_DRV4_REG22_ADDR A:&base_addr+0x84162c
y.create.l HWIO_RPMH_VRM_HEADROOM_CRS_DRV4_REG23_ADDR A:&base_addr+0x84172c
y.create.l HWIO_RPMH_VRM_HEADROOM_CRS_DRV5_REG0_ADDR A:&base_addr+0x85002c
y.create.l HWIO_RPMH_VRM_HEADROOM_CRS_DRV5_REG1_ADDR A:&base_addr+0x85012c
y.create.l HWIO_RPMH_VRM_HEADROOM_CRS_DRV5_REG2_ADDR A:&base_addr+0x85022c
y.create.l HWIO_RPMH_VRM_HEADROOM_CRS_DRV5_REG3_ADDR A:&base_addr+0x85032c
y.create.l HWIO_RPMH_VRM_HEADROOM_CRS_DRV5_REG4_ADDR A:&base_addr+0x85042c
y.create.l HWIO_RPMH_VRM_HEADROOM_CRS_DRV5_REG5_ADDR A:&base_addr+0x85052c
y.create.l HWIO_RPMH_VRM_HEADROOM_CRS_DRV5_REG6_ADDR A:&base_addr+0x85062c
y.create.l HWIO_RPMH_VRM_HEADROOM_CRS_DRV5_REG7_ADDR A:&base_addr+0x85072c
y.create.l HWIO_RPMH_VRM_HEADROOM_CRS_DRV5_REG8_ADDR A:&base_addr+0x85082c
y.create.l HWIO_RPMH_VRM_HEADROOM_CRS_DRV5_REG9_ADDR A:&base_addr+0x85092c
y.create.l HWIO_RPMH_VRM_HEADROOM_CRS_DRV5_REG10_ADDR A:&base_addr+0x850a2c
y.create.l HWIO_RPMH_VRM_HEADROOM_CRS_DRV5_REG11_ADDR A:&base_addr+0x850b2c
y.create.l HWIO_RPMH_VRM_HEADROOM_CRS_DRV5_REG12_ADDR A:&base_addr+0x850c2c
y.create.l HWIO_RPMH_VRM_HEADROOM_CRS_DRV5_REG13_ADDR A:&base_addr+0x850d2c
y.create.l HWIO_RPMH_VRM_HEADROOM_CRS_DRV5_REG14_ADDR A:&base_addr+0x850e2c
y.create.l HWIO_RPMH_VRM_HEADROOM_CRS_DRV5_REG15_ADDR A:&base_addr+0x850f2c
y.create.l HWIO_RPMH_VRM_HEADROOM_CRS_DRV5_REG16_ADDR A:&base_addr+0x85102c
y.create.l HWIO_RPMH_VRM_HEADROOM_CRS_DRV5_REG17_ADDR A:&base_addr+0x85112c
y.create.l HWIO_RPMH_VRM_HEADROOM_CRS_DRV5_REG18_ADDR A:&base_addr+0x85122c
y.create.l HWIO_RPMH_VRM_HEADROOM_CRS_DRV5_REG19_ADDR A:&base_addr+0x85132c
y.create.l HWIO_RPMH_VRM_HEADROOM_CRS_DRV5_REG20_ADDR A:&base_addr+0x85142c
y.create.l HWIO_RPMH_VRM_HEADROOM_CRS_DRV5_REG21_ADDR A:&base_addr+0x85152c
y.create.l HWIO_RPMH_VRM_HEADROOM_CRS_DRV5_REG22_ADDR A:&base_addr+0x85162c
y.create.l HWIO_RPMH_VRM_HEADROOM_CRS_DRV5_REG23_ADDR A:&base_addr+0x85172c
y.create.l HWIO_RPMH_VRM_HEADROOM_CRS_DRV6_REG0_ADDR A:&base_addr+0x86002c
y.create.l HWIO_RPMH_VRM_HEADROOM_CRS_DRV6_REG1_ADDR A:&base_addr+0x86012c
y.create.l HWIO_RPMH_VRM_HEADROOM_CRS_DRV6_REG2_ADDR A:&base_addr+0x86022c
y.create.l HWIO_RPMH_VRM_HEADROOM_CRS_DRV6_REG3_ADDR A:&base_addr+0x86032c
y.create.l HWIO_RPMH_VRM_HEADROOM_CRS_DRV6_REG4_ADDR A:&base_addr+0x86042c
y.create.l HWIO_RPMH_VRM_HEADROOM_CRS_DRV6_REG5_ADDR A:&base_addr+0x86052c
y.create.l HWIO_RPMH_VRM_HEADROOM_CRS_DRV6_REG6_ADDR A:&base_addr+0x86062c
y.create.l HWIO_RPMH_VRM_HEADROOM_CRS_DRV6_REG7_ADDR A:&base_addr+0x86072c
y.create.l HWIO_RPMH_VRM_HEADROOM_CRS_DRV6_REG8_ADDR A:&base_addr+0x86082c
y.create.l HWIO_RPMH_VRM_HEADROOM_CRS_DRV6_REG9_ADDR A:&base_addr+0x86092c
y.create.l HWIO_RPMH_VRM_HEADROOM_CRS_DRV6_REG10_ADDR A:&base_addr+0x860a2c
y.create.l HWIO_RPMH_VRM_HEADROOM_CRS_DRV6_REG11_ADDR A:&base_addr+0x860b2c
y.create.l HWIO_RPMH_VRM_HEADROOM_CRS_DRV6_REG12_ADDR A:&base_addr+0x860c2c
y.create.l HWIO_RPMH_VRM_HEADROOM_CRS_DRV6_REG13_ADDR A:&base_addr+0x860d2c
y.create.l HWIO_RPMH_VRM_HEADROOM_CRS_DRV6_REG14_ADDR A:&base_addr+0x860e2c
y.create.l HWIO_RPMH_VRM_HEADROOM_CRS_DRV6_REG15_ADDR A:&base_addr+0x860f2c
y.create.l HWIO_RPMH_VRM_HEADROOM_CRS_DRV6_REG16_ADDR A:&base_addr+0x86102c
y.create.l HWIO_RPMH_VRM_HEADROOM_CRS_DRV6_REG17_ADDR A:&base_addr+0x86112c
y.create.l HWIO_RPMH_VRM_HEADROOM_CRS_DRV6_REG18_ADDR A:&base_addr+0x86122c
y.create.l HWIO_RPMH_VRM_HEADROOM_CRS_DRV6_REG19_ADDR A:&base_addr+0x86132c
y.create.l HWIO_RPMH_VRM_HEADROOM_CRS_DRV6_REG20_ADDR A:&base_addr+0x86142c
y.create.l HWIO_RPMH_VRM_HEADROOM_CRS_DRV6_REG21_ADDR A:&base_addr+0x86152c
y.create.l HWIO_RPMH_VRM_HEADROOM_CRS_DRV6_REG22_ADDR A:&base_addr+0x86162c
y.create.l HWIO_RPMH_VRM_HEADROOM_CRS_DRV6_REG23_ADDR A:&base_addr+0x86172c
y.create.l HWIO_RPMH_VRM_ENABLE_CRS_DRV0_XOB0_ADDR A:&base_addr+0x801824
y.create.l HWIO_RPMH_VRM_ENABLE_CRS_DRV0_XOB1_ADDR A:&base_addr+0x801924
y.create.l HWIO_RPMH_VRM_ENABLE_CRS_DRV0_XOB2_ADDR A:&base_addr+0x801a24
y.create.l HWIO_RPMH_VRM_ENABLE_CRS_DRV0_XOB3_ADDR A:&base_addr+0x801b24
y.create.l HWIO_RPMH_VRM_ENABLE_CRS_DRV0_XOB4_ADDR A:&base_addr+0x801c24
y.create.l HWIO_RPMH_VRM_ENABLE_CRS_DRV0_XOB5_ADDR A:&base_addr+0x801d24
y.create.l HWIO_RPMH_VRM_ENABLE_CRS_DRV0_XOB6_ADDR A:&base_addr+0x801e24
y.create.l HWIO_RPMH_VRM_ENABLE_CRS_DRV0_XOB7_ADDR A:&base_addr+0x801f24
y.create.l HWIO_RPMH_VRM_ENABLE_CRS_DRV1_XOB0_ADDR A:&base_addr+0x811824
y.create.l HWIO_RPMH_VRM_ENABLE_CRS_DRV1_XOB1_ADDR A:&base_addr+0x811924
y.create.l HWIO_RPMH_VRM_ENABLE_CRS_DRV1_XOB2_ADDR A:&base_addr+0x811a24
y.create.l HWIO_RPMH_VRM_ENABLE_CRS_DRV1_XOB3_ADDR A:&base_addr+0x811b24
y.create.l HWIO_RPMH_VRM_ENABLE_CRS_DRV1_XOB4_ADDR A:&base_addr+0x811c24
y.create.l HWIO_RPMH_VRM_ENABLE_CRS_DRV1_XOB5_ADDR A:&base_addr+0x811d24
y.create.l HWIO_RPMH_VRM_ENABLE_CRS_DRV1_XOB6_ADDR A:&base_addr+0x811e24
y.create.l HWIO_RPMH_VRM_ENABLE_CRS_DRV1_XOB7_ADDR A:&base_addr+0x811f24
y.create.l HWIO_RPMH_VRM_ENABLE_CRS_DRV2_XOB0_ADDR A:&base_addr+0x821824
y.create.l HWIO_RPMH_VRM_ENABLE_CRS_DRV2_XOB1_ADDR A:&base_addr+0x821924
y.create.l HWIO_RPMH_VRM_ENABLE_CRS_DRV2_XOB2_ADDR A:&base_addr+0x821a24
y.create.l HWIO_RPMH_VRM_ENABLE_CRS_DRV2_XOB3_ADDR A:&base_addr+0x821b24
y.create.l HWIO_RPMH_VRM_ENABLE_CRS_DRV2_XOB4_ADDR A:&base_addr+0x821c24
y.create.l HWIO_RPMH_VRM_ENABLE_CRS_DRV2_XOB5_ADDR A:&base_addr+0x821d24
y.create.l HWIO_RPMH_VRM_ENABLE_CRS_DRV2_XOB6_ADDR A:&base_addr+0x821e24
y.create.l HWIO_RPMH_VRM_ENABLE_CRS_DRV2_XOB7_ADDR A:&base_addr+0x821f24
y.create.l HWIO_RPMH_VRM_ENABLE_CRS_DRV3_XOB0_ADDR A:&base_addr+0x831824
y.create.l HWIO_RPMH_VRM_ENABLE_CRS_DRV3_XOB1_ADDR A:&base_addr+0x831924
y.create.l HWIO_RPMH_VRM_ENABLE_CRS_DRV3_XOB2_ADDR A:&base_addr+0x831a24
y.create.l HWIO_RPMH_VRM_ENABLE_CRS_DRV3_XOB3_ADDR A:&base_addr+0x831b24
y.create.l HWIO_RPMH_VRM_ENABLE_CRS_DRV3_XOB4_ADDR A:&base_addr+0x831c24
y.create.l HWIO_RPMH_VRM_ENABLE_CRS_DRV3_XOB5_ADDR A:&base_addr+0x831d24
y.create.l HWIO_RPMH_VRM_ENABLE_CRS_DRV3_XOB6_ADDR A:&base_addr+0x831e24
y.create.l HWIO_RPMH_VRM_ENABLE_CRS_DRV3_XOB7_ADDR A:&base_addr+0x831f24
y.create.l HWIO_RPMH_VRM_ENABLE_CRS_DRV4_XOB0_ADDR A:&base_addr+0x841824
y.create.l HWIO_RPMH_VRM_ENABLE_CRS_DRV4_XOB1_ADDR A:&base_addr+0x841924
y.create.l HWIO_RPMH_VRM_ENABLE_CRS_DRV4_XOB2_ADDR A:&base_addr+0x841a24
y.create.l HWIO_RPMH_VRM_ENABLE_CRS_DRV4_XOB3_ADDR A:&base_addr+0x841b24
y.create.l HWIO_RPMH_VRM_ENABLE_CRS_DRV4_XOB4_ADDR A:&base_addr+0x841c24
y.create.l HWIO_RPMH_VRM_ENABLE_CRS_DRV4_XOB5_ADDR A:&base_addr+0x841d24
y.create.l HWIO_RPMH_VRM_ENABLE_CRS_DRV4_XOB6_ADDR A:&base_addr+0x841e24
y.create.l HWIO_RPMH_VRM_ENABLE_CRS_DRV4_XOB7_ADDR A:&base_addr+0x841f24
y.create.l HWIO_RPMH_VRM_ENABLE_CRS_DRV5_XOB0_ADDR A:&base_addr+0x851824
y.create.l HWIO_RPMH_VRM_ENABLE_CRS_DRV5_XOB1_ADDR A:&base_addr+0x851924
y.create.l HWIO_RPMH_VRM_ENABLE_CRS_DRV5_XOB2_ADDR A:&base_addr+0x851a24
y.create.l HWIO_RPMH_VRM_ENABLE_CRS_DRV5_XOB3_ADDR A:&base_addr+0x851b24
y.create.l HWIO_RPMH_VRM_ENABLE_CRS_DRV5_XOB4_ADDR A:&base_addr+0x851c24
y.create.l HWIO_RPMH_VRM_ENABLE_CRS_DRV5_XOB5_ADDR A:&base_addr+0x851d24
y.create.l HWIO_RPMH_VRM_ENABLE_CRS_DRV5_XOB6_ADDR A:&base_addr+0x851e24
y.create.l HWIO_RPMH_VRM_ENABLE_CRS_DRV5_XOB7_ADDR A:&base_addr+0x851f24
y.create.l HWIO_RPMH_VRM_ENABLE_CRS_DRV6_XOB0_ADDR A:&base_addr+0x861824
y.create.l HWIO_RPMH_VRM_ENABLE_CRS_DRV6_XOB1_ADDR A:&base_addr+0x861924
y.create.l HWIO_RPMH_VRM_ENABLE_CRS_DRV6_XOB2_ADDR A:&base_addr+0x861a24
y.create.l HWIO_RPMH_VRM_ENABLE_CRS_DRV6_XOB3_ADDR A:&base_addr+0x861b24
y.create.l HWIO_RPMH_VRM_ENABLE_CRS_DRV6_XOB4_ADDR A:&base_addr+0x861c24
y.create.l HWIO_RPMH_VRM_ENABLE_CRS_DRV6_XOB5_ADDR A:&base_addr+0x861d24
y.create.l HWIO_RPMH_VRM_ENABLE_CRS_DRV6_XOB6_ADDR A:&base_addr+0x861e24
y.create.l HWIO_RPMH_VRM_ENABLE_CRS_DRV6_XOB7_ADDR A:&base_addr+0x861f24
y.create.l HWIO_RPMH_VRM_ENABLE_CRS_DRV0_XO0_ADDR A:&base_addr+0x802024
y.create.l HWIO_RPMH_VRM_ENABLE_CRS_DRV1_XO0_ADDR A:&base_addr+0x812024
y.create.l HWIO_RPMH_VRM_ENABLE_CRS_DRV2_XO0_ADDR A:&base_addr+0x822024
y.create.l HWIO_RPMH_VRM_ENABLE_CRS_DRV3_XO0_ADDR A:&base_addr+0x832024
y.create.l HWIO_RPMH_VRM_ENABLE_CRS_DRV4_XO0_ADDR A:&base_addr+0x842024
y.create.l HWIO_RPMH_VRM_ENABLE_CRS_DRV5_XO0_ADDR A:&base_addr+0x852024
y.create.l HWIO_RPMH_VRM_ENABLE_CRS_DRV6_XO0_ADDR A:&base_addr+0x862024
y.create.l HWIO_RPMH_VRM_VOLTAGE_CRS_CSR_REG0_ADDR A:&base_addr+0x9e0000
y.create.l HWIO_RPMH_VRM_VOLTAGE_CRS_CSR_REG1_ADDR A:&base_addr+0x9e0100
y.create.l HWIO_RPMH_VRM_VOLTAGE_CRS_CSR_REG2_ADDR A:&base_addr+0x9e0200
y.create.l HWIO_RPMH_VRM_VOLTAGE_CRS_CSR_REG3_ADDR A:&base_addr+0x9e0300
y.create.l HWIO_RPMH_VRM_VOLTAGE_CRS_CSR_REG4_ADDR A:&base_addr+0x9e0400
y.create.l HWIO_RPMH_VRM_VOLTAGE_CRS_CSR_REG5_ADDR A:&base_addr+0x9e0500
y.create.l HWIO_RPMH_VRM_VOLTAGE_CRS_CSR_REG6_ADDR A:&base_addr+0x9e0600
y.create.l HWIO_RPMH_VRM_VOLTAGE_CRS_CSR_REG7_ADDR A:&base_addr+0x9e0700
y.create.l HWIO_RPMH_VRM_VOLTAGE_CRS_CSR_REG8_ADDR A:&base_addr+0x9e0800
y.create.l HWIO_RPMH_VRM_VOLTAGE_CRS_CSR_REG9_ADDR A:&base_addr+0x9e0900
y.create.l HWIO_RPMH_VRM_VOLTAGE_CRS_CSR_REG10_ADDR A:&base_addr+0x9e0a00
y.create.l HWIO_RPMH_VRM_VOLTAGE_CRS_CSR_REG11_ADDR A:&base_addr+0x9e0b00
y.create.l HWIO_RPMH_VRM_VOLTAGE_CRS_CSR_REG12_ADDR A:&base_addr+0x9e0c00
y.create.l HWIO_RPMH_VRM_VOLTAGE_CRS_CSR_REG13_ADDR A:&base_addr+0x9e0d00
y.create.l HWIO_RPMH_VRM_VOLTAGE_CRS_CSR_REG14_ADDR A:&base_addr+0x9e0e00
y.create.l HWIO_RPMH_VRM_VOLTAGE_CRS_CSR_REG15_ADDR A:&base_addr+0x9e0f00
y.create.l HWIO_RPMH_VRM_VOLTAGE_CRS_CSR_REG16_ADDR A:&base_addr+0x9e1000
y.create.l HWIO_RPMH_VRM_VOLTAGE_CRS_CSR_REG17_ADDR A:&base_addr+0x9e1100
y.create.l HWIO_RPMH_VRM_VOLTAGE_CRS_CSR_REG18_ADDR A:&base_addr+0x9e1200
y.create.l HWIO_RPMH_VRM_VOLTAGE_CRS_CSR_REG19_ADDR A:&base_addr+0x9e1300
y.create.l HWIO_RPMH_VRM_VOLTAGE_CRS_CSR_REG20_ADDR A:&base_addr+0x9e1400
y.create.l HWIO_RPMH_VRM_VOLTAGE_CRS_CSR_REG21_ADDR A:&base_addr+0x9e1500
y.create.l HWIO_RPMH_VRM_VOLTAGE_CRS_CSR_REG22_ADDR A:&base_addr+0x9e1600
y.create.l HWIO_RPMH_VRM_VOLTAGE_CRS_CSR_REG23_ADDR A:&base_addr+0x9e1700
y.create.l HWIO_RPMH_VRM_ENABLE_CRS_CSR_REG0_ADDR A:&base_addr+0x9e0004
y.create.l HWIO_RPMH_VRM_ENABLE_CRS_CSR_REG1_ADDR A:&base_addr+0x9e0104
y.create.l HWIO_RPMH_VRM_ENABLE_CRS_CSR_REG2_ADDR A:&base_addr+0x9e0204
y.create.l HWIO_RPMH_VRM_ENABLE_CRS_CSR_REG3_ADDR A:&base_addr+0x9e0304
y.create.l HWIO_RPMH_VRM_ENABLE_CRS_CSR_REG4_ADDR A:&base_addr+0x9e0404
y.create.l HWIO_RPMH_VRM_ENABLE_CRS_CSR_REG5_ADDR A:&base_addr+0x9e0504
y.create.l HWIO_RPMH_VRM_ENABLE_CRS_CSR_REG6_ADDR A:&base_addr+0x9e0604
y.create.l HWIO_RPMH_VRM_ENABLE_CRS_CSR_REG7_ADDR A:&base_addr+0x9e0704
y.create.l HWIO_RPMH_VRM_ENABLE_CRS_CSR_REG8_ADDR A:&base_addr+0x9e0804
y.create.l HWIO_RPMH_VRM_ENABLE_CRS_CSR_REG9_ADDR A:&base_addr+0x9e0904
y.create.l HWIO_RPMH_VRM_ENABLE_CRS_CSR_REG10_ADDR A:&base_addr+0x9e0a04
y.create.l HWIO_RPMH_VRM_ENABLE_CRS_CSR_REG11_ADDR A:&base_addr+0x9e0b04
y.create.l HWIO_RPMH_VRM_ENABLE_CRS_CSR_REG12_ADDR A:&base_addr+0x9e0c04
y.create.l HWIO_RPMH_VRM_ENABLE_CRS_CSR_REG13_ADDR A:&base_addr+0x9e0d04
y.create.l HWIO_RPMH_VRM_ENABLE_CRS_CSR_REG14_ADDR A:&base_addr+0x9e0e04
y.create.l HWIO_RPMH_VRM_ENABLE_CRS_CSR_REG15_ADDR A:&base_addr+0x9e0f04
y.create.l HWIO_RPMH_VRM_ENABLE_CRS_CSR_REG16_ADDR A:&base_addr+0x9e1004
y.create.l HWIO_RPMH_VRM_ENABLE_CRS_CSR_REG17_ADDR A:&base_addr+0x9e1104
y.create.l HWIO_RPMH_VRM_ENABLE_CRS_CSR_REG18_ADDR A:&base_addr+0x9e1204
y.create.l HWIO_RPMH_VRM_ENABLE_CRS_CSR_REG19_ADDR A:&base_addr+0x9e1304
y.create.l HWIO_RPMH_VRM_ENABLE_CRS_CSR_REG20_ADDR A:&base_addr+0x9e1404
y.create.l HWIO_RPMH_VRM_ENABLE_CRS_CSR_REG21_ADDR A:&base_addr+0x9e1504
y.create.l HWIO_RPMH_VRM_ENABLE_CRS_CSR_REG22_ADDR A:&base_addr+0x9e1604
y.create.l HWIO_RPMH_VRM_ENABLE_CRS_CSR_REG23_ADDR A:&base_addr+0x9e1704
y.create.l HWIO_RPMH_VRM_MODE_CRS_CSR_REG0_ADDR A:&base_addr+0x9e0008
y.create.l HWIO_RPMH_VRM_MODE_CRS_CSR_REG1_ADDR A:&base_addr+0x9e0108
y.create.l HWIO_RPMH_VRM_MODE_CRS_CSR_REG2_ADDR A:&base_addr+0x9e0208
y.create.l HWIO_RPMH_VRM_MODE_CRS_CSR_REG3_ADDR A:&base_addr+0x9e0308
y.create.l HWIO_RPMH_VRM_MODE_CRS_CSR_REG4_ADDR A:&base_addr+0x9e0408
y.create.l HWIO_RPMH_VRM_MODE_CRS_CSR_REG5_ADDR A:&base_addr+0x9e0508
y.create.l HWIO_RPMH_VRM_MODE_CRS_CSR_REG6_ADDR A:&base_addr+0x9e0608
y.create.l HWIO_RPMH_VRM_MODE_CRS_CSR_REG7_ADDR A:&base_addr+0x9e0708
y.create.l HWIO_RPMH_VRM_MODE_CRS_CSR_REG8_ADDR A:&base_addr+0x9e0808
y.create.l HWIO_RPMH_VRM_MODE_CRS_CSR_REG9_ADDR A:&base_addr+0x9e0908
y.create.l HWIO_RPMH_VRM_MODE_CRS_CSR_REG10_ADDR A:&base_addr+0x9e0a08
y.create.l HWIO_RPMH_VRM_MODE_CRS_CSR_REG11_ADDR A:&base_addr+0x9e0b08
y.create.l HWIO_RPMH_VRM_MODE_CRS_CSR_REG12_ADDR A:&base_addr+0x9e0c08
y.create.l HWIO_RPMH_VRM_MODE_CRS_CSR_REG13_ADDR A:&base_addr+0x9e0d08
y.create.l HWIO_RPMH_VRM_MODE_CRS_CSR_REG14_ADDR A:&base_addr+0x9e0e08
y.create.l HWIO_RPMH_VRM_MODE_CRS_CSR_REG15_ADDR A:&base_addr+0x9e0f08
y.create.l HWIO_RPMH_VRM_MODE_CRS_CSR_REG16_ADDR A:&base_addr+0x9e1008
y.create.l HWIO_RPMH_VRM_MODE_CRS_CSR_REG17_ADDR A:&base_addr+0x9e1108
y.create.l HWIO_RPMH_VRM_MODE_CRS_CSR_REG18_ADDR A:&base_addr+0x9e1208
y.create.l HWIO_RPMH_VRM_MODE_CRS_CSR_REG19_ADDR A:&base_addr+0x9e1308
y.create.l HWIO_RPMH_VRM_MODE_CRS_CSR_REG20_ADDR A:&base_addr+0x9e1408
y.create.l HWIO_RPMH_VRM_MODE_CRS_CSR_REG21_ADDR A:&base_addr+0x9e1508
y.create.l HWIO_RPMH_VRM_MODE_CRS_CSR_REG22_ADDR A:&base_addr+0x9e1608
y.create.l HWIO_RPMH_VRM_MODE_CRS_CSR_REG23_ADDR A:&base_addr+0x9e1708
y.create.l HWIO_RPMH_VRM_HEADROOM_CRS_CSR_REG0_ADDR A:&base_addr+0x9e000c
y.create.l HWIO_RPMH_VRM_HEADROOM_CRS_CSR_REG1_ADDR A:&base_addr+0x9e010c
y.create.l HWIO_RPMH_VRM_HEADROOM_CRS_CSR_REG2_ADDR A:&base_addr+0x9e020c
y.create.l HWIO_RPMH_VRM_HEADROOM_CRS_CSR_REG3_ADDR A:&base_addr+0x9e030c
y.create.l HWIO_RPMH_VRM_HEADROOM_CRS_CSR_REG4_ADDR A:&base_addr+0x9e040c
y.create.l HWIO_RPMH_VRM_HEADROOM_CRS_CSR_REG5_ADDR A:&base_addr+0x9e050c
y.create.l HWIO_RPMH_VRM_HEADROOM_CRS_CSR_REG6_ADDR A:&base_addr+0x9e060c
y.create.l HWIO_RPMH_VRM_HEADROOM_CRS_CSR_REG7_ADDR A:&base_addr+0x9e070c
y.create.l HWIO_RPMH_VRM_HEADROOM_CRS_CSR_REG8_ADDR A:&base_addr+0x9e080c
y.create.l HWIO_RPMH_VRM_HEADROOM_CRS_CSR_REG9_ADDR A:&base_addr+0x9e090c
y.create.l HWIO_RPMH_VRM_HEADROOM_CRS_CSR_REG10_ADDR A:&base_addr+0x9e0a0c
y.create.l HWIO_RPMH_VRM_HEADROOM_CRS_CSR_REG11_ADDR A:&base_addr+0x9e0b0c
y.create.l HWIO_RPMH_VRM_HEADROOM_CRS_CSR_REG12_ADDR A:&base_addr+0x9e0c0c
y.create.l HWIO_RPMH_VRM_HEADROOM_CRS_CSR_REG13_ADDR A:&base_addr+0x9e0d0c
y.create.l HWIO_RPMH_VRM_HEADROOM_CRS_CSR_REG14_ADDR A:&base_addr+0x9e0e0c
y.create.l HWIO_RPMH_VRM_HEADROOM_CRS_CSR_REG15_ADDR A:&base_addr+0x9e0f0c
y.create.l HWIO_RPMH_VRM_HEADROOM_CRS_CSR_REG16_ADDR A:&base_addr+0x9e100c
y.create.l HWIO_RPMH_VRM_HEADROOM_CRS_CSR_REG17_ADDR A:&base_addr+0x9e110c
y.create.l HWIO_RPMH_VRM_HEADROOM_CRS_CSR_REG18_ADDR A:&base_addr+0x9e120c
y.create.l HWIO_RPMH_VRM_HEADROOM_CRS_CSR_REG19_ADDR A:&base_addr+0x9e130c
y.create.l HWIO_RPMH_VRM_HEADROOM_CRS_CSR_REG20_ADDR A:&base_addr+0x9e140c
y.create.l HWIO_RPMH_VRM_HEADROOM_CRS_CSR_REG21_ADDR A:&base_addr+0x9e150c
y.create.l HWIO_RPMH_VRM_HEADROOM_CRS_CSR_REG22_ADDR A:&base_addr+0x9e160c
y.create.l HWIO_RPMH_VRM_HEADROOM_CRS_CSR_REG23_ADDR A:&base_addr+0x9e170c
y.create.l HWIO_RPMH_VRM_ENABLE_CRS_CSR_XOB0_ADDR A:&base_addr+0x9e1804
y.create.l HWIO_RPMH_VRM_ENABLE_CRS_CSR_XOB1_ADDR A:&base_addr+0x9e1904
y.create.l HWIO_RPMH_VRM_ENABLE_CRS_CSR_XOB2_ADDR A:&base_addr+0x9e1a04
y.create.l HWIO_RPMH_VRM_ENABLE_CRS_CSR_XOB3_ADDR A:&base_addr+0x9e1b04
y.create.l HWIO_RPMH_VRM_ENABLE_CRS_CSR_XOB4_ADDR A:&base_addr+0x9e1c04
y.create.l HWIO_RPMH_VRM_ENABLE_CRS_CSR_XOB5_ADDR A:&base_addr+0x9e1d04
y.create.l HWIO_RPMH_VRM_ENABLE_CRS_CSR_XOB6_ADDR A:&base_addr+0x9e1e04
y.create.l HWIO_RPMH_VRM_ENABLE_CRS_CSR_XOB7_ADDR A:&base_addr+0x9e1f04
y.create.l HWIO_RPMH_VRM_ENABLE_CRS_CSR_XO0_ADDR A:&base_addr+0x9e2004
y.create.l HWIO_RPMH_VRM_VOLTAGE_WRS_CSR_REG0_ADDR A:&base_addr+0x9e0020
y.create.l HWIO_RPMH_VRM_VOLTAGE_WRS_CSR_REG1_ADDR A:&base_addr+0x9e0120
y.create.l HWIO_RPMH_VRM_VOLTAGE_WRS_CSR_REG2_ADDR A:&base_addr+0x9e0220
y.create.l HWIO_RPMH_VRM_VOLTAGE_WRS_CSR_REG3_ADDR A:&base_addr+0x9e0320
y.create.l HWIO_RPMH_VRM_VOLTAGE_WRS_CSR_REG4_ADDR A:&base_addr+0x9e0420
y.create.l HWIO_RPMH_VRM_VOLTAGE_WRS_CSR_REG5_ADDR A:&base_addr+0x9e0520
y.create.l HWIO_RPMH_VRM_VOLTAGE_WRS_CSR_REG6_ADDR A:&base_addr+0x9e0620
y.create.l HWIO_RPMH_VRM_VOLTAGE_WRS_CSR_REG7_ADDR A:&base_addr+0x9e0720
y.create.l HWIO_RPMH_VRM_VOLTAGE_WRS_CSR_REG8_ADDR A:&base_addr+0x9e0820
y.create.l HWIO_RPMH_VRM_VOLTAGE_WRS_CSR_REG9_ADDR A:&base_addr+0x9e0920
y.create.l HWIO_RPMH_VRM_VOLTAGE_WRS_CSR_REG10_ADDR A:&base_addr+0x9e0a20
y.create.l HWIO_RPMH_VRM_VOLTAGE_WRS_CSR_REG11_ADDR A:&base_addr+0x9e0b20
y.create.l HWIO_RPMH_VRM_VOLTAGE_WRS_CSR_REG12_ADDR A:&base_addr+0x9e0c20
y.create.l HWIO_RPMH_VRM_VOLTAGE_WRS_CSR_REG13_ADDR A:&base_addr+0x9e0d20
y.create.l HWIO_RPMH_VRM_VOLTAGE_WRS_CSR_REG14_ADDR A:&base_addr+0x9e0e20
y.create.l HWIO_RPMH_VRM_VOLTAGE_WRS_CSR_REG15_ADDR A:&base_addr+0x9e0f20
y.create.l HWIO_RPMH_VRM_VOLTAGE_WRS_CSR_REG16_ADDR A:&base_addr+0x9e1020
y.create.l HWIO_RPMH_VRM_VOLTAGE_WRS_CSR_REG17_ADDR A:&base_addr+0x9e1120
y.create.l HWIO_RPMH_VRM_VOLTAGE_WRS_CSR_REG18_ADDR A:&base_addr+0x9e1220
y.create.l HWIO_RPMH_VRM_VOLTAGE_WRS_CSR_REG19_ADDR A:&base_addr+0x9e1320
y.create.l HWIO_RPMH_VRM_VOLTAGE_WRS_CSR_REG20_ADDR A:&base_addr+0x9e1420
y.create.l HWIO_RPMH_VRM_VOLTAGE_WRS_CSR_REG21_ADDR A:&base_addr+0x9e1520
y.create.l HWIO_RPMH_VRM_VOLTAGE_WRS_CSR_REG22_ADDR A:&base_addr+0x9e1620
y.create.l HWIO_RPMH_VRM_VOLTAGE_WRS_CSR_REG23_ADDR A:&base_addr+0x9e1720
y.create.l HWIO_RPMH_VRM_ENABLE_WRS_CSR_REG0_ADDR A:&base_addr+0x9e0024
y.create.l HWIO_RPMH_VRM_ENABLE_WRS_CSR_REG1_ADDR A:&base_addr+0x9e0124
y.create.l HWIO_RPMH_VRM_ENABLE_WRS_CSR_REG2_ADDR A:&base_addr+0x9e0224
y.create.l HWIO_RPMH_VRM_ENABLE_WRS_CSR_REG3_ADDR A:&base_addr+0x9e0324
y.create.l HWIO_RPMH_VRM_ENABLE_WRS_CSR_REG4_ADDR A:&base_addr+0x9e0424
y.create.l HWIO_RPMH_VRM_ENABLE_WRS_CSR_REG5_ADDR A:&base_addr+0x9e0524
y.create.l HWIO_RPMH_VRM_ENABLE_WRS_CSR_REG6_ADDR A:&base_addr+0x9e0624
y.create.l HWIO_RPMH_VRM_ENABLE_WRS_CSR_REG7_ADDR A:&base_addr+0x9e0724
y.create.l HWIO_RPMH_VRM_ENABLE_WRS_CSR_REG8_ADDR A:&base_addr+0x9e0824
y.create.l HWIO_RPMH_VRM_ENABLE_WRS_CSR_REG9_ADDR A:&base_addr+0x9e0924
y.create.l HWIO_RPMH_VRM_ENABLE_WRS_CSR_REG10_ADDR A:&base_addr+0x9e0a24
y.create.l HWIO_RPMH_VRM_ENABLE_WRS_CSR_REG11_ADDR A:&base_addr+0x9e0b24
y.create.l HWIO_RPMH_VRM_ENABLE_WRS_CSR_REG12_ADDR A:&base_addr+0x9e0c24
y.create.l HWIO_RPMH_VRM_ENABLE_WRS_CSR_REG13_ADDR A:&base_addr+0x9e0d24
y.create.l HWIO_RPMH_VRM_ENABLE_WRS_CSR_REG14_ADDR A:&base_addr+0x9e0e24
y.create.l HWIO_RPMH_VRM_ENABLE_WRS_CSR_REG15_ADDR A:&base_addr+0x9e0f24
y.create.l HWIO_RPMH_VRM_ENABLE_WRS_CSR_REG16_ADDR A:&base_addr+0x9e1024
y.create.l HWIO_RPMH_VRM_ENABLE_WRS_CSR_REG17_ADDR A:&base_addr+0x9e1124
y.create.l HWIO_RPMH_VRM_ENABLE_WRS_CSR_REG18_ADDR A:&base_addr+0x9e1224
y.create.l HWIO_RPMH_VRM_ENABLE_WRS_CSR_REG19_ADDR A:&base_addr+0x9e1324
y.create.l HWIO_RPMH_VRM_ENABLE_WRS_CSR_REG20_ADDR A:&base_addr+0x9e1424
y.create.l HWIO_RPMH_VRM_ENABLE_WRS_CSR_REG21_ADDR A:&base_addr+0x9e1524
y.create.l HWIO_RPMH_VRM_ENABLE_WRS_CSR_REG22_ADDR A:&base_addr+0x9e1624
y.create.l HWIO_RPMH_VRM_ENABLE_WRS_CSR_REG23_ADDR A:&base_addr+0x9e1724
y.create.l HWIO_RPMH_VRM_MODE_WRS_CSR_REG0_ADDR A:&base_addr+0x9e0028
y.create.l HWIO_RPMH_VRM_MODE_WRS_CSR_REG1_ADDR A:&base_addr+0x9e0128
y.create.l HWIO_RPMH_VRM_MODE_WRS_CSR_REG2_ADDR A:&base_addr+0x9e0228
y.create.l HWIO_RPMH_VRM_MODE_WRS_CSR_REG3_ADDR A:&base_addr+0x9e0328
y.create.l HWIO_RPMH_VRM_MODE_WRS_CSR_REG4_ADDR A:&base_addr+0x9e0428
y.create.l HWIO_RPMH_VRM_MODE_WRS_CSR_REG5_ADDR A:&base_addr+0x9e0528
y.create.l HWIO_RPMH_VRM_MODE_WRS_CSR_REG6_ADDR A:&base_addr+0x9e0628
y.create.l HWIO_RPMH_VRM_MODE_WRS_CSR_REG7_ADDR A:&base_addr+0x9e0728
y.create.l HWIO_RPMH_VRM_MODE_WRS_CSR_REG8_ADDR A:&base_addr+0x9e0828
y.create.l HWIO_RPMH_VRM_MODE_WRS_CSR_REG9_ADDR A:&base_addr+0x9e0928
y.create.l HWIO_RPMH_VRM_MODE_WRS_CSR_REG10_ADDR A:&base_addr+0x9e0a28
y.create.l HWIO_RPMH_VRM_MODE_WRS_CSR_REG11_ADDR A:&base_addr+0x9e0b28
y.create.l HWIO_RPMH_VRM_MODE_WRS_CSR_REG12_ADDR A:&base_addr+0x9e0c28
y.create.l HWIO_RPMH_VRM_MODE_WRS_CSR_REG13_ADDR A:&base_addr+0x9e0d28
y.create.l HWIO_RPMH_VRM_MODE_WRS_CSR_REG14_ADDR A:&base_addr+0x9e0e28
y.create.l HWIO_RPMH_VRM_MODE_WRS_CSR_REG15_ADDR A:&base_addr+0x9e0f28
y.create.l HWIO_RPMH_VRM_MODE_WRS_CSR_REG16_ADDR A:&base_addr+0x9e1028
y.create.l HWIO_RPMH_VRM_MODE_WRS_CSR_REG17_ADDR A:&base_addr+0x9e1128
y.create.l HWIO_RPMH_VRM_MODE_WRS_CSR_REG18_ADDR A:&base_addr+0x9e1228
y.create.l HWIO_RPMH_VRM_MODE_WRS_CSR_REG19_ADDR A:&base_addr+0x9e1328
y.create.l HWIO_RPMH_VRM_MODE_WRS_CSR_REG20_ADDR A:&base_addr+0x9e1428
y.create.l HWIO_RPMH_VRM_MODE_WRS_CSR_REG21_ADDR A:&base_addr+0x9e1528
y.create.l HWIO_RPMH_VRM_MODE_WRS_CSR_REG22_ADDR A:&base_addr+0x9e1628
y.create.l HWIO_RPMH_VRM_MODE_WRS_CSR_REG23_ADDR A:&base_addr+0x9e1728
y.create.l HWIO_RPMH_VRM_HEADROOM_WRS_CSR_REG0_ADDR A:&base_addr+0x9e002c
y.create.l HWIO_RPMH_VRM_HEADROOM_WRS_CSR_REG1_ADDR A:&base_addr+0x9e012c
y.create.l HWIO_RPMH_VRM_HEADROOM_WRS_CSR_REG2_ADDR A:&base_addr+0x9e022c
y.create.l HWIO_RPMH_VRM_HEADROOM_WRS_CSR_REG3_ADDR A:&base_addr+0x9e032c
y.create.l HWIO_RPMH_VRM_HEADROOM_WRS_CSR_REG4_ADDR A:&base_addr+0x9e042c
y.create.l HWIO_RPMH_VRM_HEADROOM_WRS_CSR_REG5_ADDR A:&base_addr+0x9e052c
y.create.l HWIO_RPMH_VRM_HEADROOM_WRS_CSR_REG6_ADDR A:&base_addr+0x9e062c
y.create.l HWIO_RPMH_VRM_HEADROOM_WRS_CSR_REG7_ADDR A:&base_addr+0x9e072c
y.create.l HWIO_RPMH_VRM_HEADROOM_WRS_CSR_REG8_ADDR A:&base_addr+0x9e082c
y.create.l HWIO_RPMH_VRM_HEADROOM_WRS_CSR_REG9_ADDR A:&base_addr+0x9e092c
y.create.l HWIO_RPMH_VRM_HEADROOM_WRS_CSR_REG10_ADDR A:&base_addr+0x9e0a2c
y.create.l HWIO_RPMH_VRM_HEADROOM_WRS_CSR_REG11_ADDR A:&base_addr+0x9e0b2c
y.create.l HWIO_RPMH_VRM_HEADROOM_WRS_CSR_REG12_ADDR A:&base_addr+0x9e0c2c
y.create.l HWIO_RPMH_VRM_HEADROOM_WRS_CSR_REG13_ADDR A:&base_addr+0x9e0d2c
y.create.l HWIO_RPMH_VRM_HEADROOM_WRS_CSR_REG14_ADDR A:&base_addr+0x9e0e2c
y.create.l HWIO_RPMH_VRM_HEADROOM_WRS_CSR_REG15_ADDR A:&base_addr+0x9e0f2c
y.create.l HWIO_RPMH_VRM_HEADROOM_WRS_CSR_REG16_ADDR A:&base_addr+0x9e102c
y.create.l HWIO_RPMH_VRM_HEADROOM_WRS_CSR_REG17_ADDR A:&base_addr+0x9e112c
y.create.l HWIO_RPMH_VRM_HEADROOM_WRS_CSR_REG18_ADDR A:&base_addr+0x9e122c
y.create.l HWIO_RPMH_VRM_HEADROOM_WRS_CSR_REG19_ADDR A:&base_addr+0x9e132c
y.create.l HWIO_RPMH_VRM_HEADROOM_WRS_CSR_REG20_ADDR A:&base_addr+0x9e142c
y.create.l HWIO_RPMH_VRM_HEADROOM_WRS_CSR_REG21_ADDR A:&base_addr+0x9e152c
y.create.l HWIO_RPMH_VRM_HEADROOM_WRS_CSR_REG22_ADDR A:&base_addr+0x9e162c
y.create.l HWIO_RPMH_VRM_HEADROOM_WRS_CSR_REG23_ADDR A:&base_addr+0x9e172c
y.create.l HWIO_RPMH_VRM_ENABLE_WRS_CSR_XOB0_ADDR A:&base_addr+0x9e1824
y.create.l HWIO_RPMH_VRM_ENABLE_WRS_CSR_XOB1_ADDR A:&base_addr+0x9e1924
y.create.l HWIO_RPMH_VRM_ENABLE_WRS_CSR_XOB2_ADDR A:&base_addr+0x9e1a24
y.create.l HWIO_RPMH_VRM_ENABLE_WRS_CSR_XOB3_ADDR A:&base_addr+0x9e1b24
y.create.l HWIO_RPMH_VRM_ENABLE_WRS_CSR_XOB4_ADDR A:&base_addr+0x9e1c24
y.create.l HWIO_RPMH_VRM_ENABLE_WRS_CSR_XOB5_ADDR A:&base_addr+0x9e1d24
y.create.l HWIO_RPMH_VRM_ENABLE_WRS_CSR_XOB6_ADDR A:&base_addr+0x9e1e24
y.create.l HWIO_RPMH_VRM_ENABLE_WRS_CSR_XOB7_ADDR A:&base_addr+0x9e1f24
y.create.l HWIO_RPMH_VRM_ENABLE_WRS_CSR_XO0_ADDR A:&base_addr+0x9e2024
y.create.l HWIO_RPMH_VRM_VOLTAGE_DRS_CSR_REG0_ADDR A:&base_addr+0x9e0040
y.create.l HWIO_RPMH_VRM_VOLTAGE_DRS_CSR_REG1_ADDR A:&base_addr+0x9e0140
y.create.l HWIO_RPMH_VRM_VOLTAGE_DRS_CSR_REG2_ADDR A:&base_addr+0x9e0240
y.create.l HWIO_RPMH_VRM_VOLTAGE_DRS_CSR_REG3_ADDR A:&base_addr+0x9e0340
y.create.l HWIO_RPMH_VRM_VOLTAGE_DRS_CSR_REG4_ADDR A:&base_addr+0x9e0440
y.create.l HWIO_RPMH_VRM_VOLTAGE_DRS_CSR_REG5_ADDR A:&base_addr+0x9e0540
y.create.l HWIO_RPMH_VRM_VOLTAGE_DRS_CSR_REG6_ADDR A:&base_addr+0x9e0640
y.create.l HWIO_RPMH_VRM_VOLTAGE_DRS_CSR_REG7_ADDR A:&base_addr+0x9e0740
y.create.l HWIO_RPMH_VRM_VOLTAGE_DRS_CSR_REG8_ADDR A:&base_addr+0x9e0840
y.create.l HWIO_RPMH_VRM_VOLTAGE_DRS_CSR_REG9_ADDR A:&base_addr+0x9e0940
y.create.l HWIO_RPMH_VRM_VOLTAGE_DRS_CSR_REG10_ADDR A:&base_addr+0x9e0a40
y.create.l HWIO_RPMH_VRM_VOLTAGE_DRS_CSR_REG11_ADDR A:&base_addr+0x9e0b40
y.create.l HWIO_RPMH_VRM_VOLTAGE_DRS_CSR_REG12_ADDR A:&base_addr+0x9e0c40
y.create.l HWIO_RPMH_VRM_VOLTAGE_DRS_CSR_REG13_ADDR A:&base_addr+0x9e0d40
y.create.l HWIO_RPMH_VRM_VOLTAGE_DRS_CSR_REG14_ADDR A:&base_addr+0x9e0e40
y.create.l HWIO_RPMH_VRM_VOLTAGE_DRS_CSR_REG15_ADDR A:&base_addr+0x9e0f40
y.create.l HWIO_RPMH_VRM_VOLTAGE_DRS_CSR_REG16_ADDR A:&base_addr+0x9e1040
y.create.l HWIO_RPMH_VRM_VOLTAGE_DRS_CSR_REG17_ADDR A:&base_addr+0x9e1140
y.create.l HWIO_RPMH_VRM_VOLTAGE_DRS_CSR_REG18_ADDR A:&base_addr+0x9e1240
y.create.l HWIO_RPMH_VRM_VOLTAGE_DRS_CSR_REG19_ADDR A:&base_addr+0x9e1340
y.create.l HWIO_RPMH_VRM_VOLTAGE_DRS_CSR_REG20_ADDR A:&base_addr+0x9e1440
y.create.l HWIO_RPMH_VRM_VOLTAGE_DRS_CSR_REG21_ADDR A:&base_addr+0x9e1540
y.create.l HWIO_RPMH_VRM_VOLTAGE_DRS_CSR_REG22_ADDR A:&base_addr+0x9e1640
y.create.l HWIO_RPMH_VRM_VOLTAGE_DRS_CSR_REG23_ADDR A:&base_addr+0x9e1740
y.create.l HWIO_RPMH_VRM_ENABLE_DRS_CSR_REG0_ADDR A:&base_addr+0x9e0044
y.create.l HWIO_RPMH_VRM_ENABLE_DRS_CSR_REG1_ADDR A:&base_addr+0x9e0144
y.create.l HWIO_RPMH_VRM_ENABLE_DRS_CSR_REG2_ADDR A:&base_addr+0x9e0244
y.create.l HWIO_RPMH_VRM_ENABLE_DRS_CSR_REG3_ADDR A:&base_addr+0x9e0344
y.create.l HWIO_RPMH_VRM_ENABLE_DRS_CSR_REG4_ADDR A:&base_addr+0x9e0444
y.create.l HWIO_RPMH_VRM_ENABLE_DRS_CSR_REG5_ADDR A:&base_addr+0x9e0544
y.create.l HWIO_RPMH_VRM_ENABLE_DRS_CSR_REG6_ADDR A:&base_addr+0x9e0644
y.create.l HWIO_RPMH_VRM_ENABLE_DRS_CSR_REG7_ADDR A:&base_addr+0x9e0744
y.create.l HWIO_RPMH_VRM_ENABLE_DRS_CSR_REG8_ADDR A:&base_addr+0x9e0844
y.create.l HWIO_RPMH_VRM_ENABLE_DRS_CSR_REG9_ADDR A:&base_addr+0x9e0944
y.create.l HWIO_RPMH_VRM_ENABLE_DRS_CSR_REG10_ADDR A:&base_addr+0x9e0a44
y.create.l HWIO_RPMH_VRM_ENABLE_DRS_CSR_REG11_ADDR A:&base_addr+0x9e0b44
y.create.l HWIO_RPMH_VRM_ENABLE_DRS_CSR_REG12_ADDR A:&base_addr+0x9e0c44
y.create.l HWIO_RPMH_VRM_ENABLE_DRS_CSR_REG13_ADDR A:&base_addr+0x9e0d44
y.create.l HWIO_RPMH_VRM_ENABLE_DRS_CSR_REG14_ADDR A:&base_addr+0x9e0e44
y.create.l HWIO_RPMH_VRM_ENABLE_DRS_CSR_REG15_ADDR A:&base_addr+0x9e0f44
y.create.l HWIO_RPMH_VRM_ENABLE_DRS_CSR_REG16_ADDR A:&base_addr+0x9e1044
y.create.l HWIO_RPMH_VRM_ENABLE_DRS_CSR_REG17_ADDR A:&base_addr+0x9e1144
y.create.l HWIO_RPMH_VRM_ENABLE_DRS_CSR_REG18_ADDR A:&base_addr+0x9e1244
y.create.l HWIO_RPMH_VRM_ENABLE_DRS_CSR_REG19_ADDR A:&base_addr+0x9e1344
y.create.l HWIO_RPMH_VRM_ENABLE_DRS_CSR_REG20_ADDR A:&base_addr+0x9e1444
y.create.l HWIO_RPMH_VRM_ENABLE_DRS_CSR_REG21_ADDR A:&base_addr+0x9e1544
y.create.l HWIO_RPMH_VRM_ENABLE_DRS_CSR_REG22_ADDR A:&base_addr+0x9e1644
y.create.l HWIO_RPMH_VRM_ENABLE_DRS_CSR_REG23_ADDR A:&base_addr+0x9e1744
y.create.l HWIO_RPMH_VRM_MODE_DRS_CSR_REG0_ADDR A:&base_addr+0x9e0048
y.create.l HWIO_RPMH_VRM_MODE_DRS_CSR_REG1_ADDR A:&base_addr+0x9e0148
y.create.l HWIO_RPMH_VRM_MODE_DRS_CSR_REG2_ADDR A:&base_addr+0x9e0248
y.create.l HWIO_RPMH_VRM_MODE_DRS_CSR_REG3_ADDR A:&base_addr+0x9e0348
y.create.l HWIO_RPMH_VRM_MODE_DRS_CSR_REG4_ADDR A:&base_addr+0x9e0448
y.create.l HWIO_RPMH_VRM_MODE_DRS_CSR_REG5_ADDR A:&base_addr+0x9e0548
y.create.l HWIO_RPMH_VRM_MODE_DRS_CSR_REG6_ADDR A:&base_addr+0x9e0648
y.create.l HWIO_RPMH_VRM_MODE_DRS_CSR_REG7_ADDR A:&base_addr+0x9e0748
y.create.l HWIO_RPMH_VRM_MODE_DRS_CSR_REG8_ADDR A:&base_addr+0x9e0848
y.create.l HWIO_RPMH_VRM_MODE_DRS_CSR_REG9_ADDR A:&base_addr+0x9e0948
y.create.l HWIO_RPMH_VRM_MODE_DRS_CSR_REG10_ADDR A:&base_addr+0x9e0a48
y.create.l HWIO_RPMH_VRM_MODE_DRS_CSR_REG11_ADDR A:&base_addr+0x9e0b48
y.create.l HWIO_RPMH_VRM_MODE_DRS_CSR_REG12_ADDR A:&base_addr+0x9e0c48
y.create.l HWIO_RPMH_VRM_MODE_DRS_CSR_REG13_ADDR A:&base_addr+0x9e0d48
y.create.l HWIO_RPMH_VRM_MODE_DRS_CSR_REG14_ADDR A:&base_addr+0x9e0e48
y.create.l HWIO_RPMH_VRM_MODE_DRS_CSR_REG15_ADDR A:&base_addr+0x9e0f48
y.create.l HWIO_RPMH_VRM_MODE_DRS_CSR_REG16_ADDR A:&base_addr+0x9e1048
y.create.l HWIO_RPMH_VRM_MODE_DRS_CSR_REG17_ADDR A:&base_addr+0x9e1148
y.create.l HWIO_RPMH_VRM_MODE_DRS_CSR_REG18_ADDR A:&base_addr+0x9e1248
y.create.l HWIO_RPMH_VRM_MODE_DRS_CSR_REG19_ADDR A:&base_addr+0x9e1348
y.create.l HWIO_RPMH_VRM_MODE_DRS_CSR_REG20_ADDR A:&base_addr+0x9e1448
y.create.l HWIO_RPMH_VRM_MODE_DRS_CSR_REG21_ADDR A:&base_addr+0x9e1548
y.create.l HWIO_RPMH_VRM_MODE_DRS_CSR_REG22_ADDR A:&base_addr+0x9e1648
y.create.l HWIO_RPMH_VRM_MODE_DRS_CSR_REG23_ADDR A:&base_addr+0x9e1748
y.create.l HWIO_RPMH_VRM_HEADROOM_DRS_CSR_REG0_ADDR A:&base_addr+0x9e004c
y.create.l HWIO_RPMH_VRM_HEADROOM_DRS_CSR_REG1_ADDR A:&base_addr+0x9e014c
y.create.l HWIO_RPMH_VRM_HEADROOM_DRS_CSR_REG2_ADDR A:&base_addr+0x9e024c
y.create.l HWIO_RPMH_VRM_HEADROOM_DRS_CSR_REG3_ADDR A:&base_addr+0x9e034c
y.create.l HWIO_RPMH_VRM_HEADROOM_DRS_CSR_REG4_ADDR A:&base_addr+0x9e044c
y.create.l HWIO_RPMH_VRM_HEADROOM_DRS_CSR_REG5_ADDR A:&base_addr+0x9e054c
y.create.l HWIO_RPMH_VRM_HEADROOM_DRS_CSR_REG6_ADDR A:&base_addr+0x9e064c
y.create.l HWIO_RPMH_VRM_HEADROOM_DRS_CSR_REG7_ADDR A:&base_addr+0x9e074c
y.create.l HWIO_RPMH_VRM_HEADROOM_DRS_CSR_REG8_ADDR A:&base_addr+0x9e084c
y.create.l HWIO_RPMH_VRM_HEADROOM_DRS_CSR_REG9_ADDR A:&base_addr+0x9e094c
y.create.l HWIO_RPMH_VRM_HEADROOM_DRS_CSR_REG10_ADDR A:&base_addr+0x9e0a4c
y.create.l HWIO_RPMH_VRM_HEADROOM_DRS_CSR_REG11_ADDR A:&base_addr+0x9e0b4c
y.create.l HWIO_RPMH_VRM_HEADROOM_DRS_CSR_REG12_ADDR A:&base_addr+0x9e0c4c
y.create.l HWIO_RPMH_VRM_HEADROOM_DRS_CSR_REG13_ADDR A:&base_addr+0x9e0d4c
y.create.l HWIO_RPMH_VRM_HEADROOM_DRS_CSR_REG14_ADDR A:&base_addr+0x9e0e4c
y.create.l HWIO_RPMH_VRM_HEADROOM_DRS_CSR_REG15_ADDR A:&base_addr+0x9e0f4c
y.create.l HWIO_RPMH_VRM_HEADROOM_DRS_CSR_REG16_ADDR A:&base_addr+0x9e104c
y.create.l HWIO_RPMH_VRM_HEADROOM_DRS_CSR_REG17_ADDR A:&base_addr+0x9e114c
y.create.l HWIO_RPMH_VRM_HEADROOM_DRS_CSR_REG18_ADDR A:&base_addr+0x9e124c
y.create.l HWIO_RPMH_VRM_HEADROOM_DRS_CSR_REG19_ADDR A:&base_addr+0x9e134c
y.create.l HWIO_RPMH_VRM_HEADROOM_DRS_CSR_REG20_ADDR A:&base_addr+0x9e144c
y.create.l HWIO_RPMH_VRM_HEADROOM_DRS_CSR_REG21_ADDR A:&base_addr+0x9e154c
y.create.l HWIO_RPMH_VRM_HEADROOM_DRS_CSR_REG22_ADDR A:&base_addr+0x9e164c
y.create.l HWIO_RPMH_VRM_HEADROOM_DRS_CSR_REG23_ADDR A:&base_addr+0x9e174c
y.create.l HWIO_RPMH_VRM_ENABLE_DRS_CSR_XOB0_ADDR A:&base_addr+0x9e1844
y.create.l HWIO_RPMH_VRM_ENABLE_DRS_CSR_XOB1_ADDR A:&base_addr+0x9e1944
y.create.l HWIO_RPMH_VRM_ENABLE_DRS_CSR_XOB2_ADDR A:&base_addr+0x9e1a44
y.create.l HWIO_RPMH_VRM_ENABLE_DRS_CSR_XOB3_ADDR A:&base_addr+0x9e1b44
y.create.l HWIO_RPMH_VRM_ENABLE_DRS_CSR_XOB4_ADDR A:&base_addr+0x9e1c44
y.create.l HWIO_RPMH_VRM_ENABLE_DRS_CSR_XOB5_ADDR A:&base_addr+0x9e1d44
y.create.l HWIO_RPMH_VRM_ENABLE_DRS_CSR_XOB6_ADDR A:&base_addr+0x9e1e44
y.create.l HWIO_RPMH_VRM_ENABLE_DRS_CSR_XOB7_ADDR A:&base_addr+0x9e1f44
y.create.l HWIO_RPMH_VRM_ENABLE_DRS_CSR_XO0_ADDR A:&base_addr+0x9e2044
y.create.l HWIO_RPMH_VRM_VOLTAGE_ARS_CSR_REG0_ADDR A:&base_addr+0x9e0060
y.create.l HWIO_RPMH_VRM_VOLTAGE_ARS_CSR_REG1_ADDR A:&base_addr+0x9e0160
y.create.l HWIO_RPMH_VRM_VOLTAGE_ARS_CSR_REG2_ADDR A:&base_addr+0x9e0260
y.create.l HWIO_RPMH_VRM_VOLTAGE_ARS_CSR_REG3_ADDR A:&base_addr+0x9e0360
y.create.l HWIO_RPMH_VRM_VOLTAGE_ARS_CSR_REG4_ADDR A:&base_addr+0x9e0460
y.create.l HWIO_RPMH_VRM_VOLTAGE_ARS_CSR_REG5_ADDR A:&base_addr+0x9e0560
y.create.l HWIO_RPMH_VRM_VOLTAGE_ARS_CSR_REG6_ADDR A:&base_addr+0x9e0660
y.create.l HWIO_RPMH_VRM_VOLTAGE_ARS_CSR_REG7_ADDR A:&base_addr+0x9e0760
y.create.l HWIO_RPMH_VRM_VOLTAGE_ARS_CSR_REG8_ADDR A:&base_addr+0x9e0860
y.create.l HWIO_RPMH_VRM_VOLTAGE_ARS_CSR_REG9_ADDR A:&base_addr+0x9e0960
y.create.l HWIO_RPMH_VRM_VOLTAGE_ARS_CSR_REG10_ADDR A:&base_addr+0x9e0a60
y.create.l HWIO_RPMH_VRM_VOLTAGE_ARS_CSR_REG11_ADDR A:&base_addr+0x9e0b60
y.create.l HWIO_RPMH_VRM_VOLTAGE_ARS_CSR_REG12_ADDR A:&base_addr+0x9e0c60
y.create.l HWIO_RPMH_VRM_VOLTAGE_ARS_CSR_REG13_ADDR A:&base_addr+0x9e0d60
y.create.l HWIO_RPMH_VRM_VOLTAGE_ARS_CSR_REG14_ADDR A:&base_addr+0x9e0e60
y.create.l HWIO_RPMH_VRM_VOLTAGE_ARS_CSR_REG15_ADDR A:&base_addr+0x9e0f60
y.create.l HWIO_RPMH_VRM_VOLTAGE_ARS_CSR_REG16_ADDR A:&base_addr+0x9e1060
y.create.l HWIO_RPMH_VRM_VOLTAGE_ARS_CSR_REG17_ADDR A:&base_addr+0x9e1160
y.create.l HWIO_RPMH_VRM_VOLTAGE_ARS_CSR_REG18_ADDR A:&base_addr+0x9e1260
y.create.l HWIO_RPMH_VRM_VOLTAGE_ARS_CSR_REG19_ADDR A:&base_addr+0x9e1360
y.create.l HWIO_RPMH_VRM_VOLTAGE_ARS_CSR_REG20_ADDR A:&base_addr+0x9e1460
y.create.l HWIO_RPMH_VRM_VOLTAGE_ARS_CSR_REG21_ADDR A:&base_addr+0x9e1560
y.create.l HWIO_RPMH_VRM_VOLTAGE_ARS_CSR_REG22_ADDR A:&base_addr+0x9e1660
y.create.l HWIO_RPMH_VRM_VOLTAGE_ARS_CSR_REG23_ADDR A:&base_addr+0x9e1760
y.create.l HWIO_RPMH_VRM_ENABLE_ARS_CSR_REG0_ADDR A:&base_addr+0x9e0064
y.create.l HWIO_RPMH_VRM_ENABLE_ARS_CSR_REG1_ADDR A:&base_addr+0x9e0164
y.create.l HWIO_RPMH_VRM_ENABLE_ARS_CSR_REG2_ADDR A:&base_addr+0x9e0264
y.create.l HWIO_RPMH_VRM_ENABLE_ARS_CSR_REG3_ADDR A:&base_addr+0x9e0364
y.create.l HWIO_RPMH_VRM_ENABLE_ARS_CSR_REG4_ADDR A:&base_addr+0x9e0464
y.create.l HWIO_RPMH_VRM_ENABLE_ARS_CSR_REG5_ADDR A:&base_addr+0x9e0564
y.create.l HWIO_RPMH_VRM_ENABLE_ARS_CSR_REG6_ADDR A:&base_addr+0x9e0664
y.create.l HWIO_RPMH_VRM_ENABLE_ARS_CSR_REG7_ADDR A:&base_addr+0x9e0764
y.create.l HWIO_RPMH_VRM_ENABLE_ARS_CSR_REG8_ADDR A:&base_addr+0x9e0864
y.create.l HWIO_RPMH_VRM_ENABLE_ARS_CSR_REG9_ADDR A:&base_addr+0x9e0964
y.create.l HWIO_RPMH_VRM_ENABLE_ARS_CSR_REG10_ADDR A:&base_addr+0x9e0a64
y.create.l HWIO_RPMH_VRM_ENABLE_ARS_CSR_REG11_ADDR A:&base_addr+0x9e0b64
y.create.l HWIO_RPMH_VRM_ENABLE_ARS_CSR_REG12_ADDR A:&base_addr+0x9e0c64
y.create.l HWIO_RPMH_VRM_ENABLE_ARS_CSR_REG13_ADDR A:&base_addr+0x9e0d64
y.create.l HWIO_RPMH_VRM_ENABLE_ARS_CSR_REG14_ADDR A:&base_addr+0x9e0e64
y.create.l HWIO_RPMH_VRM_ENABLE_ARS_CSR_REG15_ADDR A:&base_addr+0x9e0f64
y.create.l HWIO_RPMH_VRM_ENABLE_ARS_CSR_REG16_ADDR A:&base_addr+0x9e1064
y.create.l HWIO_RPMH_VRM_ENABLE_ARS_CSR_REG17_ADDR A:&base_addr+0x9e1164
y.create.l HWIO_RPMH_VRM_ENABLE_ARS_CSR_REG18_ADDR A:&base_addr+0x9e1264
y.create.l HWIO_RPMH_VRM_ENABLE_ARS_CSR_REG19_ADDR A:&base_addr+0x9e1364
y.create.l HWIO_RPMH_VRM_ENABLE_ARS_CSR_REG20_ADDR A:&base_addr+0x9e1464
y.create.l HWIO_RPMH_VRM_ENABLE_ARS_CSR_REG21_ADDR A:&base_addr+0x9e1564
y.create.l HWIO_RPMH_VRM_ENABLE_ARS_CSR_REG22_ADDR A:&base_addr+0x9e1664
y.create.l HWIO_RPMH_VRM_ENABLE_ARS_CSR_REG23_ADDR A:&base_addr+0x9e1764
y.create.l HWIO_RPMH_VRM_MODE_ARS_CSR_REG0_ADDR A:&base_addr+0x9e0068
y.create.l HWIO_RPMH_VRM_MODE_ARS_CSR_REG1_ADDR A:&base_addr+0x9e0168
y.create.l HWIO_RPMH_VRM_MODE_ARS_CSR_REG2_ADDR A:&base_addr+0x9e0268
y.create.l HWIO_RPMH_VRM_MODE_ARS_CSR_REG3_ADDR A:&base_addr+0x9e0368
y.create.l HWIO_RPMH_VRM_MODE_ARS_CSR_REG4_ADDR A:&base_addr+0x9e0468
y.create.l HWIO_RPMH_VRM_MODE_ARS_CSR_REG5_ADDR A:&base_addr+0x9e0568
y.create.l HWIO_RPMH_VRM_MODE_ARS_CSR_REG6_ADDR A:&base_addr+0x9e0668
y.create.l HWIO_RPMH_VRM_MODE_ARS_CSR_REG7_ADDR A:&base_addr+0x9e0768
y.create.l HWIO_RPMH_VRM_MODE_ARS_CSR_REG8_ADDR A:&base_addr+0x9e0868
y.create.l HWIO_RPMH_VRM_MODE_ARS_CSR_REG9_ADDR A:&base_addr+0x9e0968
y.create.l HWIO_RPMH_VRM_MODE_ARS_CSR_REG10_ADDR A:&base_addr+0x9e0a68
y.create.l HWIO_RPMH_VRM_MODE_ARS_CSR_REG11_ADDR A:&base_addr+0x9e0b68
y.create.l HWIO_RPMH_VRM_MODE_ARS_CSR_REG12_ADDR A:&base_addr+0x9e0c68
y.create.l HWIO_RPMH_VRM_MODE_ARS_CSR_REG13_ADDR A:&base_addr+0x9e0d68
y.create.l HWIO_RPMH_VRM_MODE_ARS_CSR_REG14_ADDR A:&base_addr+0x9e0e68
y.create.l HWIO_RPMH_VRM_MODE_ARS_CSR_REG15_ADDR A:&base_addr+0x9e0f68
y.create.l HWIO_RPMH_VRM_MODE_ARS_CSR_REG16_ADDR A:&base_addr+0x9e1068
y.create.l HWIO_RPMH_VRM_MODE_ARS_CSR_REG17_ADDR A:&base_addr+0x9e1168
y.create.l HWIO_RPMH_VRM_MODE_ARS_CSR_REG18_ADDR A:&base_addr+0x9e1268
y.create.l HWIO_RPMH_VRM_MODE_ARS_CSR_REG19_ADDR A:&base_addr+0x9e1368
y.create.l HWIO_RPMH_VRM_MODE_ARS_CSR_REG20_ADDR A:&base_addr+0x9e1468
y.create.l HWIO_RPMH_VRM_MODE_ARS_CSR_REG21_ADDR A:&base_addr+0x9e1568
y.create.l HWIO_RPMH_VRM_MODE_ARS_CSR_REG22_ADDR A:&base_addr+0x9e1668
y.create.l HWIO_RPMH_VRM_MODE_ARS_CSR_REG23_ADDR A:&base_addr+0x9e1768
y.create.l HWIO_RPMH_VRM_HEADROOM_ARS_CSR_REG0_ADDR A:&base_addr+0x9e006c
y.create.l HWIO_RPMH_VRM_HEADROOM_ARS_CSR_REG1_ADDR A:&base_addr+0x9e016c
y.create.l HWIO_RPMH_VRM_HEADROOM_ARS_CSR_REG2_ADDR A:&base_addr+0x9e026c
y.create.l HWIO_RPMH_VRM_HEADROOM_ARS_CSR_REG3_ADDR A:&base_addr+0x9e036c
y.create.l HWIO_RPMH_VRM_HEADROOM_ARS_CSR_REG4_ADDR A:&base_addr+0x9e046c
y.create.l HWIO_RPMH_VRM_HEADROOM_ARS_CSR_REG5_ADDR A:&base_addr+0x9e056c
y.create.l HWIO_RPMH_VRM_HEADROOM_ARS_CSR_REG6_ADDR A:&base_addr+0x9e066c
y.create.l HWIO_RPMH_VRM_HEADROOM_ARS_CSR_REG7_ADDR A:&base_addr+0x9e076c
y.create.l HWIO_RPMH_VRM_HEADROOM_ARS_CSR_REG8_ADDR A:&base_addr+0x9e086c
y.create.l HWIO_RPMH_VRM_HEADROOM_ARS_CSR_REG9_ADDR A:&base_addr+0x9e096c
y.create.l HWIO_RPMH_VRM_HEADROOM_ARS_CSR_REG10_ADDR A:&base_addr+0x9e0a6c
y.create.l HWIO_RPMH_VRM_HEADROOM_ARS_CSR_REG11_ADDR A:&base_addr+0x9e0b6c
y.create.l HWIO_RPMH_VRM_HEADROOM_ARS_CSR_REG12_ADDR A:&base_addr+0x9e0c6c
y.create.l HWIO_RPMH_VRM_HEADROOM_ARS_CSR_REG13_ADDR A:&base_addr+0x9e0d6c
y.create.l HWIO_RPMH_VRM_HEADROOM_ARS_CSR_REG14_ADDR A:&base_addr+0x9e0e6c
y.create.l HWIO_RPMH_VRM_HEADROOM_ARS_CSR_REG15_ADDR A:&base_addr+0x9e0f6c
y.create.l HWIO_RPMH_VRM_HEADROOM_ARS_CSR_REG16_ADDR A:&base_addr+0x9e106c
y.create.l HWIO_RPMH_VRM_HEADROOM_ARS_CSR_REG17_ADDR A:&base_addr+0x9e116c
y.create.l HWIO_RPMH_VRM_HEADROOM_ARS_CSR_REG18_ADDR A:&base_addr+0x9e126c
y.create.l HWIO_RPMH_VRM_HEADROOM_ARS_CSR_REG19_ADDR A:&base_addr+0x9e136c
y.create.l HWIO_RPMH_VRM_HEADROOM_ARS_CSR_REG20_ADDR A:&base_addr+0x9e146c
y.create.l HWIO_RPMH_VRM_HEADROOM_ARS_CSR_REG21_ADDR A:&base_addr+0x9e156c
y.create.l HWIO_RPMH_VRM_HEADROOM_ARS_CSR_REG22_ADDR A:&base_addr+0x9e166c
y.create.l HWIO_RPMH_VRM_HEADROOM_ARS_CSR_REG23_ADDR A:&base_addr+0x9e176c
y.create.l HWIO_RPMH_VRM_ENABLE_ARS_CSR_XOB0_ADDR A:&base_addr+0x9e1864
y.create.l HWIO_RPMH_VRM_ENABLE_ARS_CSR_XOB1_ADDR A:&base_addr+0x9e1964
y.create.l HWIO_RPMH_VRM_ENABLE_ARS_CSR_XOB2_ADDR A:&base_addr+0x9e1a64
y.create.l HWIO_RPMH_VRM_ENABLE_ARS_CSR_XOB3_ADDR A:&base_addr+0x9e1b64
y.create.l HWIO_RPMH_VRM_ENABLE_ARS_CSR_XOB4_ADDR A:&base_addr+0x9e1c64
y.create.l HWIO_RPMH_VRM_ENABLE_ARS_CSR_XOB5_ADDR A:&base_addr+0x9e1d64
y.create.l HWIO_RPMH_VRM_ENABLE_ARS_CSR_XOB6_ADDR A:&base_addr+0x9e1e64
y.create.l HWIO_RPMH_VRM_ENABLE_ARS_CSR_XOB7_ADDR A:&base_addr+0x9e1f64
y.create.l HWIO_RPMH_VRM_ENABLE_ARS_CSR_XO0_ADDR A:&base_addr+0x9e2064
y.create.l HWIO_RPMH_VRM_TYPE_CSR_REG0_ADDR A:&base_addr+0x9e0080
y.create.l HWIO_RPMH_VRM_TYPE_CSR_REG1_ADDR A:&base_addr+0x9e0180
y.create.l HWIO_RPMH_VRM_TYPE_CSR_REG2_ADDR A:&base_addr+0x9e0280
y.create.l HWIO_RPMH_VRM_TYPE_CSR_REG3_ADDR A:&base_addr+0x9e0380
y.create.l HWIO_RPMH_VRM_TYPE_CSR_REG4_ADDR A:&base_addr+0x9e0480
y.create.l HWIO_RPMH_VRM_TYPE_CSR_REG5_ADDR A:&base_addr+0x9e0580
y.create.l HWIO_RPMH_VRM_TYPE_CSR_REG6_ADDR A:&base_addr+0x9e0680
y.create.l HWIO_RPMH_VRM_TYPE_CSR_REG7_ADDR A:&base_addr+0x9e0780
y.create.l HWIO_RPMH_VRM_TYPE_CSR_REG8_ADDR A:&base_addr+0x9e0880
y.create.l HWIO_RPMH_VRM_TYPE_CSR_REG9_ADDR A:&base_addr+0x9e0980
y.create.l HWIO_RPMH_VRM_TYPE_CSR_REG10_ADDR A:&base_addr+0x9e0a80
y.create.l HWIO_RPMH_VRM_TYPE_CSR_REG11_ADDR A:&base_addr+0x9e0b80
y.create.l HWIO_RPMH_VRM_TYPE_CSR_REG12_ADDR A:&base_addr+0x9e0c80
y.create.l HWIO_RPMH_VRM_TYPE_CSR_REG13_ADDR A:&base_addr+0x9e0d80
y.create.l HWIO_RPMH_VRM_TYPE_CSR_REG14_ADDR A:&base_addr+0x9e0e80
y.create.l HWIO_RPMH_VRM_TYPE_CSR_REG15_ADDR A:&base_addr+0x9e0f80
y.create.l HWIO_RPMH_VRM_TYPE_CSR_REG16_ADDR A:&base_addr+0x9e1080
y.create.l HWIO_RPMH_VRM_TYPE_CSR_REG17_ADDR A:&base_addr+0x9e1180
y.create.l HWIO_RPMH_VRM_TYPE_CSR_REG18_ADDR A:&base_addr+0x9e1280
y.create.l HWIO_RPMH_VRM_TYPE_CSR_REG19_ADDR A:&base_addr+0x9e1380
y.create.l HWIO_RPMH_VRM_TYPE_CSR_REG20_ADDR A:&base_addr+0x9e1480
y.create.l HWIO_RPMH_VRM_TYPE_CSR_REG21_ADDR A:&base_addr+0x9e1580
y.create.l HWIO_RPMH_VRM_TYPE_CSR_REG22_ADDR A:&base_addr+0x9e1680
y.create.l HWIO_RPMH_VRM_TYPE_CSR_REG23_ADDR A:&base_addr+0x9e1780
y.create.l HWIO_RPMH_VRM_BASE_ADDR_CSR_REG0_ADDR A:&base_addr+0x9e0084
y.create.l HWIO_RPMH_VRM_BASE_ADDR_CSR_REG1_ADDR A:&base_addr+0x9e0184
y.create.l HWIO_RPMH_VRM_BASE_ADDR_CSR_REG2_ADDR A:&base_addr+0x9e0284
y.create.l HWIO_RPMH_VRM_BASE_ADDR_CSR_REG3_ADDR A:&base_addr+0x9e0384
y.create.l HWIO_RPMH_VRM_BASE_ADDR_CSR_REG4_ADDR A:&base_addr+0x9e0484
y.create.l HWIO_RPMH_VRM_BASE_ADDR_CSR_REG5_ADDR A:&base_addr+0x9e0584
y.create.l HWIO_RPMH_VRM_BASE_ADDR_CSR_REG6_ADDR A:&base_addr+0x9e0684
y.create.l HWIO_RPMH_VRM_BASE_ADDR_CSR_REG7_ADDR A:&base_addr+0x9e0784
y.create.l HWIO_RPMH_VRM_BASE_ADDR_CSR_REG8_ADDR A:&base_addr+0x9e0884
y.create.l HWIO_RPMH_VRM_BASE_ADDR_CSR_REG9_ADDR A:&base_addr+0x9e0984
y.create.l HWIO_RPMH_VRM_BASE_ADDR_CSR_REG10_ADDR A:&base_addr+0x9e0a84
y.create.l HWIO_RPMH_VRM_BASE_ADDR_CSR_REG11_ADDR A:&base_addr+0x9e0b84
y.create.l HWIO_RPMH_VRM_BASE_ADDR_CSR_REG12_ADDR A:&base_addr+0x9e0c84
y.create.l HWIO_RPMH_VRM_BASE_ADDR_CSR_REG13_ADDR A:&base_addr+0x9e0d84
y.create.l HWIO_RPMH_VRM_BASE_ADDR_CSR_REG14_ADDR A:&base_addr+0x9e0e84
y.create.l HWIO_RPMH_VRM_BASE_ADDR_CSR_REG15_ADDR A:&base_addr+0x9e0f84
y.create.l HWIO_RPMH_VRM_BASE_ADDR_CSR_REG16_ADDR A:&base_addr+0x9e1084
y.create.l HWIO_RPMH_VRM_BASE_ADDR_CSR_REG17_ADDR A:&base_addr+0x9e1184
y.create.l HWIO_RPMH_VRM_BASE_ADDR_CSR_REG18_ADDR A:&base_addr+0x9e1284
y.create.l HWIO_RPMH_VRM_BASE_ADDR_CSR_REG19_ADDR A:&base_addr+0x9e1384
y.create.l HWIO_RPMH_VRM_BASE_ADDR_CSR_REG20_ADDR A:&base_addr+0x9e1484
y.create.l HWIO_RPMH_VRM_BASE_ADDR_CSR_REG21_ADDR A:&base_addr+0x9e1584
y.create.l HWIO_RPMH_VRM_BASE_ADDR_CSR_REG22_ADDR A:&base_addr+0x9e1684
y.create.l HWIO_RPMH_VRM_BASE_ADDR_CSR_REG23_ADDR A:&base_addr+0x9e1784
y.create.l HWIO_RPMH_VRM_MAX_VOLTAGE_CSR_REG0_ADDR A:&base_addr+0x9e0088
y.create.l HWIO_RPMH_VRM_MAX_VOLTAGE_CSR_REG1_ADDR A:&base_addr+0x9e0188
y.create.l HWIO_RPMH_VRM_MAX_VOLTAGE_CSR_REG2_ADDR A:&base_addr+0x9e0288
y.create.l HWIO_RPMH_VRM_MAX_VOLTAGE_CSR_REG3_ADDR A:&base_addr+0x9e0388
y.create.l HWIO_RPMH_VRM_MAX_VOLTAGE_CSR_REG4_ADDR A:&base_addr+0x9e0488
y.create.l HWIO_RPMH_VRM_MAX_VOLTAGE_CSR_REG5_ADDR A:&base_addr+0x9e0588
y.create.l HWIO_RPMH_VRM_MAX_VOLTAGE_CSR_REG6_ADDR A:&base_addr+0x9e0688
y.create.l HWIO_RPMH_VRM_MAX_VOLTAGE_CSR_REG7_ADDR A:&base_addr+0x9e0788
y.create.l HWIO_RPMH_VRM_MAX_VOLTAGE_CSR_REG8_ADDR A:&base_addr+0x9e0888
y.create.l HWIO_RPMH_VRM_MAX_VOLTAGE_CSR_REG9_ADDR A:&base_addr+0x9e0988
y.create.l HWIO_RPMH_VRM_MAX_VOLTAGE_CSR_REG10_ADDR A:&base_addr+0x9e0a88
y.create.l HWIO_RPMH_VRM_MAX_VOLTAGE_CSR_REG11_ADDR A:&base_addr+0x9e0b88
y.create.l HWIO_RPMH_VRM_MAX_VOLTAGE_CSR_REG12_ADDR A:&base_addr+0x9e0c88
y.create.l HWIO_RPMH_VRM_MAX_VOLTAGE_CSR_REG13_ADDR A:&base_addr+0x9e0d88
y.create.l HWIO_RPMH_VRM_MAX_VOLTAGE_CSR_REG14_ADDR A:&base_addr+0x9e0e88
y.create.l HWIO_RPMH_VRM_MAX_VOLTAGE_CSR_REG15_ADDR A:&base_addr+0x9e0f88
y.create.l HWIO_RPMH_VRM_MAX_VOLTAGE_CSR_REG16_ADDR A:&base_addr+0x9e1088
y.create.l HWIO_RPMH_VRM_MAX_VOLTAGE_CSR_REG17_ADDR A:&base_addr+0x9e1188
y.create.l HWIO_RPMH_VRM_MAX_VOLTAGE_CSR_REG18_ADDR A:&base_addr+0x9e1288
y.create.l HWIO_RPMH_VRM_MAX_VOLTAGE_CSR_REG19_ADDR A:&base_addr+0x9e1388
y.create.l HWIO_RPMH_VRM_MAX_VOLTAGE_CSR_REG20_ADDR A:&base_addr+0x9e1488
y.create.l HWIO_RPMH_VRM_MAX_VOLTAGE_CSR_REG21_ADDR A:&base_addr+0x9e1588
y.create.l HWIO_RPMH_VRM_MAX_VOLTAGE_CSR_REG22_ADDR A:&base_addr+0x9e1688
y.create.l HWIO_RPMH_VRM_MAX_VOLTAGE_CSR_REG23_ADDR A:&base_addr+0x9e1788
y.create.l HWIO_RPMH_VRM_VOLTAGE_SEQ_ID_CSR_REG0_ADDR A:&base_addr+0x9e008c
y.create.l HWIO_RPMH_VRM_VOLTAGE_SEQ_ID_CSR_REG1_ADDR A:&base_addr+0x9e018c
y.create.l HWIO_RPMH_VRM_VOLTAGE_SEQ_ID_CSR_REG2_ADDR A:&base_addr+0x9e028c
y.create.l HWIO_RPMH_VRM_VOLTAGE_SEQ_ID_CSR_REG3_ADDR A:&base_addr+0x9e038c
y.create.l HWIO_RPMH_VRM_VOLTAGE_SEQ_ID_CSR_REG4_ADDR A:&base_addr+0x9e048c
y.create.l HWIO_RPMH_VRM_VOLTAGE_SEQ_ID_CSR_REG5_ADDR A:&base_addr+0x9e058c
y.create.l HWIO_RPMH_VRM_VOLTAGE_SEQ_ID_CSR_REG6_ADDR A:&base_addr+0x9e068c
y.create.l HWIO_RPMH_VRM_VOLTAGE_SEQ_ID_CSR_REG7_ADDR A:&base_addr+0x9e078c
y.create.l HWIO_RPMH_VRM_VOLTAGE_SEQ_ID_CSR_REG8_ADDR A:&base_addr+0x9e088c
y.create.l HWIO_RPMH_VRM_VOLTAGE_SEQ_ID_CSR_REG9_ADDR A:&base_addr+0x9e098c
y.create.l HWIO_RPMH_VRM_VOLTAGE_SEQ_ID_CSR_REG10_ADDR A:&base_addr+0x9e0a8c
y.create.l HWIO_RPMH_VRM_VOLTAGE_SEQ_ID_CSR_REG11_ADDR A:&base_addr+0x9e0b8c
y.create.l HWIO_RPMH_VRM_VOLTAGE_SEQ_ID_CSR_REG12_ADDR A:&base_addr+0x9e0c8c
y.create.l HWIO_RPMH_VRM_VOLTAGE_SEQ_ID_CSR_REG13_ADDR A:&base_addr+0x9e0d8c
y.create.l HWIO_RPMH_VRM_VOLTAGE_SEQ_ID_CSR_REG14_ADDR A:&base_addr+0x9e0e8c
y.create.l HWIO_RPMH_VRM_VOLTAGE_SEQ_ID_CSR_REG15_ADDR A:&base_addr+0x9e0f8c
y.create.l HWIO_RPMH_VRM_VOLTAGE_SEQ_ID_CSR_REG16_ADDR A:&base_addr+0x9e108c
y.create.l HWIO_RPMH_VRM_VOLTAGE_SEQ_ID_CSR_REG17_ADDR A:&base_addr+0x9e118c
y.create.l HWIO_RPMH_VRM_VOLTAGE_SEQ_ID_CSR_REG18_ADDR A:&base_addr+0x9e128c
y.create.l HWIO_RPMH_VRM_VOLTAGE_SEQ_ID_CSR_REG19_ADDR A:&base_addr+0x9e138c
y.create.l HWIO_RPMH_VRM_VOLTAGE_SEQ_ID_CSR_REG20_ADDR A:&base_addr+0x9e148c
y.create.l HWIO_RPMH_VRM_VOLTAGE_SEQ_ID_CSR_REG21_ADDR A:&base_addr+0x9e158c
y.create.l HWIO_RPMH_VRM_VOLTAGE_SEQ_ID_CSR_REG22_ADDR A:&base_addr+0x9e168c
y.create.l HWIO_RPMH_VRM_VOLTAGE_SEQ_ID_CSR_REG23_ADDR A:&base_addr+0x9e178c
y.create.l HWIO_RPMH_VRM_ENABLE_SEQ_ID_CSR_REG0_ADDR A:&base_addr+0x9e0090
y.create.l HWIO_RPMH_VRM_ENABLE_SEQ_ID_CSR_REG1_ADDR A:&base_addr+0x9e0190
y.create.l HWIO_RPMH_VRM_ENABLE_SEQ_ID_CSR_REG2_ADDR A:&base_addr+0x9e0290
y.create.l HWIO_RPMH_VRM_ENABLE_SEQ_ID_CSR_REG3_ADDR A:&base_addr+0x9e0390
y.create.l HWIO_RPMH_VRM_ENABLE_SEQ_ID_CSR_REG4_ADDR A:&base_addr+0x9e0490
y.create.l HWIO_RPMH_VRM_ENABLE_SEQ_ID_CSR_REG5_ADDR A:&base_addr+0x9e0590
y.create.l HWIO_RPMH_VRM_ENABLE_SEQ_ID_CSR_REG6_ADDR A:&base_addr+0x9e0690
y.create.l HWIO_RPMH_VRM_ENABLE_SEQ_ID_CSR_REG7_ADDR A:&base_addr+0x9e0790
y.create.l HWIO_RPMH_VRM_ENABLE_SEQ_ID_CSR_REG8_ADDR A:&base_addr+0x9e0890
y.create.l HWIO_RPMH_VRM_ENABLE_SEQ_ID_CSR_REG9_ADDR A:&base_addr+0x9e0990
y.create.l HWIO_RPMH_VRM_ENABLE_SEQ_ID_CSR_REG10_ADDR A:&base_addr+0x9e0a90
y.create.l HWIO_RPMH_VRM_ENABLE_SEQ_ID_CSR_REG11_ADDR A:&base_addr+0x9e0b90
y.create.l HWIO_RPMH_VRM_ENABLE_SEQ_ID_CSR_REG12_ADDR A:&base_addr+0x9e0c90
y.create.l HWIO_RPMH_VRM_ENABLE_SEQ_ID_CSR_REG13_ADDR A:&base_addr+0x9e0d90
y.create.l HWIO_RPMH_VRM_ENABLE_SEQ_ID_CSR_REG14_ADDR A:&base_addr+0x9e0e90
y.create.l HWIO_RPMH_VRM_ENABLE_SEQ_ID_CSR_REG15_ADDR A:&base_addr+0x9e0f90
y.create.l HWIO_RPMH_VRM_ENABLE_SEQ_ID_CSR_REG16_ADDR A:&base_addr+0x9e1090
y.create.l HWIO_RPMH_VRM_ENABLE_SEQ_ID_CSR_REG17_ADDR A:&base_addr+0x9e1190
y.create.l HWIO_RPMH_VRM_ENABLE_SEQ_ID_CSR_REG18_ADDR A:&base_addr+0x9e1290
y.create.l HWIO_RPMH_VRM_ENABLE_SEQ_ID_CSR_REG19_ADDR A:&base_addr+0x9e1390
y.create.l HWIO_RPMH_VRM_ENABLE_SEQ_ID_CSR_REG20_ADDR A:&base_addr+0x9e1490
y.create.l HWIO_RPMH_VRM_ENABLE_SEQ_ID_CSR_REG21_ADDR A:&base_addr+0x9e1590
y.create.l HWIO_RPMH_VRM_ENABLE_SEQ_ID_CSR_REG22_ADDR A:&base_addr+0x9e1690
y.create.l HWIO_RPMH_VRM_ENABLE_SEQ_ID_CSR_REG23_ADDR A:&base_addr+0x9e1790
y.create.l HWIO_RPMH_VRM_MODE_SEQ_ID_CSR_REG0_ADDR A:&base_addr+0x9e0094
y.create.l HWIO_RPMH_VRM_MODE_SEQ_ID_CSR_REG1_ADDR A:&base_addr+0x9e0194
y.create.l HWIO_RPMH_VRM_MODE_SEQ_ID_CSR_REG2_ADDR A:&base_addr+0x9e0294
y.create.l HWIO_RPMH_VRM_MODE_SEQ_ID_CSR_REG3_ADDR A:&base_addr+0x9e0394
y.create.l HWIO_RPMH_VRM_MODE_SEQ_ID_CSR_REG4_ADDR A:&base_addr+0x9e0494
y.create.l HWIO_RPMH_VRM_MODE_SEQ_ID_CSR_REG5_ADDR A:&base_addr+0x9e0594
y.create.l HWIO_RPMH_VRM_MODE_SEQ_ID_CSR_REG6_ADDR A:&base_addr+0x9e0694
y.create.l HWIO_RPMH_VRM_MODE_SEQ_ID_CSR_REG7_ADDR A:&base_addr+0x9e0794
y.create.l HWIO_RPMH_VRM_MODE_SEQ_ID_CSR_REG8_ADDR A:&base_addr+0x9e0894
y.create.l HWIO_RPMH_VRM_MODE_SEQ_ID_CSR_REG9_ADDR A:&base_addr+0x9e0994
y.create.l HWIO_RPMH_VRM_MODE_SEQ_ID_CSR_REG10_ADDR A:&base_addr+0x9e0a94
y.create.l HWIO_RPMH_VRM_MODE_SEQ_ID_CSR_REG11_ADDR A:&base_addr+0x9e0b94
y.create.l HWIO_RPMH_VRM_MODE_SEQ_ID_CSR_REG12_ADDR A:&base_addr+0x9e0c94
y.create.l HWIO_RPMH_VRM_MODE_SEQ_ID_CSR_REG13_ADDR A:&base_addr+0x9e0d94
y.create.l HWIO_RPMH_VRM_MODE_SEQ_ID_CSR_REG14_ADDR A:&base_addr+0x9e0e94
y.create.l HWIO_RPMH_VRM_MODE_SEQ_ID_CSR_REG15_ADDR A:&base_addr+0x9e0f94
y.create.l HWIO_RPMH_VRM_MODE_SEQ_ID_CSR_REG16_ADDR A:&base_addr+0x9e1094
y.create.l HWIO_RPMH_VRM_MODE_SEQ_ID_CSR_REG17_ADDR A:&base_addr+0x9e1194
y.create.l HWIO_RPMH_VRM_MODE_SEQ_ID_CSR_REG18_ADDR A:&base_addr+0x9e1294
y.create.l HWIO_RPMH_VRM_MODE_SEQ_ID_CSR_REG19_ADDR A:&base_addr+0x9e1394
y.create.l HWIO_RPMH_VRM_MODE_SEQ_ID_CSR_REG20_ADDR A:&base_addr+0x9e1494
y.create.l HWIO_RPMH_VRM_MODE_SEQ_ID_CSR_REG21_ADDR A:&base_addr+0x9e1594
y.create.l HWIO_RPMH_VRM_MODE_SEQ_ID_CSR_REG22_ADDR A:&base_addr+0x9e1694
y.create.l HWIO_RPMH_VRM_MODE_SEQ_ID_CSR_REG23_ADDR A:&base_addr+0x9e1794
y.create.l HWIO_RPMH_VRM_HEADROOM_SEQ_ID_CSR_REG0_ADDR A:&base_addr+0x9e0098
y.create.l HWIO_RPMH_VRM_HEADROOM_SEQ_ID_CSR_REG1_ADDR A:&base_addr+0x9e0198
y.create.l HWIO_RPMH_VRM_HEADROOM_SEQ_ID_CSR_REG2_ADDR A:&base_addr+0x9e0298
y.create.l HWIO_RPMH_VRM_HEADROOM_SEQ_ID_CSR_REG3_ADDR A:&base_addr+0x9e0398
y.create.l HWIO_RPMH_VRM_HEADROOM_SEQ_ID_CSR_REG4_ADDR A:&base_addr+0x9e0498
y.create.l HWIO_RPMH_VRM_HEADROOM_SEQ_ID_CSR_REG5_ADDR A:&base_addr+0x9e0598
y.create.l HWIO_RPMH_VRM_HEADROOM_SEQ_ID_CSR_REG6_ADDR A:&base_addr+0x9e0698
y.create.l HWIO_RPMH_VRM_HEADROOM_SEQ_ID_CSR_REG7_ADDR A:&base_addr+0x9e0798
y.create.l HWIO_RPMH_VRM_HEADROOM_SEQ_ID_CSR_REG8_ADDR A:&base_addr+0x9e0898
y.create.l HWIO_RPMH_VRM_HEADROOM_SEQ_ID_CSR_REG9_ADDR A:&base_addr+0x9e0998
y.create.l HWIO_RPMH_VRM_HEADROOM_SEQ_ID_CSR_REG10_ADDR A:&base_addr+0x9e0a98
y.create.l HWIO_RPMH_VRM_HEADROOM_SEQ_ID_CSR_REG11_ADDR A:&base_addr+0x9e0b98
y.create.l HWIO_RPMH_VRM_HEADROOM_SEQ_ID_CSR_REG12_ADDR A:&base_addr+0x9e0c98
y.create.l HWIO_RPMH_VRM_HEADROOM_SEQ_ID_CSR_REG13_ADDR A:&base_addr+0x9e0d98
y.create.l HWIO_RPMH_VRM_HEADROOM_SEQ_ID_CSR_REG14_ADDR A:&base_addr+0x9e0e98
y.create.l HWIO_RPMH_VRM_HEADROOM_SEQ_ID_CSR_REG15_ADDR A:&base_addr+0x9e0f98
y.create.l HWIO_RPMH_VRM_HEADROOM_SEQ_ID_CSR_REG16_ADDR A:&base_addr+0x9e1098
y.create.l HWIO_RPMH_VRM_HEADROOM_SEQ_ID_CSR_REG17_ADDR A:&base_addr+0x9e1198
y.create.l HWIO_RPMH_VRM_HEADROOM_SEQ_ID_CSR_REG18_ADDR A:&base_addr+0x9e1298
y.create.l HWIO_RPMH_VRM_HEADROOM_SEQ_ID_CSR_REG19_ADDR A:&base_addr+0x9e1398
y.create.l HWIO_RPMH_VRM_HEADROOM_SEQ_ID_CSR_REG20_ADDR A:&base_addr+0x9e1498
y.create.l HWIO_RPMH_VRM_HEADROOM_SEQ_ID_CSR_REG21_ADDR A:&base_addr+0x9e1598
y.create.l HWIO_RPMH_VRM_HEADROOM_SEQ_ID_CSR_REG22_ADDR A:&base_addr+0x9e1698
y.create.l HWIO_RPMH_VRM_HEADROOM_SEQ_ID_CSR_REG23_ADDR A:&base_addr+0x9e1798
y.create.l HWIO_RPMH_VRM_VOLTAGE_DEP_ENABLE_CSR_REG0_ADDR A:&base_addr+0x9e00a8
y.create.l HWIO_RPMH_VRM_VOLTAGE_DEP_ENABLE_CSR_REG1_ADDR A:&base_addr+0x9e01a8
y.create.l HWIO_RPMH_VRM_VOLTAGE_DEP_ENABLE_CSR_REG2_ADDR A:&base_addr+0x9e02a8
y.create.l HWIO_RPMH_VRM_VOLTAGE_DEP_ENABLE_CSR_REG3_ADDR A:&base_addr+0x9e03a8
y.create.l HWIO_RPMH_VRM_VOLTAGE_DEP_ENABLE_CSR_REG4_ADDR A:&base_addr+0x9e04a8
y.create.l HWIO_RPMH_VRM_VOLTAGE_DEP_ENABLE_CSR_REG5_ADDR A:&base_addr+0x9e05a8
y.create.l HWIO_RPMH_VRM_VOLTAGE_DEP_ENABLE_CSR_REG6_ADDR A:&base_addr+0x9e06a8
y.create.l HWIO_RPMH_VRM_VOLTAGE_DEP_ENABLE_CSR_REG7_ADDR A:&base_addr+0x9e07a8
y.create.l HWIO_RPMH_VRM_VOLTAGE_DEP_ENABLE_CSR_REG8_ADDR A:&base_addr+0x9e08a8
y.create.l HWIO_RPMH_VRM_VOLTAGE_DEP_ENABLE_CSR_REG9_ADDR A:&base_addr+0x9e09a8
y.create.l HWIO_RPMH_VRM_VOLTAGE_DEP_ENABLE_CSR_REG10_ADDR A:&base_addr+0x9e0aa8
y.create.l HWIO_RPMH_VRM_VOLTAGE_DEP_ENABLE_CSR_REG11_ADDR A:&base_addr+0x9e0ba8
y.create.l HWIO_RPMH_VRM_VOLTAGE_DEP_ENABLE_CSR_REG12_ADDR A:&base_addr+0x9e0ca8
y.create.l HWIO_RPMH_VRM_VOLTAGE_DEP_ENABLE_CSR_REG13_ADDR A:&base_addr+0x9e0da8
y.create.l HWIO_RPMH_VRM_VOLTAGE_DEP_ENABLE_CSR_REG14_ADDR A:&base_addr+0x9e0ea8
y.create.l HWIO_RPMH_VRM_VOLTAGE_DEP_ENABLE_CSR_REG15_ADDR A:&base_addr+0x9e0fa8
y.create.l HWIO_RPMH_VRM_VOLTAGE_DEP_ENABLE_CSR_REG16_ADDR A:&base_addr+0x9e10a8
y.create.l HWIO_RPMH_VRM_VOLTAGE_DEP_ENABLE_CSR_REG17_ADDR A:&base_addr+0x9e11a8
y.create.l HWIO_RPMH_VRM_VOLTAGE_DEP_ENABLE_CSR_REG18_ADDR A:&base_addr+0x9e12a8
y.create.l HWIO_RPMH_VRM_VOLTAGE_DEP_ENABLE_CSR_REG19_ADDR A:&base_addr+0x9e13a8
y.create.l HWIO_RPMH_VRM_VOLTAGE_DEP_ENABLE_CSR_REG20_ADDR A:&base_addr+0x9e14a8
y.create.l HWIO_RPMH_VRM_VOLTAGE_DEP_ENABLE_CSR_REG21_ADDR A:&base_addr+0x9e15a8
y.create.l HWIO_RPMH_VRM_VOLTAGE_DEP_ENABLE_CSR_REG22_ADDR A:&base_addr+0x9e16a8
y.create.l HWIO_RPMH_VRM_VOLTAGE_DEP_ENABLE_CSR_REG23_ADDR A:&base_addr+0x9e17a8
y.create.l HWIO_RPMH_VRM_ENABLE_DEP_ENABLE_CSR_REG0_ADDR A:&base_addr+0x9e00ac
y.create.l HWIO_RPMH_VRM_ENABLE_DEP_ENABLE_CSR_REG1_ADDR A:&base_addr+0x9e01ac
y.create.l HWIO_RPMH_VRM_ENABLE_DEP_ENABLE_CSR_REG2_ADDR A:&base_addr+0x9e02ac
y.create.l HWIO_RPMH_VRM_ENABLE_DEP_ENABLE_CSR_REG3_ADDR A:&base_addr+0x9e03ac
y.create.l HWIO_RPMH_VRM_ENABLE_DEP_ENABLE_CSR_REG4_ADDR A:&base_addr+0x9e04ac
y.create.l HWIO_RPMH_VRM_ENABLE_DEP_ENABLE_CSR_REG5_ADDR A:&base_addr+0x9e05ac
y.create.l HWIO_RPMH_VRM_ENABLE_DEP_ENABLE_CSR_REG6_ADDR A:&base_addr+0x9e06ac
y.create.l HWIO_RPMH_VRM_ENABLE_DEP_ENABLE_CSR_REG7_ADDR A:&base_addr+0x9e07ac
y.create.l HWIO_RPMH_VRM_ENABLE_DEP_ENABLE_CSR_REG8_ADDR A:&base_addr+0x9e08ac
y.create.l HWIO_RPMH_VRM_ENABLE_DEP_ENABLE_CSR_REG9_ADDR A:&base_addr+0x9e09ac
y.create.l HWIO_RPMH_VRM_ENABLE_DEP_ENABLE_CSR_REG10_ADDR A:&base_addr+0x9e0aac
y.create.l HWIO_RPMH_VRM_ENABLE_DEP_ENABLE_CSR_REG11_ADDR A:&base_addr+0x9e0bac
y.create.l HWIO_RPMH_VRM_ENABLE_DEP_ENABLE_CSR_REG12_ADDR A:&base_addr+0x9e0cac
y.create.l HWIO_RPMH_VRM_ENABLE_DEP_ENABLE_CSR_REG13_ADDR A:&base_addr+0x9e0dac
y.create.l HWIO_RPMH_VRM_ENABLE_DEP_ENABLE_CSR_REG14_ADDR A:&base_addr+0x9e0eac
y.create.l HWIO_RPMH_VRM_ENABLE_DEP_ENABLE_CSR_REG15_ADDR A:&base_addr+0x9e0fac
y.create.l HWIO_RPMH_VRM_ENABLE_DEP_ENABLE_CSR_REG16_ADDR A:&base_addr+0x9e10ac
y.create.l HWIO_RPMH_VRM_ENABLE_DEP_ENABLE_CSR_REG17_ADDR A:&base_addr+0x9e11ac
y.create.l HWIO_RPMH_VRM_ENABLE_DEP_ENABLE_CSR_REG18_ADDR A:&base_addr+0x9e12ac
y.create.l HWIO_RPMH_VRM_ENABLE_DEP_ENABLE_CSR_REG19_ADDR A:&base_addr+0x9e13ac
y.create.l HWIO_RPMH_VRM_ENABLE_DEP_ENABLE_CSR_REG20_ADDR A:&base_addr+0x9e14ac
y.create.l HWIO_RPMH_VRM_ENABLE_DEP_ENABLE_CSR_REG21_ADDR A:&base_addr+0x9e15ac
y.create.l HWIO_RPMH_VRM_ENABLE_DEP_ENABLE_CSR_REG22_ADDR A:&base_addr+0x9e16ac
y.create.l HWIO_RPMH_VRM_ENABLE_DEP_ENABLE_CSR_REG23_ADDR A:&base_addr+0x9e17ac
y.create.l HWIO_RPMH_VRM_MODE_DEP_ENABLE_CSR_REG0_ADDR A:&base_addr+0x9e00b0
y.create.l HWIO_RPMH_VRM_MODE_DEP_ENABLE_CSR_REG1_ADDR A:&base_addr+0x9e01b0
y.create.l HWIO_RPMH_VRM_MODE_DEP_ENABLE_CSR_REG2_ADDR A:&base_addr+0x9e02b0
y.create.l HWIO_RPMH_VRM_MODE_DEP_ENABLE_CSR_REG3_ADDR A:&base_addr+0x9e03b0
y.create.l HWIO_RPMH_VRM_MODE_DEP_ENABLE_CSR_REG4_ADDR A:&base_addr+0x9e04b0
y.create.l HWIO_RPMH_VRM_MODE_DEP_ENABLE_CSR_REG5_ADDR A:&base_addr+0x9e05b0
y.create.l HWIO_RPMH_VRM_MODE_DEP_ENABLE_CSR_REG6_ADDR A:&base_addr+0x9e06b0
y.create.l HWIO_RPMH_VRM_MODE_DEP_ENABLE_CSR_REG7_ADDR A:&base_addr+0x9e07b0
y.create.l HWIO_RPMH_VRM_MODE_DEP_ENABLE_CSR_REG8_ADDR A:&base_addr+0x9e08b0
y.create.l HWIO_RPMH_VRM_MODE_DEP_ENABLE_CSR_REG9_ADDR A:&base_addr+0x9e09b0
y.create.l HWIO_RPMH_VRM_MODE_DEP_ENABLE_CSR_REG10_ADDR A:&base_addr+0x9e0ab0
y.create.l HWIO_RPMH_VRM_MODE_DEP_ENABLE_CSR_REG11_ADDR A:&base_addr+0x9e0bb0
y.create.l HWIO_RPMH_VRM_MODE_DEP_ENABLE_CSR_REG12_ADDR A:&base_addr+0x9e0cb0
y.create.l HWIO_RPMH_VRM_MODE_DEP_ENABLE_CSR_REG13_ADDR A:&base_addr+0x9e0db0
y.create.l HWIO_RPMH_VRM_MODE_DEP_ENABLE_CSR_REG14_ADDR A:&base_addr+0x9e0eb0
y.create.l HWIO_RPMH_VRM_MODE_DEP_ENABLE_CSR_REG15_ADDR A:&base_addr+0x9e0fb0
y.create.l HWIO_RPMH_VRM_MODE_DEP_ENABLE_CSR_REG16_ADDR A:&base_addr+0x9e10b0
y.create.l HWIO_RPMH_VRM_MODE_DEP_ENABLE_CSR_REG17_ADDR A:&base_addr+0x9e11b0
y.create.l HWIO_RPMH_VRM_MODE_DEP_ENABLE_CSR_REG18_ADDR A:&base_addr+0x9e12b0
y.create.l HWIO_RPMH_VRM_MODE_DEP_ENABLE_CSR_REG19_ADDR A:&base_addr+0x9e13b0
y.create.l HWIO_RPMH_VRM_MODE_DEP_ENABLE_CSR_REG20_ADDR A:&base_addr+0x9e14b0
y.create.l HWIO_RPMH_VRM_MODE_DEP_ENABLE_CSR_REG21_ADDR A:&base_addr+0x9e15b0
y.create.l HWIO_RPMH_VRM_MODE_DEP_ENABLE_CSR_REG22_ADDR A:&base_addr+0x9e16b0
y.create.l HWIO_RPMH_VRM_MODE_DEP_ENABLE_CSR_REG23_ADDR A:&base_addr+0x9e17b0
y.create.l HWIO_RPMH_VRM_HEADROOM_DEP_ENABLE_CSR_REG0_ADDR A:&base_addr+0x9e00b4
y.create.l HWIO_RPMH_VRM_HEADROOM_DEP_ENABLE_CSR_REG1_ADDR A:&base_addr+0x9e01b4
y.create.l HWIO_RPMH_VRM_HEADROOM_DEP_ENABLE_CSR_REG2_ADDR A:&base_addr+0x9e02b4
y.create.l HWIO_RPMH_VRM_HEADROOM_DEP_ENABLE_CSR_REG3_ADDR A:&base_addr+0x9e03b4
y.create.l HWIO_RPMH_VRM_HEADROOM_DEP_ENABLE_CSR_REG4_ADDR A:&base_addr+0x9e04b4
y.create.l HWIO_RPMH_VRM_HEADROOM_DEP_ENABLE_CSR_REG5_ADDR A:&base_addr+0x9e05b4
y.create.l HWIO_RPMH_VRM_HEADROOM_DEP_ENABLE_CSR_REG6_ADDR A:&base_addr+0x9e06b4
y.create.l HWIO_RPMH_VRM_HEADROOM_DEP_ENABLE_CSR_REG7_ADDR A:&base_addr+0x9e07b4
y.create.l HWIO_RPMH_VRM_HEADROOM_DEP_ENABLE_CSR_REG8_ADDR A:&base_addr+0x9e08b4
y.create.l HWIO_RPMH_VRM_HEADROOM_DEP_ENABLE_CSR_REG9_ADDR A:&base_addr+0x9e09b4
y.create.l HWIO_RPMH_VRM_HEADROOM_DEP_ENABLE_CSR_REG10_ADDR A:&base_addr+0x9e0ab4
y.create.l HWIO_RPMH_VRM_HEADROOM_DEP_ENABLE_CSR_REG11_ADDR A:&base_addr+0x9e0bb4
y.create.l HWIO_RPMH_VRM_HEADROOM_DEP_ENABLE_CSR_REG12_ADDR A:&base_addr+0x9e0cb4
y.create.l HWIO_RPMH_VRM_HEADROOM_DEP_ENABLE_CSR_REG13_ADDR A:&base_addr+0x9e0db4
y.create.l HWIO_RPMH_VRM_HEADROOM_DEP_ENABLE_CSR_REG14_ADDR A:&base_addr+0x9e0eb4
y.create.l HWIO_RPMH_VRM_HEADROOM_DEP_ENABLE_CSR_REG15_ADDR A:&base_addr+0x9e0fb4
y.create.l HWIO_RPMH_VRM_HEADROOM_DEP_ENABLE_CSR_REG16_ADDR A:&base_addr+0x9e10b4
y.create.l HWIO_RPMH_VRM_HEADROOM_DEP_ENABLE_CSR_REG17_ADDR A:&base_addr+0x9e11b4
y.create.l HWIO_RPMH_VRM_HEADROOM_DEP_ENABLE_CSR_REG18_ADDR A:&base_addr+0x9e12b4
y.create.l HWIO_RPMH_VRM_HEADROOM_DEP_ENABLE_CSR_REG19_ADDR A:&base_addr+0x9e13b4
y.create.l HWIO_RPMH_VRM_HEADROOM_DEP_ENABLE_CSR_REG20_ADDR A:&base_addr+0x9e14b4
y.create.l HWIO_RPMH_VRM_HEADROOM_DEP_ENABLE_CSR_REG21_ADDR A:&base_addr+0x9e15b4
y.create.l HWIO_RPMH_VRM_HEADROOM_DEP_ENABLE_CSR_REG22_ADDR A:&base_addr+0x9e16b4
y.create.l HWIO_RPMH_VRM_HEADROOM_DEP_ENABLE_CSR_REG23_ADDR A:&base_addr+0x9e17b4
y.create.l HWIO_RPMH_VRM_VOLTAGE_SETTLING_BLOCK_ENABLE_CSR_REG0_ADDR A:&base_addr+0x9e00c4
y.create.l HWIO_RPMH_VRM_VOLTAGE_SETTLING_BLOCK_ENABLE_CSR_REG1_ADDR A:&base_addr+0x9e01c4
y.create.l HWIO_RPMH_VRM_VOLTAGE_SETTLING_BLOCK_ENABLE_CSR_REG2_ADDR A:&base_addr+0x9e02c4
y.create.l HWIO_RPMH_VRM_VOLTAGE_SETTLING_BLOCK_ENABLE_CSR_REG3_ADDR A:&base_addr+0x9e03c4
y.create.l HWIO_RPMH_VRM_VOLTAGE_SETTLING_BLOCK_ENABLE_CSR_REG4_ADDR A:&base_addr+0x9e04c4
y.create.l HWIO_RPMH_VRM_VOLTAGE_SETTLING_BLOCK_ENABLE_CSR_REG5_ADDR A:&base_addr+0x9e05c4
y.create.l HWIO_RPMH_VRM_VOLTAGE_SETTLING_BLOCK_ENABLE_CSR_REG6_ADDR A:&base_addr+0x9e06c4
y.create.l HWIO_RPMH_VRM_VOLTAGE_SETTLING_BLOCK_ENABLE_CSR_REG7_ADDR A:&base_addr+0x9e07c4
y.create.l HWIO_RPMH_VRM_VOLTAGE_SETTLING_BLOCK_ENABLE_CSR_REG8_ADDR A:&base_addr+0x9e08c4
y.create.l HWIO_RPMH_VRM_VOLTAGE_SETTLING_BLOCK_ENABLE_CSR_REG9_ADDR A:&base_addr+0x9e09c4
y.create.l HWIO_RPMH_VRM_VOLTAGE_SETTLING_BLOCK_ENABLE_CSR_REG10_ADDR A:&base_addr+0x9e0ac4
y.create.l HWIO_RPMH_VRM_VOLTAGE_SETTLING_BLOCK_ENABLE_CSR_REG11_ADDR A:&base_addr+0x9e0bc4
y.create.l HWIO_RPMH_VRM_VOLTAGE_SETTLING_BLOCK_ENABLE_CSR_REG12_ADDR A:&base_addr+0x9e0cc4
y.create.l HWIO_RPMH_VRM_VOLTAGE_SETTLING_BLOCK_ENABLE_CSR_REG13_ADDR A:&base_addr+0x9e0dc4
y.create.l HWIO_RPMH_VRM_VOLTAGE_SETTLING_BLOCK_ENABLE_CSR_REG14_ADDR A:&base_addr+0x9e0ec4
y.create.l HWIO_RPMH_VRM_VOLTAGE_SETTLING_BLOCK_ENABLE_CSR_REG15_ADDR A:&base_addr+0x9e0fc4
y.create.l HWIO_RPMH_VRM_VOLTAGE_SETTLING_BLOCK_ENABLE_CSR_REG16_ADDR A:&base_addr+0x9e10c4
y.create.l HWIO_RPMH_VRM_VOLTAGE_SETTLING_BLOCK_ENABLE_CSR_REG17_ADDR A:&base_addr+0x9e11c4
y.create.l HWIO_RPMH_VRM_VOLTAGE_SETTLING_BLOCK_ENABLE_CSR_REG18_ADDR A:&base_addr+0x9e12c4
y.create.l HWIO_RPMH_VRM_VOLTAGE_SETTLING_BLOCK_ENABLE_CSR_REG19_ADDR A:&base_addr+0x9e13c4
y.create.l HWIO_RPMH_VRM_VOLTAGE_SETTLING_BLOCK_ENABLE_CSR_REG20_ADDR A:&base_addr+0x9e14c4
y.create.l HWIO_RPMH_VRM_VOLTAGE_SETTLING_BLOCK_ENABLE_CSR_REG21_ADDR A:&base_addr+0x9e15c4
y.create.l HWIO_RPMH_VRM_VOLTAGE_SETTLING_BLOCK_ENABLE_CSR_REG22_ADDR A:&base_addr+0x9e16c4
y.create.l HWIO_RPMH_VRM_VOLTAGE_SETTLING_BLOCK_ENABLE_CSR_REG23_ADDR A:&base_addr+0x9e17c4
y.create.l HWIO_RPMH_VRM_ENABLE_SETTLING_BLOCK_ENABLE_CSR_REG0_ADDR A:&base_addr+0x9e00c8
y.create.l HWIO_RPMH_VRM_ENABLE_SETTLING_BLOCK_ENABLE_CSR_REG1_ADDR A:&base_addr+0x9e01c8
y.create.l HWIO_RPMH_VRM_ENABLE_SETTLING_BLOCK_ENABLE_CSR_REG2_ADDR A:&base_addr+0x9e02c8
y.create.l HWIO_RPMH_VRM_ENABLE_SETTLING_BLOCK_ENABLE_CSR_REG3_ADDR A:&base_addr+0x9e03c8
y.create.l HWIO_RPMH_VRM_ENABLE_SETTLING_BLOCK_ENABLE_CSR_REG4_ADDR A:&base_addr+0x9e04c8
y.create.l HWIO_RPMH_VRM_ENABLE_SETTLING_BLOCK_ENABLE_CSR_REG5_ADDR A:&base_addr+0x9e05c8
y.create.l HWIO_RPMH_VRM_ENABLE_SETTLING_BLOCK_ENABLE_CSR_REG6_ADDR A:&base_addr+0x9e06c8
y.create.l HWIO_RPMH_VRM_ENABLE_SETTLING_BLOCK_ENABLE_CSR_REG7_ADDR A:&base_addr+0x9e07c8
y.create.l HWIO_RPMH_VRM_ENABLE_SETTLING_BLOCK_ENABLE_CSR_REG8_ADDR A:&base_addr+0x9e08c8
y.create.l HWIO_RPMH_VRM_ENABLE_SETTLING_BLOCK_ENABLE_CSR_REG9_ADDR A:&base_addr+0x9e09c8
y.create.l HWIO_RPMH_VRM_ENABLE_SETTLING_BLOCK_ENABLE_CSR_REG10_ADDR A:&base_addr+0x9e0ac8
y.create.l HWIO_RPMH_VRM_ENABLE_SETTLING_BLOCK_ENABLE_CSR_REG11_ADDR A:&base_addr+0x9e0bc8
y.create.l HWIO_RPMH_VRM_ENABLE_SETTLING_BLOCK_ENABLE_CSR_REG12_ADDR A:&base_addr+0x9e0cc8
y.create.l HWIO_RPMH_VRM_ENABLE_SETTLING_BLOCK_ENABLE_CSR_REG13_ADDR A:&base_addr+0x9e0dc8
y.create.l HWIO_RPMH_VRM_ENABLE_SETTLING_BLOCK_ENABLE_CSR_REG14_ADDR A:&base_addr+0x9e0ec8
y.create.l HWIO_RPMH_VRM_ENABLE_SETTLING_BLOCK_ENABLE_CSR_REG15_ADDR A:&base_addr+0x9e0fc8
y.create.l HWIO_RPMH_VRM_ENABLE_SETTLING_BLOCK_ENABLE_CSR_REG16_ADDR A:&base_addr+0x9e10c8
y.create.l HWIO_RPMH_VRM_ENABLE_SETTLING_BLOCK_ENABLE_CSR_REG17_ADDR A:&base_addr+0x9e11c8
y.create.l HWIO_RPMH_VRM_ENABLE_SETTLING_BLOCK_ENABLE_CSR_REG18_ADDR A:&base_addr+0x9e12c8
y.create.l HWIO_RPMH_VRM_ENABLE_SETTLING_BLOCK_ENABLE_CSR_REG19_ADDR A:&base_addr+0x9e13c8
y.create.l HWIO_RPMH_VRM_ENABLE_SETTLING_BLOCK_ENABLE_CSR_REG20_ADDR A:&base_addr+0x9e14c8
y.create.l HWIO_RPMH_VRM_ENABLE_SETTLING_BLOCK_ENABLE_CSR_REG21_ADDR A:&base_addr+0x9e15c8
y.create.l HWIO_RPMH_VRM_ENABLE_SETTLING_BLOCK_ENABLE_CSR_REG22_ADDR A:&base_addr+0x9e16c8
y.create.l HWIO_RPMH_VRM_ENABLE_SETTLING_BLOCK_ENABLE_CSR_REG23_ADDR A:&base_addr+0x9e17c8
y.create.l HWIO_RPMH_VRM_MODE_SETTLING_BLOCK_ENABLE_CSR_REG0_ADDR A:&base_addr+0x9e00cc
y.create.l HWIO_RPMH_VRM_MODE_SETTLING_BLOCK_ENABLE_CSR_REG1_ADDR A:&base_addr+0x9e01cc
y.create.l HWIO_RPMH_VRM_MODE_SETTLING_BLOCK_ENABLE_CSR_REG2_ADDR A:&base_addr+0x9e02cc
y.create.l HWIO_RPMH_VRM_MODE_SETTLING_BLOCK_ENABLE_CSR_REG3_ADDR A:&base_addr+0x9e03cc
y.create.l HWIO_RPMH_VRM_MODE_SETTLING_BLOCK_ENABLE_CSR_REG4_ADDR A:&base_addr+0x9e04cc
y.create.l HWIO_RPMH_VRM_MODE_SETTLING_BLOCK_ENABLE_CSR_REG5_ADDR A:&base_addr+0x9e05cc
y.create.l HWIO_RPMH_VRM_MODE_SETTLING_BLOCK_ENABLE_CSR_REG6_ADDR A:&base_addr+0x9e06cc
y.create.l HWIO_RPMH_VRM_MODE_SETTLING_BLOCK_ENABLE_CSR_REG7_ADDR A:&base_addr+0x9e07cc
y.create.l HWIO_RPMH_VRM_MODE_SETTLING_BLOCK_ENABLE_CSR_REG8_ADDR A:&base_addr+0x9e08cc
y.create.l HWIO_RPMH_VRM_MODE_SETTLING_BLOCK_ENABLE_CSR_REG9_ADDR A:&base_addr+0x9e09cc
y.create.l HWIO_RPMH_VRM_MODE_SETTLING_BLOCK_ENABLE_CSR_REG10_ADDR A:&base_addr+0x9e0acc
y.create.l HWIO_RPMH_VRM_MODE_SETTLING_BLOCK_ENABLE_CSR_REG11_ADDR A:&base_addr+0x9e0bcc
y.create.l HWIO_RPMH_VRM_MODE_SETTLING_BLOCK_ENABLE_CSR_REG12_ADDR A:&base_addr+0x9e0ccc
y.create.l HWIO_RPMH_VRM_MODE_SETTLING_BLOCK_ENABLE_CSR_REG13_ADDR A:&base_addr+0x9e0dcc
y.create.l HWIO_RPMH_VRM_MODE_SETTLING_BLOCK_ENABLE_CSR_REG14_ADDR A:&base_addr+0x9e0ecc
y.create.l HWIO_RPMH_VRM_MODE_SETTLING_BLOCK_ENABLE_CSR_REG15_ADDR A:&base_addr+0x9e0fcc
y.create.l HWIO_RPMH_VRM_MODE_SETTLING_BLOCK_ENABLE_CSR_REG16_ADDR A:&base_addr+0x9e10cc
y.create.l HWIO_RPMH_VRM_MODE_SETTLING_BLOCK_ENABLE_CSR_REG17_ADDR A:&base_addr+0x9e11cc
y.create.l HWIO_RPMH_VRM_MODE_SETTLING_BLOCK_ENABLE_CSR_REG18_ADDR A:&base_addr+0x9e12cc
y.create.l HWIO_RPMH_VRM_MODE_SETTLING_BLOCK_ENABLE_CSR_REG19_ADDR A:&base_addr+0x9e13cc
y.create.l HWIO_RPMH_VRM_MODE_SETTLING_BLOCK_ENABLE_CSR_REG20_ADDR A:&base_addr+0x9e14cc
y.create.l HWIO_RPMH_VRM_MODE_SETTLING_BLOCK_ENABLE_CSR_REG21_ADDR A:&base_addr+0x9e15cc
y.create.l HWIO_RPMH_VRM_MODE_SETTLING_BLOCK_ENABLE_CSR_REG22_ADDR A:&base_addr+0x9e16cc
y.create.l HWIO_RPMH_VRM_MODE_SETTLING_BLOCK_ENABLE_CSR_REG23_ADDR A:&base_addr+0x9e17cc
y.create.l HWIO_RPMH_VRM_HEADROOM_SETTLING_BLOCK_ENABLE_CSR_REG0_ADDR A:&base_addr+0x9e00d0
y.create.l HWIO_RPMH_VRM_HEADROOM_SETTLING_BLOCK_ENABLE_CSR_REG1_ADDR A:&base_addr+0x9e01d0
y.create.l HWIO_RPMH_VRM_HEADROOM_SETTLING_BLOCK_ENABLE_CSR_REG2_ADDR A:&base_addr+0x9e02d0
y.create.l HWIO_RPMH_VRM_HEADROOM_SETTLING_BLOCK_ENABLE_CSR_REG3_ADDR A:&base_addr+0x9e03d0
y.create.l HWIO_RPMH_VRM_HEADROOM_SETTLING_BLOCK_ENABLE_CSR_REG4_ADDR A:&base_addr+0x9e04d0
y.create.l HWIO_RPMH_VRM_HEADROOM_SETTLING_BLOCK_ENABLE_CSR_REG5_ADDR A:&base_addr+0x9e05d0
y.create.l HWIO_RPMH_VRM_HEADROOM_SETTLING_BLOCK_ENABLE_CSR_REG6_ADDR A:&base_addr+0x9e06d0
y.create.l HWIO_RPMH_VRM_HEADROOM_SETTLING_BLOCK_ENABLE_CSR_REG7_ADDR A:&base_addr+0x9e07d0
y.create.l HWIO_RPMH_VRM_HEADROOM_SETTLING_BLOCK_ENABLE_CSR_REG8_ADDR A:&base_addr+0x9e08d0
y.create.l HWIO_RPMH_VRM_HEADROOM_SETTLING_BLOCK_ENABLE_CSR_REG9_ADDR A:&base_addr+0x9e09d0
y.create.l HWIO_RPMH_VRM_HEADROOM_SETTLING_BLOCK_ENABLE_CSR_REG10_ADDR A:&base_addr+0x9e0ad0
y.create.l HWIO_RPMH_VRM_HEADROOM_SETTLING_BLOCK_ENABLE_CSR_REG11_ADDR A:&base_addr+0x9e0bd0
y.create.l HWIO_RPMH_VRM_HEADROOM_SETTLING_BLOCK_ENABLE_CSR_REG12_ADDR A:&base_addr+0x9e0cd0
y.create.l HWIO_RPMH_VRM_HEADROOM_SETTLING_BLOCK_ENABLE_CSR_REG13_ADDR A:&base_addr+0x9e0dd0
y.create.l HWIO_RPMH_VRM_HEADROOM_SETTLING_BLOCK_ENABLE_CSR_REG14_ADDR A:&base_addr+0x9e0ed0
y.create.l HWIO_RPMH_VRM_HEADROOM_SETTLING_BLOCK_ENABLE_CSR_REG15_ADDR A:&base_addr+0x9e0fd0
y.create.l HWIO_RPMH_VRM_HEADROOM_SETTLING_BLOCK_ENABLE_CSR_REG16_ADDR A:&base_addr+0x9e10d0
y.create.l HWIO_RPMH_VRM_HEADROOM_SETTLING_BLOCK_ENABLE_CSR_REG17_ADDR A:&base_addr+0x9e11d0
y.create.l HWIO_RPMH_VRM_HEADROOM_SETTLING_BLOCK_ENABLE_CSR_REG18_ADDR A:&base_addr+0x9e12d0
y.create.l HWIO_RPMH_VRM_HEADROOM_SETTLING_BLOCK_ENABLE_CSR_REG19_ADDR A:&base_addr+0x9e13d0
y.create.l HWIO_RPMH_VRM_HEADROOM_SETTLING_BLOCK_ENABLE_CSR_REG20_ADDR A:&base_addr+0x9e14d0
y.create.l HWIO_RPMH_VRM_HEADROOM_SETTLING_BLOCK_ENABLE_CSR_REG21_ADDR A:&base_addr+0x9e15d0
y.create.l HWIO_RPMH_VRM_HEADROOM_SETTLING_BLOCK_ENABLE_CSR_REG22_ADDR A:&base_addr+0x9e16d0
y.create.l HWIO_RPMH_VRM_HEADROOM_SETTLING_BLOCK_ENABLE_CSR_REG23_ADDR A:&base_addr+0x9e17d0
y.create.l HWIO_RPMH_VRM_VREG_READY_ENABLE_CSR_REG0_ADDR A:&base_addr+0x9e00d4
y.create.l HWIO_RPMH_VRM_VREG_READY_ENABLE_CSR_REG1_ADDR A:&base_addr+0x9e01d4
y.create.l HWIO_RPMH_VRM_VREG_READY_ENABLE_CSR_REG2_ADDR A:&base_addr+0x9e02d4
y.create.l HWIO_RPMH_VRM_VREG_READY_ENABLE_CSR_REG3_ADDR A:&base_addr+0x9e03d4
y.create.l HWIO_RPMH_VRM_VREG_READY_ENABLE_CSR_REG4_ADDR A:&base_addr+0x9e04d4
y.create.l HWIO_RPMH_VRM_VREG_READY_ENABLE_CSR_REG5_ADDR A:&base_addr+0x9e05d4
y.create.l HWIO_RPMH_VRM_VREG_READY_ENABLE_CSR_REG6_ADDR A:&base_addr+0x9e06d4
y.create.l HWIO_RPMH_VRM_VREG_READY_ENABLE_CSR_REG7_ADDR A:&base_addr+0x9e07d4
y.create.l HWIO_RPMH_VRM_VREG_READY_ENABLE_CSR_REG8_ADDR A:&base_addr+0x9e08d4
y.create.l HWIO_RPMH_VRM_VREG_READY_ENABLE_CSR_REG9_ADDR A:&base_addr+0x9e09d4
y.create.l HWIO_RPMH_VRM_VREG_READY_ENABLE_CSR_REG10_ADDR A:&base_addr+0x9e0ad4
y.create.l HWIO_RPMH_VRM_VREG_READY_ENABLE_CSR_REG11_ADDR A:&base_addr+0x9e0bd4
y.create.l HWIO_RPMH_VRM_VREG_READY_ENABLE_CSR_REG12_ADDR A:&base_addr+0x9e0cd4
y.create.l HWIO_RPMH_VRM_VREG_READY_ENABLE_CSR_REG13_ADDR A:&base_addr+0x9e0dd4
y.create.l HWIO_RPMH_VRM_VREG_READY_ENABLE_CSR_REG14_ADDR A:&base_addr+0x9e0ed4
y.create.l HWIO_RPMH_VRM_VREG_READY_ENABLE_CSR_REG15_ADDR A:&base_addr+0x9e0fd4
y.create.l HWIO_RPMH_VRM_VREG_READY_ENABLE_CSR_REG16_ADDR A:&base_addr+0x9e10d4
y.create.l HWIO_RPMH_VRM_VREG_READY_ENABLE_CSR_REG17_ADDR A:&base_addr+0x9e11d4
y.create.l HWIO_RPMH_VRM_VREG_READY_ENABLE_CSR_REG18_ADDR A:&base_addr+0x9e12d4
y.create.l HWIO_RPMH_VRM_VREG_READY_ENABLE_CSR_REG19_ADDR A:&base_addr+0x9e13d4
y.create.l HWIO_RPMH_VRM_VREG_READY_ENABLE_CSR_REG20_ADDR A:&base_addr+0x9e14d4
y.create.l HWIO_RPMH_VRM_VREG_READY_ENABLE_CSR_REG21_ADDR A:&base_addr+0x9e15d4
y.create.l HWIO_RPMH_VRM_VREG_READY_ENABLE_CSR_REG22_ADDR A:&base_addr+0x9e16d4
y.create.l HWIO_RPMH_VRM_VREG_READY_ENABLE_CSR_REG23_ADDR A:&base_addr+0x9e17d4
y.create.l HWIO_RPMH_VRM_VREG_READY_WDOG_ERROR_ENABLE_CSR_REG0_ADDR A:&base_addr+0x9e00d8
y.create.l HWIO_RPMH_VRM_VREG_READY_WDOG_ERROR_ENABLE_CSR_REG1_ADDR A:&base_addr+0x9e01d8
y.create.l HWIO_RPMH_VRM_VREG_READY_WDOG_ERROR_ENABLE_CSR_REG2_ADDR A:&base_addr+0x9e02d8
y.create.l HWIO_RPMH_VRM_VREG_READY_WDOG_ERROR_ENABLE_CSR_REG3_ADDR A:&base_addr+0x9e03d8
y.create.l HWIO_RPMH_VRM_VREG_READY_WDOG_ERROR_ENABLE_CSR_REG4_ADDR A:&base_addr+0x9e04d8
y.create.l HWIO_RPMH_VRM_VREG_READY_WDOG_ERROR_ENABLE_CSR_REG5_ADDR A:&base_addr+0x9e05d8
y.create.l HWIO_RPMH_VRM_VREG_READY_WDOG_ERROR_ENABLE_CSR_REG6_ADDR A:&base_addr+0x9e06d8
y.create.l HWIO_RPMH_VRM_VREG_READY_WDOG_ERROR_ENABLE_CSR_REG7_ADDR A:&base_addr+0x9e07d8
y.create.l HWIO_RPMH_VRM_VREG_READY_WDOG_ERROR_ENABLE_CSR_REG8_ADDR A:&base_addr+0x9e08d8
y.create.l HWIO_RPMH_VRM_VREG_READY_WDOG_ERROR_ENABLE_CSR_REG9_ADDR A:&base_addr+0x9e09d8
y.create.l HWIO_RPMH_VRM_VREG_READY_WDOG_ERROR_ENABLE_CSR_REG10_ADDR A:&base_addr+0x9e0ad8
y.create.l HWIO_RPMH_VRM_VREG_READY_WDOG_ERROR_ENABLE_CSR_REG11_ADDR A:&base_addr+0x9e0bd8
y.create.l HWIO_RPMH_VRM_VREG_READY_WDOG_ERROR_ENABLE_CSR_REG12_ADDR A:&base_addr+0x9e0cd8
y.create.l HWIO_RPMH_VRM_VREG_READY_WDOG_ERROR_ENABLE_CSR_REG13_ADDR A:&base_addr+0x9e0dd8
y.create.l HWIO_RPMH_VRM_VREG_READY_WDOG_ERROR_ENABLE_CSR_REG14_ADDR A:&base_addr+0x9e0ed8
y.create.l HWIO_RPMH_VRM_VREG_READY_WDOG_ERROR_ENABLE_CSR_REG15_ADDR A:&base_addr+0x9e0fd8
y.create.l HWIO_RPMH_VRM_VREG_READY_WDOG_ERROR_ENABLE_CSR_REG16_ADDR A:&base_addr+0x9e10d8
y.create.l HWIO_RPMH_VRM_VREG_READY_WDOG_ERROR_ENABLE_CSR_REG17_ADDR A:&base_addr+0x9e11d8
y.create.l HWIO_RPMH_VRM_VREG_READY_WDOG_ERROR_ENABLE_CSR_REG18_ADDR A:&base_addr+0x9e12d8
y.create.l HWIO_RPMH_VRM_VREG_READY_WDOG_ERROR_ENABLE_CSR_REG19_ADDR A:&base_addr+0x9e13d8
y.create.l HWIO_RPMH_VRM_VREG_READY_WDOG_ERROR_ENABLE_CSR_REG20_ADDR A:&base_addr+0x9e14d8
y.create.l HWIO_RPMH_VRM_VREG_READY_WDOG_ERROR_ENABLE_CSR_REG21_ADDR A:&base_addr+0x9e15d8
y.create.l HWIO_RPMH_VRM_VREG_READY_WDOG_ERROR_ENABLE_CSR_REG22_ADDR A:&base_addr+0x9e16d8
y.create.l HWIO_RPMH_VRM_VREG_READY_WDOG_ERROR_ENABLE_CSR_REG23_ADDR A:&base_addr+0x9e17d8
y.create.l HWIO_RPMH_VRM_VREG_READY_LEGACY_MODE_CSR_REG0_ADDR A:&base_addr+0x9e00dc
y.create.l HWIO_RPMH_VRM_VREG_READY_LEGACY_MODE_CSR_REG1_ADDR A:&base_addr+0x9e01dc
y.create.l HWIO_RPMH_VRM_VREG_READY_LEGACY_MODE_CSR_REG2_ADDR A:&base_addr+0x9e02dc
y.create.l HWIO_RPMH_VRM_VREG_READY_LEGACY_MODE_CSR_REG3_ADDR A:&base_addr+0x9e03dc
y.create.l HWIO_RPMH_VRM_VREG_READY_LEGACY_MODE_CSR_REG4_ADDR A:&base_addr+0x9e04dc
y.create.l HWIO_RPMH_VRM_VREG_READY_LEGACY_MODE_CSR_REG5_ADDR A:&base_addr+0x9e05dc
y.create.l HWIO_RPMH_VRM_VREG_READY_LEGACY_MODE_CSR_REG6_ADDR A:&base_addr+0x9e06dc
y.create.l HWIO_RPMH_VRM_VREG_READY_LEGACY_MODE_CSR_REG7_ADDR A:&base_addr+0x9e07dc
y.create.l HWIO_RPMH_VRM_VREG_READY_LEGACY_MODE_CSR_REG8_ADDR A:&base_addr+0x9e08dc
y.create.l HWIO_RPMH_VRM_VREG_READY_LEGACY_MODE_CSR_REG9_ADDR A:&base_addr+0x9e09dc
y.create.l HWIO_RPMH_VRM_VREG_READY_LEGACY_MODE_CSR_REG10_ADDR A:&base_addr+0x9e0adc
y.create.l HWIO_RPMH_VRM_VREG_READY_LEGACY_MODE_CSR_REG11_ADDR A:&base_addr+0x9e0bdc
y.create.l HWIO_RPMH_VRM_VREG_READY_LEGACY_MODE_CSR_REG12_ADDR A:&base_addr+0x9e0cdc
y.create.l HWIO_RPMH_VRM_VREG_READY_LEGACY_MODE_CSR_REG13_ADDR A:&base_addr+0x9e0ddc
y.create.l HWIO_RPMH_VRM_VREG_READY_LEGACY_MODE_CSR_REG14_ADDR A:&base_addr+0x9e0edc
y.create.l HWIO_RPMH_VRM_VREG_READY_LEGACY_MODE_CSR_REG15_ADDR A:&base_addr+0x9e0fdc
y.create.l HWIO_RPMH_VRM_VREG_READY_LEGACY_MODE_CSR_REG16_ADDR A:&base_addr+0x9e10dc
y.create.l HWIO_RPMH_VRM_VREG_READY_LEGACY_MODE_CSR_REG17_ADDR A:&base_addr+0x9e11dc
y.create.l HWIO_RPMH_VRM_VREG_READY_LEGACY_MODE_CSR_REG18_ADDR A:&base_addr+0x9e12dc
y.create.l HWIO_RPMH_VRM_VREG_READY_LEGACY_MODE_CSR_REG19_ADDR A:&base_addr+0x9e13dc
y.create.l HWIO_RPMH_VRM_VREG_READY_LEGACY_MODE_CSR_REG20_ADDR A:&base_addr+0x9e14dc
y.create.l HWIO_RPMH_VRM_VREG_READY_LEGACY_MODE_CSR_REG21_ADDR A:&base_addr+0x9e15dc
y.create.l HWIO_RPMH_VRM_VREG_READY_LEGACY_MODE_CSR_REG22_ADDR A:&base_addr+0x9e16dc
y.create.l HWIO_RPMH_VRM_VREG_READY_LEGACY_MODE_CSR_REG23_ADDR A:&base_addr+0x9e17dc
y.create.l HWIO_RPMH_VRM_TYPE_CSR_XOB0_ADDR A:&base_addr+0x9e1880
y.create.l HWIO_RPMH_VRM_TYPE_CSR_XOB1_ADDR A:&base_addr+0x9e1980
y.create.l HWIO_RPMH_VRM_TYPE_CSR_XOB2_ADDR A:&base_addr+0x9e1a80
y.create.l HWIO_RPMH_VRM_TYPE_CSR_XOB3_ADDR A:&base_addr+0x9e1b80
y.create.l HWIO_RPMH_VRM_TYPE_CSR_XOB4_ADDR A:&base_addr+0x9e1c80
y.create.l HWIO_RPMH_VRM_TYPE_CSR_XOB5_ADDR A:&base_addr+0x9e1d80
y.create.l HWIO_RPMH_VRM_TYPE_CSR_XOB6_ADDR A:&base_addr+0x9e1e80
y.create.l HWIO_RPMH_VRM_TYPE_CSR_XOB7_ADDR A:&base_addr+0x9e1f80
y.create.l HWIO_RPMH_VRM_BASE_ADDR_CSR_XOB0_ADDR A:&base_addr+0x9e1884
y.create.l HWIO_RPMH_VRM_BASE_ADDR_CSR_XOB1_ADDR A:&base_addr+0x9e1984
y.create.l HWIO_RPMH_VRM_BASE_ADDR_CSR_XOB2_ADDR A:&base_addr+0x9e1a84
y.create.l HWIO_RPMH_VRM_BASE_ADDR_CSR_XOB3_ADDR A:&base_addr+0x9e1b84
y.create.l HWIO_RPMH_VRM_BASE_ADDR_CSR_XOB4_ADDR A:&base_addr+0x9e1c84
y.create.l HWIO_RPMH_VRM_BASE_ADDR_CSR_XOB5_ADDR A:&base_addr+0x9e1d84
y.create.l HWIO_RPMH_VRM_BASE_ADDR_CSR_XOB6_ADDR A:&base_addr+0x9e1e84
y.create.l HWIO_RPMH_VRM_BASE_ADDR_CSR_XOB7_ADDR A:&base_addr+0x9e1f84
y.create.l HWIO_RPMH_VRM_ENABLE_SEQ_ID_CSR_XOB0_ADDR A:&base_addr+0x9e1890
y.create.l HWIO_RPMH_VRM_ENABLE_SEQ_ID_CSR_XOB1_ADDR A:&base_addr+0x9e1990
y.create.l HWIO_RPMH_VRM_ENABLE_SEQ_ID_CSR_XOB2_ADDR A:&base_addr+0x9e1a90
y.create.l HWIO_RPMH_VRM_ENABLE_SEQ_ID_CSR_XOB3_ADDR A:&base_addr+0x9e1b90
y.create.l HWIO_RPMH_VRM_ENABLE_SEQ_ID_CSR_XOB4_ADDR A:&base_addr+0x9e1c90
y.create.l HWIO_RPMH_VRM_ENABLE_SEQ_ID_CSR_XOB5_ADDR A:&base_addr+0x9e1d90
y.create.l HWIO_RPMH_VRM_ENABLE_SEQ_ID_CSR_XOB6_ADDR A:&base_addr+0x9e1e90
y.create.l HWIO_RPMH_VRM_ENABLE_SEQ_ID_CSR_XOB7_ADDR A:&base_addr+0x9e1f90
y.create.l HWIO_RPMH_VRM_ENABLE_DEP_ENABLE_CSR_XOB0_ADDR A:&base_addr+0x9e18ac
y.create.l HWIO_RPMH_VRM_ENABLE_DEP_ENABLE_CSR_XOB1_ADDR A:&base_addr+0x9e19ac
y.create.l HWIO_RPMH_VRM_ENABLE_DEP_ENABLE_CSR_XOB2_ADDR A:&base_addr+0x9e1aac
y.create.l HWIO_RPMH_VRM_ENABLE_DEP_ENABLE_CSR_XOB3_ADDR A:&base_addr+0x9e1bac
y.create.l HWIO_RPMH_VRM_ENABLE_DEP_ENABLE_CSR_XOB4_ADDR A:&base_addr+0x9e1cac
y.create.l HWIO_RPMH_VRM_ENABLE_DEP_ENABLE_CSR_XOB5_ADDR A:&base_addr+0x9e1dac
y.create.l HWIO_RPMH_VRM_ENABLE_DEP_ENABLE_CSR_XOB6_ADDR A:&base_addr+0x9e1eac
y.create.l HWIO_RPMH_VRM_ENABLE_DEP_ENABLE_CSR_XOB7_ADDR A:&base_addr+0x9e1fac
y.create.l HWIO_RPMH_VRM_ENABLE_SETTLING_BLOCK_ENABLE_CSR_XOB0_ADDR A:&base_addr+0x9e18c8
y.create.l HWIO_RPMH_VRM_ENABLE_SETTLING_BLOCK_ENABLE_CSR_XOB1_ADDR A:&base_addr+0x9e19c8
y.create.l HWIO_RPMH_VRM_ENABLE_SETTLING_BLOCK_ENABLE_CSR_XOB2_ADDR A:&base_addr+0x9e1ac8
y.create.l HWIO_RPMH_VRM_ENABLE_SETTLING_BLOCK_ENABLE_CSR_XOB3_ADDR A:&base_addr+0x9e1bc8
y.create.l HWIO_RPMH_VRM_ENABLE_SETTLING_BLOCK_ENABLE_CSR_XOB4_ADDR A:&base_addr+0x9e1cc8
y.create.l HWIO_RPMH_VRM_ENABLE_SETTLING_BLOCK_ENABLE_CSR_XOB5_ADDR A:&base_addr+0x9e1dc8
y.create.l HWIO_RPMH_VRM_ENABLE_SETTLING_BLOCK_ENABLE_CSR_XOB6_ADDR A:&base_addr+0x9e1ec8
y.create.l HWIO_RPMH_VRM_ENABLE_SETTLING_BLOCK_ENABLE_CSR_XOB7_ADDR A:&base_addr+0x9e1fc8
y.create.l HWIO_RPMH_VRM_XOB_READY_ENABLE_CSR_REG0_ADDR A:&base_addr+0x9e18cc
y.create.l HWIO_RPMH_VRM_XOB_READY_ENABLE_CSR_REG1_ADDR A:&base_addr+0x9e19cc
y.create.l HWIO_RPMH_VRM_XOB_READY_ENABLE_CSR_REG2_ADDR A:&base_addr+0x9e1acc
y.create.l HWIO_RPMH_VRM_XOB_READY_ENABLE_CSR_REG3_ADDR A:&base_addr+0x9e1bcc
y.create.l HWIO_RPMH_VRM_XOB_READY_ENABLE_CSR_REG4_ADDR A:&base_addr+0x9e1ccc
y.create.l HWIO_RPMH_VRM_XOB_READY_ENABLE_CSR_REG5_ADDR A:&base_addr+0x9e1dcc
y.create.l HWIO_RPMH_VRM_XOB_READY_ENABLE_CSR_REG6_ADDR A:&base_addr+0x9e1ecc
y.create.l HWIO_RPMH_VRM_XOB_READY_ENABLE_CSR_REG7_ADDR A:&base_addr+0x9e1fcc
y.create.l HWIO_RPMH_VRM_TYPE_CSR_XO0_ADDR A:&base_addr+0x9e2080
y.create.l HWIO_RPMH_VRM_BASE_ADDR_CSR_XO0_ADDR A:&base_addr+0x9e2084
y.create.l HWIO_RPMH_VRM_ENABLE_SEQ_ID_CSR_XO0_ADDR A:&base_addr+0x9e2090
y.create.l HWIO_RPMH_VRM_ENABLE_DEP_ENABLE_CSR_XO0_ADDR A:&base_addr+0x9e20ac
y.create.l HWIO_RPMH_VRM_ENABLE_SETTLING_BLOCK_ENABLE_CSR_XO0_ADDR A:&base_addr+0x9e20c8
y.create.l HWIO_RPMH_VRM_XO_READY_ENABLE_CSR_REG0_ADDR A:&base_addr+0x9e20cc
y.create.l HWIO_RPMH_VRM_VOLTAGE_ENABLE_SETTLING_DEP_ENABLE_CSR_REG0_ADDR A:&base_addr+0x9e20e4
y.create.l HWIO_RPMH_VRM_VOLTAGE_ENABLE_SETTLING_DEP_ENABLE_CSR_REG1_ADDR A:&base_addr+0x9e21e4
y.create.l HWIO_RPMH_VRM_VOLTAGE_ENABLE_SETTLING_DEP_ENABLE_CSR_REG2_ADDR A:&base_addr+0x9e22e4
y.create.l HWIO_RPMH_VRM_VOLTAGE_ENABLE_SETTLING_DEP_ENABLE_CSR_REG3_ADDR A:&base_addr+0x9e23e4
y.create.l HWIO_RPMH_VRM_VOLTAGE_ENABLE_SETTLING_DEP_ENABLE_CSR_REG4_ADDR A:&base_addr+0x9e24e4
y.create.l HWIO_RPMH_VRM_VOLTAGE_ENABLE_SETTLING_DEP_ENABLE_CSR_REG5_ADDR A:&base_addr+0x9e25e4
y.create.l HWIO_RPMH_VRM_VOLTAGE_ENABLE_SETTLING_DEP_ENABLE_CSR_REG6_ADDR A:&base_addr+0x9e26e4
y.create.l HWIO_RPMH_VRM_VOLTAGE_ENABLE_SETTLING_DEP_ENABLE_CSR_REG7_ADDR A:&base_addr+0x9e27e4
y.create.l HWIO_RPMH_VRM_VOLTAGE_ENABLE_SETTLING_DEP_ENABLE_CSR_REG8_ADDR A:&base_addr+0x9e28e4
y.create.l HWIO_RPMH_VRM_VOLTAGE_ENABLE_SETTLING_DEP_ENABLE_CSR_REG9_ADDR A:&base_addr+0x9e29e4
y.create.l HWIO_RPMH_VRM_VOLTAGE_ENABLE_SETTLING_DEP_ENABLE_CSR_REG10_ADDR A:&base_addr+0x9e2ae4
y.create.l HWIO_RPMH_VRM_VOLTAGE_ENABLE_SETTLING_DEP_ENABLE_CSR_REG11_ADDR A:&base_addr+0x9e2be4
y.create.l HWIO_RPMH_VRM_VOLTAGE_ENABLE_SETTLING_DEP_ENABLE_CSR_REG12_ADDR A:&base_addr+0x9e2ce4
y.create.l HWIO_RPMH_VRM_VOLTAGE_ENABLE_SETTLING_DEP_ENABLE_CSR_REG13_ADDR A:&base_addr+0x9e2de4
y.create.l HWIO_RPMH_VRM_VOLTAGE_ENABLE_SETTLING_DEP_ENABLE_CSR_REG14_ADDR A:&base_addr+0x9e2ee4
y.create.l HWIO_RPMH_VRM_VOLTAGE_ENABLE_SETTLING_DEP_ENABLE_CSR_REG15_ADDR A:&base_addr+0x9e2fe4
y.create.l HWIO_RPMH_VRM_VOLTAGE_ENABLE_SETTLING_DEP_ENABLE_CSR_REG16_ADDR A:&base_addr+0x9e30e4
y.create.l HWIO_RPMH_VRM_VOLTAGE_ENABLE_SETTLING_DEP_ENABLE_CSR_REG17_ADDR A:&base_addr+0x9e31e4
y.create.l HWIO_RPMH_VRM_VOLTAGE_ENABLE_SETTLING_DEP_ENABLE_CSR_REG18_ADDR A:&base_addr+0x9e32e4
y.create.l HWIO_RPMH_VRM_VOLTAGE_ENABLE_SETTLING_DEP_ENABLE_CSR_REG19_ADDR A:&base_addr+0x9e33e4
y.create.l HWIO_RPMH_VRM_VOLTAGE_ENABLE_SETTLING_DEP_ENABLE_CSR_REG20_ADDR A:&base_addr+0x9e34e4
y.create.l HWIO_RPMH_VRM_VOLTAGE_ENABLE_SETTLING_DEP_ENABLE_CSR_REG21_ADDR A:&base_addr+0x9e35e4
y.create.l HWIO_RPMH_VRM_VOLTAGE_ENABLE_SETTLING_DEP_ENABLE_CSR_REG22_ADDR A:&base_addr+0x9e36e4
y.create.l HWIO_RPMH_VRM_VOLTAGE_ENABLE_SETTLING_DEP_ENABLE_CSR_REG23_ADDR A:&base_addr+0x9e37e4
y.create.l HWIO_RPMH_VRM_SW_WORKAROUND_CSR_REG0_ADDR A:&base_addr+0x9e00fc
y.create.l HWIO_RPMH_VRM_SW_WORKAROUND_CSR_REG1_ADDR A:&base_addr+0x9e01fc
y.create.l HWIO_RPMH_VRM_SW_WORKAROUND_CSR_REG2_ADDR A:&base_addr+0x9e02fc
y.create.l HWIO_RPMH_VRM_SW_WORKAROUND_CSR_REG3_ADDR A:&base_addr+0x9e03fc
y.create.l HWIO_RPMH_VRM_SW_WORKAROUND_CSR_REG4_ADDR A:&base_addr+0x9e04fc
y.create.l HWIO_RPMH_VRM_SW_WORKAROUND_CSR_REG5_ADDR A:&base_addr+0x9e05fc
y.create.l HWIO_RPMH_VRM_SW_WORKAROUND_CSR_REG6_ADDR A:&base_addr+0x9e06fc
y.create.l HWIO_RPMH_VRM_SW_WORKAROUND_CSR_REG7_ADDR A:&base_addr+0x9e07fc
y.create.l HWIO_RPMH_VRM_SW_WORKAROUND_CSR_REG8_ADDR A:&base_addr+0x9e08fc
y.create.l HWIO_RPMH_VRM_SW_WORKAROUND_CSR_REG9_ADDR A:&base_addr+0x9e09fc
y.create.l HWIO_RPMH_VRM_SW_WORKAROUND_CSR_REG10_ADDR A:&base_addr+0x9e0afc
y.create.l HWIO_RPMH_VRM_SW_WORKAROUND_CSR_REG11_ADDR A:&base_addr+0x9e0bfc
y.create.l HWIO_RPMH_VRM_SW_WORKAROUND_CSR_REG12_ADDR A:&base_addr+0x9e0cfc
y.create.l HWIO_RPMH_VRM_SW_WORKAROUND_CSR_REG13_ADDR A:&base_addr+0x9e0dfc
y.create.l HWIO_RPMH_VRM_SW_WORKAROUND_CSR_REG14_ADDR A:&base_addr+0x9e0efc
y.create.l HWIO_RPMH_VRM_SW_WORKAROUND_CSR_REG15_ADDR A:&base_addr+0x9e0ffc
y.create.l HWIO_RPMH_VRM_SW_WORKAROUND_CSR_REG16_ADDR A:&base_addr+0x9e10fc
y.create.l HWIO_RPMH_VRM_SW_WORKAROUND_CSR_REG17_ADDR A:&base_addr+0x9e11fc
y.create.l HWIO_RPMH_VRM_SW_WORKAROUND_CSR_REG18_ADDR A:&base_addr+0x9e12fc
y.create.l HWIO_RPMH_VRM_SW_WORKAROUND_CSR_REG19_ADDR A:&base_addr+0x9e13fc
y.create.l HWIO_RPMH_VRM_SW_WORKAROUND_CSR_REG20_ADDR A:&base_addr+0x9e14fc
y.create.l HWIO_RPMH_VRM_SW_WORKAROUND_CSR_REG21_ADDR A:&base_addr+0x9e15fc
y.create.l HWIO_RPMH_VRM_SW_WORKAROUND_CSR_REG22_ADDR A:&base_addr+0x9e16fc
y.create.l HWIO_RPMH_VRM_SW_WORKAROUND_CSR_REG23_ADDR A:&base_addr+0x9e17fc
y.create.l HWIO_RPMH_VRM_XO_SETTLING_TIME_CSR_RES0_ADDR A:&base_addr+0x9ef000
y.create.l HWIO_RPMH_VRM_XOB_SETTLING_TIME_CSR_RES0_ADDR A:&base_addr+0x9ef108
y.create.l HWIO_RPMH_VRM_XOB_SETTLING_TIME_CSR_RES1_ADDR A:&base_addr+0x9ef10c
y.create.l HWIO_RPMH_VRM_XOB_SETTLING_TIME_CSR_RES2_ADDR A:&base_addr+0x9ef110
y.create.l HWIO_RPMH_VRM_XOB_SETTLING_TIME_CSR_RES3_ADDR A:&base_addr+0x9ef114
y.create.l HWIO_RPMH_VRM_XOB_SETTLING_TIME_CSR_RES4_ADDR A:&base_addr+0x9ef118
y.create.l HWIO_RPMH_VRM_XOB_SETTLING_TIME_CSR_RES5_ADDR A:&base_addr+0x9ef11c
y.create.l HWIO_RPMH_VRM_XOB_SETTLING_TIME_CSR_RES6_ADDR A:&base_addr+0x9ef120
y.create.l HWIO_RPMH_VRM_XOB_SETTLING_TIME_CSR_RES7_ADDR A:&base_addr+0x9ef124
y.create.l HWIO_RPMH_VRM_VOLTAGE_ADDR_OFFSET_CSR_TYPE0_ADDR A:&base_addr+0x9f0000
y.create.l HWIO_RPMH_VRM_VOLTAGE_ADDR_OFFSET_CSR_TYPE1_ADDR A:&base_addr+0x9f0060
y.create.l HWIO_RPMH_VRM_VOLTAGE_ADDR_OFFSET_CSR_TYPE2_ADDR A:&base_addr+0x9f00c0
y.create.l HWIO_RPMH_VRM_VOLTAGE_ADDR_OFFSET_CSR_TYPE3_ADDR A:&base_addr+0x9f0120
y.create.l HWIO_RPMH_VRM_VOLTAGE_ADDR_OFFSET_CSR_TYPE4_ADDR A:&base_addr+0x9f0180
y.create.l HWIO_RPMH_VRM_VOLTAGE_ADDR_OFFSET_CSR_TYPE5_ADDR A:&base_addr+0x9f01e0
y.create.l HWIO_RPMH_VRM_VOLTAGE_ADDR_OFFSET_CSR_TYPE6_ADDR A:&base_addr+0x9f0240
y.create.l HWIO_RPMH_VRM_VOLTAGE_ADDR_OFFSET_CSR_TYPE7_ADDR A:&base_addr+0x9f02a0
y.create.l HWIO_RPMH_VRM_VOLTAGE_ADDR_OFFSET_CSR_TYPE8_ADDR A:&base_addr+0x9f0300
y.create.l HWIO_RPMH_VRM_VOLTAGE_ADDR_OFFSET_CSR_TYPE9_ADDR A:&base_addr+0x9f0360
y.create.l HWIO_RPMH_VRM_VOLTAGE_ADDR_OFFSET_CSR_TYPE10_ADDR A:&base_addr+0x9f03c0
y.create.l HWIO_RPMH_VRM_VOLTAGE_ADDR_OFFSET_CSR_TYPE11_ADDR A:&base_addr+0x9f0420
y.create.l HWIO_RPMH_VRM_VOLTAGE_ADDR_OFFSET_CSR_TYPE12_ADDR A:&base_addr+0x9f0480
y.create.l HWIO_RPMH_VRM_VOLTAGE_ADDR_OFFSET_CSR_TYPE13_ADDR A:&base_addr+0x9f04e0
y.create.l HWIO_RPMH_VRM_VOLTAGE_ADDR_OFFSET_CSR_TYPE14_ADDR A:&base_addr+0x9f0540
y.create.l HWIO_RPMH_VRM_VOLTAGE_ADDR_OFFSET_CSR_TYPE15_ADDR A:&base_addr+0x9f05a0
y.create.l HWIO_RPMH_VRM_ENABLE_ADDR_OFFSET_CSR_TYPE0_ADDR A:&base_addr+0x9f0004
y.create.l HWIO_RPMH_VRM_ENABLE_ADDR_OFFSET_CSR_TYPE1_ADDR A:&base_addr+0x9f0064
y.create.l HWIO_RPMH_VRM_ENABLE_ADDR_OFFSET_CSR_TYPE2_ADDR A:&base_addr+0x9f00c4
y.create.l HWIO_RPMH_VRM_ENABLE_ADDR_OFFSET_CSR_TYPE3_ADDR A:&base_addr+0x9f0124
y.create.l HWIO_RPMH_VRM_ENABLE_ADDR_OFFSET_CSR_TYPE4_ADDR A:&base_addr+0x9f0184
y.create.l HWIO_RPMH_VRM_ENABLE_ADDR_OFFSET_CSR_TYPE5_ADDR A:&base_addr+0x9f01e4
y.create.l HWIO_RPMH_VRM_ENABLE_ADDR_OFFSET_CSR_TYPE6_ADDR A:&base_addr+0x9f0244
y.create.l HWIO_RPMH_VRM_ENABLE_ADDR_OFFSET_CSR_TYPE7_ADDR A:&base_addr+0x9f02a4
y.create.l HWIO_RPMH_VRM_ENABLE_ADDR_OFFSET_CSR_TYPE8_ADDR A:&base_addr+0x9f0304
y.create.l HWIO_RPMH_VRM_ENABLE_ADDR_OFFSET_CSR_TYPE9_ADDR A:&base_addr+0x9f0364
y.create.l HWIO_RPMH_VRM_ENABLE_ADDR_OFFSET_CSR_TYPE10_ADDR A:&base_addr+0x9f03c4
y.create.l HWIO_RPMH_VRM_ENABLE_ADDR_OFFSET_CSR_TYPE11_ADDR A:&base_addr+0x9f0424
y.create.l HWIO_RPMH_VRM_ENABLE_ADDR_OFFSET_CSR_TYPE12_ADDR A:&base_addr+0x9f0484
y.create.l HWIO_RPMH_VRM_ENABLE_ADDR_OFFSET_CSR_TYPE13_ADDR A:&base_addr+0x9f04e4
y.create.l HWIO_RPMH_VRM_ENABLE_ADDR_OFFSET_CSR_TYPE14_ADDR A:&base_addr+0x9f0544
y.create.l HWIO_RPMH_VRM_ENABLE_ADDR_OFFSET_CSR_TYPE15_ADDR A:&base_addr+0x9f05a4
y.create.l HWIO_RPMH_VRM_MODE_ADDR_OFFSET_CSR_TYPE0_ADDR A:&base_addr+0x9f0008
y.create.l HWIO_RPMH_VRM_MODE_ADDR_OFFSET_CSR_TYPE1_ADDR A:&base_addr+0x9f0068
y.create.l HWIO_RPMH_VRM_MODE_ADDR_OFFSET_CSR_TYPE2_ADDR A:&base_addr+0x9f00c8
y.create.l HWIO_RPMH_VRM_MODE_ADDR_OFFSET_CSR_TYPE3_ADDR A:&base_addr+0x9f0128
y.create.l HWIO_RPMH_VRM_MODE_ADDR_OFFSET_CSR_TYPE4_ADDR A:&base_addr+0x9f0188
y.create.l HWIO_RPMH_VRM_MODE_ADDR_OFFSET_CSR_TYPE5_ADDR A:&base_addr+0x9f01e8
y.create.l HWIO_RPMH_VRM_MODE_ADDR_OFFSET_CSR_TYPE6_ADDR A:&base_addr+0x9f0248
y.create.l HWIO_RPMH_VRM_MODE_ADDR_OFFSET_CSR_TYPE7_ADDR A:&base_addr+0x9f02a8
y.create.l HWIO_RPMH_VRM_MODE_ADDR_OFFSET_CSR_TYPE8_ADDR A:&base_addr+0x9f0308
y.create.l HWIO_RPMH_VRM_MODE_ADDR_OFFSET_CSR_TYPE9_ADDR A:&base_addr+0x9f0368
y.create.l HWIO_RPMH_VRM_MODE_ADDR_OFFSET_CSR_TYPE10_ADDR A:&base_addr+0x9f03c8
y.create.l HWIO_RPMH_VRM_MODE_ADDR_OFFSET_CSR_TYPE11_ADDR A:&base_addr+0x9f0428
y.create.l HWIO_RPMH_VRM_MODE_ADDR_OFFSET_CSR_TYPE12_ADDR A:&base_addr+0x9f0488
y.create.l HWIO_RPMH_VRM_MODE_ADDR_OFFSET_CSR_TYPE13_ADDR A:&base_addr+0x9f04e8
y.create.l HWIO_RPMH_VRM_MODE_ADDR_OFFSET_CSR_TYPE14_ADDR A:&base_addr+0x9f0548
y.create.l HWIO_RPMH_VRM_MODE_ADDR_OFFSET_CSR_TYPE15_ADDR A:&base_addr+0x9f05a8
y.create.l HWIO_RPMH_VRM_HEADROOM_ADDR_OFFSET_CSR_TYPE0_ADDR A:&base_addr+0x9f000c
y.create.l HWIO_RPMH_VRM_HEADROOM_ADDR_OFFSET_CSR_TYPE1_ADDR A:&base_addr+0x9f006c
y.create.l HWIO_RPMH_VRM_HEADROOM_ADDR_OFFSET_CSR_TYPE2_ADDR A:&base_addr+0x9f00cc
y.create.l HWIO_RPMH_VRM_HEADROOM_ADDR_OFFSET_CSR_TYPE3_ADDR A:&base_addr+0x9f012c
y.create.l HWIO_RPMH_VRM_HEADROOM_ADDR_OFFSET_CSR_TYPE4_ADDR A:&base_addr+0x9f018c
y.create.l HWIO_RPMH_VRM_HEADROOM_ADDR_OFFSET_CSR_TYPE5_ADDR A:&base_addr+0x9f01ec
y.create.l HWIO_RPMH_VRM_HEADROOM_ADDR_OFFSET_CSR_TYPE6_ADDR A:&base_addr+0x9f024c
y.create.l HWIO_RPMH_VRM_HEADROOM_ADDR_OFFSET_CSR_TYPE7_ADDR A:&base_addr+0x9f02ac
y.create.l HWIO_RPMH_VRM_HEADROOM_ADDR_OFFSET_CSR_TYPE8_ADDR A:&base_addr+0x9f030c
y.create.l HWIO_RPMH_VRM_HEADROOM_ADDR_OFFSET_CSR_TYPE9_ADDR A:&base_addr+0x9f036c
y.create.l HWIO_RPMH_VRM_HEADROOM_ADDR_OFFSET_CSR_TYPE10_ADDR A:&base_addr+0x9f03cc
y.create.l HWIO_RPMH_VRM_HEADROOM_ADDR_OFFSET_CSR_TYPE11_ADDR A:&base_addr+0x9f042c
y.create.l HWIO_RPMH_VRM_HEADROOM_ADDR_OFFSET_CSR_TYPE12_ADDR A:&base_addr+0x9f048c
y.create.l HWIO_RPMH_VRM_HEADROOM_ADDR_OFFSET_CSR_TYPE13_ADDR A:&base_addr+0x9f04ec
y.create.l HWIO_RPMH_VRM_HEADROOM_ADDR_OFFSET_CSR_TYPE14_ADDR A:&base_addr+0x9f054c
y.create.l HWIO_RPMH_VRM_HEADROOM_ADDR_OFFSET_CSR_TYPE15_ADDR A:&base_addr+0x9f05ac
y.create.l HWIO_RPMH_VRM_VOLTAGE_STEPPER_SETTLING_TIME_CSR_TYPE0_ADDR A:&base_addr+0x9f001c
y.create.l HWIO_RPMH_VRM_VOLTAGE_STEPPER_SETTLING_TIME_CSR_TYPE1_ADDR A:&base_addr+0x9f007c
y.create.l HWIO_RPMH_VRM_VOLTAGE_STEPPER_SETTLING_TIME_CSR_TYPE2_ADDR A:&base_addr+0x9f00dc
y.create.l HWIO_RPMH_VRM_VOLTAGE_STEPPER_SETTLING_TIME_CSR_TYPE3_ADDR A:&base_addr+0x9f013c
y.create.l HWIO_RPMH_VRM_VOLTAGE_STEPPER_SETTLING_TIME_CSR_TYPE4_ADDR A:&base_addr+0x9f019c
y.create.l HWIO_RPMH_VRM_VOLTAGE_STEPPER_SETTLING_TIME_CSR_TYPE5_ADDR A:&base_addr+0x9f01fc
y.create.l HWIO_RPMH_VRM_VOLTAGE_STEPPER_SETTLING_TIME_CSR_TYPE6_ADDR A:&base_addr+0x9f025c
y.create.l HWIO_RPMH_VRM_VOLTAGE_STEPPER_SETTLING_TIME_CSR_TYPE7_ADDR A:&base_addr+0x9f02bc
y.create.l HWIO_RPMH_VRM_VOLTAGE_STEPPER_SETTLING_TIME_CSR_TYPE8_ADDR A:&base_addr+0x9f031c
y.create.l HWIO_RPMH_VRM_VOLTAGE_STEPPER_SETTLING_TIME_CSR_TYPE9_ADDR A:&base_addr+0x9f037c
y.create.l HWIO_RPMH_VRM_VOLTAGE_STEPPER_SETTLING_TIME_CSR_TYPE10_ADDR A:&base_addr+0x9f03dc
y.create.l HWIO_RPMH_VRM_VOLTAGE_STEPPER_SETTLING_TIME_CSR_TYPE11_ADDR A:&base_addr+0x9f043c
y.create.l HWIO_RPMH_VRM_VOLTAGE_STEPPER_SETTLING_TIME_CSR_TYPE12_ADDR A:&base_addr+0x9f049c
y.create.l HWIO_RPMH_VRM_VOLTAGE_STEPPER_SETTLING_TIME_CSR_TYPE13_ADDR A:&base_addr+0x9f04fc
y.create.l HWIO_RPMH_VRM_VOLTAGE_STEPPER_SETTLING_TIME_CSR_TYPE14_ADDR A:&base_addr+0x9f055c
y.create.l HWIO_RPMH_VRM_VOLTAGE_STEPPER_SETTLING_TIME_CSR_TYPE15_ADDR A:&base_addr+0x9f05bc
y.create.l HWIO_RPMH_VRM_VOLTAGE_FIXED_UP_SETTLING_TIME_CSR_TYPE0_ADDR A:&base_addr+0x9f0020
y.create.l HWIO_RPMH_VRM_VOLTAGE_FIXED_UP_SETTLING_TIME_CSR_TYPE1_ADDR A:&base_addr+0x9f0080
y.create.l HWIO_RPMH_VRM_VOLTAGE_FIXED_UP_SETTLING_TIME_CSR_TYPE2_ADDR A:&base_addr+0x9f00e0
y.create.l HWIO_RPMH_VRM_VOLTAGE_FIXED_UP_SETTLING_TIME_CSR_TYPE3_ADDR A:&base_addr+0x9f0140
y.create.l HWIO_RPMH_VRM_VOLTAGE_FIXED_UP_SETTLING_TIME_CSR_TYPE4_ADDR A:&base_addr+0x9f01a0
y.create.l HWIO_RPMH_VRM_VOLTAGE_FIXED_UP_SETTLING_TIME_CSR_TYPE5_ADDR A:&base_addr+0x9f0200
y.create.l HWIO_RPMH_VRM_VOLTAGE_FIXED_UP_SETTLING_TIME_CSR_TYPE6_ADDR A:&base_addr+0x9f0260
y.create.l HWIO_RPMH_VRM_VOLTAGE_FIXED_UP_SETTLING_TIME_CSR_TYPE7_ADDR A:&base_addr+0x9f02c0
y.create.l HWIO_RPMH_VRM_VOLTAGE_FIXED_UP_SETTLING_TIME_CSR_TYPE8_ADDR A:&base_addr+0x9f0320
y.create.l HWIO_RPMH_VRM_VOLTAGE_FIXED_UP_SETTLING_TIME_CSR_TYPE9_ADDR A:&base_addr+0x9f0380
y.create.l HWIO_RPMH_VRM_VOLTAGE_FIXED_UP_SETTLING_TIME_CSR_TYPE10_ADDR A:&base_addr+0x9f03e0
y.create.l HWIO_RPMH_VRM_VOLTAGE_FIXED_UP_SETTLING_TIME_CSR_TYPE11_ADDR A:&base_addr+0x9f0440
y.create.l HWIO_RPMH_VRM_VOLTAGE_FIXED_UP_SETTLING_TIME_CSR_TYPE12_ADDR A:&base_addr+0x9f04a0
y.create.l HWIO_RPMH_VRM_VOLTAGE_FIXED_UP_SETTLING_TIME_CSR_TYPE13_ADDR A:&base_addr+0x9f0500
y.create.l HWIO_RPMH_VRM_VOLTAGE_FIXED_UP_SETTLING_TIME_CSR_TYPE14_ADDR A:&base_addr+0x9f0560
y.create.l HWIO_RPMH_VRM_VOLTAGE_FIXED_UP_SETTLING_TIME_CSR_TYPE15_ADDR A:&base_addr+0x9f05c0
y.create.l HWIO_RPMH_VRM_VOLTAGE_FIXED_DOWN_SETTLING_TIME_CSR_TYPE0_ADDR A:&base_addr+0x9f0024
y.create.l HWIO_RPMH_VRM_VOLTAGE_FIXED_DOWN_SETTLING_TIME_CSR_TYPE1_ADDR A:&base_addr+0x9f0084
y.create.l HWIO_RPMH_VRM_VOLTAGE_FIXED_DOWN_SETTLING_TIME_CSR_TYPE2_ADDR A:&base_addr+0x9f00e4
y.create.l HWIO_RPMH_VRM_VOLTAGE_FIXED_DOWN_SETTLING_TIME_CSR_TYPE3_ADDR A:&base_addr+0x9f0144
y.create.l HWIO_RPMH_VRM_VOLTAGE_FIXED_DOWN_SETTLING_TIME_CSR_TYPE4_ADDR A:&base_addr+0x9f01a4
y.create.l HWIO_RPMH_VRM_VOLTAGE_FIXED_DOWN_SETTLING_TIME_CSR_TYPE5_ADDR A:&base_addr+0x9f0204
y.create.l HWIO_RPMH_VRM_VOLTAGE_FIXED_DOWN_SETTLING_TIME_CSR_TYPE6_ADDR A:&base_addr+0x9f0264
y.create.l HWIO_RPMH_VRM_VOLTAGE_FIXED_DOWN_SETTLING_TIME_CSR_TYPE7_ADDR A:&base_addr+0x9f02c4
y.create.l HWIO_RPMH_VRM_VOLTAGE_FIXED_DOWN_SETTLING_TIME_CSR_TYPE8_ADDR A:&base_addr+0x9f0324
y.create.l HWIO_RPMH_VRM_VOLTAGE_FIXED_DOWN_SETTLING_TIME_CSR_TYPE9_ADDR A:&base_addr+0x9f0384
y.create.l HWIO_RPMH_VRM_VOLTAGE_FIXED_DOWN_SETTLING_TIME_CSR_TYPE10_ADDR A:&base_addr+0x9f03e4
y.create.l HWIO_RPMH_VRM_VOLTAGE_FIXED_DOWN_SETTLING_TIME_CSR_TYPE11_ADDR A:&base_addr+0x9f0444
y.create.l HWIO_RPMH_VRM_VOLTAGE_FIXED_DOWN_SETTLING_TIME_CSR_TYPE12_ADDR A:&base_addr+0x9f04a4
y.create.l HWIO_RPMH_VRM_VOLTAGE_FIXED_DOWN_SETTLING_TIME_CSR_TYPE13_ADDR A:&base_addr+0x9f0504
y.create.l HWIO_RPMH_VRM_VOLTAGE_FIXED_DOWN_SETTLING_TIME_CSR_TYPE14_ADDR A:&base_addr+0x9f0564
y.create.l HWIO_RPMH_VRM_VOLTAGE_FIXED_DOWN_SETTLING_TIME_CSR_TYPE15_ADDR A:&base_addr+0x9f05c4
y.create.l HWIO_RPMH_VRM_VOLTAGE_UP_SETTLING_TIME_SEL_ADDR A:&base_addr+0x9f0ff0
y.create.l HWIO_RPMH_VRM_VOLTAGE_DOWN_SETTLING_TIME_SEL_ADDR A:&base_addr+0x9f0ff4
y.create.l HWIO_RPMH_VRM_ENABLE_STEPPER_SETTLING_TIME_CSR_TYPE0_ADDR A:&base_addr+0x9f0028
y.create.l HWIO_RPMH_VRM_ENABLE_STEPPER_SETTLING_TIME_CSR_TYPE1_ADDR A:&base_addr+0x9f0088
y.create.l HWIO_RPMH_VRM_ENABLE_STEPPER_SETTLING_TIME_CSR_TYPE2_ADDR A:&base_addr+0x9f00e8
y.create.l HWIO_RPMH_VRM_ENABLE_STEPPER_SETTLING_TIME_CSR_TYPE3_ADDR A:&base_addr+0x9f0148
y.create.l HWIO_RPMH_VRM_ENABLE_STEPPER_SETTLING_TIME_CSR_TYPE4_ADDR A:&base_addr+0x9f01a8
y.create.l HWIO_RPMH_VRM_ENABLE_STEPPER_SETTLING_TIME_CSR_TYPE5_ADDR A:&base_addr+0x9f0208
y.create.l HWIO_RPMH_VRM_ENABLE_STEPPER_SETTLING_TIME_CSR_TYPE6_ADDR A:&base_addr+0x9f0268
y.create.l HWIO_RPMH_VRM_ENABLE_STEPPER_SETTLING_TIME_CSR_TYPE7_ADDR A:&base_addr+0x9f02c8
y.create.l HWIO_RPMH_VRM_ENABLE_STEPPER_SETTLING_TIME_CSR_TYPE8_ADDR A:&base_addr+0x9f0328
y.create.l HWIO_RPMH_VRM_ENABLE_STEPPER_SETTLING_TIME_CSR_TYPE9_ADDR A:&base_addr+0x9f0388
y.create.l HWIO_RPMH_VRM_ENABLE_STEPPER_SETTLING_TIME_CSR_TYPE10_ADDR A:&base_addr+0x9f03e8
y.create.l HWIO_RPMH_VRM_ENABLE_STEPPER_SETTLING_TIME_CSR_TYPE11_ADDR A:&base_addr+0x9f0448
y.create.l HWIO_RPMH_VRM_ENABLE_STEPPER_SETTLING_TIME_CSR_TYPE12_ADDR A:&base_addr+0x9f04a8
y.create.l HWIO_RPMH_VRM_ENABLE_STEPPER_SETTLING_TIME_CSR_TYPE13_ADDR A:&base_addr+0x9f0508
y.create.l HWIO_RPMH_VRM_ENABLE_STEPPER_SETTLING_TIME_CSR_TYPE14_ADDR A:&base_addr+0x9f0568
y.create.l HWIO_RPMH_VRM_ENABLE_STEPPER_SETTLING_TIME_CSR_TYPE15_ADDR A:&base_addr+0x9f05c8
y.create.l HWIO_RPMH_VRM_ENABLE_FIXED_SETTLING_TIME_CSR_TYPE0_ADDR A:&base_addr+0x9f002c
y.create.l HWIO_RPMH_VRM_ENABLE_FIXED_SETTLING_TIME_CSR_TYPE1_ADDR A:&base_addr+0x9f008c
y.create.l HWIO_RPMH_VRM_ENABLE_FIXED_SETTLING_TIME_CSR_TYPE2_ADDR A:&base_addr+0x9f00ec
y.create.l HWIO_RPMH_VRM_ENABLE_FIXED_SETTLING_TIME_CSR_TYPE3_ADDR A:&base_addr+0x9f014c
y.create.l HWIO_RPMH_VRM_ENABLE_FIXED_SETTLING_TIME_CSR_TYPE4_ADDR A:&base_addr+0x9f01ac
y.create.l HWIO_RPMH_VRM_ENABLE_FIXED_SETTLING_TIME_CSR_TYPE5_ADDR A:&base_addr+0x9f020c
y.create.l HWIO_RPMH_VRM_ENABLE_FIXED_SETTLING_TIME_CSR_TYPE6_ADDR A:&base_addr+0x9f026c
y.create.l HWIO_RPMH_VRM_ENABLE_FIXED_SETTLING_TIME_CSR_TYPE7_ADDR A:&base_addr+0x9f02cc
y.create.l HWIO_RPMH_VRM_ENABLE_FIXED_SETTLING_TIME_CSR_TYPE8_ADDR A:&base_addr+0x9f032c
y.create.l HWIO_RPMH_VRM_ENABLE_FIXED_SETTLING_TIME_CSR_TYPE9_ADDR A:&base_addr+0x9f038c
y.create.l HWIO_RPMH_VRM_ENABLE_FIXED_SETTLING_TIME_CSR_TYPE10_ADDR A:&base_addr+0x9f03ec
y.create.l HWIO_RPMH_VRM_ENABLE_FIXED_SETTLING_TIME_CSR_TYPE11_ADDR A:&base_addr+0x9f044c
y.create.l HWIO_RPMH_VRM_ENABLE_FIXED_SETTLING_TIME_CSR_TYPE12_ADDR A:&base_addr+0x9f04ac
y.create.l HWIO_RPMH_VRM_ENABLE_FIXED_SETTLING_TIME_CSR_TYPE13_ADDR A:&base_addr+0x9f050c
y.create.l HWIO_RPMH_VRM_ENABLE_FIXED_SETTLING_TIME_CSR_TYPE14_ADDR A:&base_addr+0x9f056c
y.create.l HWIO_RPMH_VRM_ENABLE_FIXED_SETTLING_TIME_CSR_TYPE15_ADDR A:&base_addr+0x9f05cc
y.create.l HWIO_RPMH_VRM_ENABLE_WARM_UP_TIME_CSR_TYPE0_ADDR A:&base_addr+0x9f0030
y.create.l HWIO_RPMH_VRM_ENABLE_WARM_UP_TIME_CSR_TYPE1_ADDR A:&base_addr+0x9f0090
y.create.l HWIO_RPMH_VRM_ENABLE_WARM_UP_TIME_CSR_TYPE2_ADDR A:&base_addr+0x9f00f0
y.create.l HWIO_RPMH_VRM_ENABLE_WARM_UP_TIME_CSR_TYPE3_ADDR A:&base_addr+0x9f0150
y.create.l HWIO_RPMH_VRM_ENABLE_WARM_UP_TIME_CSR_TYPE4_ADDR A:&base_addr+0x9f01b0
y.create.l HWIO_RPMH_VRM_ENABLE_WARM_UP_TIME_CSR_TYPE5_ADDR A:&base_addr+0x9f0210
y.create.l HWIO_RPMH_VRM_ENABLE_WARM_UP_TIME_CSR_TYPE6_ADDR A:&base_addr+0x9f0270
y.create.l HWIO_RPMH_VRM_ENABLE_WARM_UP_TIME_CSR_TYPE7_ADDR A:&base_addr+0x9f02d0
y.create.l HWIO_RPMH_VRM_ENABLE_WARM_UP_TIME_CSR_TYPE8_ADDR A:&base_addr+0x9f0330
y.create.l HWIO_RPMH_VRM_ENABLE_WARM_UP_TIME_CSR_TYPE9_ADDR A:&base_addr+0x9f0390
y.create.l HWIO_RPMH_VRM_ENABLE_WARM_UP_TIME_CSR_TYPE10_ADDR A:&base_addr+0x9f03f0
y.create.l HWIO_RPMH_VRM_ENABLE_WARM_UP_TIME_CSR_TYPE11_ADDR A:&base_addr+0x9f0450
y.create.l HWIO_RPMH_VRM_ENABLE_WARM_UP_TIME_CSR_TYPE12_ADDR A:&base_addr+0x9f04b0
y.create.l HWIO_RPMH_VRM_ENABLE_WARM_UP_TIME_CSR_TYPE13_ADDR A:&base_addr+0x9f0510
y.create.l HWIO_RPMH_VRM_ENABLE_WARM_UP_TIME_CSR_TYPE14_ADDR A:&base_addr+0x9f0570
y.create.l HWIO_RPMH_VRM_ENABLE_WARM_UP_TIME_CSR_TYPE15_ADDR A:&base_addr+0x9f05d0
y.create.l HWIO_RPMH_VRM_ENABLE_UP_SETTLING_TIME_SEL_ADDR A:&base_addr+0x9f0ff8
y.create.l HWIO_RPMH_VRM_MODE_SETTLING_TIME_CSR_TYPE0_ADDR A:&base_addr+0x9f0034
y.create.l HWIO_RPMH_VRM_MODE_SETTLING_TIME_CSR_TYPE1_ADDR A:&base_addr+0x9f0094
y.create.l HWIO_RPMH_VRM_MODE_SETTLING_TIME_CSR_TYPE2_ADDR A:&base_addr+0x9f00f4
y.create.l HWIO_RPMH_VRM_MODE_SETTLING_TIME_CSR_TYPE3_ADDR A:&base_addr+0x9f0154
y.create.l HWIO_RPMH_VRM_MODE_SETTLING_TIME_CSR_TYPE4_ADDR A:&base_addr+0x9f01b4
y.create.l HWIO_RPMH_VRM_MODE_SETTLING_TIME_CSR_TYPE5_ADDR A:&base_addr+0x9f0214
y.create.l HWIO_RPMH_VRM_MODE_SETTLING_TIME_CSR_TYPE6_ADDR A:&base_addr+0x9f0274
y.create.l HWIO_RPMH_VRM_MODE_SETTLING_TIME_CSR_TYPE7_ADDR A:&base_addr+0x9f02d4
y.create.l HWIO_RPMH_VRM_MODE_SETTLING_TIME_CSR_TYPE8_ADDR A:&base_addr+0x9f0334
y.create.l HWIO_RPMH_VRM_MODE_SETTLING_TIME_CSR_TYPE9_ADDR A:&base_addr+0x9f0394
y.create.l HWIO_RPMH_VRM_MODE_SETTLING_TIME_CSR_TYPE10_ADDR A:&base_addr+0x9f03f4
y.create.l HWIO_RPMH_VRM_MODE_SETTLING_TIME_CSR_TYPE11_ADDR A:&base_addr+0x9f0454
y.create.l HWIO_RPMH_VRM_MODE_SETTLING_TIME_CSR_TYPE12_ADDR A:&base_addr+0x9f04b4
y.create.l HWIO_RPMH_VRM_MODE_SETTLING_TIME_CSR_TYPE13_ADDR A:&base_addr+0x9f0514
y.create.l HWIO_RPMH_VRM_MODE_SETTLING_TIME_CSR_TYPE14_ADDR A:&base_addr+0x9f0574
y.create.l HWIO_RPMH_VRM_MODE_SETTLING_TIME_CSR_TYPE15_ADDR A:&base_addr+0x9f05d4
y.create.l HWIO_RPMH_VRM_HEADROOM_SETTLING_TIME_CSR_TYPE0_ADDR A:&base_addr+0x9f0038
y.create.l HWIO_RPMH_VRM_HEADROOM_SETTLING_TIME_CSR_TYPE1_ADDR A:&base_addr+0x9f0098
y.create.l HWIO_RPMH_VRM_HEADROOM_SETTLING_TIME_CSR_TYPE2_ADDR A:&base_addr+0x9f00f8
y.create.l HWIO_RPMH_VRM_HEADROOM_SETTLING_TIME_CSR_TYPE3_ADDR A:&base_addr+0x9f0158
y.create.l HWIO_RPMH_VRM_HEADROOM_SETTLING_TIME_CSR_TYPE4_ADDR A:&base_addr+0x9f01b8
y.create.l HWIO_RPMH_VRM_HEADROOM_SETTLING_TIME_CSR_TYPE5_ADDR A:&base_addr+0x9f0218
y.create.l HWIO_RPMH_VRM_HEADROOM_SETTLING_TIME_CSR_TYPE6_ADDR A:&base_addr+0x9f0278
y.create.l HWIO_RPMH_VRM_HEADROOM_SETTLING_TIME_CSR_TYPE7_ADDR A:&base_addr+0x9f02d8
y.create.l HWIO_RPMH_VRM_HEADROOM_SETTLING_TIME_CSR_TYPE8_ADDR A:&base_addr+0x9f0338
y.create.l HWIO_RPMH_VRM_HEADROOM_SETTLING_TIME_CSR_TYPE9_ADDR A:&base_addr+0x9f0398
y.create.l HWIO_RPMH_VRM_HEADROOM_SETTLING_TIME_CSR_TYPE10_ADDR A:&base_addr+0x9f03f8
y.create.l HWIO_RPMH_VRM_HEADROOM_SETTLING_TIME_CSR_TYPE11_ADDR A:&base_addr+0x9f0458
y.create.l HWIO_RPMH_VRM_HEADROOM_SETTLING_TIME_CSR_TYPE12_ADDR A:&base_addr+0x9f04b8
y.create.l HWIO_RPMH_VRM_HEADROOM_SETTLING_TIME_CSR_TYPE13_ADDR A:&base_addr+0x9f0518
y.create.l HWIO_RPMH_VRM_HEADROOM_SETTLING_TIME_CSR_TYPE14_ADDR A:&base_addr+0x9f0578
y.create.l HWIO_RPMH_VRM_HEADROOM_SETTLING_TIME_CSR_TYPE15_ADDR A:&base_addr+0x9f05d8
y.create.l HWIO_RPMH_VRM_VREG_READY_WDOG_TIMER_MUL_CSR_TYPE0_ADDR A:&base_addr+0x9f003c
y.create.l HWIO_RPMH_VRM_VREG_READY_WDOG_TIMER_MUL_CSR_TYPE1_ADDR A:&base_addr+0x9f009c
y.create.l HWIO_RPMH_VRM_VREG_READY_WDOG_TIMER_MUL_CSR_TYPE2_ADDR A:&base_addr+0x9f00fc
y.create.l HWIO_RPMH_VRM_VREG_READY_WDOG_TIMER_MUL_CSR_TYPE3_ADDR A:&base_addr+0x9f015c
y.create.l HWIO_RPMH_VRM_VREG_READY_WDOG_TIMER_MUL_CSR_TYPE4_ADDR A:&base_addr+0x9f01bc
y.create.l HWIO_RPMH_VRM_VREG_READY_WDOG_TIMER_MUL_CSR_TYPE5_ADDR A:&base_addr+0x9f021c
y.create.l HWIO_RPMH_VRM_VREG_READY_WDOG_TIMER_MUL_CSR_TYPE6_ADDR A:&base_addr+0x9f027c
y.create.l HWIO_RPMH_VRM_VREG_READY_WDOG_TIMER_MUL_CSR_TYPE7_ADDR A:&base_addr+0x9f02dc
y.create.l HWIO_RPMH_VRM_VREG_READY_WDOG_TIMER_MUL_CSR_TYPE8_ADDR A:&base_addr+0x9f033c
y.create.l HWIO_RPMH_VRM_VREG_READY_WDOG_TIMER_MUL_CSR_TYPE9_ADDR A:&base_addr+0x9f039c
y.create.l HWIO_RPMH_VRM_VREG_READY_WDOG_TIMER_MUL_CSR_TYPE10_ADDR A:&base_addr+0x9f03fc
y.create.l HWIO_RPMH_VRM_VREG_READY_WDOG_TIMER_MUL_CSR_TYPE11_ADDR A:&base_addr+0x9f045c
y.create.l HWIO_RPMH_VRM_VREG_READY_WDOG_TIMER_MUL_CSR_TYPE12_ADDR A:&base_addr+0x9f04bc
y.create.l HWIO_RPMH_VRM_VREG_READY_WDOG_TIMER_MUL_CSR_TYPE13_ADDR A:&base_addr+0x9f051c
y.create.l HWIO_RPMH_VRM_VREG_READY_WDOG_TIMER_MUL_CSR_TYPE14_ADDR A:&base_addr+0x9f057c
y.create.l HWIO_RPMH_VRM_VREG_READY_WDOG_TIMER_MUL_CSR_TYPE15_ADDR A:&base_addr+0x9f05dc
y.create.l HWIO_RPMH_VRM_VOLTAGE_UP_EXTRA_TIME_TYPE0_ADDR A:&base_addr+0x9f0040
y.create.l HWIO_RPMH_VRM_VOLTAGE_UP_EXTRA_TIME_TYPE1_ADDR A:&base_addr+0x9f00a0
y.create.l HWIO_RPMH_VRM_VOLTAGE_UP_EXTRA_TIME_TYPE2_ADDR A:&base_addr+0x9f0100
y.create.l HWIO_RPMH_VRM_VOLTAGE_UP_EXTRA_TIME_TYPE3_ADDR A:&base_addr+0x9f0160
y.create.l HWIO_RPMH_VRM_VOLTAGE_UP_EXTRA_TIME_TYPE4_ADDR A:&base_addr+0x9f01c0
y.create.l HWIO_RPMH_VRM_VOLTAGE_UP_EXTRA_TIME_TYPE5_ADDR A:&base_addr+0x9f0220
y.create.l HWIO_RPMH_VRM_VOLTAGE_UP_EXTRA_TIME_TYPE6_ADDR A:&base_addr+0x9f0280
y.create.l HWIO_RPMH_VRM_VOLTAGE_UP_EXTRA_TIME_TYPE7_ADDR A:&base_addr+0x9f02e0
y.create.l HWIO_RPMH_VRM_VOLTAGE_UP_EXTRA_TIME_TYPE8_ADDR A:&base_addr+0x9f0340
y.create.l HWIO_RPMH_VRM_VOLTAGE_UP_EXTRA_TIME_TYPE9_ADDR A:&base_addr+0x9f03a0
y.create.l HWIO_RPMH_VRM_VOLTAGE_UP_EXTRA_TIME_TYPE10_ADDR A:&base_addr+0x9f0400
y.create.l HWIO_RPMH_VRM_VOLTAGE_UP_EXTRA_TIME_TYPE11_ADDR A:&base_addr+0x9f0460
y.create.l HWIO_RPMH_VRM_VOLTAGE_UP_EXTRA_TIME_TYPE12_ADDR A:&base_addr+0x9f04c0
y.create.l HWIO_RPMH_VRM_VOLTAGE_UP_EXTRA_TIME_TYPE13_ADDR A:&base_addr+0x9f0520
y.create.l HWIO_RPMH_VRM_VOLTAGE_UP_EXTRA_TIME_TYPE14_ADDR A:&base_addr+0x9f0580
y.create.l HWIO_RPMH_VRM_VOLTAGE_UP_EXTRA_TIME_TYPE15_ADDR A:&base_addr+0x9f05e0
y.create.l HWIO_RPMH_VRM_VOLTAGE_DOWN_EXTRA_TIME_TYPE0_ADDR A:&base_addr+0x9f0044
y.create.l HWIO_RPMH_VRM_VOLTAGE_DOWN_EXTRA_TIME_TYPE1_ADDR A:&base_addr+0x9f00a4
y.create.l HWIO_RPMH_VRM_VOLTAGE_DOWN_EXTRA_TIME_TYPE2_ADDR A:&base_addr+0x9f0104
y.create.l HWIO_RPMH_VRM_VOLTAGE_DOWN_EXTRA_TIME_TYPE3_ADDR A:&base_addr+0x9f0164
y.create.l HWIO_RPMH_VRM_VOLTAGE_DOWN_EXTRA_TIME_TYPE4_ADDR A:&base_addr+0x9f01c4
y.create.l HWIO_RPMH_VRM_VOLTAGE_DOWN_EXTRA_TIME_TYPE5_ADDR A:&base_addr+0x9f0224
y.create.l HWIO_RPMH_VRM_VOLTAGE_DOWN_EXTRA_TIME_TYPE6_ADDR A:&base_addr+0x9f0284
y.create.l HWIO_RPMH_VRM_VOLTAGE_DOWN_EXTRA_TIME_TYPE7_ADDR A:&base_addr+0x9f02e4
y.create.l HWIO_RPMH_VRM_VOLTAGE_DOWN_EXTRA_TIME_TYPE8_ADDR A:&base_addr+0x9f0344
y.create.l HWIO_RPMH_VRM_VOLTAGE_DOWN_EXTRA_TIME_TYPE9_ADDR A:&base_addr+0x9f03a4
y.create.l HWIO_RPMH_VRM_VOLTAGE_DOWN_EXTRA_TIME_TYPE10_ADDR A:&base_addr+0x9f0404
y.create.l HWIO_RPMH_VRM_VOLTAGE_DOWN_EXTRA_TIME_TYPE11_ADDR A:&base_addr+0x9f0464
y.create.l HWIO_RPMH_VRM_VOLTAGE_DOWN_EXTRA_TIME_TYPE12_ADDR A:&base_addr+0x9f04c4
y.create.l HWIO_RPMH_VRM_VOLTAGE_DOWN_EXTRA_TIME_TYPE13_ADDR A:&base_addr+0x9f0524
y.create.l HWIO_RPMH_VRM_VOLTAGE_DOWN_EXTRA_TIME_TYPE14_ADDR A:&base_addr+0x9f0584
y.create.l HWIO_RPMH_VRM_VOLTAGE_DOWN_EXTRA_TIME_TYPE15_ADDR A:&base_addr+0x9f05e4
y.create.l HWIO_RPMH_VRM_VREG_CLR_ADDR_OFFSET_CSR_TYPE0_ADDR A:&base_addr+0x9f004c
y.create.l HWIO_RPMH_VRM_VREG_CLR_ADDR_OFFSET_CSR_TYPE1_ADDR A:&base_addr+0x9f00ac
y.create.l HWIO_RPMH_VRM_VREG_CLR_ADDR_OFFSET_CSR_TYPE2_ADDR A:&base_addr+0x9f010c
y.create.l HWIO_RPMH_VRM_VREG_CLR_ADDR_OFFSET_CSR_TYPE3_ADDR A:&base_addr+0x9f016c
y.create.l HWIO_RPMH_VRM_VREG_CLR_ADDR_OFFSET_CSR_TYPE4_ADDR A:&base_addr+0x9f01cc
y.create.l HWIO_RPMH_VRM_VREG_CLR_ADDR_OFFSET_CSR_TYPE5_ADDR A:&base_addr+0x9f022c
y.create.l HWIO_RPMH_VRM_VREG_CLR_ADDR_OFFSET_CSR_TYPE6_ADDR A:&base_addr+0x9f028c
y.create.l HWIO_RPMH_VRM_VREG_CLR_ADDR_OFFSET_CSR_TYPE7_ADDR A:&base_addr+0x9f02ec
y.create.l HWIO_RPMH_VRM_VREG_CLR_ADDR_OFFSET_CSR_TYPE8_ADDR A:&base_addr+0x9f034c
y.create.l HWIO_RPMH_VRM_VREG_CLR_ADDR_OFFSET_CSR_TYPE9_ADDR A:&base_addr+0x9f03ac
y.create.l HWIO_RPMH_VRM_VREG_CLR_ADDR_OFFSET_CSR_TYPE10_ADDR A:&base_addr+0x9f040c
y.create.l HWIO_RPMH_VRM_VREG_CLR_ADDR_OFFSET_CSR_TYPE11_ADDR A:&base_addr+0x9f046c
y.create.l HWIO_RPMH_VRM_VREG_CLR_ADDR_OFFSET_CSR_TYPE12_ADDR A:&base_addr+0x9f04cc
y.create.l HWIO_RPMH_VRM_VREG_CLR_ADDR_OFFSET_CSR_TYPE13_ADDR A:&base_addr+0x9f052c
y.create.l HWIO_RPMH_VRM_VREG_CLR_ADDR_OFFSET_CSR_TYPE14_ADDR A:&base_addr+0x9f058c
y.create.l HWIO_RPMH_VRM_VREG_CLR_ADDR_OFFSET_CSR_TYPE15_ADDR A:&base_addr+0x9f05ec
y.create.l HWIO_RPMH_VRM_VREG_CLR_DATA_CSR_TYPE0_ADDR A:&base_addr+0x9f0050
y.create.l HWIO_RPMH_VRM_VREG_CLR_DATA_CSR_TYPE1_ADDR A:&base_addr+0x9f00b0
y.create.l HWIO_RPMH_VRM_VREG_CLR_DATA_CSR_TYPE2_ADDR A:&base_addr+0x9f0110
y.create.l HWIO_RPMH_VRM_VREG_CLR_DATA_CSR_TYPE3_ADDR A:&base_addr+0x9f0170
y.create.l HWIO_RPMH_VRM_VREG_CLR_DATA_CSR_TYPE4_ADDR A:&base_addr+0x9f01d0
y.create.l HWIO_RPMH_VRM_VREG_CLR_DATA_CSR_TYPE5_ADDR A:&base_addr+0x9f0230
y.create.l HWIO_RPMH_VRM_VREG_CLR_DATA_CSR_TYPE6_ADDR A:&base_addr+0x9f0290
y.create.l HWIO_RPMH_VRM_VREG_CLR_DATA_CSR_TYPE7_ADDR A:&base_addr+0x9f02f0
y.create.l HWIO_RPMH_VRM_VREG_CLR_DATA_CSR_TYPE8_ADDR A:&base_addr+0x9f0350
y.create.l HWIO_RPMH_VRM_VREG_CLR_DATA_CSR_TYPE9_ADDR A:&base_addr+0x9f03b0
y.create.l HWIO_RPMH_VRM_VREG_CLR_DATA_CSR_TYPE10_ADDR A:&base_addr+0x9f0410
y.create.l HWIO_RPMH_VRM_VREG_CLR_DATA_CSR_TYPE11_ADDR A:&base_addr+0x9f0470
y.create.l HWIO_RPMH_VRM_VREG_CLR_DATA_CSR_TYPE12_ADDR A:&base_addr+0x9f04d0
y.create.l HWIO_RPMH_VRM_VREG_CLR_DATA_CSR_TYPE13_ADDR A:&base_addr+0x9f0530
y.create.l HWIO_RPMH_VRM_VREG_CLR_DATA_CSR_TYPE14_ADDR A:&base_addr+0x9f0590
y.create.l HWIO_RPMH_VRM_VREG_CLR_DATA_CSR_TYPE15_ADDR A:&base_addr+0x9f05f0
y.create.l HWIO_RPMH_VRM_DISCHARGE_TIME_CSR_TYPE0_ADDR A:&base_addr+0x9f0054
y.create.l HWIO_RPMH_VRM_DISCHARGE_TIME_CSR_TYPE1_ADDR A:&base_addr+0x9f00b4
y.create.l HWIO_RPMH_VRM_DISCHARGE_TIME_CSR_TYPE2_ADDR A:&base_addr+0x9f0114
y.create.l HWIO_RPMH_VRM_DISCHARGE_TIME_CSR_TYPE3_ADDR A:&base_addr+0x9f0174
y.create.l HWIO_RPMH_VRM_DISCHARGE_TIME_CSR_TYPE4_ADDR A:&base_addr+0x9f01d4
y.create.l HWIO_RPMH_VRM_DISCHARGE_TIME_CSR_TYPE5_ADDR A:&base_addr+0x9f0234
y.create.l HWIO_RPMH_VRM_DISCHARGE_TIME_CSR_TYPE6_ADDR A:&base_addr+0x9f0294
y.create.l HWIO_RPMH_VRM_DISCHARGE_TIME_CSR_TYPE7_ADDR A:&base_addr+0x9f02f4
y.create.l HWIO_RPMH_VRM_DISCHARGE_TIME_CSR_TYPE8_ADDR A:&base_addr+0x9f0354
y.create.l HWIO_RPMH_VRM_DISCHARGE_TIME_CSR_TYPE9_ADDR A:&base_addr+0x9f03b4
y.create.l HWIO_RPMH_VRM_DISCHARGE_TIME_CSR_TYPE10_ADDR A:&base_addr+0x9f0414
y.create.l HWIO_RPMH_VRM_DISCHARGE_TIME_CSR_TYPE11_ADDR A:&base_addr+0x9f0474
y.create.l HWIO_RPMH_VRM_DISCHARGE_TIME_CSR_TYPE12_ADDR A:&base_addr+0x9f04d4
y.create.l HWIO_RPMH_VRM_DISCHARGE_TIME_CSR_TYPE13_ADDR A:&base_addr+0x9f0534
y.create.l HWIO_RPMH_VRM_DISCHARGE_TIME_CSR_TYPE14_ADDR A:&base_addr+0x9f0594
y.create.l HWIO_RPMH_VRM_DISCHARGE_TIME_CSR_TYPE15_ADDR A:&base_addr+0x9f05f4
y.create.l HWIO_RPMH_VRM_VOLTAGE_DEP_IRQ_STATUS_0_CSR_ADDR A:&base_addr+0x9f1000
y.create.l HWIO_RPMH_VRM_ENABLE_DEP_IRQ_STATUS_0_CSR_ADDR A:&base_addr+0x9f1018
y.create.l HWIO_RPMH_VRM_ENABLE_DEP_IRQ_STATUS_1_CSR_ADDR A:&base_addr+0x9f101c
y.create.l HWIO_RPMH_VRM_MODE_DEP_IRQ_STATUS_0_CSR_ADDR A:&base_addr+0x9f1038
y.create.l HWIO_RPMH_VRM_HEADROOM_DEP_IRQ_STATUS_0_CSR_ADDR A:&base_addr+0x9f1050
y.create.l HWIO_RPMH_VRM_VOLTAGE_CHANGE_IRQ_STATUS_0_CSR_ADDR A:&base_addr+0x9f1108
y.create.l HWIO_RPMH_VRM_ENABLE_CHANGE_IRQ_STATUS_0_CSR_ADDR A:&base_addr+0x9f1120
y.create.l HWIO_RPMH_VRM_ENABLE_CHANGE_IRQ_STATUS_1_CSR_ADDR A:&base_addr+0x9f1124
y.create.l HWIO_RPMH_VRM_MODE_CHANGE_IRQ_STATUS_0_CSR_ADDR A:&base_addr+0x9f1140
y.create.l HWIO_RPMH_VRM_HEADROOM_CHANGE_IRQ_STATUS_0_CSR_ADDR A:&base_addr+0x9f1158
y.create.l HWIO_RPMH_VRM_VOLTAGE_SETTLED_IRQ_STATUS_0_CSR_ADDR A:&base_addr+0x9f1170
y.create.l HWIO_RPMH_VRM_ENABLE_SETTLED_IRQ_STATUS_0_CSR_ADDR A:&base_addr+0x9f1188
y.create.l HWIO_RPMH_VRM_ENABLE_SETTLED_IRQ_STATUS_1_CSR_ADDR A:&base_addr+0x9f118c
y.create.l HWIO_RPMH_VRM_MODE_SETTLED_IRQ_STATUS_0_CSR_ADDR A:&base_addr+0x9f11a0
y.create.l HWIO_RPMH_VRM_HEADROOM_SETTLED_IRQ_STATUS_0_CSR_ADDR A:&base_addr+0x9f11b8
y.create.l HWIO_RPMH_VRM_VREG_READY_WDOG_IRQ_STATUS_0_CSR_ADDR A:&base_addr+0x9f1270
y.create.l HWIO_RPMH_VRM_VOLTAGE_DEP_IRQ_ENABLE_0_CSR_ADDR A:&base_addr+0x9f12c0
y.create.l HWIO_RPMH_VRM_ENABLE_DEP_IRQ_ENABLE_0_CSR_ADDR A:&base_addr+0x9f12d8
y.create.l HWIO_RPMH_VRM_ENABLE_DEP_IRQ_ENABLE_1_CSR_ADDR A:&base_addr+0x9f12dc
y.create.l HWIO_RPMH_VRM_MODE_DEP_IRQ_ENABLE_0_CSR_ADDR A:&base_addr+0x9f12f8
y.create.l HWIO_RPMH_VRM_HEADROOM_DEP_IRQ_ENABLE_0_CSR_ADDR A:&base_addr+0x9f1310
y.create.l HWIO_RPMH_VRM_VOLTAGE_CHANGE_IRQ_ENABLE_0_CSR_ADDR A:&base_addr+0x9f13c8
y.create.l HWIO_RPMH_VRM_ENABLE_CHANGE_IRQ_ENABLE_0_CSR_ADDR A:&base_addr+0x9f13e0
y.create.l HWIO_RPMH_VRM_ENABLE_CHANGE_IRQ_ENABLE_1_CSR_ADDR A:&base_addr+0x9f13e4
y.create.l HWIO_RPMH_VRM_MODE_CHANGE_IRQ_ENABLE_0_CSR_ADDR A:&base_addr+0x9f1400
y.create.l HWIO_RPMH_VRM_HEADROOM_CHANGE_IRQ_ENABLE_0_CSR_ADDR A:&base_addr+0x9f1418
y.create.l HWIO_RPMH_VRM_VOLTAGE_SETTLED_IRQ_ENABLE_0_CSR_ADDR A:&base_addr+0x9f14d0
y.create.l HWIO_RPMH_VRM_ENABLE_SETTLED_IRQ_ENABLE_0_CSR_ADDR A:&base_addr+0x9f14e8
y.create.l HWIO_RPMH_VRM_ENABLE_SETTLED_IRQ_ENABLE_1_CSR_ADDR A:&base_addr+0x9f14ec
y.create.l HWIO_RPMH_VRM_MODE_SETTLED_IRQ_ENABLE_0_CSR_ADDR A:&base_addr+0x9f1508
y.create.l HWIO_RPMH_VRM_HEADROOM_SETTLED_IRQ_ENABLE_0_CSR_ADDR A:&base_addr+0x9f1520
y.create.l HWIO_RPMH_VRM_VREG_READY_WDOG_IRQ_ENABLE_0_CSR_ADDR A:&base_addr+0x9f1538
;y.create.l HWIO_RPMH_VRM_VOLTAGE_CHANGE_IRQ_CLEAR_0_CSR_ADDR A:&base_addr+0x9f1588
;y.create.l HWIO_RPMH_VRM_ENABLE_CHANGE_IRQ_CLEAR_0_CSR_ADDR A:&base_addr+0x9f15a0
;y.create.l HWIO_RPMH_VRM_ENABLE_CHANGE_IRQ_CLEAR_1_CSR_ADDR A:&base_addr+0x9f15a4
;y.create.l HWIO_RPMH_VRM_MODE_CHANGE_IRQ_CLEAR_0_CSR_ADDR A:&base_addr+0x9f15c0
;y.create.l HWIO_RPMH_VRM_HEADROOM_CHANGE_IRQ_CLEAR_0_CSR_ADDR A:&base_addr+0x9f15d8
;y.create.l HWIO_RPMH_VRM_VOLTAGE_SETTLED_IRQ_CLEAR_0_CSR_ADDR A:&base_addr+0x9f1690
;y.create.l HWIO_RPMH_VRM_ENABLE_SETTLED_IRQ_CLEAR_0_CSR_ADDR A:&base_addr+0x9f16a8
;y.create.l HWIO_RPMH_VRM_ENABLE_SETTLED_IRQ_CLEAR_1_CSR_ADDR A:&base_addr+0x9f16ac
;y.create.l HWIO_RPMH_VRM_MODE_SETTLED_IRQ_CLEAR_0_CSR_ADDR A:&base_addr+0x9f16c8
;y.create.l HWIO_RPMH_VRM_HEADROOM_SETTLED_IRQ_CLEAR_0_CSR_ADDR A:&base_addr+0x9f16e0
;y.create.l HWIO_RPMH_VRM_VREG_READY_WDOG_IRQ_CLEAR_0_CSR_ADDR A:&base_addr+0x9f1798
y.create.l HWIO_RPMH_VRM_MAX_VOLTAGE_VIOLATION_IRQ_STATUS_0_CSR_ADDR A:&base_addr+0x9f17b4
y.create.l HWIO_RPMH_VRM_MAX_VOLTAGE_VIOLATION_IRQ_ENABLE_0_CSR_ADDR A:&base_addr+0x9f17c0
;y.create.l HWIO_RPMH_VRM_MAX_VOLTAGE_VIOLATION_IRQ_CLEAR_0_CSR_ADDR A:&base_addr+0x9f18c0
y.create.l HWIO_RPMH_VRM_CTT_OVERFLOW_IRQ_STATUS_CSR_ADDR A:&base_addr+0x9f18cc
y.create.l HWIO_RPMH_VRM_CTT_OVERFLOW_IRQ_ENABLE_CSR_ADDR A:&base_addr+0x9f18d0
;y.create.l HWIO_RPMH_VRM_CTT_OVERFLOW_IRQ_CLEAR_CSR_ADDR A:&base_addr+0x9f18d4
y.create.l HWIO_RPMH_VRM_S_PORT_FAILURE_IRQ_STATUS_CSR_ADDR A:&base_addr+0x9f18d8
y.create.l HWIO_RPMH_VRM_S_PORT_FAILURE_IRQ_ENABLE_CSR_ADDR A:&base_addr+0x9f18dc
;y.create.l HWIO_RPMH_VRM_S_PORT_FAILURE_IRQ_CLEAR_CSR_ADDR A:&base_addr+0x9f18e0
;y.create.l HWIO_RPMH_VRM_SW_UNBLOCK_SEQ_PRE_CSR_ADDR A:&base_addr+0x9f18e4
;y.create.l HWIO_RPMH_VRM_SW_UNBLOCK_SEQ_POST_CSR_ADDR A:&base_addr+0x9f18e8
;y.create.l HWIO_RPMH_VRM_SEQUENCER_IRQ_CLEAR_PRE_CSR_ADDR A:&base_addr+0x9f18ec
;y.create.l HWIO_RPMH_VRM_SEQUENCER_IRQ_CLEAR_POST_CSR_ADDR A:&base_addr+0x9f18f0
y.create.l HWIO_RPMH_VRM_SEQUENCER_IRQ_ENABLE_PRE_CSR_ADDR A:&base_addr+0x9f18f4
y.create.l HWIO_RPMH_VRM_SEQUENCER_IRQ_ENABLE_POST_CSR_ADDR A:&base_addr+0x9f18f8
y.create.l HWIO_RPMH_VRM_SEQUENCER_IRQ_STATUS_PRE_CSR_ADDR A:&base_addr+0x9f18fc
y.create.l HWIO_RPMH_VRM_SEQUENCER_IRQ_STATUS_POST_CSR_ADDR A:&base_addr+0x9f1900
y.create.l HWIO_RPMH_VRM_SEQUENCER0_STATUS_CSR_ADDR A:&base_addr+0x9f2000
y.create.l HWIO_RPMH_VRM_SEQUENCER1_STATUS_CSR_ADDR A:&base_addr+0x9f2004
y.create.l HWIO_RPMH_VRM_SEQUENCER2_STATUS_CSR_ADDR A:&base_addr+0x9f2008
y.create.l HWIO_RPMH_VRM_SEQUENCER3_STATUS_CSR_ADDR A:&base_addr+0x9f200c
y.create.l HWIO_RPMH_VRM_SEQUENCER4_STATUS_CSR_ADDR A:&base_addr+0x9f2010
y.create.l HWIO_RPMH_VRM_SEQUENCER5_STATUS_CSR_ADDR A:&base_addr+0x9f2014
y.create.l HWIO_RPMH_VRM_SEQUENCER6_STATUS_CSR_ADDR A:&base_addr+0x9f2018
y.create.l HWIO_RPMH_VRM_SEQUENCER7_STATUS_CSR_ADDR A:&base_addr+0x9f201c
y.create.l HWIO_RPMH_VRM_SEQUENCER8_STATUS_CSR_ADDR A:&base_addr+0x9f2020
y.create.l HWIO_RPMH_VRM_SEQUENCER9_STATUS_CSR_ADDR A:&base_addr+0x9f2024
y.create.l HWIO_RPMH_VRM_SEQUENCER10_STATUS_CSR_ADDR A:&base_addr+0x9f2028
y.create.l HWIO_RPMH_VRM_SEQUENCER11_STATUS_CSR_ADDR A:&base_addr+0x9f202c
y.create.l HWIO_RPMH_VRM_SEQUENCER12_STATUS_CSR_ADDR A:&base_addr+0x9f2030
y.create.l HWIO_RPMH_VRM_SEQUENCER13_STATUS_CSR_ADDR A:&base_addr+0x9f2034
y.create.l HWIO_RPMH_VRM_SEQUENCER14_STATUS_CSR_ADDR A:&base_addr+0x9f2038
y.create.l HWIO_RPMH_VRM_SEQUENCER15_STATUS_CSR_ADDR A:&base_addr+0x9f203c
y.create.l HWIO_RPMH_VRM_SEQUENCER16_STATUS_CSR_ADDR A:&base_addr+0x9f2040
y.create.l HWIO_RPMH_VRM_SEQUENCER17_STATUS_CSR_ADDR A:&base_addr+0x9f2044
y.create.l HWIO_RPMH_VRM_SEQUENCER18_STATUS_CSR_ADDR A:&base_addr+0x9f2048
y.create.l HWIO_RPMH_VRM_SEQUENCER19_STATUS_CSR_ADDR A:&base_addr+0x9f204c
y.create.l HWIO_RPMH_VRM_VRM_IDLE_STATUS_CSR_ADDR A:&base_addr+0x9f2100
y.create.l HWIO_RPMH_VRM_SEQ_START_ADDR0_ADDR A:&base_addr+0x9f3190
y.create.l HWIO_RPMH_VRM_SEQ_START_ADDR1_ADDR A:&base_addr+0x9f3194
y.create.l HWIO_RPMH_VRM_SEQ_START_ADDR2_ADDR A:&base_addr+0x9f3198
y.create.l HWIO_RPMH_VRM_SEQ_START_ADDR3_ADDR A:&base_addr+0x9f319c
y.create.l HWIO_RPMH_VRM_SEQ_START_ADDR4_ADDR A:&base_addr+0x9f31a0
y.create.l HWIO_RPMH_VRM_SEQ_START_ADDR5_ADDR A:&base_addr+0x9f31a4
y.create.l HWIO_RPMH_VRM_SEQ_START_ADDR6_ADDR A:&base_addr+0x9f31a8
y.create.l HWIO_RPMH_VRM_SEQ_START_ADDR7_ADDR A:&base_addr+0x9f31ac
y.create.l HWIO_RPMH_VRM_SEQ_WORD0_ADDR A:&base_addr+0x9f31f4
y.create.l HWIO_RPMH_VRM_SEQ_WORD1_ADDR A:&base_addr+0x9f31f8
y.create.l HWIO_RPMH_VRM_SEQ_WORD2_ADDR A:&base_addr+0x9f31fc
y.create.l HWIO_RPMH_VRM_SEQ_WORD3_ADDR A:&base_addr+0x9f3200
y.create.l HWIO_RPMH_VRM_SEQ_WORD4_ADDR A:&base_addr+0x9f3204
y.create.l HWIO_RPMH_VRM_SEQ_WORD5_ADDR A:&base_addr+0x9f3208
y.create.l HWIO_RPMH_VRM_SEQ_WORD6_ADDR A:&base_addr+0x9f320c
y.create.l HWIO_RPMH_VRM_SEQ_WORD7_ADDR A:&base_addr+0x9f3210
y.create.l HWIO_RPMH_VRM_SEQ_WORD8_ADDR A:&base_addr+0x9f3214
y.create.l HWIO_RPMH_VRM_SEQ_WORD9_ADDR A:&base_addr+0x9f3218
y.create.l HWIO_RPMH_VRM_SEQ_WORD10_ADDR A:&base_addr+0x9f321c
y.create.l HWIO_RPMH_VRM_SEQ_WORD11_ADDR A:&base_addr+0x9f3220
y.create.l HWIO_RPMH_VRM_SEQ_WORD12_ADDR A:&base_addr+0x9f3224
y.create.l HWIO_RPMH_VRM_SEQ_WORD13_ADDR A:&base_addr+0x9f3228
y.create.l HWIO_RPMH_VRM_SEQ_WORD14_ADDR A:&base_addr+0x9f322c
y.create.l HWIO_RPMH_VRM_SEQ_WORD15_ADDR A:&base_addr+0x9f3230
y.create.l HWIO_RPMH_VRM_SEQ_WORD16_ADDR A:&base_addr+0x9f3234
y.create.l HWIO_RPMH_VRM_SEQ_WORD17_ADDR A:&base_addr+0x9f3238
y.create.l HWIO_RPMH_VRM_SEQ_WORD18_ADDR A:&base_addr+0x9f323c
y.create.l HWIO_RPMH_VRM_SEQ_WORD19_ADDR A:&base_addr+0x9f3240
y.create.l HWIO_RPMH_VRM_SEQ_WORD20_ADDR A:&base_addr+0x9f3244
y.create.l HWIO_RPMH_VRM_SEQ_WORD21_ADDR A:&base_addr+0x9f3248
y.create.l HWIO_RPMH_VRM_SEQ_WORD22_ADDR A:&base_addr+0x9f324c
y.create.l HWIO_RPMH_VRM_SEQ_WORD23_ADDR A:&base_addr+0x9f3250
y.create.l HWIO_RPMH_VRM_SEQ_WORD24_ADDR A:&base_addr+0x9f3254
y.create.l HWIO_RPMH_VRM_SEQ_WORD25_ADDR A:&base_addr+0x9f3258
y.create.l HWIO_RPMH_VRM_SEQ_WORD26_ADDR A:&base_addr+0x9f325c
y.create.l HWIO_RPMH_VRM_SEQ_WORD27_ADDR A:&base_addr+0x9f3260
y.create.l HWIO_RPMH_VRM_SEQ_WORD28_ADDR A:&base_addr+0x9f3264
y.create.l HWIO_RPMH_VRM_SEQ_WORD29_ADDR A:&base_addr+0x9f3268
y.create.l HWIO_RPMH_VRM_SEQ_WORD30_ADDR A:&base_addr+0x9f326c
y.create.l HWIO_RPMH_VRM_SEQ_WORD31_ADDR A:&base_addr+0x9f3270
y.create.l HWIO_RPMH_VRM_SEQ_DATA_0_SEQCERS0_ADDR A:&base_addr+0x9f35f4
y.create.l HWIO_RPMH_VRM_SEQ_DATA_0_SEQCERS1_ADDR A:&base_addr+0x9f3600
y.create.l HWIO_RPMH_VRM_SEQ_DATA_0_SEQCERS2_ADDR A:&base_addr+0x9f360c
y.create.l HWIO_RPMH_VRM_SEQ_DATA_0_SEQCERS3_ADDR A:&base_addr+0x9f3618
y.create.l HWIO_RPMH_VRM_SEQ_DATA_0_SEQCERS4_ADDR A:&base_addr+0x9f3624
y.create.l HWIO_RPMH_VRM_SEQ_DATA_0_SEQCERS5_ADDR A:&base_addr+0x9f3630
y.create.l HWIO_RPMH_VRM_SEQ_DATA_0_SEQCERS6_ADDR A:&base_addr+0x9f363c
y.create.l HWIO_RPMH_VRM_SEQ_DATA_0_SEQCERS7_ADDR A:&base_addr+0x9f3648
y.create.l HWIO_RPMH_VRM_SEQ_DATA_0_SEQCERS8_ADDR A:&base_addr+0x9f3654
y.create.l HWIO_RPMH_VRM_SEQ_DATA_0_SEQCERS9_ADDR A:&base_addr+0x9f3660
y.create.l HWIO_RPMH_VRM_SEQ_DATA_0_SEQCERS10_ADDR A:&base_addr+0x9f366c
y.create.l HWIO_RPMH_VRM_SEQ_DATA_0_SEQCERS11_ADDR A:&base_addr+0x9f3678
y.create.l HWIO_RPMH_VRM_SEQ_DATA_0_SEQCERS12_ADDR A:&base_addr+0x9f3684
y.create.l HWIO_RPMH_VRM_SEQ_DATA_0_SEQCERS13_ADDR A:&base_addr+0x9f3690
y.create.l HWIO_RPMH_VRM_SEQ_DATA_0_SEQCERS14_ADDR A:&base_addr+0x9f369c
y.create.l HWIO_RPMH_VRM_SEQ_DATA_0_SEQCERS15_ADDR A:&base_addr+0x9f36a8
y.create.l HWIO_RPMH_VRM_SEQ_DATA_0_SEQCERS16_ADDR A:&base_addr+0x9f36b4
y.create.l HWIO_RPMH_VRM_SEQ_DATA_0_SEQCERS17_ADDR A:&base_addr+0x9f36c0
y.create.l HWIO_RPMH_VRM_SEQ_DATA_0_SEQCERS18_ADDR A:&base_addr+0x9f36cc
y.create.l HWIO_RPMH_VRM_SEQ_DATA_0_SEQCERS19_ADDR A:&base_addr+0x9f36d8
y.create.l HWIO_RPMH_VRM_SEQ_DATA_1_SEQCERS0_ADDR A:&base_addr+0x9f35f8
y.create.l HWIO_RPMH_VRM_SEQ_DATA_1_SEQCERS1_ADDR A:&base_addr+0x9f3604
y.create.l HWIO_RPMH_VRM_SEQ_DATA_1_SEQCERS2_ADDR A:&base_addr+0x9f3610
y.create.l HWIO_RPMH_VRM_SEQ_DATA_1_SEQCERS3_ADDR A:&base_addr+0x9f361c
y.create.l HWIO_RPMH_VRM_SEQ_DATA_1_SEQCERS4_ADDR A:&base_addr+0x9f3628
y.create.l HWIO_RPMH_VRM_SEQ_DATA_1_SEQCERS5_ADDR A:&base_addr+0x9f3634
y.create.l HWIO_RPMH_VRM_SEQ_DATA_1_SEQCERS6_ADDR A:&base_addr+0x9f3640
y.create.l HWIO_RPMH_VRM_SEQ_DATA_1_SEQCERS7_ADDR A:&base_addr+0x9f364c
y.create.l HWIO_RPMH_VRM_SEQ_DATA_1_SEQCERS8_ADDR A:&base_addr+0x9f3658
y.create.l HWIO_RPMH_VRM_SEQ_DATA_1_SEQCERS9_ADDR A:&base_addr+0x9f3664
y.create.l HWIO_RPMH_VRM_SEQ_DATA_1_SEQCERS10_ADDR A:&base_addr+0x9f3670
y.create.l HWIO_RPMH_VRM_SEQ_DATA_1_SEQCERS11_ADDR A:&base_addr+0x9f367c
y.create.l HWIO_RPMH_VRM_SEQ_DATA_1_SEQCERS12_ADDR A:&base_addr+0x9f3688
y.create.l HWIO_RPMH_VRM_SEQ_DATA_1_SEQCERS13_ADDR A:&base_addr+0x9f3694
y.create.l HWIO_RPMH_VRM_SEQ_DATA_1_SEQCERS14_ADDR A:&base_addr+0x9f36a0
y.create.l HWIO_RPMH_VRM_SEQ_DATA_1_SEQCERS15_ADDR A:&base_addr+0x9f36ac
y.create.l HWIO_RPMH_VRM_SEQ_DATA_1_SEQCERS16_ADDR A:&base_addr+0x9f36b8
y.create.l HWIO_RPMH_VRM_SEQ_DATA_1_SEQCERS17_ADDR A:&base_addr+0x9f36c4
y.create.l HWIO_RPMH_VRM_SEQ_DATA_1_SEQCERS18_ADDR A:&base_addr+0x9f36d0
y.create.l HWIO_RPMH_VRM_SEQ_DATA_1_SEQCERS19_ADDR A:&base_addr+0x9f36dc
y.create.l HWIO_RPMH_VRM_SEQ_DATA_2_SEQCERS0_ADDR A:&base_addr+0x9f35fc
y.create.l HWIO_RPMH_VRM_SEQ_DATA_2_SEQCERS1_ADDR A:&base_addr+0x9f3608
y.create.l HWIO_RPMH_VRM_SEQ_DATA_2_SEQCERS2_ADDR A:&base_addr+0x9f3614
y.create.l HWIO_RPMH_VRM_SEQ_DATA_2_SEQCERS3_ADDR A:&base_addr+0x9f3620
y.create.l HWIO_RPMH_VRM_SEQ_DATA_2_SEQCERS4_ADDR A:&base_addr+0x9f362c
y.create.l HWIO_RPMH_VRM_SEQ_DATA_2_SEQCERS5_ADDR A:&base_addr+0x9f3638
y.create.l HWIO_RPMH_VRM_SEQ_DATA_2_SEQCERS6_ADDR A:&base_addr+0x9f3644
y.create.l HWIO_RPMH_VRM_SEQ_DATA_2_SEQCERS7_ADDR A:&base_addr+0x9f3650
y.create.l HWIO_RPMH_VRM_SEQ_DATA_2_SEQCERS8_ADDR A:&base_addr+0x9f365c
y.create.l HWIO_RPMH_VRM_SEQ_DATA_2_SEQCERS9_ADDR A:&base_addr+0x9f3668
y.create.l HWIO_RPMH_VRM_SEQ_DATA_2_SEQCERS10_ADDR A:&base_addr+0x9f3674
y.create.l HWIO_RPMH_VRM_SEQ_DATA_2_SEQCERS11_ADDR A:&base_addr+0x9f3680
y.create.l HWIO_RPMH_VRM_SEQ_DATA_2_SEQCERS12_ADDR A:&base_addr+0x9f368c
y.create.l HWIO_RPMH_VRM_SEQ_DATA_2_SEQCERS13_ADDR A:&base_addr+0x9f3698
y.create.l HWIO_RPMH_VRM_SEQ_DATA_2_SEQCERS14_ADDR A:&base_addr+0x9f36a4
y.create.l HWIO_RPMH_VRM_SEQ_DATA_2_SEQCERS15_ADDR A:&base_addr+0x9f36b0
y.create.l HWIO_RPMH_VRM_SEQ_DATA_2_SEQCERS16_ADDR A:&base_addr+0x9f36bc
y.create.l HWIO_RPMH_VRM_SEQ_DATA_2_SEQCERS17_ADDR A:&base_addr+0x9f36c8
y.create.l HWIO_RPMH_VRM_SEQ_DATA_2_SEQCERS18_ADDR A:&base_addr+0x9f36d4
y.create.l HWIO_RPMH_VRM_SEQ_DATA_2_SEQCERS19_ADDR A:&base_addr+0x9f36e0
y.create.l HWIO_RPMH_VRM_VRM_VERSION_ADDR A:&base_addr+0x9f5000
y.create.l HWIO_RPMH_VRM_VREG_READY_EXTRA_TIME_ADDR A:&base_addr+0x9f5004
y.create.l HWIO_RPMH_VRM_VREG_READY_WDOG_ERROR_ENABLE_ADDR A:&base_addr+0x9f5008
y.create.l HWIO_RPMH_VRM_VREG_READY_CLR_BR_ADDR_CSR_REG_ADDR A:&base_addr+0x9f500c
y.create.l HWIO_RPMH_VRM_CMD_SYN_UNBLOCK_ADDR A:&base_addr+0x9f5010
y.create.l HWIO_RPMH_VRM_MIN_SETTLING_TIME_CSR_REG_ADDR A:&base_addr+0x9f5014
y.create.l HWIO_RPMH_VRM_RESP_ADDR_DRV0_ADDR A:&base_addr+0x9f5090
y.create.l HWIO_RPMH_VRM_RESP_ADDR_DRV1_ADDR A:&base_addr+0x9f5094
y.create.l HWIO_RPMH_VRM_RESP_ADDR_DRV2_ADDR A:&base_addr+0x9f5098
y.create.l HWIO_RPMH_VRM_RESP_ADDR_DRV3_ADDR A:&base_addr+0x9f509c
y.create.l HWIO_RPMH_VRM_RESP_ADDR_DRV4_ADDR A:&base_addr+0x9f50a0
y.create.l HWIO_RPMH_VRM_RESP_ADDR_DRV5_ADDR A:&base_addr+0x9f50a4
y.create.l HWIO_RPMH_VRM_RESP_ADDR_DRV6_ADDR A:&base_addr+0x9f50a8
y.create.l HWIO_RPMH_VRM_RESP_ADDR2_DRV0_ADDR A:&base_addr+0x9f5100
y.create.l HWIO_RPMH_VRM_RESP_ADDR2_DRV1_ADDR A:&base_addr+0x9f5104
y.create.l HWIO_RPMH_VRM_RESP_ADDR2_DRV2_ADDR A:&base_addr+0x9f5108
y.create.l HWIO_RPMH_VRM_RESP_ADDR2_DRV3_ADDR A:&base_addr+0x9f510c
y.create.l HWIO_RPMH_VRM_RESP_ADDR2_DRV4_ADDR A:&base_addr+0x9f5110
y.create.l HWIO_RPMH_VRM_RESP_ADDR2_DRV5_ADDR A:&base_addr+0x9f5114
y.create.l HWIO_RPMH_VRM_RESP_ADDR2_DRV6_ADDR A:&base_addr+0x9f5118
y.create.l HWIO_RPMH_VRM_VRM_CFG_ADDR A:&base_addr+0x9f54a8
y.create.l HWIO_RPMH_VRM_CMD_SYN_CFG_ADDR A:&base_addr+0x9f54ac
y.create.l HWIO_RPMH_VRM_SW_WORKAROUND_BR_ADDR0_CSR_REG_ADDR A:&base_addr+0x9f54b0
y.create.l HWIO_RPMH_VRM_SW_WORKAROUND_BR_ADDR1_CSR_REG_ADDR A:&base_addr+0x9f54b4
y.create.l HWIO_RPMH_VRM_SW_WORKAROUND_BR_ADDR2_CSR_REG_ADDR A:&base_addr+0x9f54b8
y.create.l HWIO_RPMH_VRM_VRM_CLK_GATING_EN_CFG_ADDR A:&base_addr+0x9f54bc
y.create.l HWIO_RPMH_VRM_VRM_DEBUG_BUS_EN_CFG_ADDR A:&base_addr+0x9f54c0
y.create.l HWIO_RPMH_VRM_VRM_DEBUG_BUS_CFG_ADDR A:&base_addr+0x9f54c4
y.create.l HWIO_RPMH_BCM_BCM_CFG_DRV_ID_FOR_VRM_VOTE_ADDR A:&base_addr+0xbe7088
y.create.l HWIO_RPMH_CPRF_VRM_COMPLETION_WA_ADDR A:&base_addr+0x120000c
y.create.l HWIO_RPMH_CPRF_VRM_BRCST_WA_ADDR A:&base_addr+0x1200010
y.create.l HWIO_RPMH_CPRF_VRM_BRCST_ENDIANNESS_ADDR A:&base_addr+0x1200030
y.create.l HWIO_RPMH_CPRF_CPRF0_VRM_SETTINGS_ADDR A:&base_addr+0x1201008
y.create.l HWIO_RPMH_CPRF_CPRF1_VRM_SETTINGS_ADDR A:&base_addr+0x1202008
y.create.l HWIO_RPMH_CPRF_CPRF2_VRM_SETTINGS_ADDR A:&base_addr+0x1203008
y.create.l HWIO_RPMH_CPRF_CPRF3_VRM_SETTINGS_ADDR A:&base_addr+0x1204008
y.create.l HWIO_RPMH_CPRF_VRM_MESSAGE_ADDR A:&base_addr+0x120f000
y.create.l HWIO_PMIC_ARB_VRM_S_INTF_CTL_ADDR A:&base_addr+0x1442200
y.create.l HWIO_PMIC_ARB_VRM_S_INTF_STATUS_ADDR A:&base_addr+0x1442204
y.create.l HWIO_PMIC_ARB_VRM_S_PORT_CTL_ADDR A:&base_addr+0x1442208
y.create.l HWIO_PMIC_ARB_VRM_S_PORT_STATUS_ADDR A:&base_addr+0x144220c
y.create.l HWIO_PMIC_ARB_VRM_S_ADDR0_ADDR A:&base_addr+0x1442300
y.create.l HWIO_PMIC_ARB_VRM_S_ADDR1_ADDR A:&base_addr+0x1442304
y.create.l HWIO_PMIC_ARB_VRM_S_ADDR2_ADDR A:&base_addr+0x1442308
y.create.l HWIO_PMIC_ARB_VRM_S_ADDR3_ADDR A:&base_addr+0x144230c
y.create.l HWIO_PMIC_ARB_VRM_S_ADDR4_ADDR A:&base_addr+0x1442310
y.create.l HWIO_PMIC_ARB_VRM_S_ADDR5_ADDR A:&base_addr+0x1442314
y.create.l HWIO_PMIC_ARB_VRM_S_ADDR6_ADDR A:&base_addr+0x1442318
y.create.l HWIO_PMIC_ARB_VRM_S_ADDR7_ADDR A:&base_addr+0x144231c
y.create.l HWIO_PMIC_ARB_VRM_S_ADDR8_ADDR A:&base_addr+0x1442320
y.create.l HWIO_PMIC_ARB_VRM_S_ADDR9_ADDR A:&base_addr+0x1442324
y.create.l HWIO_PMIC_ARB_VRM_S_ADDR10_ADDR A:&base_addr+0x1442328
y.create.l HWIO_PMIC_ARB_VRM_S_ADDR11_ADDR A:&base_addr+0x144232c
y.create.l HWIO_PMIC_ARB_VRM_S_ADDR12_ADDR A:&base_addr+0x1442330
y.create.l HWIO_PMIC_ARB_VRM_S_ADDR13_ADDR A:&base_addr+0x1442334
y.create.l HWIO_PMIC_ARB_VRM_S_ADDR14_ADDR A:&base_addr+0x1442338
y.create.l HWIO_PMIC_ARB_VRM_S_ADDR15_ADDR A:&base_addr+0x144233c
y.create.l HWIO_PMIC_ARB_VRM_S_ADDR16_ADDR A:&base_addr+0x1442340
y.create.l HWIO_PMIC_ARB_VRM_S_ADDR17_ADDR A:&base_addr+0x1442344
y.create.l HWIO_PMIC_ARB_VRM_S_ADDR18_ADDR A:&base_addr+0x1442348
y.create.l HWIO_PMIC_ARB_VRM_S_ADDR19_ADDR A:&base_addr+0x144234c
y.create.l HWIO_PMIC_ARB_VRM_S_ADDR20_ADDR A:&base_addr+0x1442350
y.create.l HWIO_PMIC_ARB_VRM_S_ADDR21_ADDR A:&base_addr+0x1442354
y.create.l HWIO_PMIC_ARB_VRM_S_ADDR22_ADDR A:&base_addr+0x1442358
y.create.l HWIO_PMIC_ARB_VRM_S_ADDR23_ADDR A:&base_addr+0x144235c
y.create.l HWIO_PMIC_ARB_VRM_S_ADDR24_ADDR A:&base_addr+0x1442360
y.create.l HWIO_PMIC_ARB_VRM_S_ADDR25_ADDR A:&base_addr+0x1442364
y.create.l HWIO_PMIC_ARB_VRM_S_ADDR26_ADDR A:&base_addr+0x1442368
y.create.l HWIO_PMIC_ARB_VRM_S_ADDR27_ADDR A:&base_addr+0x144236c
y.create.l HWIO_PMIC_ARB_VRM_S_ADDR28_ADDR A:&base_addr+0x1442370
y.create.l HWIO_PMIC_ARB_VRM_S_ADDR29_ADDR A:&base_addr+0x1442374
y.create.l HWIO_PMIC_ARB_VRM_S_ADDR30_ADDR A:&base_addr+0x1442378
y.create.l HWIO_PMIC_ARB_VRM_S_ADDR31_ADDR A:&base_addr+0x144237c
y.create.l HWIO_PMIC_ARB_VRM_S_ADDR32_ADDR A:&base_addr+0x1442380
y.create.l HWIO_PMIC_ARB_VRM_S_ADDR33_ADDR A:&base_addr+0x1442384
y.create.l HWIO_PMIC_ARB_VRM_S_ADDR34_ADDR A:&base_addr+0x1442388
y.create.l HWIO_PMIC_ARB_VRM_S_ADDR35_ADDR A:&base_addr+0x144238c
y.create.l HWIO_PMIC_ARB_VRM_S_ADDR36_ADDR A:&base_addr+0x1442390
y.create.l HWIO_PMIC_ARB_VRM_S_ADDR37_ADDR A:&base_addr+0x1442394
y.create.l HWIO_PMIC_ARB_VRM_S_ADDR38_ADDR A:&base_addr+0x1442398
y.create.l HWIO_PMIC_ARB_VRM_S_ADDR39_ADDR A:&base_addr+0x144239c
y.create.l HWIO_PMIC_ARB_VRM_S_ADDR40_ADDR A:&base_addr+0x14423a0
y.create.l HWIO_PMIC_ARB_VRM_S_ADDR41_ADDR A:&base_addr+0x14423a4
y.create.l HWIO_PMIC_ARB_VRM_S_ADDR42_ADDR A:&base_addr+0x14423a8
y.create.l HWIO_PMIC_ARB_VRM_S_ADDR43_ADDR A:&base_addr+0x14423ac
y.create.l HWIO_PMIC_ARB_VRM_S_ADDR44_ADDR A:&base_addr+0x14423b0
y.create.l HWIO_PMIC_ARB_VRM_S_ADDR45_ADDR A:&base_addr+0x14423b4
y.create.l HWIO_PMIC_ARB_VRM_S_ADDR46_ADDR A:&base_addr+0x14423b8
y.create.l HWIO_PMIC_ARB_VRM_S_ADDR47_ADDR A:&base_addr+0x14423bc
y.create.l HWIO_PMIC_ARB_VRM_S_ADDR48_ADDR A:&base_addr+0x14423c0
y.create.l HWIO_PMIC_ARB_VRM_S_ADDR49_ADDR A:&base_addr+0x14423c4
y.create.l HWIO_PMIC_ARB_VRM_S_ADDR50_ADDR A:&base_addr+0x14423c8
y.create.l HWIO_PMIC_ARB_VRM_S_ADDR51_ADDR A:&base_addr+0x14423cc
y.create.l HWIO_PMIC_ARB_VRM_S_ADDR52_ADDR A:&base_addr+0x14423d0
y.create.l HWIO_PMIC_ARB_VRM_S_ADDR53_ADDR A:&base_addr+0x14423d4
y.create.l HWIO_PMIC_ARB_VRM_S_ADDR54_ADDR A:&base_addr+0x14423d8
y.create.l HWIO_PMIC_ARB_VRM_S_ADDR55_ADDR A:&base_addr+0x14423dc
y.create.l HWIO_PMIC_ARB_VRM_S_ADDR56_ADDR A:&base_addr+0x14423e0
y.create.l HWIO_PMIC_ARB_VRM_S_ADDR57_ADDR A:&base_addr+0x14423e4
y.create.l HWIO_PMIC_ARB_VRM_S_ADDR58_ADDR A:&base_addr+0x14423e8
y.create.l HWIO_PMIC_ARB_VRM_S_ADDR59_ADDR A:&base_addr+0x14423ec
y.create.l HWIO_PMIC_ARB_VRM_S_ADDR60_ADDR A:&base_addr+0x14423f0
y.create.l HWIO_PMIC_ARB_VRM_S_ADDR61_ADDR A:&base_addr+0x14423f4
y.create.l HWIO_PMIC_ARB_VRM_S_ADDR62_ADDR A:&base_addr+0x14423f8
y.create.l HWIO_PMIC_ARB_VRM_S_ADDR63_ADDR A:&base_addr+0x14423fc
y.create.l HWIO_PMIC_ARB_VRM_S_ADDR64_ADDR A:&base_addr+0x1442400
y.create.l HWIO_PMIC_ARB_VRM_S_ADDR65_ADDR A:&base_addr+0x1442404
y.create.l HWIO_PMIC_ARB_VRM_S_ADDR66_ADDR A:&base_addr+0x1442408
y.create.l HWIO_PMIC_ARB_VRM_S_ADDR67_ADDR A:&base_addr+0x144240c
y.create.l HWIO_PMIC_ARB_VRM_S_ADDR68_ADDR A:&base_addr+0x1442410
y.create.l HWIO_PMIC_ARB_VRM_S_ADDR69_ADDR A:&base_addr+0x1442414
y.create.l HWIO_PMIC_ARB_VRM_S_ADDR70_ADDR A:&base_addr+0x1442418
y.create.l HWIO_PMIC_ARB_VRM_S_ADDR71_ADDR A:&base_addr+0x144241c
y.create.l HWIO_PMIC_ARB_VRM_S_ADDR72_ADDR A:&base_addr+0x1442420
y.create.l HWIO_PMIC_ARB_VRM_S_ADDR73_ADDR A:&base_addr+0x1442424
y.create.l HWIO_PMIC_ARB_VRM_S_ADDR74_ADDR A:&base_addr+0x1442428
y.create.l HWIO_PMIC_ARB_VRM_S_ADDR75_ADDR A:&base_addr+0x144242c
y.create.l HWIO_PMIC_ARB_VRM_S_ADDR76_ADDR A:&base_addr+0x1442430
y.create.l HWIO_PMIC_ARB_VRM_S_ADDR77_ADDR A:&base_addr+0x1442434
y.create.l HWIO_PMIC_ARB_VRM_S_ADDR78_ADDR A:&base_addr+0x1442438
y.create.l HWIO_PMIC_ARB_VRM_S_ADDR79_ADDR A:&base_addr+0x144243c
y.create.l HWIO_PMIC_ARB_VRM_S_ADDR80_ADDR A:&base_addr+0x1442440
y.create.l HWIO_PMIC_ARB_VRM_S_ADDR81_ADDR A:&base_addr+0x1442444
y.create.l HWIO_PMIC_ARB_VRM_S_ADDR82_ADDR A:&base_addr+0x1442448
y.create.l HWIO_PMIC_ARB_VRM_S_ADDR83_ADDR A:&base_addr+0x144244c
y.create.l HWIO_PMIC_ARB_VRM_S_ADDR84_ADDR A:&base_addr+0x1442450
y.create.l HWIO_PMIC_ARB_VRM_S_ADDR85_ADDR A:&base_addr+0x1442454
y.create.l HWIO_PMIC_ARB_VRM_S_ADDR86_ADDR A:&base_addr+0x1442458
y.create.l HWIO_PMIC_ARB_VRM_S_ADDR87_ADDR A:&base_addr+0x144245c
y.create.l HWIO_PMIC_ARB_VRM_S_ADDR88_ADDR A:&base_addr+0x1442460
y.create.l HWIO_PMIC_ARB_VRM_S_ADDR89_ADDR A:&base_addr+0x1442464
y.create.l HWIO_PMIC_ARB_VRM_S_ADDR90_ADDR A:&base_addr+0x1442468
y.create.l HWIO_PMIC_ARB_VRM_S_ADDR91_ADDR A:&base_addr+0x144246c
y.create.l HWIO_PMIC_ARB_VRM_S_ADDR92_ADDR A:&base_addr+0x1442470
y.create.l HWIO_PMIC_ARB_VRM_S_ADDR93_ADDR A:&base_addr+0x1442474
y.create.l HWIO_PMIC_ARB_VRM_S_ADDR94_ADDR A:&base_addr+0x1442478
y.create.l HWIO_PMIC_ARB_VRM_S_ADDR95_ADDR A:&base_addr+0x144247c
y.create.l HWIO_PMIC_ARB_VRM_S_ADDR96_ADDR A:&base_addr+0x1442480
y.create.l HWIO_PMIC_ARB_VRM_S_ADDR97_ADDR A:&base_addr+0x1442484
y.create.l HWIO_PMIC_ARB_VRM_S_ADDR98_ADDR A:&base_addr+0x1442488
y.create.l HWIO_PMIC_ARB_VRM_S_ADDR99_ADDR A:&base_addr+0x144248c
y.create.l HWIO_PMIC_ARB_VRM_S_ADDR100_ADDR A:&base_addr+0x1442490
y.create.l HWIO_PMIC_ARB_VRM_S_ADDR101_ADDR A:&base_addr+0x1442494
y.create.l HWIO_PMIC_ARB_VRM_S_ADDR102_ADDR A:&base_addr+0x1442498
y.create.l HWIO_PMIC_ARB_VRM_S_ADDR103_ADDR A:&base_addr+0x144249c
y.create.l HWIO_PMIC_ARB_VRM_S_ADDR104_ADDR A:&base_addr+0x14424a0
y.create.l HWIO_PMIC_ARB_VRM_S_ADDR105_ADDR A:&base_addr+0x14424a4
y.create.l HWIO_PMIC_ARB_VRM_S_ADDR106_ADDR A:&base_addr+0x14424a8
y.create.l HWIO_PMIC_ARB_VRM_S_ADDR107_ADDR A:&base_addr+0x14424ac
y.create.l HWIO_PMIC_ARB_VRM_S_ADDR108_ADDR A:&base_addr+0x14424b0
y.create.l HWIO_PMIC_ARB_VRM_S_ADDR109_ADDR A:&base_addr+0x14424b4
y.create.l HWIO_PMIC_ARB_VRM_S_ADDR110_ADDR A:&base_addr+0x14424b8
y.create.l HWIO_PMIC_ARB_VRM_S_ADDR111_ADDR A:&base_addr+0x14424bc
y.create.l HWIO_PMIC_ARB_VRM_S_ADDR112_ADDR A:&base_addr+0x14424c0
y.create.l HWIO_PMIC_ARB_VRM_S_ADDR113_ADDR A:&base_addr+0x14424c4
y.create.l HWIO_PMIC_ARB_VRM_S_ADDR114_ADDR A:&base_addr+0x14424c8
y.create.l HWIO_PMIC_ARB_VRM_S_ADDR115_ADDR A:&base_addr+0x14424cc
y.create.l HWIO_PMIC_ARB_VRM_S_ADDR116_ADDR A:&base_addr+0x14424d0
y.create.l HWIO_PMIC_ARB_VRM_S_ADDR117_ADDR A:&base_addr+0x14424d4
y.create.l HWIO_PMIC_ARB_VRM_S_ADDR118_ADDR A:&base_addr+0x14424d8
y.create.l HWIO_PMIC_ARB_VRM_S_ADDR119_ADDR A:&base_addr+0x14424dc
y.create.l HWIO_PMIC_ARB_VRM_S_ADDR120_ADDR A:&base_addr+0x14424e0
y.create.l HWIO_PMIC_ARB_VRM_S_ADDR121_ADDR A:&base_addr+0x14424e4
y.create.l HWIO_PMIC_ARB_VRM_S_ADDR122_ADDR A:&base_addr+0x14424e8
y.create.l HWIO_PMIC_ARB_VRM_S_ADDR123_ADDR A:&base_addr+0x14424ec
y.create.l HWIO_PMIC_ARB_VRM_S_ADDR124_ADDR A:&base_addr+0x14424f0
y.create.l HWIO_PMIC_ARB_VRM_S_ADDR125_ADDR A:&base_addr+0x14424f4
y.create.l HWIO_PMIC_ARB_VRM_S_ADDR126_ADDR A:&base_addr+0x14424f8
y.create.l HWIO_PMIC_ARB_VRM_S_ADDR127_ADDR A:&base_addr+0x14424fc
y.create.done

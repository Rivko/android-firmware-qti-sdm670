y.create.l HWIO_AOSS_CC_SPMI_BCR_ADDR A:0xc2a2200
y.create.l HWIO_AOSS_CC_SPMI_CFG_AHB_CBCR_ADDR A:0xc2a2204
y.create.l HWIO_AOSS_CC_SPMI_SER_CBCR_ADDR A:0xc2a2208
y.create.l HWIO_AOSS_CC_SPMI_AOD_SER_CBCR_ADDR A:0xc2a220c
y.create.l HWIO_AOSS_CC_SPMI_AOD_SER_CMD_RCGR_ADDR A:0xc2a2210
y.create.l HWIO_AOSS_CC_SPMI_AOD_SER_CFG_RCGR_ADDR A:0xc2a2214
y.create.l HWIO_SPMI_GENI_CLK_CTRL_ADDR A:0xc40a000
y.create.l HWIO_SPMI_GENI_HW_VERSION_ADDR A:0xc40a004
y.create.l HWIO_SPMI_GENI_FW_REVISION_ADDR A:0xc40a008
y.create.l HWIO_SPMI_GENI_S_FW_REVISION_ADDR A:0xc40a00c
y.create.l HWIO_SPMI_GENI_FORCE_DEFAULT_REG_ADDR A:0xc40a010
y.create.l HWIO_SPMI_GENI_OUTPUT_CTRL_ADDR A:0xc40a014
y.create.l HWIO_SPMI_GENI_CGC_CTRL_ADDR A:0xc40a018
y.create.l HWIO_SPMI_GENI_CHAR_CFG_ADDR A:0xc40a01c
y.create.l HWIO_SPMI_GENI_CHAR_DATA_0_ADDR A:0xc40a020
y.create.l HWIO_SPMI_GENI_CHAR_DATA_1_ADDR A:0xc40a024
y.create.l HWIO_SPMI_GENI_CTRL_ADDR A:0xc40a028
y.create.l HWIO_SPMI_GENI_STATUS_ADDR A:0xc40a02c
y.create.l HWIO_SPMI_GENI_TEST_BUS_CTRL_ADDR A:0xc40a030
y.create.l HWIO_SPMI_GENI_SER_CLK_CFG_ADDR A:0xc40a034
y.create.l HWIO_SPMI_GENI_TX_WATERMARK_REG_ADDR A:0xc40a038
y.create.l HWIO_SPMI_GENI_RX_WATERMARK_REG_ADDR A:0xc40a03c
y.create.l HWIO_SPMI_GENI_STOP_REG_ADDR A:0xc40a040
y.create.l HWIO_SPMI_GENI_SW_COMP_REG_ADDR A:0xc40a044
y.create.l HWIO_SPMI_GENI_PROG_ROM_CTRL_REG_ADDR A:0xc40a048
y.create.l HWIO_SPMI_GENI_CFG_REG0_ADDR A:0xc40a100
y.create.l HWIO_SPMI_GENI_CFG_REG1_ADDR A:0xc40a104
y.create.l HWIO_SPMI_GENI_CFG_REG2_ADDR A:0xc40a108
y.create.l HWIO_SPMI_GENI_CFG_REG3_ADDR A:0xc40a10c
y.create.l HWIO_SPMI_GENI_CFG_REG4_ADDR A:0xc40a110
y.create.l HWIO_SPMI_GENI_CFG_REG5_ADDR A:0xc40a114
y.create.l HWIO_SPMI_GENI_CFG_REG6_ADDR A:0xc40a118
y.create.l HWIO_SPMI_GENI_CFG_REG7_ADDR A:0xc40a11c
y.create.l HWIO_SPMI_GENI_CFG_REG8_ADDR A:0xc40a120
y.create.l HWIO_SPMI_GENI_CFG_REG9_ADDR A:0xc40a124
y.create.l HWIO_SPMI_GENI_CFG_REG10_ADDR A:0xc40a128
y.create.l HWIO_SPMI_GENI_CFG_REG11_ADDR A:0xc40a12c
y.create.l HWIO_SPMI_GENI_CFG_REG12_ADDR A:0xc40a130
y.create.l HWIO_SPMI_GENI_CFG_REG13_ADDR A:0xc40a134
y.create.l HWIO_SPMI_GENI_CFG_REG14_ADDR A:0xc40a138
y.create.l HWIO_SPMI_GENI_CFG_REG15_ADDR A:0xc40a13c
y.create.l HWIO_SPMI_GENI_CFG_REG16_ADDR A:0xc40a140
y.create.l HWIO_SPMI_GENI_CFG_REG17_ADDR A:0xc40a144
y.create.l HWIO_SPMI_GENI_CFG_REG18_ADDR A:0xc40a148
y.create.l HWIO_SPMI_GENI_CFG_REG19_ADDR A:0xc40a14c
y.create.l HWIO_SPMI_GENI_CFG_REG20_ADDR A:0xc40a150
y.create.l HWIO_SPMI_GENI_CFG_REG21_ADDR A:0xc40a154
y.create.l HWIO_SPMI_GENI_CFG_REG22_ADDR A:0xc40a158
y.create.l HWIO_SPMI_GENI_CFG_REG23_ADDR A:0xc40a15c
y.create.l HWIO_SPMI_GENI_CFG_REG24_ADDR A:0xc40a160
y.create.l HWIO_SPMI_GENI_CFG_REG25_ADDR A:0xc40a164
y.create.l HWIO_SPMI_GENI_CFG_REG26_ADDR A:0xc40a168
y.create.l HWIO_SPMI_GENI_CFG_REG27_ADDR A:0xc40a16c
y.create.l HWIO_SPMI_GENI_CFG_REG28_ADDR A:0xc40a170
y.create.l HWIO_SPMI_GENI_CFG_REG29_ADDR A:0xc40a174
y.create.l HWIO_SPMI_GENI_CFG_REG30_ADDR A:0xc40a178
y.create.l HWIO_SPMI_GENI_CFG_RAM0_ADDR A:0xc40a200
y.create.l HWIO_SPMI_GENI_CFG_RAM1_ADDR A:0xc40a204
y.create.l HWIO_SPMI_GENI_CFG_RAM2_ADDR A:0xc40a208
y.create.l HWIO_SPMI_GENI_CFG_RAM3_ADDR A:0xc40a20c
y.create.l HWIO_SPMI_GENI_CFG_RAM4_ADDR A:0xc40a210
y.create.l HWIO_SPMI_GENI_CFG_RAM5_ADDR A:0xc40a214
y.create.l HWIO_SPMI_GENI_CFG_RAM6_ADDR A:0xc40a218
y.create.l HWIO_SPMI_GENI_CFG_RAM7_ADDR A:0xc40a21c
y.create.l HWIO_SPMI_GENI_CFG_RAM8_ADDR A:0xc40a220
y.create.l HWIO_SPMI_GENI_CFG_RAM9_ADDR A:0xc40a224
y.create.l HWIO_SPMI_GENI_CFG_RAM10_ADDR A:0xc40a228
y.create.l HWIO_SPMI_GENI_CFG_RAM11_ADDR A:0xc40a22c
y.create.l HWIO_SPMI_GENI_CFG_RAM12_ADDR A:0xc40a230
y.create.l HWIO_SPMI_GENI_CFG_RAM13_ADDR A:0xc40a234
y.create.l HWIO_SPMI_GENI_CFG_RAM14_ADDR A:0xc40a238
y.create.l HWIO_SPMI_GENI_CFG_RAM15_ADDR A:0xc40a23c
y.create.l HWIO_SPMI_GENI_CFG_RAM16_ADDR A:0xc40a240
y.create.l HWIO_SPMI_GENI_CFG_RAM17_ADDR A:0xc40a244
y.create.l HWIO_SPMI_GENI_CFG_RAM18_ADDR A:0xc40a248
y.create.l HWIO_SPMI_GENI_CFG_RAM19_ADDR A:0xc40a24c
y.create.l HWIO_SPMI_GENI_CFG_RAM20_ADDR A:0xc40a250
y.create.l HWIO_SPMI_GENI_CFG_RAM21_ADDR A:0xc40a254
y.create.l HWIO_SPMI_GENI_CFG_RAM22_ADDR A:0xc40a258
y.create.l HWIO_SPMI_GENI_CFG_RAM23_ADDR A:0xc40a25c
y.create.l HWIO_SPMI_GENI_CFG_RAM24_ADDR A:0xc40a260
y.create.l HWIO_SPMI_GENI_CFG_RAM25_ADDR A:0xc40a264
y.create.l HWIO_SPMI_GENI_CFG_RAM26_ADDR A:0xc40a268
y.create.l HWIO_SPMI_GENI_CFG_RAM27_ADDR A:0xc40a26c
y.create.l HWIO_SPMI_GENI_CFG_RAM28_ADDR A:0xc40a270
y.create.l HWIO_SPMI_GENI_CFG_RAM29_ADDR A:0xc40a274
y.create.l HWIO_SPMI_GENI_CFG_RAM30_ADDR A:0xc40a278
y.create.l HWIO_SPMI_GENI_CFG_RAM31_ADDR A:0xc40a27c
y.create.l HWIO_SPMI_GENI_CFG_RAM32_ADDR A:0xc40a280
y.create.l HWIO_SPMI_GENI_CFG_RAM33_ADDR A:0xc40a284
y.create.l HWIO_SPMI_GENI_CFG_RAM34_ADDR A:0xc40a288
y.create.l HWIO_SPMI_GENI_CFG_RAM35_ADDR A:0xc40a28c
y.create.l HWIO_SPMI_GENI_CFG_RAM36_ADDR A:0xc40a290
y.create.l HWIO_SPMI_GENI_CFG_RAM37_ADDR A:0xc40a294
y.create.l HWIO_SPMI_GENI_CFG_RAM38_ADDR A:0xc40a298
y.create.l HWIO_SPMI_GENI_CFG_RAM39_ADDR A:0xc40a29c
y.create.l HWIO_SPMI_GENI_CFG_RAM40_ADDR A:0xc40a2a0
y.create.l HWIO_SPMI_GENI_CFG_RAM41_ADDR A:0xc40a2a4
y.create.l HWIO_SPMI_GENI_CFG_RAM42_ADDR A:0xc40a2a8
y.create.l HWIO_SPMI_GENI_CFG_RAM43_ADDR A:0xc40a2ac
y.create.l HWIO_SPMI_GENI_CFG_RAM44_ADDR A:0xc40a2b0
y.create.l HWIO_SPMI_GENI_CFG_RAM45_ADDR A:0xc40a2b4
y.create.l HWIO_SPMI_GENI_CFG_RAM46_ADDR A:0xc40a2b8
y.create.l HWIO_SPMI_GENI_CFG_RAM47_ADDR A:0xc40a2bc
y.create.l HWIO_SPMI_GENI_CFG_RAM48_ADDR A:0xc40a2c0
y.create.l HWIO_SPMI_GENI_CFG_RAM49_ADDR A:0xc40a2c4
y.create.l HWIO_SPMI_GENI_CFG_RAM50_ADDR A:0xc40a2c8
y.create.l HWIO_SPMI_GENI_CFG_RAM51_ADDR A:0xc40a2cc
y.create.l HWIO_SPMI_GENI_CFG_RAM52_ADDR A:0xc40a2d0
y.create.l HWIO_SPMI_GENI_CFG_RAM53_ADDR A:0xc40a2d4
y.create.l HWIO_SPMI_GENI_CFG_RAM54_ADDR A:0xc40a2d8
y.create.l HWIO_SPMI_GENI_CFG_RAM55_ADDR A:0xc40a2dc
y.create.l HWIO_SPMI_GENI_CFG_RAM56_ADDR A:0xc40a2e0
y.create.l HWIO_SPMI_GENI_CFG_RAM57_ADDR A:0xc40a2e4
y.create.l HWIO_SPMI_GENI_CFG_RAM58_ADDR A:0xc40a2e8
y.create.l HWIO_SPMI_GENI_CFG_RAM59_ADDR A:0xc40a2ec
y.create.l HWIO_SPMI_GENI_CFG_RAM60_ADDR A:0xc40a2f0
y.create.l HWIO_SPMI_GENI_CFG_RAM61_ADDR A:0xc40a2f4
y.create.l HWIO_SPMI_GENI_CFG_RAM62_ADDR A:0xc40a2f8
y.create.l HWIO_SPMI_GENI_CFG_RAM63_ADDR A:0xc40a2fc
y.create.l HWIO_SPMI_GENI_CFG_RAM64_ADDR A:0xc40a300
y.create.l HWIO_SPMI_GENI_CFG_RAM65_ADDR A:0xc40a304
y.create.l HWIO_SPMI_GENI_CFG_RAM66_ADDR A:0xc40a308
y.create.l HWIO_SPMI_GENI_CFG_RAM67_ADDR A:0xc40a30c
y.create.l HWIO_SPMI_GENI_CFG_RAM68_ADDR A:0xc40a310
y.create.l HWIO_SPMI_GENI_CFG_RAM69_ADDR A:0xc40a314
y.create.l HWIO_SPMI_GENI_CFG_RAM70_ADDR A:0xc40a318
y.create.l HWIO_SPMI_GENI_CFG_RAM71_ADDR A:0xc40a31c
y.create.l HWIO_SPMI_GENI_CFG_RAM72_ADDR A:0xc40a320
y.create.l HWIO_SPMI_GENI_CFG_RAM73_ADDR A:0xc40a324
y.create.l HWIO_SPMI_GENI_CFG_RAM74_ADDR A:0xc40a328
y.create.l HWIO_SPMI_GENI_CFG_RAM75_ADDR A:0xc40a32c
y.create.l HWIO_SPMI_GENI_CFG_RAM76_ADDR A:0xc40a330
y.create.l HWIO_SPMI_GENI_CFG_RAM77_ADDR A:0xc40a334
y.create.l HWIO_SPMI_GENI_CFG_RAM78_ADDR A:0xc40a338
y.create.l HWIO_SPMI_GENI_CFG_RAM79_ADDR A:0xc40a33c
y.create.l HWIO_SPMI_GENI_CFG_RAM80_ADDR A:0xc40a340
y.create.l HWIO_SPMI_GENI_CFG_RAM81_ADDR A:0xc40a344
y.create.l HWIO_SPMI_GENI_CFG_RAM82_ADDR A:0xc40a348
y.create.l HWIO_SPMI_GENI_CFG_RAM83_ADDR A:0xc40a34c
y.create.l HWIO_SPMI_GENI_CFG_RAM84_ADDR A:0xc40a350
y.create.l HWIO_SPMI_GENI_CFG_RAM85_ADDR A:0xc40a354
y.create.l HWIO_SPMI_GENI_CFG_RAM86_ADDR A:0xc40a358
y.create.l HWIO_SPMI_GENI_CFG_RAM87_ADDR A:0xc40a35c
y.create.l HWIO_SPMI_GENI_CFG_RAM88_ADDR A:0xc40a360
y.create.l HWIO_SPMI_GENI_CFG_RAM89_ADDR A:0xc40a364
y.create.l HWIO_SPMI_GENI_CFG_RAM90_ADDR A:0xc40a368
y.create.l HWIO_SPMI_GENI_CFG_RAM91_ADDR A:0xc40a36c
y.create.l HWIO_SPMI_GENI_CFG_RAM92_ADDR A:0xc40a370
y.create.l HWIO_SPMI_GENI_CFG_RAM93_ADDR A:0xc40a374
y.create.l HWIO_SPMI_GENI_CFG_RAM94_ADDR A:0xc40a378
y.create.l HWIO_SPMI_GENI_CFG_RAM95_ADDR A:0xc40a37c
y.create.l HWIO_SPMI_GENI_CFG_RAM96_ADDR A:0xc40a380
y.create.l HWIO_SPMI_GENI_CFG_RAM97_ADDR A:0xc40a384
y.create.l HWIO_SPMI_GENI_CFG_RAM98_ADDR A:0xc40a388
y.create.l HWIO_SPMI_GENI_CFG_RAM99_ADDR A:0xc40a38c
y.create.l HWIO_SPMI_GENI_CFG_RAM100_ADDR A:0xc40a390
y.create.l HWIO_SPMI_GENI_CFG_RAM101_ADDR A:0xc40a394
y.create.l HWIO_SPMI_GENI_CFG_RAM102_ADDR A:0xc40a398
y.create.l HWIO_SPMI_GENI_CFG_RAM103_ADDR A:0xc40a39c
y.create.l HWIO_SPMI_GENI_CFG_RAM104_ADDR A:0xc40a3a0
y.create.l HWIO_SPMI_GENI_CFG_RAM105_ADDR A:0xc40a3a4
y.create.l HWIO_SPMI_GENI_CFG_RAM106_ADDR A:0xc40a3a8
y.create.l HWIO_SPMI_GENI_CFG_RAM107_ADDR A:0xc40a3ac
y.create.l HWIO_SPMI_GENI_CFG_RAM108_ADDR A:0xc40a3b0
y.create.l HWIO_SPMI_GENI_CFG_RAM109_ADDR A:0xc40a3b4
y.create.l HWIO_SPMI_GENI_CFG_RAM110_ADDR A:0xc40a3b8
y.create.l HWIO_SPMI_GENI_CFG_RAM111_ADDR A:0xc40a3bc
y.create.l HWIO_SPMI_GENI_CFG_RAM112_ADDR A:0xc40a3c0
y.create.l HWIO_SPMI_GENI_CFG_RAM113_ADDR A:0xc40a3c4
y.create.l HWIO_SPMI_GENI_CFG_RAM114_ADDR A:0xc40a3c8
y.create.l HWIO_SPMI_GENI_CFG_RAM115_ADDR A:0xc40a3cc
y.create.l HWIO_SPMI_GENI_CFG_RAM116_ADDR A:0xc40a3d0
y.create.l HWIO_SPMI_GENI_CFG_RAM117_ADDR A:0xc40a3d4
y.create.l HWIO_SPMI_GENI_CFG_RAM118_ADDR A:0xc40a3d8
y.create.l HWIO_SPMI_GENI_CFG_RAM119_ADDR A:0xc40a3dc
y.create.l HWIO_SPMI_GENI_CFG_RAM120_ADDR A:0xc40a3e0
y.create.l HWIO_SPMI_GENI_CFG_RAM121_ADDR A:0xc40a3e4
y.create.l HWIO_SPMI_GENI_CFG_RAM122_ADDR A:0xc40a3e8
y.create.l HWIO_SPMI_GENI_CFG_RAM123_ADDR A:0xc40a3ec
y.create.l HWIO_SPMI_GENI_CFG_RAM124_ADDR A:0xc40a3f0
y.create.l HWIO_SPMI_GENI_CFG_RAM125_ADDR A:0xc40a3f4
y.create.l HWIO_SPMI_GENI_CFG_RAM126_ADDR A:0xc40a3f8
y.create.l HWIO_SPMI_GENI_CFG_RAM127_ADDR A:0xc40a3fc
y.create.l HWIO_SPMI_GENI_CFG_RAM128_ADDR A:0xc40a400
y.create.l HWIO_SPMI_GENI_CFG_RAM129_ADDR A:0xc40a404
y.create.l HWIO_SPMI_GENI_CFG_RAM130_ADDR A:0xc40a408
y.create.l HWIO_SPMI_GENI_CFG_RAM131_ADDR A:0xc40a40c
y.create.l HWIO_SPMI_GENI_CFG_RAM132_ADDR A:0xc40a410
y.create.l HWIO_SPMI_GENI_CFG_RAM133_ADDR A:0xc40a414
y.create.l HWIO_SPMI_GENI_CFG_RAM134_ADDR A:0xc40a418
y.create.l HWIO_SPMI_GENI_CFG_RAM135_ADDR A:0xc40a41c
y.create.l HWIO_SPMI_GENI_CFG_RAM136_ADDR A:0xc40a420
y.create.l HWIO_SPMI_GENI_CFG_RAM137_ADDR A:0xc40a424
y.create.l HWIO_SPMI_GENI_CFG_RAM138_ADDR A:0xc40a428
y.create.l HWIO_SPMI_GENI_CFG_RAM139_ADDR A:0xc40a42c
y.create.l HWIO_SPMI_GENI_CFG_RAM140_ADDR A:0xc40a430
y.create.l HWIO_SPMI_GENI_CFG_RAM141_ADDR A:0xc40a434
y.create.l HWIO_SPMI_GENI_CFG_RAM142_ADDR A:0xc40a438
y.create.l HWIO_SPMI_GENI_CFG_RAM143_ADDR A:0xc40a43c
y.create.l HWIO_SPMI_GENI_CFG_RAM144_ADDR A:0xc40a440
y.create.l HWIO_SPMI_GENI_CFG_RAM145_ADDR A:0xc40a444
y.create.l HWIO_SPMI_GENI_CFG_RAM146_ADDR A:0xc40a448
y.create.l HWIO_SPMI_GENI_CFG_RAM147_ADDR A:0xc40a44c
y.create.l HWIO_SPMI_GENI_CFG_RAM148_ADDR A:0xc40a450
y.create.l HWIO_SPMI_GENI_CFG_RAM149_ADDR A:0xc40a454
y.create.l HWIO_SPMI_GENI_CFG_RAM150_ADDR A:0xc40a458
y.create.l HWIO_SPMI_GENI_CFG_RAM151_ADDR A:0xc40a45c
y.create.l HWIO_SPMI_GENI_CFG_RAM152_ADDR A:0xc40a460
y.create.l HWIO_SPMI_GENI_CFG_RAM153_ADDR A:0xc40a464
y.create.l HWIO_SPMI_GENI_CFG_RAM154_ADDR A:0xc40a468
y.create.l HWIO_SPMI_GENI_CFG_RAM155_ADDR A:0xc40a46c
y.create.l HWIO_SPMI_GENI_CFG_RAM156_ADDR A:0xc40a470
y.create.l HWIO_SPMI_GENI_CFG_RAM157_ADDR A:0xc40a474
y.create.l HWIO_SPMI_GENI_CFG_RAM158_ADDR A:0xc40a478
y.create.l HWIO_SPMI_GENI_CFG_RAM159_ADDR A:0xc40a47c
y.create.l HWIO_SPMI_GENI_CFG_RAM160_ADDR A:0xc40a480
y.create.l HWIO_SPMI_GENI_CFG_RAM161_ADDR A:0xc40a484
y.create.l HWIO_SPMI_GENI_CFG_RAM162_ADDR A:0xc40a488
y.create.l HWIO_SPMI_GENI_CFG_RAM163_ADDR A:0xc40a48c
y.create.l HWIO_SPMI_GENI_CFG_RAM164_ADDR A:0xc40a490
y.create.l HWIO_SPMI_GENI_CFG_RAM165_ADDR A:0xc40a494
y.create.l HWIO_SPMI_GENI_CFG_RAM166_ADDR A:0xc40a498
y.create.l HWIO_SPMI_GENI_CFG_RAM167_ADDR A:0xc40a49c
y.create.l HWIO_SPMI_GENI_CFG_RAM168_ADDR A:0xc40a4a0
y.create.l HWIO_SPMI_GENI_CFG_RAM169_ADDR A:0xc40a4a4
y.create.l HWIO_SPMI_GENI_CFG_RAM170_ADDR A:0xc40a4a8
y.create.l HWIO_SPMI_GENI_CFG_RAM171_ADDR A:0xc40a4ac
y.create.l HWIO_SPMI_GENI_CFG_RAM172_ADDR A:0xc40a4b0
y.create.l HWIO_SPMI_GENI_CFG_RAM173_ADDR A:0xc40a4b4
y.create.l HWIO_SPMI_GENI_CFG_RAM174_ADDR A:0xc40a4b8
y.create.l HWIO_SPMI_GENI_CFG_RAM175_ADDR A:0xc40a4bc
y.create.l HWIO_SPMI_GENI_CFG_RAM176_ADDR A:0xc40a4c0
y.create.l HWIO_SPMI_GENI_CFG_RAM177_ADDR A:0xc40a4c4
y.create.l HWIO_SPMI_GENI_CFG_RAM178_ADDR A:0xc40a4c8
y.create.l HWIO_SPMI_GENI_CFG_RAM179_ADDR A:0xc40a4cc
y.create.l HWIO_SPMI_GENI_CFG_RAM180_ADDR A:0xc40a4d0
y.create.l HWIO_SPMI_GENI_CFG_RAM181_ADDR A:0xc40a4d4
y.create.l HWIO_SPMI_GENI_CFG_RAM182_ADDR A:0xc40a4d8
y.create.l HWIO_SPMI_GENI_CFG_RAM183_ADDR A:0xc40a4dc
y.create.l HWIO_SPMI_GENI_CFG_RAM184_ADDR A:0xc40a4e0
y.create.l HWIO_SPMI_GENI_CFG_RAM185_ADDR A:0xc40a4e4
y.create.l HWIO_SPMI_GENI_CFG_RAM186_ADDR A:0xc40a4e8
y.create.l HWIO_SPMI_GENI_CFG_RAM187_ADDR A:0xc40a4ec
y.create.l HWIO_SPMI_GENI_CFG_RAM188_ADDR A:0xc40a4f0
y.create.l HWIO_SPMI_GENI_CFG_RAM189_ADDR A:0xc40a4f4
y.create.l HWIO_SPMI_GENI_CFG_RAM190_ADDR A:0xc40a4f8
y.create.l HWIO_SPMI_GENI_CFG_RAM191_ADDR A:0xc40a4fc
y.create.l HWIO_SPMI_GENI_CFG_RAM192_ADDR A:0xc40a500
y.create.l HWIO_SPMI_GENI_CFG_RAM193_ADDR A:0xc40a504
y.create.l HWIO_SPMI_GENI_CFG_RAM194_ADDR A:0xc40a508
y.create.l HWIO_SPMI_GENI_CFG_RAM195_ADDR A:0xc40a50c
y.create.l HWIO_SPMI_GENI_CFG_RAM196_ADDR A:0xc40a510
y.create.l HWIO_SPMI_GENI_CFG_RAM197_ADDR A:0xc40a514
y.create.l HWIO_SPMI_GENI_CFG_RAM198_ADDR A:0xc40a518
y.create.l HWIO_SPMI_GENI_CFG_RAM199_ADDR A:0xc40a51c
y.create.l HWIO_SPMI_GENI_CFG_RAM200_ADDR A:0xc40a520
y.create.l HWIO_SPMI_GENI_CFG_RAM201_ADDR A:0xc40a524
y.create.l HWIO_SPMI_GENI_CFG_RAM202_ADDR A:0xc40a528
y.create.l HWIO_SPMI_GENI_CFG_RAM203_ADDR A:0xc40a52c
y.create.l HWIO_SPMI_GENI_CFG_RAM204_ADDR A:0xc40a530
y.create.l HWIO_SPMI_GENI_CFG_RAM205_ADDR A:0xc40a534
y.create.l HWIO_SPMI_GENI_CFG_RAM206_ADDR A:0xc40a538
y.create.l HWIO_SPMI_GENI_CFG_RAM207_ADDR A:0xc40a53c
y.create.l HWIO_SPMI_GENI_CFG_RAM208_ADDR A:0xc40a540
y.create.l HWIO_SPMI_GENI_CFG_RAM209_ADDR A:0xc40a544
y.create.l HWIO_SPMI_GENI_CFG_RAM210_ADDR A:0xc40a548
y.create.l HWIO_SPMI_GENI_CFG_RAM211_ADDR A:0xc40a54c
y.create.l HWIO_SPMI_GENI_CFG_RAM212_ADDR A:0xc40a550
y.create.l HWIO_SPMI_GENI_CFG_RAM213_ADDR A:0xc40a554
y.create.l HWIO_SPMI_GENI_CFG_RAM214_ADDR A:0xc40a558
y.create.l HWIO_SPMI_GENI_CFG_RAM215_ADDR A:0xc40a55c
y.create.l HWIO_SPMI_GENI_CFG_RAM216_ADDR A:0xc40a560
y.create.l HWIO_SPMI_GENI_CFG_RAM217_ADDR A:0xc40a564
y.create.l HWIO_SPMI_GENI_CFG_RAM218_ADDR A:0xc40a568
y.create.l HWIO_SPMI_GENI_CFG_RAM219_ADDR A:0xc40a56c
y.create.l HWIO_SPMI_GENI_CFG_RAM220_ADDR A:0xc40a570
y.create.l HWIO_SPMI_GENI_CFG_RAM221_ADDR A:0xc40a574
y.create.l HWIO_SPMI_GENI_CFG_RAM222_ADDR A:0xc40a578
y.create.l HWIO_SPMI_GENI_CFG_RAM223_ADDR A:0xc40a57c
y.create.l HWIO_SPMI_GENI_CFG_RAM224_ADDR A:0xc40a580
y.create.l HWIO_SPMI_GENI_CFG_RAM225_ADDR A:0xc40a584
y.create.l HWIO_SPMI_GENI_CFG_RAM226_ADDR A:0xc40a588
y.create.l HWIO_SPMI_GENI_CFG_RAM227_ADDR A:0xc40a58c
y.create.l HWIO_SPMI_GENI_CFG_RAM228_ADDR A:0xc40a590
y.create.l HWIO_SPMI_GENI_CFG_RAM229_ADDR A:0xc40a594
y.create.l HWIO_SPMI_GENI_CFG_RAM230_ADDR A:0xc40a598
y.create.l HWIO_SPMI_GENI_CFG_RAM231_ADDR A:0xc40a59c
y.create.l HWIO_SPMI_GENI_CFG_RAM232_ADDR A:0xc40a5a0
y.create.l HWIO_SPMI_GENI_CFG_RAM233_ADDR A:0xc40a5a4
y.create.l HWIO_SPMI_GENI_CFG_RAM234_ADDR A:0xc40a5a8
y.create.l HWIO_SPMI_GENI_CFG_RAM235_ADDR A:0xc40a5ac
y.create.l HWIO_SPMI_GENI_CFG_RAM236_ADDR A:0xc40a5b0
y.create.l HWIO_SPMI_GENI_CFG_RAM237_ADDR A:0xc40a5b4
y.create.l HWIO_SPMI_GENI_CFG_RAM238_ADDR A:0xc40a5b8
y.create.l HWIO_SPMI_GENI_CFG_RAM239_ADDR A:0xc40a5bc
y.create.l HWIO_SPMI_GENI_CFG_RAM240_ADDR A:0xc40a5c0
y.create.l HWIO_SPMI_GENI_CFG_RAM241_ADDR A:0xc40a5c4
y.create.l HWIO_SPMI_GENI_CFG_RAM242_ADDR A:0xc40a5c8
y.create.l HWIO_SPMI_GENI_CFG_RAM243_ADDR A:0xc40a5cc
y.create.l HWIO_SPMI_GENI_CFG_RAM244_ADDR A:0xc40a5d0
y.create.l HWIO_SPMI_GENI_CFG_RAM245_ADDR A:0xc40a5d4
y.create.l HWIO_SPMI_GENI_CFG_RAM246_ADDR A:0xc40a5d8
y.create.l HWIO_SPMI_GENI_CFG_RAM247_ADDR A:0xc40a5dc
y.create.l HWIO_SPMI_GENI_CFG_RAM248_ADDR A:0xc40a5e0
y.create.l HWIO_SPMI_GENI_CFG_RAM249_ADDR A:0xc40a5e4
y.create.l HWIO_SPMI_GENI_CFG_RAM250_ADDR A:0xc40a5e8
y.create.l HWIO_SPMI_GENI_CFG_RAM251_ADDR A:0xc40a5ec
y.create.l HWIO_SPMI_GENI_CFG_RAM252_ADDR A:0xc40a5f0
y.create.l HWIO_SPMI_GENI_CFG_RAM253_ADDR A:0xc40a5f4
y.create.l HWIO_SPMI_GENI_CFG_RAM254_ADDR A:0xc40a5f8
y.create.l HWIO_SPMI_GENI_CFG_RAM255_ADDR A:0xc40a5fc
y.create.l HWIO_SPMI_PERIPH0_2OWNER_TABLE_REG_ADDR A:0xc40a700
y.create.l HWIO_SPMI_PERIPH1_2OWNER_TABLE_REG_ADDR A:0xc40a704
y.create.l HWIO_SPMI_PERIPH2_2OWNER_TABLE_REG_ADDR A:0xc40a708
y.create.l HWIO_SPMI_PERIPH3_2OWNER_TABLE_REG_ADDR A:0xc40a70c
y.create.l HWIO_SPMI_PERIPH4_2OWNER_TABLE_REG_ADDR A:0xc40a710
y.create.l HWIO_SPMI_PERIPH5_2OWNER_TABLE_REG_ADDR A:0xc40a714
y.create.l HWIO_SPMI_PERIPH6_2OWNER_TABLE_REG_ADDR A:0xc40a718
y.create.l HWIO_SPMI_PERIPH7_2OWNER_TABLE_REG_ADDR A:0xc40a71c
y.create.l HWIO_SPMI_PERIPH8_2OWNER_TABLE_REG_ADDR A:0xc40a720
y.create.l HWIO_SPMI_PERIPH9_2OWNER_TABLE_REG_ADDR A:0xc40a724
y.create.l HWIO_SPMI_PERIPH10_2OWNER_TABLE_REG_ADDR A:0xc40a728
y.create.l HWIO_SPMI_PERIPH11_2OWNER_TABLE_REG_ADDR A:0xc40a72c
y.create.l HWIO_SPMI_PERIPH12_2OWNER_TABLE_REG_ADDR A:0xc40a730
y.create.l HWIO_SPMI_PERIPH13_2OWNER_TABLE_REG_ADDR A:0xc40a734
y.create.l HWIO_SPMI_PERIPH14_2OWNER_TABLE_REG_ADDR A:0xc40a738
y.create.l HWIO_SPMI_PERIPH15_2OWNER_TABLE_REG_ADDR A:0xc40a73c
y.create.l HWIO_SPMI_PERIPH16_2OWNER_TABLE_REG_ADDR A:0xc40a740
y.create.l HWIO_SPMI_PERIPH17_2OWNER_TABLE_REG_ADDR A:0xc40a744
y.create.l HWIO_SPMI_PERIPH18_2OWNER_TABLE_REG_ADDR A:0xc40a748
y.create.l HWIO_SPMI_PERIPH19_2OWNER_TABLE_REG_ADDR A:0xc40a74c
y.create.l HWIO_SPMI_PERIPH20_2OWNER_TABLE_REG_ADDR A:0xc40a750
y.create.l HWIO_SPMI_PERIPH21_2OWNER_TABLE_REG_ADDR A:0xc40a754
y.create.l HWIO_SPMI_PERIPH22_2OWNER_TABLE_REG_ADDR A:0xc40a758
y.create.l HWIO_SPMI_PERIPH23_2OWNER_TABLE_REG_ADDR A:0xc40a75c
y.create.l HWIO_SPMI_PERIPH24_2OWNER_TABLE_REG_ADDR A:0xc40a760
y.create.l HWIO_SPMI_PERIPH25_2OWNER_TABLE_REG_ADDR A:0xc40a764
y.create.l HWIO_SPMI_PERIPH26_2OWNER_TABLE_REG_ADDR A:0xc40a768
y.create.l HWIO_SPMI_PERIPH27_2OWNER_TABLE_REG_ADDR A:0xc40a76c
y.create.l HWIO_SPMI_PERIPH28_2OWNER_TABLE_REG_ADDR A:0xc40a770
y.create.l HWIO_SPMI_PERIPH29_2OWNER_TABLE_REG_ADDR A:0xc40a774
y.create.l HWIO_SPMI_PERIPH30_2OWNER_TABLE_REG_ADDR A:0xc40a778
y.create.l HWIO_SPMI_PERIPH31_2OWNER_TABLE_REG_ADDR A:0xc40a77c
y.create.l HWIO_SPMI_PERIPH32_2OWNER_TABLE_REG_ADDR A:0xc40a780
y.create.l HWIO_SPMI_PERIPH33_2OWNER_TABLE_REG_ADDR A:0xc40a784
y.create.l HWIO_SPMI_PERIPH34_2OWNER_TABLE_REG_ADDR A:0xc40a788
y.create.l HWIO_SPMI_PERIPH35_2OWNER_TABLE_REG_ADDR A:0xc40a78c
y.create.l HWIO_SPMI_PERIPH36_2OWNER_TABLE_REG_ADDR A:0xc40a790
y.create.l HWIO_SPMI_PERIPH37_2OWNER_TABLE_REG_ADDR A:0xc40a794
y.create.l HWIO_SPMI_PERIPH38_2OWNER_TABLE_REG_ADDR A:0xc40a798
y.create.l HWIO_SPMI_PERIPH39_2OWNER_TABLE_REG_ADDR A:0xc40a79c
y.create.l HWIO_SPMI_PERIPH40_2OWNER_TABLE_REG_ADDR A:0xc40a7a0
y.create.l HWIO_SPMI_PERIPH41_2OWNER_TABLE_REG_ADDR A:0xc40a7a4
y.create.l HWIO_SPMI_PERIPH42_2OWNER_TABLE_REG_ADDR A:0xc40a7a8
y.create.l HWIO_SPMI_PERIPH43_2OWNER_TABLE_REG_ADDR A:0xc40a7ac
y.create.l HWIO_SPMI_PERIPH44_2OWNER_TABLE_REG_ADDR A:0xc40a7b0
y.create.l HWIO_SPMI_PERIPH45_2OWNER_TABLE_REG_ADDR A:0xc40a7b4
y.create.l HWIO_SPMI_PERIPH46_2OWNER_TABLE_REG_ADDR A:0xc40a7b8
y.create.l HWIO_SPMI_PERIPH47_2OWNER_TABLE_REG_ADDR A:0xc40a7bc
y.create.l HWIO_SPMI_PERIPH48_2OWNER_TABLE_REG_ADDR A:0xc40a7c0
y.create.l HWIO_SPMI_PERIPH49_2OWNER_TABLE_REG_ADDR A:0xc40a7c4
y.create.l HWIO_SPMI_PERIPH50_2OWNER_TABLE_REG_ADDR A:0xc40a7c8
y.create.l HWIO_SPMI_PERIPH51_2OWNER_TABLE_REG_ADDR A:0xc40a7cc
y.create.l HWIO_SPMI_PERIPH52_2OWNER_TABLE_REG_ADDR A:0xc40a7d0
y.create.l HWIO_SPMI_PERIPH53_2OWNER_TABLE_REG_ADDR A:0xc40a7d4
y.create.l HWIO_SPMI_PERIPH54_2OWNER_TABLE_REG_ADDR A:0xc40a7d8
y.create.l HWIO_SPMI_PERIPH55_2OWNER_TABLE_REG_ADDR A:0xc40a7dc
y.create.l HWIO_SPMI_PERIPH56_2OWNER_TABLE_REG_ADDR A:0xc40a7e0
y.create.l HWIO_SPMI_PERIPH57_2OWNER_TABLE_REG_ADDR A:0xc40a7e4
y.create.l HWIO_SPMI_PERIPH58_2OWNER_TABLE_REG_ADDR A:0xc40a7e8
y.create.l HWIO_SPMI_PERIPH59_2OWNER_TABLE_REG_ADDR A:0xc40a7ec
y.create.l HWIO_SPMI_PERIPH60_2OWNER_TABLE_REG_ADDR A:0xc40a7f0
y.create.l HWIO_SPMI_PERIPH61_2OWNER_TABLE_REG_ADDR A:0xc40a7f4
y.create.l HWIO_SPMI_PERIPH62_2OWNER_TABLE_REG_ADDR A:0xc40a7f8
y.create.l HWIO_SPMI_PERIPH63_2OWNER_TABLE_REG_ADDR A:0xc40a7fc
y.create.l HWIO_SPMI_PERIPH64_2OWNER_TABLE_REG_ADDR A:0xc40a800
y.create.l HWIO_SPMI_PERIPH65_2OWNER_TABLE_REG_ADDR A:0xc40a804
y.create.l HWIO_SPMI_PERIPH66_2OWNER_TABLE_REG_ADDR A:0xc40a808
y.create.l HWIO_SPMI_PERIPH67_2OWNER_TABLE_REG_ADDR A:0xc40a80c
y.create.l HWIO_SPMI_PERIPH68_2OWNER_TABLE_REG_ADDR A:0xc40a810
y.create.l HWIO_SPMI_PERIPH69_2OWNER_TABLE_REG_ADDR A:0xc40a814
y.create.l HWIO_SPMI_PERIPH70_2OWNER_TABLE_REG_ADDR A:0xc40a818
y.create.l HWIO_SPMI_PERIPH71_2OWNER_TABLE_REG_ADDR A:0xc40a81c
y.create.l HWIO_SPMI_PERIPH72_2OWNER_TABLE_REG_ADDR A:0xc40a820
y.create.l HWIO_SPMI_PERIPH73_2OWNER_TABLE_REG_ADDR A:0xc40a824
y.create.l HWIO_SPMI_PERIPH74_2OWNER_TABLE_REG_ADDR A:0xc40a828
y.create.l HWIO_SPMI_PERIPH75_2OWNER_TABLE_REG_ADDR A:0xc40a82c
y.create.l HWIO_SPMI_PERIPH76_2OWNER_TABLE_REG_ADDR A:0xc40a830
y.create.l HWIO_SPMI_PERIPH77_2OWNER_TABLE_REG_ADDR A:0xc40a834
y.create.l HWIO_SPMI_PERIPH78_2OWNER_TABLE_REG_ADDR A:0xc40a838
y.create.l HWIO_SPMI_PERIPH79_2OWNER_TABLE_REG_ADDR A:0xc40a83c
y.create.l HWIO_SPMI_PERIPH80_2OWNER_TABLE_REG_ADDR A:0xc40a840
y.create.l HWIO_SPMI_PERIPH81_2OWNER_TABLE_REG_ADDR A:0xc40a844
y.create.l HWIO_SPMI_PERIPH82_2OWNER_TABLE_REG_ADDR A:0xc40a848
y.create.l HWIO_SPMI_PERIPH83_2OWNER_TABLE_REG_ADDR A:0xc40a84c
y.create.l HWIO_SPMI_PERIPH84_2OWNER_TABLE_REG_ADDR A:0xc40a850
y.create.l HWIO_SPMI_PERIPH85_2OWNER_TABLE_REG_ADDR A:0xc40a854
y.create.l HWIO_SPMI_PERIPH86_2OWNER_TABLE_REG_ADDR A:0xc40a858
y.create.l HWIO_SPMI_PERIPH87_2OWNER_TABLE_REG_ADDR A:0xc40a85c
y.create.l HWIO_SPMI_PERIPH88_2OWNER_TABLE_REG_ADDR A:0xc40a860
y.create.l HWIO_SPMI_PERIPH89_2OWNER_TABLE_REG_ADDR A:0xc40a864
y.create.l HWIO_SPMI_PERIPH90_2OWNER_TABLE_REG_ADDR A:0xc40a868
y.create.l HWIO_SPMI_PERIPH91_2OWNER_TABLE_REG_ADDR A:0xc40a86c
y.create.l HWIO_SPMI_PERIPH92_2OWNER_TABLE_REG_ADDR A:0xc40a870
y.create.l HWIO_SPMI_PERIPH93_2OWNER_TABLE_REG_ADDR A:0xc40a874
y.create.l HWIO_SPMI_PERIPH94_2OWNER_TABLE_REG_ADDR A:0xc40a878
y.create.l HWIO_SPMI_PERIPH95_2OWNER_TABLE_REG_ADDR A:0xc40a87c
y.create.l HWIO_SPMI_PERIPH96_2OWNER_TABLE_REG_ADDR A:0xc40a880
y.create.l HWIO_SPMI_PERIPH97_2OWNER_TABLE_REG_ADDR A:0xc40a884
y.create.l HWIO_SPMI_PERIPH98_2OWNER_TABLE_REG_ADDR A:0xc40a888
y.create.l HWIO_SPMI_PERIPH99_2OWNER_TABLE_REG_ADDR A:0xc40a88c
y.create.l HWIO_SPMI_PERIPH100_2OWNER_TABLE_REG_ADDR A:0xc40a890
y.create.l HWIO_SPMI_PERIPH101_2OWNER_TABLE_REG_ADDR A:0xc40a894
y.create.l HWIO_SPMI_PERIPH102_2OWNER_TABLE_REG_ADDR A:0xc40a898
y.create.l HWIO_SPMI_PERIPH103_2OWNER_TABLE_REG_ADDR A:0xc40a89c
y.create.l HWIO_SPMI_PERIPH104_2OWNER_TABLE_REG_ADDR A:0xc40a8a0
y.create.l HWIO_SPMI_PERIPH105_2OWNER_TABLE_REG_ADDR A:0xc40a8a4
y.create.l HWIO_SPMI_PERIPH106_2OWNER_TABLE_REG_ADDR A:0xc40a8a8
y.create.l HWIO_SPMI_PERIPH107_2OWNER_TABLE_REG_ADDR A:0xc40a8ac
y.create.l HWIO_SPMI_PERIPH108_2OWNER_TABLE_REG_ADDR A:0xc40a8b0
y.create.l HWIO_SPMI_PERIPH109_2OWNER_TABLE_REG_ADDR A:0xc40a8b4
y.create.l HWIO_SPMI_PERIPH110_2OWNER_TABLE_REG_ADDR A:0xc40a8b8
y.create.l HWIO_SPMI_PERIPH111_2OWNER_TABLE_REG_ADDR A:0xc40a8bc
y.create.l HWIO_SPMI_PERIPH112_2OWNER_TABLE_REG_ADDR A:0xc40a8c0
y.create.l HWIO_SPMI_PERIPH113_2OWNER_TABLE_REG_ADDR A:0xc40a8c4
y.create.l HWIO_SPMI_PERIPH114_2OWNER_TABLE_REG_ADDR A:0xc40a8c8
y.create.l HWIO_SPMI_PERIPH115_2OWNER_TABLE_REG_ADDR A:0xc40a8cc
y.create.l HWIO_SPMI_PERIPH116_2OWNER_TABLE_REG_ADDR A:0xc40a8d0
y.create.l HWIO_SPMI_PERIPH117_2OWNER_TABLE_REG_ADDR A:0xc40a8d4
y.create.l HWIO_SPMI_PERIPH118_2OWNER_TABLE_REG_ADDR A:0xc40a8d8
y.create.l HWIO_SPMI_PERIPH119_2OWNER_TABLE_REG_ADDR A:0xc40a8dc
y.create.l HWIO_SPMI_PERIPH120_2OWNER_TABLE_REG_ADDR A:0xc40a8e0
y.create.l HWIO_SPMI_PERIPH121_2OWNER_TABLE_REG_ADDR A:0xc40a8e4
y.create.l HWIO_SPMI_PERIPH122_2OWNER_TABLE_REG_ADDR A:0xc40a8e8
y.create.l HWIO_SPMI_PERIPH123_2OWNER_TABLE_REG_ADDR A:0xc40a8ec
y.create.l HWIO_SPMI_PERIPH124_2OWNER_TABLE_REG_ADDR A:0xc40a8f0
y.create.l HWIO_SPMI_PERIPH125_2OWNER_TABLE_REG_ADDR A:0xc40a8f4
y.create.l HWIO_SPMI_PERIPH126_2OWNER_TABLE_REG_ADDR A:0xc40a8f8
y.create.l HWIO_SPMI_PERIPH127_2OWNER_TABLE_REG_ADDR A:0xc40a8fc
y.create.l HWIO_SPMI_PERIPH128_2OWNER_TABLE_REG_ADDR A:0xc40a900
y.create.l HWIO_SPMI_PERIPH129_2OWNER_TABLE_REG_ADDR A:0xc40a904
y.create.l HWIO_SPMI_PERIPH130_2OWNER_TABLE_REG_ADDR A:0xc40a908
y.create.l HWIO_SPMI_PERIPH131_2OWNER_TABLE_REG_ADDR A:0xc40a90c
y.create.l HWIO_SPMI_PERIPH132_2OWNER_TABLE_REG_ADDR A:0xc40a910
y.create.l HWIO_SPMI_PERIPH133_2OWNER_TABLE_REG_ADDR A:0xc40a914
y.create.l HWIO_SPMI_PERIPH134_2OWNER_TABLE_REG_ADDR A:0xc40a918
y.create.l HWIO_SPMI_PERIPH135_2OWNER_TABLE_REG_ADDR A:0xc40a91c
y.create.l HWIO_SPMI_PERIPH136_2OWNER_TABLE_REG_ADDR A:0xc40a920
y.create.l HWIO_SPMI_PERIPH137_2OWNER_TABLE_REG_ADDR A:0xc40a924
y.create.l HWIO_SPMI_PERIPH138_2OWNER_TABLE_REG_ADDR A:0xc40a928
y.create.l HWIO_SPMI_PERIPH139_2OWNER_TABLE_REG_ADDR A:0xc40a92c
y.create.l HWIO_SPMI_PERIPH140_2OWNER_TABLE_REG_ADDR A:0xc40a930
y.create.l HWIO_SPMI_PERIPH141_2OWNER_TABLE_REG_ADDR A:0xc40a934
y.create.l HWIO_SPMI_PERIPH142_2OWNER_TABLE_REG_ADDR A:0xc40a938
y.create.l HWIO_SPMI_PERIPH143_2OWNER_TABLE_REG_ADDR A:0xc40a93c
y.create.l HWIO_SPMI_PERIPH144_2OWNER_TABLE_REG_ADDR A:0xc40a940
y.create.l HWIO_SPMI_PERIPH145_2OWNER_TABLE_REG_ADDR A:0xc40a944
y.create.l HWIO_SPMI_PERIPH146_2OWNER_TABLE_REG_ADDR A:0xc40a948
y.create.l HWIO_SPMI_PERIPH147_2OWNER_TABLE_REG_ADDR A:0xc40a94c
y.create.l HWIO_SPMI_PERIPH148_2OWNER_TABLE_REG_ADDR A:0xc40a950
y.create.l HWIO_SPMI_PERIPH149_2OWNER_TABLE_REG_ADDR A:0xc40a954
y.create.l HWIO_SPMI_PERIPH150_2OWNER_TABLE_REG_ADDR A:0xc40a958
y.create.l HWIO_SPMI_PERIPH151_2OWNER_TABLE_REG_ADDR A:0xc40a95c
y.create.l HWIO_SPMI_PERIPH152_2OWNER_TABLE_REG_ADDR A:0xc40a960
y.create.l HWIO_SPMI_PERIPH153_2OWNER_TABLE_REG_ADDR A:0xc40a964
y.create.l HWIO_SPMI_PERIPH154_2OWNER_TABLE_REG_ADDR A:0xc40a968
y.create.l HWIO_SPMI_PERIPH155_2OWNER_TABLE_REG_ADDR A:0xc40a96c
y.create.l HWIO_SPMI_PERIPH156_2OWNER_TABLE_REG_ADDR A:0xc40a970
y.create.l HWIO_SPMI_PERIPH157_2OWNER_TABLE_REG_ADDR A:0xc40a974
y.create.l HWIO_SPMI_PERIPH158_2OWNER_TABLE_REG_ADDR A:0xc40a978
y.create.l HWIO_SPMI_PERIPH159_2OWNER_TABLE_REG_ADDR A:0xc40a97c
y.create.l HWIO_SPMI_PERIPH160_2OWNER_TABLE_REG_ADDR A:0xc40a980
y.create.l HWIO_SPMI_PERIPH161_2OWNER_TABLE_REG_ADDR A:0xc40a984
y.create.l HWIO_SPMI_PERIPH162_2OWNER_TABLE_REG_ADDR A:0xc40a988
y.create.l HWIO_SPMI_PERIPH163_2OWNER_TABLE_REG_ADDR A:0xc40a98c
y.create.l HWIO_SPMI_PERIPH164_2OWNER_TABLE_REG_ADDR A:0xc40a990
y.create.l HWIO_SPMI_PERIPH165_2OWNER_TABLE_REG_ADDR A:0xc40a994
y.create.l HWIO_SPMI_PERIPH166_2OWNER_TABLE_REG_ADDR A:0xc40a998
y.create.l HWIO_SPMI_PERIPH167_2OWNER_TABLE_REG_ADDR A:0xc40a99c
y.create.l HWIO_SPMI_PERIPH168_2OWNER_TABLE_REG_ADDR A:0xc40a9a0
y.create.l HWIO_SPMI_PERIPH169_2OWNER_TABLE_REG_ADDR A:0xc40a9a4
y.create.l HWIO_SPMI_PERIPH170_2OWNER_TABLE_REG_ADDR A:0xc40a9a8
y.create.l HWIO_SPMI_PERIPH171_2OWNER_TABLE_REG_ADDR A:0xc40a9ac
y.create.l HWIO_SPMI_PERIPH172_2OWNER_TABLE_REG_ADDR A:0xc40a9b0
y.create.l HWIO_SPMI_PERIPH173_2OWNER_TABLE_REG_ADDR A:0xc40a9b4
y.create.l HWIO_SPMI_PERIPH174_2OWNER_TABLE_REG_ADDR A:0xc40a9b8
y.create.l HWIO_SPMI_PERIPH175_2OWNER_TABLE_REG_ADDR A:0xc40a9bc
y.create.l HWIO_SPMI_PERIPH176_2OWNER_TABLE_REG_ADDR A:0xc40a9c0
y.create.l HWIO_SPMI_PERIPH177_2OWNER_TABLE_REG_ADDR A:0xc40a9c4
y.create.l HWIO_SPMI_PERIPH178_2OWNER_TABLE_REG_ADDR A:0xc40a9c8
y.create.l HWIO_SPMI_PERIPH179_2OWNER_TABLE_REG_ADDR A:0xc40a9cc
y.create.l HWIO_SPMI_PERIPH180_2OWNER_TABLE_REG_ADDR A:0xc40a9d0
y.create.l HWIO_SPMI_PERIPH181_2OWNER_TABLE_REG_ADDR A:0xc40a9d4
y.create.l HWIO_SPMI_PERIPH182_2OWNER_TABLE_REG_ADDR A:0xc40a9d8
y.create.l HWIO_SPMI_PERIPH183_2OWNER_TABLE_REG_ADDR A:0xc40a9dc
y.create.l HWIO_SPMI_PERIPH184_2OWNER_TABLE_REG_ADDR A:0xc40a9e0
y.create.l HWIO_SPMI_PERIPH185_2OWNER_TABLE_REG_ADDR A:0xc40a9e4
y.create.l HWIO_SPMI_PERIPH186_2OWNER_TABLE_REG_ADDR A:0xc40a9e8
y.create.l HWIO_SPMI_PERIPH187_2OWNER_TABLE_REG_ADDR A:0xc40a9ec
y.create.l HWIO_SPMI_PERIPH188_2OWNER_TABLE_REG_ADDR A:0xc40a9f0
y.create.l HWIO_SPMI_PERIPH189_2OWNER_TABLE_REG_ADDR A:0xc40a9f4
y.create.l HWIO_SPMI_PERIPH190_2OWNER_TABLE_REG_ADDR A:0xc40a9f8
y.create.l HWIO_SPMI_PERIPH191_2OWNER_TABLE_REG_ADDR A:0xc40a9fc
y.create.l HWIO_SPMI_PERIPH192_2OWNER_TABLE_REG_ADDR A:0xc40aa00
y.create.l HWIO_SPMI_PERIPH193_2OWNER_TABLE_REG_ADDR A:0xc40aa04
y.create.l HWIO_SPMI_PERIPH194_2OWNER_TABLE_REG_ADDR A:0xc40aa08
y.create.l HWIO_SPMI_PERIPH195_2OWNER_TABLE_REG_ADDR A:0xc40aa0c
y.create.l HWIO_SPMI_PERIPH196_2OWNER_TABLE_REG_ADDR A:0xc40aa10
y.create.l HWIO_SPMI_PERIPH197_2OWNER_TABLE_REG_ADDR A:0xc40aa14
y.create.l HWIO_SPMI_PERIPH198_2OWNER_TABLE_REG_ADDR A:0xc40aa18
y.create.l HWIO_SPMI_PERIPH199_2OWNER_TABLE_REG_ADDR A:0xc40aa1c
y.create.l HWIO_SPMI_PERIPH200_2OWNER_TABLE_REG_ADDR A:0xc40aa20
y.create.l HWIO_SPMI_PERIPH201_2OWNER_TABLE_REG_ADDR A:0xc40aa24
y.create.l HWIO_SPMI_PERIPH202_2OWNER_TABLE_REG_ADDR A:0xc40aa28
y.create.l HWIO_SPMI_PERIPH203_2OWNER_TABLE_REG_ADDR A:0xc40aa2c
y.create.l HWIO_SPMI_PERIPH204_2OWNER_TABLE_REG_ADDR A:0xc40aa30
y.create.l HWIO_SPMI_PERIPH205_2OWNER_TABLE_REG_ADDR A:0xc40aa34
y.create.l HWIO_SPMI_PERIPH206_2OWNER_TABLE_REG_ADDR A:0xc40aa38
y.create.l HWIO_SPMI_PERIPH207_2OWNER_TABLE_REG_ADDR A:0xc40aa3c
y.create.l HWIO_SPMI_PERIPH208_2OWNER_TABLE_REG_ADDR A:0xc40aa40
y.create.l HWIO_SPMI_PERIPH209_2OWNER_TABLE_REG_ADDR A:0xc40aa44
y.create.l HWIO_SPMI_PERIPH210_2OWNER_TABLE_REG_ADDR A:0xc40aa48
y.create.l HWIO_SPMI_PERIPH211_2OWNER_TABLE_REG_ADDR A:0xc40aa4c
y.create.l HWIO_SPMI_PERIPH212_2OWNER_TABLE_REG_ADDR A:0xc40aa50
y.create.l HWIO_SPMI_PERIPH213_2OWNER_TABLE_REG_ADDR A:0xc40aa54
y.create.l HWIO_SPMI_PERIPH214_2OWNER_TABLE_REG_ADDR A:0xc40aa58
y.create.l HWIO_SPMI_PERIPH215_2OWNER_TABLE_REG_ADDR A:0xc40aa5c
y.create.l HWIO_SPMI_PERIPH216_2OWNER_TABLE_REG_ADDR A:0xc40aa60
y.create.l HWIO_SPMI_PERIPH217_2OWNER_TABLE_REG_ADDR A:0xc40aa64
y.create.l HWIO_SPMI_PERIPH218_2OWNER_TABLE_REG_ADDR A:0xc40aa68
y.create.l HWIO_SPMI_PERIPH219_2OWNER_TABLE_REG_ADDR A:0xc40aa6c
y.create.l HWIO_SPMI_PERIPH220_2OWNER_TABLE_REG_ADDR A:0xc40aa70
y.create.l HWIO_SPMI_PERIPH221_2OWNER_TABLE_REG_ADDR A:0xc40aa74
y.create.l HWIO_SPMI_PERIPH222_2OWNER_TABLE_REG_ADDR A:0xc40aa78
y.create.l HWIO_SPMI_PERIPH223_2OWNER_TABLE_REG_ADDR A:0xc40aa7c
y.create.l HWIO_SPMI_PERIPH224_2OWNER_TABLE_REG_ADDR A:0xc40aa80
y.create.l HWIO_SPMI_PERIPH225_2OWNER_TABLE_REG_ADDR A:0xc40aa84
y.create.l HWIO_SPMI_PERIPH226_2OWNER_TABLE_REG_ADDR A:0xc40aa88
y.create.l HWIO_SPMI_PERIPH227_2OWNER_TABLE_REG_ADDR A:0xc40aa8c
y.create.l HWIO_SPMI_PERIPH228_2OWNER_TABLE_REG_ADDR A:0xc40aa90
y.create.l HWIO_SPMI_PERIPH229_2OWNER_TABLE_REG_ADDR A:0xc40aa94
y.create.l HWIO_SPMI_PERIPH230_2OWNER_TABLE_REG_ADDR A:0xc40aa98
y.create.l HWIO_SPMI_PERIPH231_2OWNER_TABLE_REG_ADDR A:0xc40aa9c
y.create.l HWIO_SPMI_PERIPH232_2OWNER_TABLE_REG_ADDR A:0xc40aaa0
y.create.l HWIO_SPMI_PERIPH233_2OWNER_TABLE_REG_ADDR A:0xc40aaa4
y.create.l HWIO_SPMI_PERIPH234_2OWNER_TABLE_REG_ADDR A:0xc40aaa8
y.create.l HWIO_SPMI_PERIPH235_2OWNER_TABLE_REG_ADDR A:0xc40aaac
y.create.l HWIO_SPMI_PERIPH236_2OWNER_TABLE_REG_ADDR A:0xc40aab0
y.create.l HWIO_SPMI_PERIPH237_2OWNER_TABLE_REG_ADDR A:0xc40aab4
y.create.l HWIO_SPMI_PERIPH238_2OWNER_TABLE_REG_ADDR A:0xc40aab8
y.create.l HWIO_SPMI_PERIPH239_2OWNER_TABLE_REG_ADDR A:0xc40aabc
y.create.l HWIO_SPMI_PERIPH240_2OWNER_TABLE_REG_ADDR A:0xc40aac0
y.create.l HWIO_SPMI_PERIPH241_2OWNER_TABLE_REG_ADDR A:0xc40aac4
y.create.l HWIO_SPMI_PERIPH242_2OWNER_TABLE_REG_ADDR A:0xc40aac8
y.create.l HWIO_SPMI_PERIPH243_2OWNER_TABLE_REG_ADDR A:0xc40aacc
y.create.l HWIO_SPMI_PERIPH244_2OWNER_TABLE_REG_ADDR A:0xc40aad0
y.create.l HWIO_SPMI_PERIPH245_2OWNER_TABLE_REG_ADDR A:0xc40aad4
y.create.l HWIO_SPMI_PERIPH246_2OWNER_TABLE_REG_ADDR A:0xc40aad8
y.create.l HWIO_SPMI_PERIPH247_2OWNER_TABLE_REG_ADDR A:0xc40aadc
y.create.l HWIO_SPMI_PERIPH248_2OWNER_TABLE_REG_ADDR A:0xc40aae0
y.create.l HWIO_SPMI_PERIPH249_2OWNER_TABLE_REG_ADDR A:0xc40aae4
y.create.l HWIO_SPMI_PERIPH250_2OWNER_TABLE_REG_ADDR A:0xc40aae8
y.create.l HWIO_SPMI_PERIPH251_2OWNER_TABLE_REG_ADDR A:0xc40aaec
y.create.l HWIO_SPMI_PERIPH252_2OWNER_TABLE_REG_ADDR A:0xc40aaf0
y.create.l HWIO_SPMI_PERIPH253_2OWNER_TABLE_REG_ADDR A:0xc40aaf4
y.create.l HWIO_SPMI_PERIPH254_2OWNER_TABLE_REG_ADDR A:0xc40aaf8
y.create.l HWIO_SPMI_PERIPH255_2OWNER_TABLE_REG_ADDR A:0xc40aafc
y.create.l HWIO_SPMI_MID_REG_ADDR A:0xc40af00
y.create.l HWIO_SPMI_CFG_REG_ADDR A:0xc40af04
y.create.l HWIO_SPMI_SEC_DISABLE_REG_ADDR A:0xc40af08
y.create.l HWIO_SPMI_HW_VERSION_ADDR A:0xc40af0c
y.create.l HWIO_SPMI_CGC_CTRL_ADDR A:0xc40af10
y.create.l HWIO_SPMI_MWB_ENABLE_REG_ADDR A:0xc40af14
y.create.l HWIO_SPMI_CHAR_CFG_ADDR A:0xc40af40
y.create.l HWIO_SPMI_CHAR_DATA_0_ADDR A:0xc40af44
y.create.l HWIO_SPMI_CHAR_DATA_1_ADDR A:0xc40af48
y.create.l HWIO_SPMI_CMPR_EN_REG_ADDR A:0xc40af54
y.create.l HWIO_SPMI_PIC_RCS_VIOCTL_0_ADDR A:0xc40af58
y.create.l HWIO_SPMI_PIC_RCS_VIOCTL_N_0_ADDR A:0xc40af5c
y.create.l HWIO_SPMI_PROTOCOL_IRQ_STATUS_ADDR A:0xc410000
y.create.l HWIO_SPMI_PROTOCOL_IRQ_ENABLE_ADDR A:0xc410004
y.create.l HWIO_SPMI_PROTOCOL_IRQ_CLEAR_ADDR A:0xc410008
y.create.l HWIO_SPMI_PROTOCOL_IRQ_EN_SET_ADDR A:0xc41000c
y.create.l HWIO_SPMI_PROTOCOL_IRQ_EN_CLEAR_ADDR A:0xc410010
y.create.l HWIO_SPMI_TEST_BUS_CTRL_ADDR A:0xc420000
y.create.l HWIO_SPMI_HW_SW_EVENTS_CTRL_ADDR A:0xc420004
y.create.l HWIO_SPMI_HW_SW_EVENTS_BITWISE_REG0_ADDR A:0xc420008
y.create.l HWIO_SPMI_HW_SW_EVENTS_BITWISE_REG1_ADDR A:0xc42000c
y.create.l HWIO_SPMI_HW_SW_EVENTS_BITWISE_REG2_ADDR A:0xc420010
y.create.l HWIO_SPMI_HW_SW_EVENTS_BITWISE_REG3_ADDR A:0xc420014
y.create.l HWIO_SPMI_HW_SW_EVENTS_BITWISE_REG4_ADDR A:0xc420018
y.create.l HWIO_SPMI_HW_SW_EVENTS_BITWISE_REG5_ADDR A:0xc42001c
y.create.l HWIO_SPMI_HW_SW_EVENTS_BITWISE_REG6_ADDR A:0xc420020
y.create.l HWIO_SPMI_HW_SW_EVENTS_BITWISE_REG7_ADDR A:0xc420024
y.create.l HWIO_SPMI_DEBUG_REG_ADDR A:0xc420028
y.create.l HWIO_SPMI_PIC_OWNER0_ACC_STATUS0_ADDR A:0xe700000
y.create.l HWIO_SPMI_PIC_OWNER0_ACC_STATUS1_ADDR A:0xe700004
y.create.l HWIO_SPMI_PIC_OWNER0_ACC_STATUS2_ADDR A:0xe700008
y.create.l HWIO_SPMI_PIC_OWNER0_ACC_STATUS3_ADDR A:0xe70000c
y.create.l HWIO_SPMI_PIC_OWNER0_ACC_STATUS4_ADDR A:0xe700010
y.create.l HWIO_SPMI_PIC_OWNER0_ACC_STATUS5_ADDR A:0xe700014
y.create.l HWIO_SPMI_PIC_OWNER0_ACC_STATUS6_ADDR A:0xe700018
y.create.l HWIO_SPMI_PIC_OWNER0_ACC_STATUS7_ADDR A:0xe70001c
y.create.l HWIO_SPMI_PIC_OWNER1_ACC_STATUS0_ADDR A:0xe710000
y.create.l HWIO_SPMI_PIC_OWNER1_ACC_STATUS1_ADDR A:0xe710004
y.create.l HWIO_SPMI_PIC_OWNER1_ACC_STATUS2_ADDR A:0xe710008
y.create.l HWIO_SPMI_PIC_OWNER1_ACC_STATUS3_ADDR A:0xe71000c
y.create.l HWIO_SPMI_PIC_OWNER1_ACC_STATUS4_ADDR A:0xe710010
y.create.l HWIO_SPMI_PIC_OWNER1_ACC_STATUS5_ADDR A:0xe710014
y.create.l HWIO_SPMI_PIC_OWNER1_ACC_STATUS6_ADDR A:0xe710018
y.create.l HWIO_SPMI_PIC_OWNER1_ACC_STATUS7_ADDR A:0xe71001c
y.create.l HWIO_SPMI_PIC_OWNER2_ACC_STATUS0_ADDR A:0xe720000
y.create.l HWIO_SPMI_PIC_OWNER2_ACC_STATUS1_ADDR A:0xe720004
y.create.l HWIO_SPMI_PIC_OWNER2_ACC_STATUS2_ADDR A:0xe720008
y.create.l HWIO_SPMI_PIC_OWNER2_ACC_STATUS3_ADDR A:0xe72000c
y.create.l HWIO_SPMI_PIC_OWNER2_ACC_STATUS4_ADDR A:0xe720010
y.create.l HWIO_SPMI_PIC_OWNER2_ACC_STATUS5_ADDR A:0xe720014
y.create.l HWIO_SPMI_PIC_OWNER2_ACC_STATUS6_ADDR A:0xe720018
y.create.l HWIO_SPMI_PIC_OWNER2_ACC_STATUS7_ADDR A:0xe72001c
y.create.l HWIO_SPMI_PIC_OWNER3_ACC_STATUS0_ADDR A:0xe730000
y.create.l HWIO_SPMI_PIC_OWNER3_ACC_STATUS1_ADDR A:0xe730004
y.create.l HWIO_SPMI_PIC_OWNER3_ACC_STATUS2_ADDR A:0xe730008
y.create.l HWIO_SPMI_PIC_OWNER3_ACC_STATUS3_ADDR A:0xe73000c
y.create.l HWIO_SPMI_PIC_OWNER3_ACC_STATUS4_ADDR A:0xe730010
y.create.l HWIO_SPMI_PIC_OWNER3_ACC_STATUS5_ADDR A:0xe730014
y.create.l HWIO_SPMI_PIC_OWNER3_ACC_STATUS6_ADDR A:0xe730018
y.create.l HWIO_SPMI_PIC_OWNER3_ACC_STATUS7_ADDR A:0xe73001c
y.create.l HWIO_SPMI_PIC_OWNER4_ACC_STATUS0_ADDR A:0xe740000
y.create.l HWIO_SPMI_PIC_OWNER4_ACC_STATUS1_ADDR A:0xe740004
y.create.l HWIO_SPMI_PIC_OWNER4_ACC_STATUS2_ADDR A:0xe740008
y.create.l HWIO_SPMI_PIC_OWNER4_ACC_STATUS3_ADDR A:0xe74000c
y.create.l HWIO_SPMI_PIC_OWNER4_ACC_STATUS4_ADDR A:0xe740010
y.create.l HWIO_SPMI_PIC_OWNER4_ACC_STATUS5_ADDR A:0xe740014
y.create.l HWIO_SPMI_PIC_OWNER4_ACC_STATUS6_ADDR A:0xe740018
y.create.l HWIO_SPMI_PIC_OWNER4_ACC_STATUS7_ADDR A:0xe74001c
y.create.l HWIO_PMIC_MGPI_TRIG_CONFIG0_ADDR A:0xc462000
y.create.l HWIO_PMIC_MGPI_TRIG_CONFIG1_ADDR A:0xc462008
y.create.l HWIO_PMIC_MGPI_TRIG_CONFIG2_ADDR A:0xc462010
y.create.l HWIO_PMIC_MGPI_TRIG_CONFIG3_ADDR A:0xc462018
y.create.l HWIO_PMIC_MGPI_TRIG_CONFIG_EN0_ADDR A:0xc462004
y.create.l HWIO_PMIC_MGPI_TRIG_CONFIG_EN1_ADDR A:0xc46200c
y.create.l HWIO_PMIC_MGPI_TRIG_CONFIG_EN2_ADDR A:0xc462014
y.create.l HWIO_PMIC_MGPI_TRIG_CONFIG_EN3_ADDR A:0xc46201c
y.create.l HWIO_PMIC_MGPI_MASTER_CSR_ADDR A:0xc462100
y.create.l HWIO_PMIC_MGPI_HW_VERSION_ADDR A:0xc462104
y.create.l HWIO_PMIC_MGPI_TRIG_STATUS0_ADDR A:0xc470000
y.create.l HWIO_PMIC_MGPI_TRIG_STATUS1_ADDR A:0xc480000
y.create.l HWIO_PMIC_MGPI_TRIG_STATUS2_ADDR A:0xc490000
y.create.l HWIO_PMIC_MGPI_TRIG_STATUS3_ADDR A:0xc4a0000
y.create.l HWIO_PMIC_ARB_HW_VERSION_ADDR A:0xc440000
y.create.l HWIO_PMIC_ARB_FEATURES_ADDR A:0xc440004
y.create.l HWIO_PMIC_ARB_MISC_CONFIG_ADDR A:0xc440010
y.create.l HWIO_PMIC_ARB_PRIORITIES0_ADDR A:0xc440100
y.create.l HWIO_PMIC_ARB_PRIORITIES1_ADDR A:0xc440104
y.create.l HWIO_PMIC_ARB_PRIORITIES2_ADDR A:0xc440108
y.create.l HWIO_PMIC_ARB_PRIORITIES3_ADDR A:0xc44010c
y.create.l HWIO_PMIC_ARB_PRIORITIES4_ADDR A:0xc440110
y.create.l HWIO_PMIC_ARB_PRIORITIES5_ADDR A:0xc440114
y.create.l HWIO_PMIC_ARB_PVC_INTF_CTL_ADDR A:0xc440200
y.create.l HWIO_PMIC_ARB_PVC_INTF_STATUS_ADDR A:0xc440204
y.create.l HWIO_PMIC_ARB_PVC_PORT0_CTL_ADDR A:0xc440208
y.create.l HWIO_PMIC_ARB_PVC_PORT1_CTL_ADDR A:0xc44020c
y.create.l HWIO_PMIC_ARB_PVC_PORT2_CTL_ADDR A:0xc440210
y.create.l HWIO_PMIC_ARB_PVC_PORT0_STATUS_ADDR A:0xc440288
y.create.l HWIO_PMIC_ARB_PVC_PORT1_STATUS_ADDR A:0xc44028c
y.create.l HWIO_PMIC_ARB_PVC_PORT2_STATUS_ADDR A:0xc440290
y.create.l HWIO_PMIC_ARB_PVC0_ADDR0_ADDR A:0xc440400
y.create.l HWIO_PMIC_ARB_PVC0_ADDR1_ADDR A:0xc440404
y.create.l HWIO_PMIC_ARB_PVC0_ADDR2_ADDR A:0xc440408
y.create.l HWIO_PMIC_ARB_PVC0_ADDR3_ADDR A:0xc44040c
y.create.l HWIO_PMIC_ARB_PVC1_ADDR0_ADDR A:0xc440420
y.create.l HWIO_PMIC_ARB_PVC1_ADDR1_ADDR A:0xc440424
y.create.l HWIO_PMIC_ARB_PVC1_ADDR2_ADDR A:0xc440428
y.create.l HWIO_PMIC_ARB_PVC1_ADDR3_ADDR A:0xc44042c
y.create.l HWIO_PMIC_ARB_PVC2_ADDR0_ADDR A:0xc440440
y.create.l HWIO_PMIC_ARB_PVC2_ADDR1_ADDR A:0xc440444
y.create.l HWIO_PMIC_ARB_PVC2_ADDR2_ADDR A:0xc440448
y.create.l HWIO_PMIC_ARB_PVC2_ADDR3_ADDR A:0xc44044c
y.create.l HWIO_PMIC_ARB_REG_ADDR0_ADDR A:0xc440900
y.create.l HWIO_PMIC_ARB_REG_ADDR1_ADDR A:0xc440904
y.create.l HWIO_PMIC_ARB_REG_ADDR2_ADDR A:0xc440908
y.create.l HWIO_PMIC_ARB_REG_ADDR3_ADDR A:0xc44090c
y.create.l HWIO_PMIC_ARB_REG_ADDR4_ADDR A:0xc440910
y.create.l HWIO_PMIC_ARB_REG_ADDR5_ADDR A:0xc440914
y.create.l HWIO_PMIC_ARB_REG_ADDR6_ADDR A:0xc440918
y.create.l HWIO_PMIC_ARB_REG_ADDR7_ADDR A:0xc44091c
y.create.l HWIO_PMIC_ARB_REG_ADDR8_ADDR A:0xc440920
y.create.l HWIO_PMIC_ARB_REG_ADDR9_ADDR A:0xc440924
y.create.l HWIO_PMIC_ARB_REG_ADDR10_ADDR A:0xc440928
y.create.l HWIO_PMIC_ARB_REG_ADDR11_ADDR A:0xc44092c
y.create.l HWIO_PMIC_ARB_REG_ADDR12_ADDR A:0xc440930
y.create.l HWIO_PMIC_ARB_REG_ADDR13_ADDR A:0xc440934
y.create.l HWIO_PMIC_ARB_REG_ADDR14_ADDR A:0xc440938
y.create.l HWIO_PMIC_ARB_REG_ADDR15_ADDR A:0xc44093c
y.create.l HWIO_PMIC_ARB_REG_ADDR16_ADDR A:0xc440940
y.create.l HWIO_PMIC_ARB_REG_ADDR17_ADDR A:0xc440944
y.create.l HWIO_PMIC_ARB_REG_ADDR18_ADDR A:0xc440948
y.create.l HWIO_PMIC_ARB_REG_ADDR19_ADDR A:0xc44094c
y.create.l HWIO_PMIC_ARB_REG_ADDR20_ADDR A:0xc440950
y.create.l HWIO_PMIC_ARB_REG_ADDR21_ADDR A:0xc440954
y.create.l HWIO_PMIC_ARB_REG_ADDR22_ADDR A:0xc440958
y.create.l HWIO_PMIC_ARB_REG_ADDR23_ADDR A:0xc44095c
y.create.l HWIO_PMIC_ARB_REG_ADDR24_ADDR A:0xc440960
y.create.l HWIO_PMIC_ARB_REG_ADDR25_ADDR A:0xc440964
y.create.l HWIO_PMIC_ARB_REG_ADDR26_ADDR A:0xc440968
y.create.l HWIO_PMIC_ARB_REG_ADDR27_ADDR A:0xc44096c
y.create.l HWIO_PMIC_ARB_REG_ADDR28_ADDR A:0xc440970
y.create.l HWIO_PMIC_ARB_REG_ADDR29_ADDR A:0xc440974
y.create.l HWIO_PMIC_ARB_REG_ADDR30_ADDR A:0xc440978
y.create.l HWIO_PMIC_ARB_REG_ADDR31_ADDR A:0xc44097c
y.create.l HWIO_PMIC_ARB_REG_ADDR32_ADDR A:0xc440980
y.create.l HWIO_PMIC_ARB_REG_ADDR33_ADDR A:0xc440984
y.create.l HWIO_PMIC_ARB_REG_ADDR34_ADDR A:0xc440988
y.create.l HWIO_PMIC_ARB_REG_ADDR35_ADDR A:0xc44098c
y.create.l HWIO_PMIC_ARB_REG_ADDR36_ADDR A:0xc440990
y.create.l HWIO_PMIC_ARB_REG_ADDR37_ADDR A:0xc440994
y.create.l HWIO_PMIC_ARB_REG_ADDR38_ADDR A:0xc440998
y.create.l HWIO_PMIC_ARB_REG_ADDR39_ADDR A:0xc44099c
y.create.l HWIO_PMIC_ARB_REG_ADDR40_ADDR A:0xc4409a0
y.create.l HWIO_PMIC_ARB_REG_ADDR41_ADDR A:0xc4409a4
y.create.l HWIO_PMIC_ARB_REG_ADDR42_ADDR A:0xc4409a8
y.create.l HWIO_PMIC_ARB_REG_ADDR43_ADDR A:0xc4409ac
y.create.l HWIO_PMIC_ARB_REG_ADDR44_ADDR A:0xc4409b0
y.create.l HWIO_PMIC_ARB_REG_ADDR45_ADDR A:0xc4409b4
y.create.l HWIO_PMIC_ARB_REG_ADDR46_ADDR A:0xc4409b8
y.create.l HWIO_PMIC_ARB_REG_ADDR47_ADDR A:0xc4409bc
y.create.l HWIO_PMIC_ARB_REG_ADDR48_ADDR A:0xc4409c0
y.create.l HWIO_PMIC_ARB_REG_ADDR49_ADDR A:0xc4409c4
y.create.l HWIO_PMIC_ARB_REG_ADDR50_ADDR A:0xc4409c8
y.create.l HWIO_PMIC_ARB_REG_ADDR51_ADDR A:0xc4409cc
y.create.l HWIO_PMIC_ARB_REG_ADDR52_ADDR A:0xc4409d0
y.create.l HWIO_PMIC_ARB_REG_ADDR53_ADDR A:0xc4409d4
y.create.l HWIO_PMIC_ARB_REG_ADDR54_ADDR A:0xc4409d8
y.create.l HWIO_PMIC_ARB_REG_ADDR55_ADDR A:0xc4409dc
y.create.l HWIO_PMIC_ARB_REG_ADDR56_ADDR A:0xc4409e0
y.create.l HWIO_PMIC_ARB_REG_ADDR57_ADDR A:0xc4409e4
y.create.l HWIO_PMIC_ARB_REG_ADDR58_ADDR A:0xc4409e8
y.create.l HWIO_PMIC_ARB_REG_ADDR59_ADDR A:0xc4409ec
y.create.l HWIO_PMIC_ARB_REG_ADDR60_ADDR A:0xc4409f0
y.create.l HWIO_PMIC_ARB_REG_ADDR61_ADDR A:0xc4409f4
y.create.l HWIO_PMIC_ARB_REG_ADDR62_ADDR A:0xc4409f8
y.create.l HWIO_PMIC_ARB_REG_ADDR63_ADDR A:0xc4409fc
y.create.l HWIO_PMIC_ARB_REG_ADDR64_ADDR A:0xc440a00
y.create.l HWIO_PMIC_ARB_REG_ADDR65_ADDR A:0xc440a04
y.create.l HWIO_PMIC_ARB_REG_ADDR66_ADDR A:0xc440a08
y.create.l HWIO_PMIC_ARB_REG_ADDR67_ADDR A:0xc440a0c
y.create.l HWIO_PMIC_ARB_REG_ADDR68_ADDR A:0xc440a10
y.create.l HWIO_PMIC_ARB_REG_ADDR69_ADDR A:0xc440a14
y.create.l HWIO_PMIC_ARB_REG_ADDR70_ADDR A:0xc440a18
y.create.l HWIO_PMIC_ARB_REG_ADDR71_ADDR A:0xc440a1c
y.create.l HWIO_PMIC_ARB_REG_ADDR72_ADDR A:0xc440a20
y.create.l HWIO_PMIC_ARB_REG_ADDR73_ADDR A:0xc440a24
y.create.l HWIO_PMIC_ARB_REG_ADDR74_ADDR A:0xc440a28
y.create.l HWIO_PMIC_ARB_REG_ADDR75_ADDR A:0xc440a2c
y.create.l HWIO_PMIC_ARB_REG_ADDR76_ADDR A:0xc440a30
y.create.l HWIO_PMIC_ARB_REG_ADDR77_ADDR A:0xc440a34
y.create.l HWIO_PMIC_ARB_REG_ADDR78_ADDR A:0xc440a38
y.create.l HWIO_PMIC_ARB_REG_ADDR79_ADDR A:0xc440a3c
y.create.l HWIO_PMIC_ARB_REG_ADDR80_ADDR A:0xc440a40
y.create.l HWIO_PMIC_ARB_REG_ADDR81_ADDR A:0xc440a44
y.create.l HWIO_PMIC_ARB_REG_ADDR82_ADDR A:0xc440a48
y.create.l HWIO_PMIC_ARB_REG_ADDR83_ADDR A:0xc440a4c
y.create.l HWIO_PMIC_ARB_REG_ADDR84_ADDR A:0xc440a50
y.create.l HWIO_PMIC_ARB_REG_ADDR85_ADDR A:0xc440a54
y.create.l HWIO_PMIC_ARB_REG_ADDR86_ADDR A:0xc440a58
y.create.l HWIO_PMIC_ARB_REG_ADDR87_ADDR A:0xc440a5c
y.create.l HWIO_PMIC_ARB_REG_ADDR88_ADDR A:0xc440a60
y.create.l HWIO_PMIC_ARB_REG_ADDR89_ADDR A:0xc440a64
y.create.l HWIO_PMIC_ARB_REG_ADDR90_ADDR A:0xc440a68
y.create.l HWIO_PMIC_ARB_REG_ADDR91_ADDR A:0xc440a6c
y.create.l HWIO_PMIC_ARB_REG_ADDR92_ADDR A:0xc440a70
y.create.l HWIO_PMIC_ARB_REG_ADDR93_ADDR A:0xc440a74
y.create.l HWIO_PMIC_ARB_REG_ADDR94_ADDR A:0xc440a78
y.create.l HWIO_PMIC_ARB_REG_ADDR95_ADDR A:0xc440a7c
y.create.l HWIO_PMIC_ARB_REG_ADDR96_ADDR A:0xc440a80
y.create.l HWIO_PMIC_ARB_REG_ADDR97_ADDR A:0xc440a84
y.create.l HWIO_PMIC_ARB_REG_ADDR98_ADDR A:0xc440a88
y.create.l HWIO_PMIC_ARB_REG_ADDR99_ADDR A:0xc440a8c
y.create.l HWIO_PMIC_ARB_REG_ADDR100_ADDR A:0xc440a90
y.create.l HWIO_PMIC_ARB_REG_ADDR101_ADDR A:0xc440a94
y.create.l HWIO_PMIC_ARB_REG_ADDR102_ADDR A:0xc440a98
y.create.l HWIO_PMIC_ARB_REG_ADDR103_ADDR A:0xc440a9c
y.create.l HWIO_PMIC_ARB_REG_ADDR104_ADDR A:0xc440aa0
y.create.l HWIO_PMIC_ARB_REG_ADDR105_ADDR A:0xc440aa4
y.create.l HWIO_PMIC_ARB_REG_ADDR106_ADDR A:0xc440aa8
y.create.l HWIO_PMIC_ARB_REG_ADDR107_ADDR A:0xc440aac
y.create.l HWIO_PMIC_ARB_REG_ADDR108_ADDR A:0xc440ab0
y.create.l HWIO_PMIC_ARB_REG_ADDR109_ADDR A:0xc440ab4
y.create.l HWIO_PMIC_ARB_REG_ADDR110_ADDR A:0xc440ab8
y.create.l HWIO_PMIC_ARB_REG_ADDR111_ADDR A:0xc440abc
y.create.l HWIO_PMIC_ARB_REG_ADDR112_ADDR A:0xc440ac0
y.create.l HWIO_PMIC_ARB_REG_ADDR113_ADDR A:0xc440ac4
y.create.l HWIO_PMIC_ARB_REG_ADDR114_ADDR A:0xc440ac8
y.create.l HWIO_PMIC_ARB_REG_ADDR115_ADDR A:0xc440acc
y.create.l HWIO_PMIC_ARB_REG_ADDR116_ADDR A:0xc440ad0
y.create.l HWIO_PMIC_ARB_REG_ADDR117_ADDR A:0xc440ad4
y.create.l HWIO_PMIC_ARB_REG_ADDR118_ADDR A:0xc440ad8
y.create.l HWIO_PMIC_ARB_REG_ADDR119_ADDR A:0xc440adc
y.create.l HWIO_PMIC_ARB_REG_ADDR120_ADDR A:0xc440ae0
y.create.l HWIO_PMIC_ARB_REG_ADDR121_ADDR A:0xc440ae4
y.create.l HWIO_PMIC_ARB_REG_ADDR122_ADDR A:0xc440ae8
y.create.l HWIO_PMIC_ARB_REG_ADDR123_ADDR A:0xc440aec
y.create.l HWIO_PMIC_ARB_REG_ADDR124_ADDR A:0xc440af0
y.create.l HWIO_PMIC_ARB_REG_ADDR125_ADDR A:0xc440af4
y.create.l HWIO_PMIC_ARB_REG_ADDR126_ADDR A:0xc440af8
y.create.l HWIO_PMIC_ARB_REG_ADDR127_ADDR A:0xc440afc
y.create.l HWIO_PMIC_ARB_REG_ADDR128_ADDR A:0xc440b00
y.create.l HWIO_PMIC_ARB_REG_ADDR129_ADDR A:0xc440b04
y.create.l HWIO_PMIC_ARB_REG_ADDR130_ADDR A:0xc440b08
y.create.l HWIO_PMIC_ARB_REG_ADDR131_ADDR A:0xc440b0c
y.create.l HWIO_PMIC_ARB_REG_ADDR132_ADDR A:0xc440b10
y.create.l HWIO_PMIC_ARB_REG_ADDR133_ADDR A:0xc440b14
y.create.l HWIO_PMIC_ARB_REG_ADDR134_ADDR A:0xc440b18
y.create.l HWIO_PMIC_ARB_REG_ADDR135_ADDR A:0xc440b1c
y.create.l HWIO_PMIC_ARB_REG_ADDR136_ADDR A:0xc440b20
y.create.l HWIO_PMIC_ARB_REG_ADDR137_ADDR A:0xc440b24
y.create.l HWIO_PMIC_ARB_REG_ADDR138_ADDR A:0xc440b28
y.create.l HWIO_PMIC_ARB_REG_ADDR139_ADDR A:0xc440b2c
y.create.l HWIO_PMIC_ARB_REG_ADDR140_ADDR A:0xc440b30
y.create.l HWIO_PMIC_ARB_REG_ADDR141_ADDR A:0xc440b34
y.create.l HWIO_PMIC_ARB_REG_ADDR142_ADDR A:0xc440b38
y.create.l HWIO_PMIC_ARB_REG_ADDR143_ADDR A:0xc440b3c
y.create.l HWIO_PMIC_ARB_REG_ADDR144_ADDR A:0xc440b40
y.create.l HWIO_PMIC_ARB_REG_ADDR145_ADDR A:0xc440b44
y.create.l HWIO_PMIC_ARB_REG_ADDR146_ADDR A:0xc440b48
y.create.l HWIO_PMIC_ARB_REG_ADDR147_ADDR A:0xc440b4c
y.create.l HWIO_PMIC_ARB_REG_ADDR148_ADDR A:0xc440b50
y.create.l HWIO_PMIC_ARB_REG_ADDR149_ADDR A:0xc440b54
y.create.l HWIO_PMIC_ARB_REG_ADDR150_ADDR A:0xc440b58
y.create.l HWIO_PMIC_ARB_REG_ADDR151_ADDR A:0xc440b5c
y.create.l HWIO_PMIC_ARB_REG_ADDR152_ADDR A:0xc440b60
y.create.l HWIO_PMIC_ARB_REG_ADDR153_ADDR A:0xc440b64
y.create.l HWIO_PMIC_ARB_REG_ADDR154_ADDR A:0xc440b68
y.create.l HWIO_PMIC_ARB_REG_ADDR155_ADDR A:0xc440b6c
y.create.l HWIO_PMIC_ARB_REG_ADDR156_ADDR A:0xc440b70
y.create.l HWIO_PMIC_ARB_REG_ADDR157_ADDR A:0xc440b74
y.create.l HWIO_PMIC_ARB_REG_ADDR158_ADDR A:0xc440b78
y.create.l HWIO_PMIC_ARB_REG_ADDR159_ADDR A:0xc440b7c
y.create.l HWIO_PMIC_ARB_REG_ADDR160_ADDR A:0xc440b80
y.create.l HWIO_PMIC_ARB_REG_ADDR161_ADDR A:0xc440b84
y.create.l HWIO_PMIC_ARB_REG_ADDR162_ADDR A:0xc440b88
y.create.l HWIO_PMIC_ARB_REG_ADDR163_ADDR A:0xc440b8c
y.create.l HWIO_PMIC_ARB_REG_ADDR164_ADDR A:0xc440b90
y.create.l HWIO_PMIC_ARB_REG_ADDR165_ADDR A:0xc440b94
y.create.l HWIO_PMIC_ARB_REG_ADDR166_ADDR A:0xc440b98
y.create.l HWIO_PMIC_ARB_REG_ADDR167_ADDR A:0xc440b9c
y.create.l HWIO_PMIC_ARB_REG_ADDR168_ADDR A:0xc440ba0
y.create.l HWIO_PMIC_ARB_REG_ADDR169_ADDR A:0xc440ba4
y.create.l HWIO_PMIC_ARB_REG_ADDR170_ADDR A:0xc440ba8
y.create.l HWIO_PMIC_ARB_REG_ADDR171_ADDR A:0xc440bac
y.create.l HWIO_PMIC_ARB_REG_ADDR172_ADDR A:0xc440bb0
y.create.l HWIO_PMIC_ARB_REG_ADDR173_ADDR A:0xc440bb4
y.create.l HWIO_PMIC_ARB_REG_ADDR174_ADDR A:0xc440bb8
y.create.l HWIO_PMIC_ARB_REG_ADDR175_ADDR A:0xc440bbc
y.create.l HWIO_PMIC_ARB_REG_ADDR176_ADDR A:0xc440bc0
y.create.l HWIO_PMIC_ARB_REG_ADDR177_ADDR A:0xc440bc4
y.create.l HWIO_PMIC_ARB_REG_ADDR178_ADDR A:0xc440bc8
y.create.l HWIO_PMIC_ARB_REG_ADDR179_ADDR A:0xc440bcc
y.create.l HWIO_PMIC_ARB_REG_ADDR180_ADDR A:0xc440bd0
y.create.l HWIO_PMIC_ARB_REG_ADDR181_ADDR A:0xc440bd4
y.create.l HWIO_PMIC_ARB_REG_ADDR182_ADDR A:0xc440bd8
y.create.l HWIO_PMIC_ARB_REG_ADDR183_ADDR A:0xc440bdc
y.create.l HWIO_PMIC_ARB_REG_ADDR184_ADDR A:0xc440be0
y.create.l HWIO_PMIC_ARB_REG_ADDR185_ADDR A:0xc440be4
y.create.l HWIO_PMIC_ARB_REG_ADDR186_ADDR A:0xc440be8
y.create.l HWIO_PMIC_ARB_REG_ADDR187_ADDR A:0xc440bec
y.create.l HWIO_PMIC_ARB_REG_ADDR188_ADDR A:0xc440bf0
y.create.l HWIO_PMIC_ARB_REG_ADDR189_ADDR A:0xc440bf4
y.create.l HWIO_PMIC_ARB_REG_ADDR190_ADDR A:0xc440bf8
y.create.l HWIO_PMIC_ARB_REG_ADDR191_ADDR A:0xc440bfc
y.create.l HWIO_PMIC_ARB_REG_ADDR192_ADDR A:0xc440c00
y.create.l HWIO_PMIC_ARB_REG_ADDR193_ADDR A:0xc440c04
y.create.l HWIO_PMIC_ARB_REG_ADDR194_ADDR A:0xc440c08
y.create.l HWIO_PMIC_ARB_REG_ADDR195_ADDR A:0xc440c0c
y.create.l HWIO_PMIC_ARB_REG_ADDR196_ADDR A:0xc440c10
y.create.l HWIO_PMIC_ARB_REG_ADDR197_ADDR A:0xc440c14
y.create.l HWIO_PMIC_ARB_REG_ADDR198_ADDR A:0xc440c18
y.create.l HWIO_PMIC_ARB_REG_ADDR199_ADDR A:0xc440c1c
y.create.l HWIO_PMIC_ARB_REG_ADDR200_ADDR A:0xc440c20
y.create.l HWIO_PMIC_ARB_REG_ADDR201_ADDR A:0xc440c24
y.create.l HWIO_PMIC_ARB_REG_ADDR202_ADDR A:0xc440c28
y.create.l HWIO_PMIC_ARB_REG_ADDR203_ADDR A:0xc440c2c
y.create.l HWIO_PMIC_ARB_REG_ADDR204_ADDR A:0xc440c30
y.create.l HWIO_PMIC_ARB_REG_ADDR205_ADDR A:0xc440c34
y.create.l HWIO_PMIC_ARB_REG_ADDR206_ADDR A:0xc440c38
y.create.l HWIO_PMIC_ARB_REG_ADDR207_ADDR A:0xc440c3c
y.create.l HWIO_PMIC_ARB_REG_ADDR208_ADDR A:0xc440c40
y.create.l HWIO_PMIC_ARB_REG_ADDR209_ADDR A:0xc440c44
y.create.l HWIO_PMIC_ARB_REG_ADDR210_ADDR A:0xc440c48
y.create.l HWIO_PMIC_ARB_REG_ADDR211_ADDR A:0xc440c4c
y.create.l HWIO_PMIC_ARB_REG_ADDR212_ADDR A:0xc440c50
y.create.l HWIO_PMIC_ARB_REG_ADDR213_ADDR A:0xc440c54
y.create.l HWIO_PMIC_ARB_REG_ADDR214_ADDR A:0xc440c58
y.create.l HWIO_PMIC_ARB_REG_ADDR215_ADDR A:0xc440c5c
y.create.l HWIO_PMIC_ARB_REG_ADDR216_ADDR A:0xc440c60
y.create.l HWIO_PMIC_ARB_REG_ADDR217_ADDR A:0xc440c64
y.create.l HWIO_PMIC_ARB_REG_ADDR218_ADDR A:0xc440c68
y.create.l HWIO_PMIC_ARB_REG_ADDR219_ADDR A:0xc440c6c
y.create.l HWIO_PMIC_ARB_REG_ADDR220_ADDR A:0xc440c70
y.create.l HWIO_PMIC_ARB_REG_ADDR221_ADDR A:0xc440c74
y.create.l HWIO_PMIC_ARB_REG_ADDR222_ADDR A:0xc440c78
y.create.l HWIO_PMIC_ARB_REG_ADDR223_ADDR A:0xc440c7c
y.create.l HWIO_PMIC_ARB_REG_ADDR224_ADDR A:0xc440c80
y.create.l HWIO_PMIC_ARB_REG_ADDR225_ADDR A:0xc440c84
y.create.l HWIO_PMIC_ARB_REG_ADDR226_ADDR A:0xc440c88
y.create.l HWIO_PMIC_ARB_REG_ADDR227_ADDR A:0xc440c8c
y.create.l HWIO_PMIC_ARB_REG_ADDR228_ADDR A:0xc440c90
y.create.l HWIO_PMIC_ARB_REG_ADDR229_ADDR A:0xc440c94
y.create.l HWIO_PMIC_ARB_REG_ADDR230_ADDR A:0xc440c98
y.create.l HWIO_PMIC_ARB_REG_ADDR231_ADDR A:0xc440c9c
y.create.l HWIO_PMIC_ARB_REG_ADDR232_ADDR A:0xc440ca0
y.create.l HWIO_PMIC_ARB_REG_ADDR233_ADDR A:0xc440ca4
y.create.l HWIO_PMIC_ARB_REG_ADDR234_ADDR A:0xc440ca8
y.create.l HWIO_PMIC_ARB_REG_ADDR235_ADDR A:0xc440cac
y.create.l HWIO_PMIC_ARB_REG_ADDR236_ADDR A:0xc440cb0
y.create.l HWIO_PMIC_ARB_REG_ADDR237_ADDR A:0xc440cb4
y.create.l HWIO_PMIC_ARB_REG_ADDR238_ADDR A:0xc440cb8
y.create.l HWIO_PMIC_ARB_REG_ADDR239_ADDR A:0xc440cbc
y.create.l HWIO_PMIC_ARB_REG_ADDR240_ADDR A:0xc440cc0
y.create.l HWIO_PMIC_ARB_REG_ADDR241_ADDR A:0xc440cc4
y.create.l HWIO_PMIC_ARB_REG_ADDR242_ADDR A:0xc440cc8
y.create.l HWIO_PMIC_ARB_REG_ADDR243_ADDR A:0xc440ccc
y.create.l HWIO_PMIC_ARB_REG_ADDR244_ADDR A:0xc440cd0
y.create.l HWIO_PMIC_ARB_REG_ADDR245_ADDR A:0xc440cd4
y.create.l HWIO_PMIC_ARB_REG_ADDR246_ADDR A:0xc440cd8
y.create.l HWIO_PMIC_ARB_REG_ADDR247_ADDR A:0xc440cdc
y.create.l HWIO_PMIC_ARB_REG_ADDR248_ADDR A:0xc440ce0
y.create.l HWIO_PMIC_ARB_REG_ADDR249_ADDR A:0xc440ce4
y.create.l HWIO_PMIC_ARB_REG_ADDR250_ADDR A:0xc440ce8
y.create.l HWIO_PMIC_ARB_REG_ADDR251_ADDR A:0xc440cec
y.create.l HWIO_PMIC_ARB_REG_ADDR252_ADDR A:0xc440cf0
y.create.l HWIO_PMIC_ARB_REG_ADDR253_ADDR A:0xc440cf4
y.create.l HWIO_PMIC_ARB_REG_ADDR254_ADDR A:0xc440cf8
y.create.l HWIO_PMIC_ARB_REG_ADDR255_ADDR A:0xc440cfc
y.create.l HWIO_PMIC_ARB_VRM_S_INTF_CTL_ADDR A:0xc442200
y.create.l HWIO_PMIC_ARB_VRM_S_INTF_STATUS_ADDR A:0xc442204
y.create.l HWIO_PMIC_ARB_VRM_S_PORT_CTL_ADDR A:0xc442208
y.create.l HWIO_PMIC_ARB_VRM_S_PORT_STATUS_ADDR A:0xc44220c
y.create.l HWIO_PMIC_ARB_VRM_S_ADDR0_ADDR A:0xc442300
y.create.l HWIO_PMIC_ARB_VRM_S_ADDR1_ADDR A:0xc442304
y.create.l HWIO_PMIC_ARB_VRM_S_ADDR2_ADDR A:0xc442308
y.create.l HWIO_PMIC_ARB_VRM_S_ADDR3_ADDR A:0xc44230c
y.create.l HWIO_PMIC_ARB_VRM_S_ADDR4_ADDR A:0xc442310
y.create.l HWIO_PMIC_ARB_VRM_S_ADDR5_ADDR A:0xc442314
y.create.l HWIO_PMIC_ARB_VRM_S_ADDR6_ADDR A:0xc442318
y.create.l HWIO_PMIC_ARB_VRM_S_ADDR7_ADDR A:0xc44231c
y.create.l HWIO_PMIC_ARB_VRM_S_ADDR8_ADDR A:0xc442320
y.create.l HWIO_PMIC_ARB_VRM_S_ADDR9_ADDR A:0xc442324
y.create.l HWIO_PMIC_ARB_VRM_S_ADDR10_ADDR A:0xc442328
y.create.l HWIO_PMIC_ARB_VRM_S_ADDR11_ADDR A:0xc44232c
y.create.l HWIO_PMIC_ARB_VRM_S_ADDR12_ADDR A:0xc442330
y.create.l HWIO_PMIC_ARB_VRM_S_ADDR13_ADDR A:0xc442334
y.create.l HWIO_PMIC_ARB_VRM_S_ADDR14_ADDR A:0xc442338
y.create.l HWIO_PMIC_ARB_VRM_S_ADDR15_ADDR A:0xc44233c
y.create.l HWIO_PMIC_ARB_VRM_S_ADDR16_ADDR A:0xc442340
y.create.l HWIO_PMIC_ARB_VRM_S_ADDR17_ADDR A:0xc442344
y.create.l HWIO_PMIC_ARB_VRM_S_ADDR18_ADDR A:0xc442348
y.create.l HWIO_PMIC_ARB_VRM_S_ADDR19_ADDR A:0xc44234c
y.create.l HWIO_PMIC_ARB_VRM_S_ADDR20_ADDR A:0xc442350
y.create.l HWIO_PMIC_ARB_VRM_S_ADDR21_ADDR A:0xc442354
y.create.l HWIO_PMIC_ARB_VRM_S_ADDR22_ADDR A:0xc442358
y.create.l HWIO_PMIC_ARB_VRM_S_ADDR23_ADDR A:0xc44235c
y.create.l HWIO_PMIC_ARB_VRM_S_ADDR24_ADDR A:0xc442360
y.create.l HWIO_PMIC_ARB_VRM_S_ADDR25_ADDR A:0xc442364
y.create.l HWIO_PMIC_ARB_VRM_S_ADDR26_ADDR A:0xc442368
y.create.l HWIO_PMIC_ARB_VRM_S_ADDR27_ADDR A:0xc44236c
y.create.l HWIO_PMIC_ARB_VRM_S_ADDR28_ADDR A:0xc442370
y.create.l HWIO_PMIC_ARB_VRM_S_ADDR29_ADDR A:0xc442374
y.create.l HWIO_PMIC_ARB_VRM_S_ADDR30_ADDR A:0xc442378
y.create.l HWIO_PMIC_ARB_VRM_S_ADDR31_ADDR A:0xc44237c
y.create.l HWIO_PMIC_ARB_VRM_S_ADDR32_ADDR A:0xc442380
y.create.l HWIO_PMIC_ARB_VRM_S_ADDR33_ADDR A:0xc442384
y.create.l HWIO_PMIC_ARB_VRM_S_ADDR34_ADDR A:0xc442388
y.create.l HWIO_PMIC_ARB_VRM_S_ADDR35_ADDR A:0xc44238c
y.create.l HWIO_PMIC_ARB_VRM_S_ADDR36_ADDR A:0xc442390
y.create.l HWIO_PMIC_ARB_VRM_S_ADDR37_ADDR A:0xc442394
y.create.l HWIO_PMIC_ARB_VRM_S_ADDR38_ADDR A:0xc442398
y.create.l HWIO_PMIC_ARB_VRM_S_ADDR39_ADDR A:0xc44239c
y.create.l HWIO_PMIC_ARB_VRM_S_ADDR40_ADDR A:0xc4423a0
y.create.l HWIO_PMIC_ARB_VRM_S_ADDR41_ADDR A:0xc4423a4
y.create.l HWIO_PMIC_ARB_VRM_S_ADDR42_ADDR A:0xc4423a8
y.create.l HWIO_PMIC_ARB_VRM_S_ADDR43_ADDR A:0xc4423ac
y.create.l HWIO_PMIC_ARB_VRM_S_ADDR44_ADDR A:0xc4423b0
y.create.l HWIO_PMIC_ARB_VRM_S_ADDR45_ADDR A:0xc4423b4
y.create.l HWIO_PMIC_ARB_VRM_S_ADDR46_ADDR A:0xc4423b8
y.create.l HWIO_PMIC_ARB_VRM_S_ADDR47_ADDR A:0xc4423bc
y.create.l HWIO_PMIC_ARB_VRM_S_ADDR48_ADDR A:0xc4423c0
y.create.l HWIO_PMIC_ARB_VRM_S_ADDR49_ADDR A:0xc4423c4
y.create.l HWIO_PMIC_ARB_VRM_S_ADDR50_ADDR A:0xc4423c8
y.create.l HWIO_PMIC_ARB_VRM_S_ADDR51_ADDR A:0xc4423cc
y.create.l HWIO_PMIC_ARB_VRM_S_ADDR52_ADDR A:0xc4423d0
y.create.l HWIO_PMIC_ARB_VRM_S_ADDR53_ADDR A:0xc4423d4
y.create.l HWIO_PMIC_ARB_VRM_S_ADDR54_ADDR A:0xc4423d8
y.create.l HWIO_PMIC_ARB_VRM_S_ADDR55_ADDR A:0xc4423dc
y.create.l HWIO_PMIC_ARB_VRM_S_ADDR56_ADDR A:0xc4423e0
y.create.l HWIO_PMIC_ARB_VRM_S_ADDR57_ADDR A:0xc4423e4
y.create.l HWIO_PMIC_ARB_VRM_S_ADDR58_ADDR A:0xc4423e8
y.create.l HWIO_PMIC_ARB_VRM_S_ADDR59_ADDR A:0xc4423ec
y.create.l HWIO_PMIC_ARB_VRM_S_ADDR60_ADDR A:0xc4423f0
y.create.l HWIO_PMIC_ARB_VRM_S_ADDR61_ADDR A:0xc4423f4
y.create.l HWIO_PMIC_ARB_VRM_S_ADDR62_ADDR A:0xc4423f8
y.create.l HWIO_PMIC_ARB_VRM_S_ADDR63_ADDR A:0xc4423fc
y.create.l HWIO_PMIC_ARB_VRM_S_ADDR64_ADDR A:0xc442400
y.create.l HWIO_PMIC_ARB_VRM_S_ADDR65_ADDR A:0xc442404
y.create.l HWIO_PMIC_ARB_VRM_S_ADDR66_ADDR A:0xc442408
y.create.l HWIO_PMIC_ARB_VRM_S_ADDR67_ADDR A:0xc44240c
y.create.l HWIO_PMIC_ARB_VRM_S_ADDR68_ADDR A:0xc442410
y.create.l HWIO_PMIC_ARB_VRM_S_ADDR69_ADDR A:0xc442414
y.create.l HWIO_PMIC_ARB_VRM_S_ADDR70_ADDR A:0xc442418
y.create.l HWIO_PMIC_ARB_VRM_S_ADDR71_ADDR A:0xc44241c
y.create.l HWIO_PMIC_ARB_VRM_S_ADDR72_ADDR A:0xc442420
y.create.l HWIO_PMIC_ARB_VRM_S_ADDR73_ADDR A:0xc442424
y.create.l HWIO_PMIC_ARB_VRM_S_ADDR74_ADDR A:0xc442428
y.create.l HWIO_PMIC_ARB_VRM_S_ADDR75_ADDR A:0xc44242c
y.create.l HWIO_PMIC_ARB_VRM_S_ADDR76_ADDR A:0xc442430
y.create.l HWIO_PMIC_ARB_VRM_S_ADDR77_ADDR A:0xc442434
y.create.l HWIO_PMIC_ARB_VRM_S_ADDR78_ADDR A:0xc442438
y.create.l HWIO_PMIC_ARB_VRM_S_ADDR79_ADDR A:0xc44243c
y.create.l HWIO_PMIC_ARB_VRM_S_ADDR80_ADDR A:0xc442440
y.create.l HWIO_PMIC_ARB_VRM_S_ADDR81_ADDR A:0xc442444
y.create.l HWIO_PMIC_ARB_VRM_S_ADDR82_ADDR A:0xc442448
y.create.l HWIO_PMIC_ARB_VRM_S_ADDR83_ADDR A:0xc44244c
y.create.l HWIO_PMIC_ARB_VRM_S_ADDR84_ADDR A:0xc442450
y.create.l HWIO_PMIC_ARB_VRM_S_ADDR85_ADDR A:0xc442454
y.create.l HWIO_PMIC_ARB_VRM_S_ADDR86_ADDR A:0xc442458
y.create.l HWIO_PMIC_ARB_VRM_S_ADDR87_ADDR A:0xc44245c
y.create.l HWIO_PMIC_ARB_VRM_S_ADDR88_ADDR A:0xc442460
y.create.l HWIO_PMIC_ARB_VRM_S_ADDR89_ADDR A:0xc442464
y.create.l HWIO_PMIC_ARB_VRM_S_ADDR90_ADDR A:0xc442468
y.create.l HWIO_PMIC_ARB_VRM_S_ADDR91_ADDR A:0xc44246c
y.create.l HWIO_PMIC_ARB_VRM_S_ADDR92_ADDR A:0xc442470
y.create.l HWIO_PMIC_ARB_VRM_S_ADDR93_ADDR A:0xc442474
y.create.l HWIO_PMIC_ARB_VRM_S_ADDR94_ADDR A:0xc442478
y.create.l HWIO_PMIC_ARB_VRM_S_ADDR95_ADDR A:0xc44247c
y.create.l HWIO_PMIC_ARB_VRM_S_ADDR96_ADDR A:0xc442480
y.create.l HWIO_PMIC_ARB_VRM_S_ADDR97_ADDR A:0xc442484
y.create.l HWIO_PMIC_ARB_VRM_S_ADDR98_ADDR A:0xc442488
y.create.l HWIO_PMIC_ARB_VRM_S_ADDR99_ADDR A:0xc44248c
y.create.l HWIO_PMIC_ARB_VRM_S_ADDR100_ADDR A:0xc442490
y.create.l HWIO_PMIC_ARB_VRM_S_ADDR101_ADDR A:0xc442494
y.create.l HWIO_PMIC_ARB_VRM_S_ADDR102_ADDR A:0xc442498
y.create.l HWIO_PMIC_ARB_VRM_S_ADDR103_ADDR A:0xc44249c
y.create.l HWIO_PMIC_ARB_VRM_S_ADDR104_ADDR A:0xc4424a0
y.create.l HWIO_PMIC_ARB_VRM_S_ADDR105_ADDR A:0xc4424a4
y.create.l HWIO_PMIC_ARB_VRM_S_ADDR106_ADDR A:0xc4424a8
y.create.l HWIO_PMIC_ARB_VRM_S_ADDR107_ADDR A:0xc4424ac
y.create.l HWIO_PMIC_ARB_VRM_S_ADDR108_ADDR A:0xc4424b0
y.create.l HWIO_PMIC_ARB_VRM_S_ADDR109_ADDR A:0xc4424b4
y.create.l HWIO_PMIC_ARB_VRM_S_ADDR110_ADDR A:0xc4424b8
y.create.l HWIO_PMIC_ARB_VRM_S_ADDR111_ADDR A:0xc4424bc
y.create.l HWIO_PMIC_ARB_VRM_S_ADDR112_ADDR A:0xc4424c0
y.create.l HWIO_PMIC_ARB_VRM_S_ADDR113_ADDR A:0xc4424c4
y.create.l HWIO_PMIC_ARB_VRM_S_ADDR114_ADDR A:0xc4424c8
y.create.l HWIO_PMIC_ARB_VRM_S_ADDR115_ADDR A:0xc4424cc
y.create.l HWIO_PMIC_ARB_VRM_S_ADDR116_ADDR A:0xc4424d0
y.create.l HWIO_PMIC_ARB_VRM_S_ADDR117_ADDR A:0xc4424d4
y.create.l HWIO_PMIC_ARB_VRM_S_ADDR118_ADDR A:0xc4424d8
y.create.l HWIO_PMIC_ARB_VRM_S_ADDR119_ADDR A:0xc4424dc
y.create.l HWIO_PMIC_ARB_VRM_S_ADDR120_ADDR A:0xc4424e0
y.create.l HWIO_PMIC_ARB_VRM_S_ADDR121_ADDR A:0xc4424e4
y.create.l HWIO_PMIC_ARB_VRM_S_ADDR122_ADDR A:0xc4424e8
y.create.l HWIO_PMIC_ARB_VRM_S_ADDR123_ADDR A:0xc4424ec
y.create.l HWIO_PMIC_ARB_VRM_S_ADDR124_ADDR A:0xc4424f0
y.create.l HWIO_PMIC_ARB_VRM_S_ADDR125_ADDR A:0xc4424f4
y.create.l HWIO_PMIC_ARB_VRM_S_ADDR126_ADDR A:0xc4424f8
y.create.l HWIO_PMIC_ARB_VRM_S_ADDR127_ADDR A:0xc4424fc
y.create.l HWIO_PMIC_ARB_CHNL0_CMD_ADDR A:0xc600000
y.create.l HWIO_PMIC_ARB_CHNL1_CMD_ADDR A:0xc610000
y.create.l HWIO_PMIC_ARB_CHNL2_CMD_ADDR A:0xc620000
y.create.l HWIO_PMIC_ARB_CHNL3_CMD_ADDR A:0xc630000
y.create.l HWIO_PMIC_ARB_CHNL4_CMD_ADDR A:0xc640000
y.create.l HWIO_PMIC_ARB_CHNL5_CMD_ADDR A:0xc650000
y.create.l HWIO_PMIC_ARB_CHNL6_CMD_ADDR A:0xc660000
y.create.l HWIO_PMIC_ARB_CHNL7_CMD_ADDR A:0xc670000
y.create.l HWIO_PMIC_ARB_CHNL8_CMD_ADDR A:0xc680000
y.create.l HWIO_PMIC_ARB_CHNL9_CMD_ADDR A:0xc690000
y.create.l HWIO_PMIC_ARB_CHNL10_CMD_ADDR A:0xc6a0000
y.create.l HWIO_PMIC_ARB_CHNL11_CMD_ADDR A:0xc6b0000
y.create.l HWIO_PMIC_ARB_CHNL12_CMD_ADDR A:0xc6c0000
y.create.l HWIO_PMIC_ARB_CHNL13_CMD_ADDR A:0xc6d0000
y.create.l HWIO_PMIC_ARB_CHNL14_CMD_ADDR A:0xc6e0000
y.create.l HWIO_PMIC_ARB_CHNL15_CMD_ADDR A:0xc6f0000
y.create.l HWIO_PMIC_ARB_CHNL16_CMD_ADDR A:0xc700000
y.create.l HWIO_PMIC_ARB_CHNL17_CMD_ADDR A:0xc710000
y.create.l HWIO_PMIC_ARB_CHNL18_CMD_ADDR A:0xc720000
y.create.l HWIO_PMIC_ARB_CHNL19_CMD_ADDR A:0xc730000
y.create.l HWIO_PMIC_ARB_CHNL20_CMD_ADDR A:0xc740000
y.create.l HWIO_PMIC_ARB_CHNL21_CMD_ADDR A:0xc750000
y.create.l HWIO_PMIC_ARB_CHNL22_CMD_ADDR A:0xc760000
y.create.l HWIO_PMIC_ARB_CHNL23_CMD_ADDR A:0xc770000
y.create.l HWIO_PMIC_ARB_CHNL24_CMD_ADDR A:0xc780000
y.create.l HWIO_PMIC_ARB_CHNL25_CMD_ADDR A:0xc790000
y.create.l HWIO_PMIC_ARB_CHNL26_CMD_ADDR A:0xc7a0000
y.create.l HWIO_PMIC_ARB_CHNL27_CMD_ADDR A:0xc7b0000
y.create.l HWIO_PMIC_ARB_CHNL28_CMD_ADDR A:0xc7c0000
y.create.l HWIO_PMIC_ARB_CHNL29_CMD_ADDR A:0xc7d0000
y.create.l HWIO_PMIC_ARB_CHNL30_CMD_ADDR A:0xc7e0000
y.create.l HWIO_PMIC_ARB_CHNL31_CMD_ADDR A:0xc7f0000
y.create.l HWIO_PMIC_ARB_CHNL32_CMD_ADDR A:0xc800000
y.create.l HWIO_PMIC_ARB_CHNL33_CMD_ADDR A:0xc810000
y.create.l HWIO_PMIC_ARB_CHNL34_CMD_ADDR A:0xc820000
y.create.l HWIO_PMIC_ARB_CHNL35_CMD_ADDR A:0xc830000
y.create.l HWIO_PMIC_ARB_CHNL36_CMD_ADDR A:0xc840000
y.create.l HWIO_PMIC_ARB_CHNL37_CMD_ADDR A:0xc850000
y.create.l HWIO_PMIC_ARB_CHNL38_CMD_ADDR A:0xc860000
y.create.l HWIO_PMIC_ARB_CHNL39_CMD_ADDR A:0xc870000
y.create.l HWIO_PMIC_ARB_CHNL40_CMD_ADDR A:0xc880000
y.create.l HWIO_PMIC_ARB_CHNL41_CMD_ADDR A:0xc890000
y.create.l HWIO_PMIC_ARB_CHNL42_CMD_ADDR A:0xc8a0000
y.create.l HWIO_PMIC_ARB_CHNL43_CMD_ADDR A:0xc8b0000
y.create.l HWIO_PMIC_ARB_CHNL44_CMD_ADDR A:0xc8c0000
y.create.l HWIO_PMIC_ARB_CHNL45_CMD_ADDR A:0xc8d0000
y.create.l HWIO_PMIC_ARB_CHNL46_CMD_ADDR A:0xc8e0000
y.create.l HWIO_PMIC_ARB_CHNL47_CMD_ADDR A:0xc8f0000
y.create.l HWIO_PMIC_ARB_CHNL48_CMD_ADDR A:0xc900000
y.create.l HWIO_PMIC_ARB_CHNL49_CMD_ADDR A:0xc910000
y.create.l HWIO_PMIC_ARB_CHNL50_CMD_ADDR A:0xc920000
y.create.l HWIO_PMIC_ARB_CHNL51_CMD_ADDR A:0xc930000
y.create.l HWIO_PMIC_ARB_CHNL52_CMD_ADDR A:0xc940000
y.create.l HWIO_PMIC_ARB_CHNL53_CMD_ADDR A:0xc950000
y.create.l HWIO_PMIC_ARB_CHNL54_CMD_ADDR A:0xc960000
y.create.l HWIO_PMIC_ARB_CHNL55_CMD_ADDR A:0xc970000
y.create.l HWIO_PMIC_ARB_CHNL56_CMD_ADDR A:0xc980000
y.create.l HWIO_PMIC_ARB_CHNL57_CMD_ADDR A:0xc990000
y.create.l HWIO_PMIC_ARB_CHNL58_CMD_ADDR A:0xc9a0000
y.create.l HWIO_PMIC_ARB_CHNL59_CMD_ADDR A:0xc9b0000
y.create.l HWIO_PMIC_ARB_CHNL60_CMD_ADDR A:0xc9c0000
y.create.l HWIO_PMIC_ARB_CHNL61_CMD_ADDR A:0xc9d0000
y.create.l HWIO_PMIC_ARB_CHNL62_CMD_ADDR A:0xc9e0000
y.create.l HWIO_PMIC_ARB_CHNL63_CMD_ADDR A:0xc9f0000
y.create.l HWIO_PMIC_ARB_CHNL64_CMD_ADDR A:0xca00000
y.create.l HWIO_PMIC_ARB_CHNL65_CMD_ADDR A:0xca10000
y.create.l HWIO_PMIC_ARB_CHNL66_CMD_ADDR A:0xca20000
y.create.l HWIO_PMIC_ARB_CHNL67_CMD_ADDR A:0xca30000
y.create.l HWIO_PMIC_ARB_CHNL68_CMD_ADDR A:0xca40000
y.create.l HWIO_PMIC_ARB_CHNL69_CMD_ADDR A:0xca50000
y.create.l HWIO_PMIC_ARB_CHNL70_CMD_ADDR A:0xca60000
y.create.l HWIO_PMIC_ARB_CHNL71_CMD_ADDR A:0xca70000
y.create.l HWIO_PMIC_ARB_CHNL72_CMD_ADDR A:0xca80000
y.create.l HWIO_PMIC_ARB_CHNL73_CMD_ADDR A:0xca90000
y.create.l HWIO_PMIC_ARB_CHNL74_CMD_ADDR A:0xcaa0000
y.create.l HWIO_PMIC_ARB_CHNL75_CMD_ADDR A:0xcab0000
y.create.l HWIO_PMIC_ARB_CHNL76_CMD_ADDR A:0xcac0000
y.create.l HWIO_PMIC_ARB_CHNL77_CMD_ADDR A:0xcad0000
y.create.l HWIO_PMIC_ARB_CHNL78_CMD_ADDR A:0xcae0000
y.create.l HWIO_PMIC_ARB_CHNL79_CMD_ADDR A:0xcaf0000
y.create.l HWIO_PMIC_ARB_CHNL80_CMD_ADDR A:0xcb00000
y.create.l HWIO_PMIC_ARB_CHNL81_CMD_ADDR A:0xcb10000
y.create.l HWIO_PMIC_ARB_CHNL82_CMD_ADDR A:0xcb20000
y.create.l HWIO_PMIC_ARB_CHNL83_CMD_ADDR A:0xcb30000
y.create.l HWIO_PMIC_ARB_CHNL84_CMD_ADDR A:0xcb40000
y.create.l HWIO_PMIC_ARB_CHNL85_CMD_ADDR A:0xcb50000
y.create.l HWIO_PMIC_ARB_CHNL86_CMD_ADDR A:0xcb60000
y.create.l HWIO_PMIC_ARB_CHNL87_CMD_ADDR A:0xcb70000
y.create.l HWIO_PMIC_ARB_CHNL88_CMD_ADDR A:0xcb80000
y.create.l HWIO_PMIC_ARB_CHNL89_CMD_ADDR A:0xcb90000
y.create.l HWIO_PMIC_ARB_CHNL90_CMD_ADDR A:0xcba0000
y.create.l HWIO_PMIC_ARB_CHNL91_CMD_ADDR A:0xcbb0000
y.create.l HWIO_PMIC_ARB_CHNL92_CMD_ADDR A:0xcbc0000
y.create.l HWIO_PMIC_ARB_CHNL93_CMD_ADDR A:0xcbd0000
y.create.l HWIO_PMIC_ARB_CHNL94_CMD_ADDR A:0xcbe0000
y.create.l HWIO_PMIC_ARB_CHNL95_CMD_ADDR A:0xcbf0000
y.create.l HWIO_PMIC_ARB_CHNL96_CMD_ADDR A:0xcc00000
y.create.l HWIO_PMIC_ARB_CHNL97_CMD_ADDR A:0xcc10000
y.create.l HWIO_PMIC_ARB_CHNL98_CMD_ADDR A:0xcc20000
y.create.l HWIO_PMIC_ARB_CHNL99_CMD_ADDR A:0xcc30000
y.create.l HWIO_PMIC_ARB_CHNL100_CMD_ADDR A:0xcc40000
y.create.l HWIO_PMIC_ARB_CHNL101_CMD_ADDR A:0xcc50000
y.create.l HWIO_PMIC_ARB_CHNL102_CMD_ADDR A:0xcc60000
y.create.l HWIO_PMIC_ARB_CHNL103_CMD_ADDR A:0xcc70000
y.create.l HWIO_PMIC_ARB_CHNL104_CMD_ADDR A:0xcc80000
y.create.l HWIO_PMIC_ARB_CHNL105_CMD_ADDR A:0xcc90000
y.create.l HWIO_PMIC_ARB_CHNL106_CMD_ADDR A:0xcca0000
y.create.l HWIO_PMIC_ARB_CHNL107_CMD_ADDR A:0xccb0000
y.create.l HWIO_PMIC_ARB_CHNL108_CMD_ADDR A:0xccc0000
y.create.l HWIO_PMIC_ARB_CHNL109_CMD_ADDR A:0xccd0000
y.create.l HWIO_PMIC_ARB_CHNL110_CMD_ADDR A:0xcce0000
y.create.l HWIO_PMIC_ARB_CHNL111_CMD_ADDR A:0xccf0000
y.create.l HWIO_PMIC_ARB_CHNL112_CMD_ADDR A:0xcd00000
y.create.l HWIO_PMIC_ARB_CHNL113_CMD_ADDR A:0xcd10000
y.create.l HWIO_PMIC_ARB_CHNL114_CMD_ADDR A:0xcd20000
y.create.l HWIO_PMIC_ARB_CHNL115_CMD_ADDR A:0xcd30000
y.create.l HWIO_PMIC_ARB_CHNL116_CMD_ADDR A:0xcd40000
y.create.l HWIO_PMIC_ARB_CHNL117_CMD_ADDR A:0xcd50000
y.create.l HWIO_PMIC_ARB_CHNL118_CMD_ADDR A:0xcd60000
y.create.l HWIO_PMIC_ARB_CHNL119_CMD_ADDR A:0xcd70000
y.create.l HWIO_PMIC_ARB_CHNL120_CMD_ADDR A:0xcd80000
y.create.l HWIO_PMIC_ARB_CHNL121_CMD_ADDR A:0xcd90000
y.create.l HWIO_PMIC_ARB_CHNL122_CMD_ADDR A:0xcda0000
y.create.l HWIO_PMIC_ARB_CHNL123_CMD_ADDR A:0xcdb0000
y.create.l HWIO_PMIC_ARB_CHNL124_CMD_ADDR A:0xcdc0000
y.create.l HWIO_PMIC_ARB_CHNL125_CMD_ADDR A:0xcdd0000
y.create.l HWIO_PMIC_ARB_CHNL126_CMD_ADDR A:0xcde0000
y.create.l HWIO_PMIC_ARB_CHNL127_CMD_ADDR A:0xcdf0000
y.create.l HWIO_PMIC_ARB_CHNL128_CMD_ADDR A:0xce00000
y.create.l HWIO_PMIC_ARB_CHNL129_CMD_ADDR A:0xce10000
y.create.l HWIO_PMIC_ARB_CHNL130_CMD_ADDR A:0xce20000
y.create.l HWIO_PMIC_ARB_CHNL131_CMD_ADDR A:0xce30000
y.create.l HWIO_PMIC_ARB_CHNL132_CMD_ADDR A:0xce40000
y.create.l HWIO_PMIC_ARB_CHNL133_CMD_ADDR A:0xce50000
y.create.l HWIO_PMIC_ARB_CHNL134_CMD_ADDR A:0xce60000
y.create.l HWIO_PMIC_ARB_CHNL135_CMD_ADDR A:0xce70000
y.create.l HWIO_PMIC_ARB_CHNL136_CMD_ADDR A:0xce80000
y.create.l HWIO_PMIC_ARB_CHNL137_CMD_ADDR A:0xce90000
y.create.l HWIO_PMIC_ARB_CHNL138_CMD_ADDR A:0xcea0000
y.create.l HWIO_PMIC_ARB_CHNL139_CMD_ADDR A:0xceb0000
y.create.l HWIO_PMIC_ARB_CHNL140_CMD_ADDR A:0xcec0000
y.create.l HWIO_PMIC_ARB_CHNL141_CMD_ADDR A:0xced0000
y.create.l HWIO_PMIC_ARB_CHNL142_CMD_ADDR A:0xcee0000
y.create.l HWIO_PMIC_ARB_CHNL143_CMD_ADDR A:0xcef0000
y.create.l HWIO_PMIC_ARB_CHNL144_CMD_ADDR A:0xcf00000
y.create.l HWIO_PMIC_ARB_CHNL145_CMD_ADDR A:0xcf10000
y.create.l HWIO_PMIC_ARB_CHNL146_CMD_ADDR A:0xcf20000
y.create.l HWIO_PMIC_ARB_CHNL147_CMD_ADDR A:0xcf30000
y.create.l HWIO_PMIC_ARB_CHNL148_CMD_ADDR A:0xcf40000
y.create.l HWIO_PMIC_ARB_CHNL149_CMD_ADDR A:0xcf50000
y.create.l HWIO_PMIC_ARB_CHNL150_CMD_ADDR A:0xcf60000
y.create.l HWIO_PMIC_ARB_CHNL151_CMD_ADDR A:0xcf70000
y.create.l HWIO_PMIC_ARB_CHNL152_CMD_ADDR A:0xcf80000
y.create.l HWIO_PMIC_ARB_CHNL153_CMD_ADDR A:0xcf90000
y.create.l HWIO_PMIC_ARB_CHNL154_CMD_ADDR A:0xcfa0000
y.create.l HWIO_PMIC_ARB_CHNL155_CMD_ADDR A:0xcfb0000
y.create.l HWIO_PMIC_ARB_CHNL156_CMD_ADDR A:0xcfc0000
y.create.l HWIO_PMIC_ARB_CHNL157_CMD_ADDR A:0xcfd0000
y.create.l HWIO_PMIC_ARB_CHNL158_CMD_ADDR A:0xcfe0000
y.create.l HWIO_PMIC_ARB_CHNL159_CMD_ADDR A:0xcff0000
y.create.l HWIO_PMIC_ARB_CHNL160_CMD_ADDR A:0xd000000
y.create.l HWIO_PMIC_ARB_CHNL161_CMD_ADDR A:0xd010000
y.create.l HWIO_PMIC_ARB_CHNL162_CMD_ADDR A:0xd020000
y.create.l HWIO_PMIC_ARB_CHNL163_CMD_ADDR A:0xd030000
y.create.l HWIO_PMIC_ARB_CHNL164_CMD_ADDR A:0xd040000
y.create.l HWIO_PMIC_ARB_CHNL165_CMD_ADDR A:0xd050000
y.create.l HWIO_PMIC_ARB_CHNL166_CMD_ADDR A:0xd060000
y.create.l HWIO_PMIC_ARB_CHNL167_CMD_ADDR A:0xd070000
y.create.l HWIO_PMIC_ARB_CHNL168_CMD_ADDR A:0xd080000
y.create.l HWIO_PMIC_ARB_CHNL169_CMD_ADDR A:0xd090000
y.create.l HWIO_PMIC_ARB_CHNL170_CMD_ADDR A:0xd0a0000
y.create.l HWIO_PMIC_ARB_CHNL171_CMD_ADDR A:0xd0b0000
y.create.l HWIO_PMIC_ARB_CHNL172_CMD_ADDR A:0xd0c0000
y.create.l HWIO_PMIC_ARB_CHNL173_CMD_ADDR A:0xd0d0000
y.create.l HWIO_PMIC_ARB_CHNL174_CMD_ADDR A:0xd0e0000
y.create.l HWIO_PMIC_ARB_CHNL175_CMD_ADDR A:0xd0f0000
y.create.l HWIO_PMIC_ARB_CHNL176_CMD_ADDR A:0xd100000
y.create.l HWIO_PMIC_ARB_CHNL177_CMD_ADDR A:0xd110000
y.create.l HWIO_PMIC_ARB_CHNL178_CMD_ADDR A:0xd120000
y.create.l HWIO_PMIC_ARB_CHNL179_CMD_ADDR A:0xd130000
y.create.l HWIO_PMIC_ARB_CHNL180_CMD_ADDR A:0xd140000
y.create.l HWIO_PMIC_ARB_CHNL181_CMD_ADDR A:0xd150000
y.create.l HWIO_PMIC_ARB_CHNL182_CMD_ADDR A:0xd160000
y.create.l HWIO_PMIC_ARB_CHNL183_CMD_ADDR A:0xd170000
y.create.l HWIO_PMIC_ARB_CHNL184_CMD_ADDR A:0xd180000
y.create.l HWIO_PMIC_ARB_CHNL185_CMD_ADDR A:0xd190000
y.create.l HWIO_PMIC_ARB_CHNL186_CMD_ADDR A:0xd1a0000
y.create.l HWIO_PMIC_ARB_CHNL187_CMD_ADDR A:0xd1b0000
y.create.l HWIO_PMIC_ARB_CHNL188_CMD_ADDR A:0xd1c0000
y.create.l HWIO_PMIC_ARB_CHNL189_CMD_ADDR A:0xd1d0000
y.create.l HWIO_PMIC_ARB_CHNL190_CMD_ADDR A:0xd1e0000
y.create.l HWIO_PMIC_ARB_CHNL191_CMD_ADDR A:0xd1f0000
y.create.l HWIO_PMIC_ARB_CHNL192_CMD_ADDR A:0xd200000
y.create.l HWIO_PMIC_ARB_CHNL193_CMD_ADDR A:0xd210000
y.create.l HWIO_PMIC_ARB_CHNL194_CMD_ADDR A:0xd220000
y.create.l HWIO_PMIC_ARB_CHNL195_CMD_ADDR A:0xd230000
y.create.l HWIO_PMIC_ARB_CHNL196_CMD_ADDR A:0xd240000
y.create.l HWIO_PMIC_ARB_CHNL197_CMD_ADDR A:0xd250000
y.create.l HWIO_PMIC_ARB_CHNL198_CMD_ADDR A:0xd260000
y.create.l HWIO_PMIC_ARB_CHNL199_CMD_ADDR A:0xd270000
y.create.l HWIO_PMIC_ARB_CHNL200_CMD_ADDR A:0xd280000
y.create.l HWIO_PMIC_ARB_CHNL201_CMD_ADDR A:0xd290000
y.create.l HWIO_PMIC_ARB_CHNL202_CMD_ADDR A:0xd2a0000
y.create.l HWIO_PMIC_ARB_CHNL203_CMD_ADDR A:0xd2b0000
y.create.l HWIO_PMIC_ARB_CHNL204_CMD_ADDR A:0xd2c0000
y.create.l HWIO_PMIC_ARB_CHNL205_CMD_ADDR A:0xd2d0000
y.create.l HWIO_PMIC_ARB_CHNL206_CMD_ADDR A:0xd2e0000
y.create.l HWIO_PMIC_ARB_CHNL207_CMD_ADDR A:0xd2f0000
y.create.l HWIO_PMIC_ARB_CHNL208_CMD_ADDR A:0xd300000
y.create.l HWIO_PMIC_ARB_CHNL209_CMD_ADDR A:0xd310000
y.create.l HWIO_PMIC_ARB_CHNL210_CMD_ADDR A:0xd320000
y.create.l HWIO_PMIC_ARB_CHNL211_CMD_ADDR A:0xd330000
y.create.l HWIO_PMIC_ARB_CHNL212_CMD_ADDR A:0xd340000
y.create.l HWIO_PMIC_ARB_CHNL213_CMD_ADDR A:0xd350000
y.create.l HWIO_PMIC_ARB_CHNL214_CMD_ADDR A:0xd360000
y.create.l HWIO_PMIC_ARB_CHNL215_CMD_ADDR A:0xd370000
y.create.l HWIO_PMIC_ARB_CHNL216_CMD_ADDR A:0xd380000
y.create.l HWIO_PMIC_ARB_CHNL217_CMD_ADDR A:0xd390000
y.create.l HWIO_PMIC_ARB_CHNL218_CMD_ADDR A:0xd3a0000
y.create.l HWIO_PMIC_ARB_CHNL219_CMD_ADDR A:0xd3b0000
y.create.l HWIO_PMIC_ARB_CHNL220_CMD_ADDR A:0xd3c0000
y.create.l HWIO_PMIC_ARB_CHNL221_CMD_ADDR A:0xd3d0000
y.create.l HWIO_PMIC_ARB_CHNL222_CMD_ADDR A:0xd3e0000
y.create.l HWIO_PMIC_ARB_CHNL223_CMD_ADDR A:0xd3f0000
y.create.l HWIO_PMIC_ARB_CHNL224_CMD_ADDR A:0xd400000
y.create.l HWIO_PMIC_ARB_CHNL225_CMD_ADDR A:0xd410000
y.create.l HWIO_PMIC_ARB_CHNL226_CMD_ADDR A:0xd420000
y.create.l HWIO_PMIC_ARB_CHNL227_CMD_ADDR A:0xd430000
y.create.l HWIO_PMIC_ARB_CHNL228_CMD_ADDR A:0xd440000
y.create.l HWIO_PMIC_ARB_CHNL229_CMD_ADDR A:0xd450000
y.create.l HWIO_PMIC_ARB_CHNL230_CMD_ADDR A:0xd460000
y.create.l HWIO_PMIC_ARB_CHNL231_CMD_ADDR A:0xd470000
y.create.l HWIO_PMIC_ARB_CHNL232_CMD_ADDR A:0xd480000
y.create.l HWIO_PMIC_ARB_CHNL233_CMD_ADDR A:0xd490000
y.create.l HWIO_PMIC_ARB_CHNL234_CMD_ADDR A:0xd4a0000
y.create.l HWIO_PMIC_ARB_CHNL235_CMD_ADDR A:0xd4b0000
y.create.l HWIO_PMIC_ARB_CHNL236_CMD_ADDR A:0xd4c0000
y.create.l HWIO_PMIC_ARB_CHNL237_CMD_ADDR A:0xd4d0000
y.create.l HWIO_PMIC_ARB_CHNL238_CMD_ADDR A:0xd4e0000
y.create.l HWIO_PMIC_ARB_CHNL239_CMD_ADDR A:0xd4f0000
y.create.l HWIO_PMIC_ARB_CHNL240_CMD_ADDR A:0xd500000
y.create.l HWIO_PMIC_ARB_CHNL241_CMD_ADDR A:0xd510000
y.create.l HWIO_PMIC_ARB_CHNL242_CMD_ADDR A:0xd520000
y.create.l HWIO_PMIC_ARB_CHNL243_CMD_ADDR A:0xd530000
y.create.l HWIO_PMIC_ARB_CHNL244_CMD_ADDR A:0xd540000
y.create.l HWIO_PMIC_ARB_CHNL245_CMD_ADDR A:0xd550000
y.create.l HWIO_PMIC_ARB_CHNL246_CMD_ADDR A:0xd560000
y.create.l HWIO_PMIC_ARB_CHNL247_CMD_ADDR A:0xd570000
y.create.l HWIO_PMIC_ARB_CHNL248_CMD_ADDR A:0xd580000
y.create.l HWIO_PMIC_ARB_CHNL249_CMD_ADDR A:0xd590000
y.create.l HWIO_PMIC_ARB_CHNL250_CMD_ADDR A:0xd5a0000
y.create.l HWIO_PMIC_ARB_CHNL251_CMD_ADDR A:0xd5b0000
y.create.l HWIO_PMIC_ARB_CHNL252_CMD_ADDR A:0xd5c0000
y.create.l HWIO_PMIC_ARB_CHNL253_CMD_ADDR A:0xd5d0000
y.create.l HWIO_PMIC_ARB_CHNL254_CMD_ADDR A:0xd5e0000
y.create.l HWIO_PMIC_ARB_CHNL255_CMD_ADDR A:0xd5f0000
y.create.l HWIO_PMIC_ARB_CHNL0_CONFIG_ADDR A:0xc600004
y.create.l HWIO_PMIC_ARB_CHNL1_CONFIG_ADDR A:0xc610004
y.create.l HWIO_PMIC_ARB_CHNL2_CONFIG_ADDR A:0xc620004
y.create.l HWIO_PMIC_ARB_CHNL3_CONFIG_ADDR A:0xc630004
y.create.l HWIO_PMIC_ARB_CHNL4_CONFIG_ADDR A:0xc640004
y.create.l HWIO_PMIC_ARB_CHNL5_CONFIG_ADDR A:0xc650004
y.create.l HWIO_PMIC_ARB_CHNL6_CONFIG_ADDR A:0xc660004
y.create.l HWIO_PMIC_ARB_CHNL7_CONFIG_ADDR A:0xc670004
y.create.l HWIO_PMIC_ARB_CHNL8_CONFIG_ADDR A:0xc680004
y.create.l HWIO_PMIC_ARB_CHNL9_CONFIG_ADDR A:0xc690004
y.create.l HWIO_PMIC_ARB_CHNL10_CONFIG_ADDR A:0xc6a0004
y.create.l HWIO_PMIC_ARB_CHNL11_CONFIG_ADDR A:0xc6b0004
y.create.l HWIO_PMIC_ARB_CHNL12_CONFIG_ADDR A:0xc6c0004
y.create.l HWIO_PMIC_ARB_CHNL13_CONFIG_ADDR A:0xc6d0004
y.create.l HWIO_PMIC_ARB_CHNL14_CONFIG_ADDR A:0xc6e0004
y.create.l HWIO_PMIC_ARB_CHNL15_CONFIG_ADDR A:0xc6f0004
y.create.l HWIO_PMIC_ARB_CHNL16_CONFIG_ADDR A:0xc700004
y.create.l HWIO_PMIC_ARB_CHNL17_CONFIG_ADDR A:0xc710004
y.create.l HWIO_PMIC_ARB_CHNL18_CONFIG_ADDR A:0xc720004
y.create.l HWIO_PMIC_ARB_CHNL19_CONFIG_ADDR A:0xc730004
y.create.l HWIO_PMIC_ARB_CHNL20_CONFIG_ADDR A:0xc740004
y.create.l HWIO_PMIC_ARB_CHNL21_CONFIG_ADDR A:0xc750004
y.create.l HWIO_PMIC_ARB_CHNL22_CONFIG_ADDR A:0xc760004
y.create.l HWIO_PMIC_ARB_CHNL23_CONFIG_ADDR A:0xc770004
y.create.l HWIO_PMIC_ARB_CHNL24_CONFIG_ADDR A:0xc780004
y.create.l HWIO_PMIC_ARB_CHNL25_CONFIG_ADDR A:0xc790004
y.create.l HWIO_PMIC_ARB_CHNL26_CONFIG_ADDR A:0xc7a0004
y.create.l HWIO_PMIC_ARB_CHNL27_CONFIG_ADDR A:0xc7b0004
y.create.l HWIO_PMIC_ARB_CHNL28_CONFIG_ADDR A:0xc7c0004
y.create.l HWIO_PMIC_ARB_CHNL29_CONFIG_ADDR A:0xc7d0004
y.create.l HWIO_PMIC_ARB_CHNL30_CONFIG_ADDR A:0xc7e0004
y.create.l HWIO_PMIC_ARB_CHNL31_CONFIG_ADDR A:0xc7f0004
y.create.l HWIO_PMIC_ARB_CHNL32_CONFIG_ADDR A:0xc800004
y.create.l HWIO_PMIC_ARB_CHNL33_CONFIG_ADDR A:0xc810004
y.create.l HWIO_PMIC_ARB_CHNL34_CONFIG_ADDR A:0xc820004
y.create.l HWIO_PMIC_ARB_CHNL35_CONFIG_ADDR A:0xc830004
y.create.l HWIO_PMIC_ARB_CHNL36_CONFIG_ADDR A:0xc840004
y.create.l HWIO_PMIC_ARB_CHNL37_CONFIG_ADDR A:0xc850004
y.create.l HWIO_PMIC_ARB_CHNL38_CONFIG_ADDR A:0xc860004
y.create.l HWIO_PMIC_ARB_CHNL39_CONFIG_ADDR A:0xc870004
y.create.l HWIO_PMIC_ARB_CHNL40_CONFIG_ADDR A:0xc880004
y.create.l HWIO_PMIC_ARB_CHNL41_CONFIG_ADDR A:0xc890004
y.create.l HWIO_PMIC_ARB_CHNL42_CONFIG_ADDR A:0xc8a0004
y.create.l HWIO_PMIC_ARB_CHNL43_CONFIG_ADDR A:0xc8b0004
y.create.l HWIO_PMIC_ARB_CHNL44_CONFIG_ADDR A:0xc8c0004
y.create.l HWIO_PMIC_ARB_CHNL45_CONFIG_ADDR A:0xc8d0004
y.create.l HWIO_PMIC_ARB_CHNL46_CONFIG_ADDR A:0xc8e0004
y.create.l HWIO_PMIC_ARB_CHNL47_CONFIG_ADDR A:0xc8f0004
y.create.l HWIO_PMIC_ARB_CHNL48_CONFIG_ADDR A:0xc900004
y.create.l HWIO_PMIC_ARB_CHNL49_CONFIG_ADDR A:0xc910004
y.create.l HWIO_PMIC_ARB_CHNL50_CONFIG_ADDR A:0xc920004
y.create.l HWIO_PMIC_ARB_CHNL51_CONFIG_ADDR A:0xc930004
y.create.l HWIO_PMIC_ARB_CHNL52_CONFIG_ADDR A:0xc940004
y.create.l HWIO_PMIC_ARB_CHNL53_CONFIG_ADDR A:0xc950004
y.create.l HWIO_PMIC_ARB_CHNL54_CONFIG_ADDR A:0xc960004
y.create.l HWIO_PMIC_ARB_CHNL55_CONFIG_ADDR A:0xc970004
y.create.l HWIO_PMIC_ARB_CHNL56_CONFIG_ADDR A:0xc980004
y.create.l HWIO_PMIC_ARB_CHNL57_CONFIG_ADDR A:0xc990004
y.create.l HWIO_PMIC_ARB_CHNL58_CONFIG_ADDR A:0xc9a0004
y.create.l HWIO_PMIC_ARB_CHNL59_CONFIG_ADDR A:0xc9b0004
y.create.l HWIO_PMIC_ARB_CHNL60_CONFIG_ADDR A:0xc9c0004
y.create.l HWIO_PMIC_ARB_CHNL61_CONFIG_ADDR A:0xc9d0004
y.create.l HWIO_PMIC_ARB_CHNL62_CONFIG_ADDR A:0xc9e0004
y.create.l HWIO_PMIC_ARB_CHNL63_CONFIG_ADDR A:0xc9f0004
y.create.l HWIO_PMIC_ARB_CHNL64_CONFIG_ADDR A:0xca00004
y.create.l HWIO_PMIC_ARB_CHNL65_CONFIG_ADDR A:0xca10004
y.create.l HWIO_PMIC_ARB_CHNL66_CONFIG_ADDR A:0xca20004
y.create.l HWIO_PMIC_ARB_CHNL67_CONFIG_ADDR A:0xca30004
y.create.l HWIO_PMIC_ARB_CHNL68_CONFIG_ADDR A:0xca40004
y.create.l HWIO_PMIC_ARB_CHNL69_CONFIG_ADDR A:0xca50004
y.create.l HWIO_PMIC_ARB_CHNL70_CONFIG_ADDR A:0xca60004
y.create.l HWIO_PMIC_ARB_CHNL71_CONFIG_ADDR A:0xca70004
y.create.l HWIO_PMIC_ARB_CHNL72_CONFIG_ADDR A:0xca80004
y.create.l HWIO_PMIC_ARB_CHNL73_CONFIG_ADDR A:0xca90004
y.create.l HWIO_PMIC_ARB_CHNL74_CONFIG_ADDR A:0xcaa0004
y.create.l HWIO_PMIC_ARB_CHNL75_CONFIG_ADDR A:0xcab0004
y.create.l HWIO_PMIC_ARB_CHNL76_CONFIG_ADDR A:0xcac0004
y.create.l HWIO_PMIC_ARB_CHNL77_CONFIG_ADDR A:0xcad0004
y.create.l HWIO_PMIC_ARB_CHNL78_CONFIG_ADDR A:0xcae0004
y.create.l HWIO_PMIC_ARB_CHNL79_CONFIG_ADDR A:0xcaf0004
y.create.l HWIO_PMIC_ARB_CHNL80_CONFIG_ADDR A:0xcb00004
y.create.l HWIO_PMIC_ARB_CHNL81_CONFIG_ADDR A:0xcb10004
y.create.l HWIO_PMIC_ARB_CHNL82_CONFIG_ADDR A:0xcb20004
y.create.l HWIO_PMIC_ARB_CHNL83_CONFIG_ADDR A:0xcb30004
y.create.l HWIO_PMIC_ARB_CHNL84_CONFIG_ADDR A:0xcb40004
y.create.l HWIO_PMIC_ARB_CHNL85_CONFIG_ADDR A:0xcb50004
y.create.l HWIO_PMIC_ARB_CHNL86_CONFIG_ADDR A:0xcb60004
y.create.l HWIO_PMIC_ARB_CHNL87_CONFIG_ADDR A:0xcb70004
y.create.l HWIO_PMIC_ARB_CHNL88_CONFIG_ADDR A:0xcb80004
y.create.l HWIO_PMIC_ARB_CHNL89_CONFIG_ADDR A:0xcb90004
y.create.l HWIO_PMIC_ARB_CHNL90_CONFIG_ADDR A:0xcba0004
y.create.l HWIO_PMIC_ARB_CHNL91_CONFIG_ADDR A:0xcbb0004
y.create.l HWIO_PMIC_ARB_CHNL92_CONFIG_ADDR A:0xcbc0004
y.create.l HWIO_PMIC_ARB_CHNL93_CONFIG_ADDR A:0xcbd0004
y.create.l HWIO_PMIC_ARB_CHNL94_CONFIG_ADDR A:0xcbe0004
y.create.l HWIO_PMIC_ARB_CHNL95_CONFIG_ADDR A:0xcbf0004
y.create.l HWIO_PMIC_ARB_CHNL96_CONFIG_ADDR A:0xcc00004
y.create.l HWIO_PMIC_ARB_CHNL97_CONFIG_ADDR A:0xcc10004
y.create.l HWIO_PMIC_ARB_CHNL98_CONFIG_ADDR A:0xcc20004
y.create.l HWIO_PMIC_ARB_CHNL99_CONFIG_ADDR A:0xcc30004
y.create.l HWIO_PMIC_ARB_CHNL100_CONFIG_ADDR A:0xcc40004
y.create.l HWIO_PMIC_ARB_CHNL101_CONFIG_ADDR A:0xcc50004
y.create.l HWIO_PMIC_ARB_CHNL102_CONFIG_ADDR A:0xcc60004
y.create.l HWIO_PMIC_ARB_CHNL103_CONFIG_ADDR A:0xcc70004
y.create.l HWIO_PMIC_ARB_CHNL104_CONFIG_ADDR A:0xcc80004
y.create.l HWIO_PMIC_ARB_CHNL105_CONFIG_ADDR A:0xcc90004
y.create.l HWIO_PMIC_ARB_CHNL106_CONFIG_ADDR A:0xcca0004
y.create.l HWIO_PMIC_ARB_CHNL107_CONFIG_ADDR A:0xccb0004
y.create.l HWIO_PMIC_ARB_CHNL108_CONFIG_ADDR A:0xccc0004
y.create.l HWIO_PMIC_ARB_CHNL109_CONFIG_ADDR A:0xccd0004
y.create.l HWIO_PMIC_ARB_CHNL110_CONFIG_ADDR A:0xcce0004
y.create.l HWIO_PMIC_ARB_CHNL111_CONFIG_ADDR A:0xccf0004
y.create.l HWIO_PMIC_ARB_CHNL112_CONFIG_ADDR A:0xcd00004
y.create.l HWIO_PMIC_ARB_CHNL113_CONFIG_ADDR A:0xcd10004
y.create.l HWIO_PMIC_ARB_CHNL114_CONFIG_ADDR A:0xcd20004
y.create.l HWIO_PMIC_ARB_CHNL115_CONFIG_ADDR A:0xcd30004
y.create.l HWIO_PMIC_ARB_CHNL116_CONFIG_ADDR A:0xcd40004
y.create.l HWIO_PMIC_ARB_CHNL117_CONFIG_ADDR A:0xcd50004
y.create.l HWIO_PMIC_ARB_CHNL118_CONFIG_ADDR A:0xcd60004
y.create.l HWIO_PMIC_ARB_CHNL119_CONFIG_ADDR A:0xcd70004
y.create.l HWIO_PMIC_ARB_CHNL120_CONFIG_ADDR A:0xcd80004
y.create.l HWIO_PMIC_ARB_CHNL121_CONFIG_ADDR A:0xcd90004
y.create.l HWIO_PMIC_ARB_CHNL122_CONFIG_ADDR A:0xcda0004
y.create.l HWIO_PMIC_ARB_CHNL123_CONFIG_ADDR A:0xcdb0004
y.create.l HWIO_PMIC_ARB_CHNL124_CONFIG_ADDR A:0xcdc0004
y.create.l HWIO_PMIC_ARB_CHNL125_CONFIG_ADDR A:0xcdd0004
y.create.l HWIO_PMIC_ARB_CHNL126_CONFIG_ADDR A:0xcde0004
y.create.l HWIO_PMIC_ARB_CHNL127_CONFIG_ADDR A:0xcdf0004
y.create.l HWIO_PMIC_ARB_CHNL128_CONFIG_ADDR A:0xce00004
y.create.l HWIO_PMIC_ARB_CHNL129_CONFIG_ADDR A:0xce10004
y.create.l HWIO_PMIC_ARB_CHNL130_CONFIG_ADDR A:0xce20004
y.create.l HWIO_PMIC_ARB_CHNL131_CONFIG_ADDR A:0xce30004
y.create.l HWIO_PMIC_ARB_CHNL132_CONFIG_ADDR A:0xce40004
y.create.l HWIO_PMIC_ARB_CHNL133_CONFIG_ADDR A:0xce50004
y.create.l HWIO_PMIC_ARB_CHNL134_CONFIG_ADDR A:0xce60004
y.create.l HWIO_PMIC_ARB_CHNL135_CONFIG_ADDR A:0xce70004
y.create.l HWIO_PMIC_ARB_CHNL136_CONFIG_ADDR A:0xce80004
y.create.l HWIO_PMIC_ARB_CHNL137_CONFIG_ADDR A:0xce90004
y.create.l HWIO_PMIC_ARB_CHNL138_CONFIG_ADDR A:0xcea0004
y.create.l HWIO_PMIC_ARB_CHNL139_CONFIG_ADDR A:0xceb0004
y.create.l HWIO_PMIC_ARB_CHNL140_CONFIG_ADDR A:0xcec0004
y.create.l HWIO_PMIC_ARB_CHNL141_CONFIG_ADDR A:0xced0004
y.create.l HWIO_PMIC_ARB_CHNL142_CONFIG_ADDR A:0xcee0004
y.create.l HWIO_PMIC_ARB_CHNL143_CONFIG_ADDR A:0xcef0004
y.create.l HWIO_PMIC_ARB_CHNL144_CONFIG_ADDR A:0xcf00004
y.create.l HWIO_PMIC_ARB_CHNL145_CONFIG_ADDR A:0xcf10004
y.create.l HWIO_PMIC_ARB_CHNL146_CONFIG_ADDR A:0xcf20004
y.create.l HWIO_PMIC_ARB_CHNL147_CONFIG_ADDR A:0xcf30004
y.create.l HWIO_PMIC_ARB_CHNL148_CONFIG_ADDR A:0xcf40004
y.create.l HWIO_PMIC_ARB_CHNL149_CONFIG_ADDR A:0xcf50004
y.create.l HWIO_PMIC_ARB_CHNL150_CONFIG_ADDR A:0xcf60004
y.create.l HWIO_PMIC_ARB_CHNL151_CONFIG_ADDR A:0xcf70004
y.create.l HWIO_PMIC_ARB_CHNL152_CONFIG_ADDR A:0xcf80004
y.create.l HWIO_PMIC_ARB_CHNL153_CONFIG_ADDR A:0xcf90004
y.create.l HWIO_PMIC_ARB_CHNL154_CONFIG_ADDR A:0xcfa0004
y.create.l HWIO_PMIC_ARB_CHNL155_CONFIG_ADDR A:0xcfb0004
y.create.l HWIO_PMIC_ARB_CHNL156_CONFIG_ADDR A:0xcfc0004
y.create.l HWIO_PMIC_ARB_CHNL157_CONFIG_ADDR A:0xcfd0004
y.create.l HWIO_PMIC_ARB_CHNL158_CONFIG_ADDR A:0xcfe0004
y.create.l HWIO_PMIC_ARB_CHNL159_CONFIG_ADDR A:0xcff0004
y.create.l HWIO_PMIC_ARB_CHNL160_CONFIG_ADDR A:0xd000004
y.create.l HWIO_PMIC_ARB_CHNL161_CONFIG_ADDR A:0xd010004
y.create.l HWIO_PMIC_ARB_CHNL162_CONFIG_ADDR A:0xd020004
y.create.l HWIO_PMIC_ARB_CHNL163_CONFIG_ADDR A:0xd030004
y.create.l HWIO_PMIC_ARB_CHNL164_CONFIG_ADDR A:0xd040004
y.create.l HWIO_PMIC_ARB_CHNL165_CONFIG_ADDR A:0xd050004
y.create.l HWIO_PMIC_ARB_CHNL166_CONFIG_ADDR A:0xd060004
y.create.l HWIO_PMIC_ARB_CHNL167_CONFIG_ADDR A:0xd070004
y.create.l HWIO_PMIC_ARB_CHNL168_CONFIG_ADDR A:0xd080004
y.create.l HWIO_PMIC_ARB_CHNL169_CONFIG_ADDR A:0xd090004
y.create.l HWIO_PMIC_ARB_CHNL170_CONFIG_ADDR A:0xd0a0004
y.create.l HWIO_PMIC_ARB_CHNL171_CONFIG_ADDR A:0xd0b0004
y.create.l HWIO_PMIC_ARB_CHNL172_CONFIG_ADDR A:0xd0c0004
y.create.l HWIO_PMIC_ARB_CHNL173_CONFIG_ADDR A:0xd0d0004
y.create.l HWIO_PMIC_ARB_CHNL174_CONFIG_ADDR A:0xd0e0004
y.create.l HWIO_PMIC_ARB_CHNL175_CONFIG_ADDR A:0xd0f0004
y.create.l HWIO_PMIC_ARB_CHNL176_CONFIG_ADDR A:0xd100004
y.create.l HWIO_PMIC_ARB_CHNL177_CONFIG_ADDR A:0xd110004
y.create.l HWIO_PMIC_ARB_CHNL178_CONFIG_ADDR A:0xd120004
y.create.l HWIO_PMIC_ARB_CHNL179_CONFIG_ADDR A:0xd130004
y.create.l HWIO_PMIC_ARB_CHNL180_CONFIG_ADDR A:0xd140004
y.create.l HWIO_PMIC_ARB_CHNL181_CONFIG_ADDR A:0xd150004
y.create.l HWIO_PMIC_ARB_CHNL182_CONFIG_ADDR A:0xd160004
y.create.l HWIO_PMIC_ARB_CHNL183_CONFIG_ADDR A:0xd170004
y.create.l HWIO_PMIC_ARB_CHNL184_CONFIG_ADDR A:0xd180004
y.create.l HWIO_PMIC_ARB_CHNL185_CONFIG_ADDR A:0xd190004
y.create.l HWIO_PMIC_ARB_CHNL186_CONFIG_ADDR A:0xd1a0004
y.create.l HWIO_PMIC_ARB_CHNL187_CONFIG_ADDR A:0xd1b0004
y.create.l HWIO_PMIC_ARB_CHNL188_CONFIG_ADDR A:0xd1c0004
y.create.l HWIO_PMIC_ARB_CHNL189_CONFIG_ADDR A:0xd1d0004
y.create.l HWIO_PMIC_ARB_CHNL190_CONFIG_ADDR A:0xd1e0004
y.create.l HWIO_PMIC_ARB_CHNL191_CONFIG_ADDR A:0xd1f0004
y.create.l HWIO_PMIC_ARB_CHNL192_CONFIG_ADDR A:0xd200004
y.create.l HWIO_PMIC_ARB_CHNL193_CONFIG_ADDR A:0xd210004
y.create.l HWIO_PMIC_ARB_CHNL194_CONFIG_ADDR A:0xd220004
y.create.l HWIO_PMIC_ARB_CHNL195_CONFIG_ADDR A:0xd230004
y.create.l HWIO_PMIC_ARB_CHNL196_CONFIG_ADDR A:0xd240004
y.create.l HWIO_PMIC_ARB_CHNL197_CONFIG_ADDR A:0xd250004
y.create.l HWIO_PMIC_ARB_CHNL198_CONFIG_ADDR A:0xd260004
y.create.l HWIO_PMIC_ARB_CHNL199_CONFIG_ADDR A:0xd270004
y.create.l HWIO_PMIC_ARB_CHNL200_CONFIG_ADDR A:0xd280004
y.create.l HWIO_PMIC_ARB_CHNL201_CONFIG_ADDR A:0xd290004
y.create.l HWIO_PMIC_ARB_CHNL202_CONFIG_ADDR A:0xd2a0004
y.create.l HWIO_PMIC_ARB_CHNL203_CONFIG_ADDR A:0xd2b0004
y.create.l HWIO_PMIC_ARB_CHNL204_CONFIG_ADDR A:0xd2c0004
y.create.l HWIO_PMIC_ARB_CHNL205_CONFIG_ADDR A:0xd2d0004
y.create.l HWIO_PMIC_ARB_CHNL206_CONFIG_ADDR A:0xd2e0004
y.create.l HWIO_PMIC_ARB_CHNL207_CONFIG_ADDR A:0xd2f0004
y.create.l HWIO_PMIC_ARB_CHNL208_CONFIG_ADDR A:0xd300004
y.create.l HWIO_PMIC_ARB_CHNL209_CONFIG_ADDR A:0xd310004
y.create.l HWIO_PMIC_ARB_CHNL210_CONFIG_ADDR A:0xd320004
y.create.l HWIO_PMIC_ARB_CHNL211_CONFIG_ADDR A:0xd330004
y.create.l HWIO_PMIC_ARB_CHNL212_CONFIG_ADDR A:0xd340004
y.create.l HWIO_PMIC_ARB_CHNL213_CONFIG_ADDR A:0xd350004
y.create.l HWIO_PMIC_ARB_CHNL214_CONFIG_ADDR A:0xd360004
y.create.l HWIO_PMIC_ARB_CHNL215_CONFIG_ADDR A:0xd370004
y.create.l HWIO_PMIC_ARB_CHNL216_CONFIG_ADDR A:0xd380004
y.create.l HWIO_PMIC_ARB_CHNL217_CONFIG_ADDR A:0xd390004
y.create.l HWIO_PMIC_ARB_CHNL218_CONFIG_ADDR A:0xd3a0004
y.create.l HWIO_PMIC_ARB_CHNL219_CONFIG_ADDR A:0xd3b0004
y.create.l HWIO_PMIC_ARB_CHNL220_CONFIG_ADDR A:0xd3c0004
y.create.l HWIO_PMIC_ARB_CHNL221_CONFIG_ADDR A:0xd3d0004
y.create.l HWIO_PMIC_ARB_CHNL222_CONFIG_ADDR A:0xd3e0004
y.create.l HWIO_PMIC_ARB_CHNL223_CONFIG_ADDR A:0xd3f0004
y.create.l HWIO_PMIC_ARB_CHNL224_CONFIG_ADDR A:0xd400004
y.create.l HWIO_PMIC_ARB_CHNL225_CONFIG_ADDR A:0xd410004
y.create.l HWIO_PMIC_ARB_CHNL226_CONFIG_ADDR A:0xd420004
y.create.l HWIO_PMIC_ARB_CHNL227_CONFIG_ADDR A:0xd430004
y.create.l HWIO_PMIC_ARB_CHNL228_CONFIG_ADDR A:0xd440004
y.create.l HWIO_PMIC_ARB_CHNL229_CONFIG_ADDR A:0xd450004
y.create.l HWIO_PMIC_ARB_CHNL230_CONFIG_ADDR A:0xd460004
y.create.l HWIO_PMIC_ARB_CHNL231_CONFIG_ADDR A:0xd470004
y.create.l HWIO_PMIC_ARB_CHNL232_CONFIG_ADDR A:0xd480004
y.create.l HWIO_PMIC_ARB_CHNL233_CONFIG_ADDR A:0xd490004
y.create.l HWIO_PMIC_ARB_CHNL234_CONFIG_ADDR A:0xd4a0004
y.create.l HWIO_PMIC_ARB_CHNL235_CONFIG_ADDR A:0xd4b0004
y.create.l HWIO_PMIC_ARB_CHNL236_CONFIG_ADDR A:0xd4c0004
y.create.l HWIO_PMIC_ARB_CHNL237_CONFIG_ADDR A:0xd4d0004
y.create.l HWIO_PMIC_ARB_CHNL238_CONFIG_ADDR A:0xd4e0004
y.create.l HWIO_PMIC_ARB_CHNL239_CONFIG_ADDR A:0xd4f0004
y.create.l HWIO_PMIC_ARB_CHNL240_CONFIG_ADDR A:0xd500004
y.create.l HWIO_PMIC_ARB_CHNL241_CONFIG_ADDR A:0xd510004
y.create.l HWIO_PMIC_ARB_CHNL242_CONFIG_ADDR A:0xd520004
y.create.l HWIO_PMIC_ARB_CHNL243_CONFIG_ADDR A:0xd530004
y.create.l HWIO_PMIC_ARB_CHNL244_CONFIG_ADDR A:0xd540004
y.create.l HWIO_PMIC_ARB_CHNL245_CONFIG_ADDR A:0xd550004
y.create.l HWIO_PMIC_ARB_CHNL246_CONFIG_ADDR A:0xd560004
y.create.l HWIO_PMIC_ARB_CHNL247_CONFIG_ADDR A:0xd570004
y.create.l HWIO_PMIC_ARB_CHNL248_CONFIG_ADDR A:0xd580004
y.create.l HWIO_PMIC_ARB_CHNL249_CONFIG_ADDR A:0xd590004
y.create.l HWIO_PMIC_ARB_CHNL250_CONFIG_ADDR A:0xd5a0004
y.create.l HWIO_PMIC_ARB_CHNL251_CONFIG_ADDR A:0xd5b0004
y.create.l HWIO_PMIC_ARB_CHNL252_CONFIG_ADDR A:0xd5c0004
y.create.l HWIO_PMIC_ARB_CHNL253_CONFIG_ADDR A:0xd5d0004
y.create.l HWIO_PMIC_ARB_CHNL254_CONFIG_ADDR A:0xd5e0004
y.create.l HWIO_PMIC_ARB_CHNL255_CONFIG_ADDR A:0xd5f0004
y.create.l HWIO_PMIC_ARB_CHNL0_STATUS_ADDR A:0xc600008
y.create.l HWIO_PMIC_ARB_CHNL1_STATUS_ADDR A:0xc610008
y.create.l HWIO_PMIC_ARB_CHNL2_STATUS_ADDR A:0xc620008
y.create.l HWIO_PMIC_ARB_CHNL3_STATUS_ADDR A:0xc630008
y.create.l HWIO_PMIC_ARB_CHNL4_STATUS_ADDR A:0xc640008
y.create.l HWIO_PMIC_ARB_CHNL5_STATUS_ADDR A:0xc650008
y.create.l HWIO_PMIC_ARB_CHNL6_STATUS_ADDR A:0xc660008
y.create.l HWIO_PMIC_ARB_CHNL7_STATUS_ADDR A:0xc670008
y.create.l HWIO_PMIC_ARB_CHNL8_STATUS_ADDR A:0xc680008
y.create.l HWIO_PMIC_ARB_CHNL9_STATUS_ADDR A:0xc690008
y.create.l HWIO_PMIC_ARB_CHNL10_STATUS_ADDR A:0xc6a0008
y.create.l HWIO_PMIC_ARB_CHNL11_STATUS_ADDR A:0xc6b0008
y.create.l HWIO_PMIC_ARB_CHNL12_STATUS_ADDR A:0xc6c0008
y.create.l HWIO_PMIC_ARB_CHNL13_STATUS_ADDR A:0xc6d0008
y.create.l HWIO_PMIC_ARB_CHNL14_STATUS_ADDR A:0xc6e0008
y.create.l HWIO_PMIC_ARB_CHNL15_STATUS_ADDR A:0xc6f0008
y.create.l HWIO_PMIC_ARB_CHNL16_STATUS_ADDR A:0xc700008
y.create.l HWIO_PMIC_ARB_CHNL17_STATUS_ADDR A:0xc710008
y.create.l HWIO_PMIC_ARB_CHNL18_STATUS_ADDR A:0xc720008
y.create.l HWIO_PMIC_ARB_CHNL19_STATUS_ADDR A:0xc730008
y.create.l HWIO_PMIC_ARB_CHNL20_STATUS_ADDR A:0xc740008
y.create.l HWIO_PMIC_ARB_CHNL21_STATUS_ADDR A:0xc750008
y.create.l HWIO_PMIC_ARB_CHNL22_STATUS_ADDR A:0xc760008
y.create.l HWIO_PMIC_ARB_CHNL23_STATUS_ADDR A:0xc770008
y.create.l HWIO_PMIC_ARB_CHNL24_STATUS_ADDR A:0xc780008
y.create.l HWIO_PMIC_ARB_CHNL25_STATUS_ADDR A:0xc790008
y.create.l HWIO_PMIC_ARB_CHNL26_STATUS_ADDR A:0xc7a0008
y.create.l HWIO_PMIC_ARB_CHNL27_STATUS_ADDR A:0xc7b0008
y.create.l HWIO_PMIC_ARB_CHNL28_STATUS_ADDR A:0xc7c0008
y.create.l HWIO_PMIC_ARB_CHNL29_STATUS_ADDR A:0xc7d0008
y.create.l HWIO_PMIC_ARB_CHNL30_STATUS_ADDR A:0xc7e0008
y.create.l HWIO_PMIC_ARB_CHNL31_STATUS_ADDR A:0xc7f0008
y.create.l HWIO_PMIC_ARB_CHNL32_STATUS_ADDR A:0xc800008
y.create.l HWIO_PMIC_ARB_CHNL33_STATUS_ADDR A:0xc810008
y.create.l HWIO_PMIC_ARB_CHNL34_STATUS_ADDR A:0xc820008
y.create.l HWIO_PMIC_ARB_CHNL35_STATUS_ADDR A:0xc830008
y.create.l HWIO_PMIC_ARB_CHNL36_STATUS_ADDR A:0xc840008
y.create.l HWIO_PMIC_ARB_CHNL37_STATUS_ADDR A:0xc850008
y.create.l HWIO_PMIC_ARB_CHNL38_STATUS_ADDR A:0xc860008
y.create.l HWIO_PMIC_ARB_CHNL39_STATUS_ADDR A:0xc870008
y.create.l HWIO_PMIC_ARB_CHNL40_STATUS_ADDR A:0xc880008
y.create.l HWIO_PMIC_ARB_CHNL41_STATUS_ADDR A:0xc890008
y.create.l HWIO_PMIC_ARB_CHNL42_STATUS_ADDR A:0xc8a0008
y.create.l HWIO_PMIC_ARB_CHNL43_STATUS_ADDR A:0xc8b0008
y.create.l HWIO_PMIC_ARB_CHNL44_STATUS_ADDR A:0xc8c0008
y.create.l HWIO_PMIC_ARB_CHNL45_STATUS_ADDR A:0xc8d0008
y.create.l HWIO_PMIC_ARB_CHNL46_STATUS_ADDR A:0xc8e0008
y.create.l HWIO_PMIC_ARB_CHNL47_STATUS_ADDR A:0xc8f0008
y.create.l HWIO_PMIC_ARB_CHNL48_STATUS_ADDR A:0xc900008
y.create.l HWIO_PMIC_ARB_CHNL49_STATUS_ADDR A:0xc910008
y.create.l HWIO_PMIC_ARB_CHNL50_STATUS_ADDR A:0xc920008
y.create.l HWIO_PMIC_ARB_CHNL51_STATUS_ADDR A:0xc930008
y.create.l HWIO_PMIC_ARB_CHNL52_STATUS_ADDR A:0xc940008
y.create.l HWIO_PMIC_ARB_CHNL53_STATUS_ADDR A:0xc950008
y.create.l HWIO_PMIC_ARB_CHNL54_STATUS_ADDR A:0xc960008
y.create.l HWIO_PMIC_ARB_CHNL55_STATUS_ADDR A:0xc970008
y.create.l HWIO_PMIC_ARB_CHNL56_STATUS_ADDR A:0xc980008
y.create.l HWIO_PMIC_ARB_CHNL57_STATUS_ADDR A:0xc990008
y.create.l HWIO_PMIC_ARB_CHNL58_STATUS_ADDR A:0xc9a0008
y.create.l HWIO_PMIC_ARB_CHNL59_STATUS_ADDR A:0xc9b0008
y.create.l HWIO_PMIC_ARB_CHNL60_STATUS_ADDR A:0xc9c0008
y.create.l HWIO_PMIC_ARB_CHNL61_STATUS_ADDR A:0xc9d0008
y.create.l HWIO_PMIC_ARB_CHNL62_STATUS_ADDR A:0xc9e0008
y.create.l HWIO_PMIC_ARB_CHNL63_STATUS_ADDR A:0xc9f0008
y.create.l HWIO_PMIC_ARB_CHNL64_STATUS_ADDR A:0xca00008
y.create.l HWIO_PMIC_ARB_CHNL65_STATUS_ADDR A:0xca10008
y.create.l HWIO_PMIC_ARB_CHNL66_STATUS_ADDR A:0xca20008
y.create.l HWIO_PMIC_ARB_CHNL67_STATUS_ADDR A:0xca30008
y.create.l HWIO_PMIC_ARB_CHNL68_STATUS_ADDR A:0xca40008
y.create.l HWIO_PMIC_ARB_CHNL69_STATUS_ADDR A:0xca50008
y.create.l HWIO_PMIC_ARB_CHNL70_STATUS_ADDR A:0xca60008
y.create.l HWIO_PMIC_ARB_CHNL71_STATUS_ADDR A:0xca70008
y.create.l HWIO_PMIC_ARB_CHNL72_STATUS_ADDR A:0xca80008
y.create.l HWIO_PMIC_ARB_CHNL73_STATUS_ADDR A:0xca90008
y.create.l HWIO_PMIC_ARB_CHNL74_STATUS_ADDR A:0xcaa0008
y.create.l HWIO_PMIC_ARB_CHNL75_STATUS_ADDR A:0xcab0008
y.create.l HWIO_PMIC_ARB_CHNL76_STATUS_ADDR A:0xcac0008
y.create.l HWIO_PMIC_ARB_CHNL77_STATUS_ADDR A:0xcad0008
y.create.l HWIO_PMIC_ARB_CHNL78_STATUS_ADDR A:0xcae0008
y.create.l HWIO_PMIC_ARB_CHNL79_STATUS_ADDR A:0xcaf0008
y.create.l HWIO_PMIC_ARB_CHNL80_STATUS_ADDR A:0xcb00008
y.create.l HWIO_PMIC_ARB_CHNL81_STATUS_ADDR A:0xcb10008
y.create.l HWIO_PMIC_ARB_CHNL82_STATUS_ADDR A:0xcb20008
y.create.l HWIO_PMIC_ARB_CHNL83_STATUS_ADDR A:0xcb30008
y.create.l HWIO_PMIC_ARB_CHNL84_STATUS_ADDR A:0xcb40008
y.create.l HWIO_PMIC_ARB_CHNL85_STATUS_ADDR A:0xcb50008
y.create.l HWIO_PMIC_ARB_CHNL86_STATUS_ADDR A:0xcb60008
y.create.l HWIO_PMIC_ARB_CHNL87_STATUS_ADDR A:0xcb70008
y.create.l HWIO_PMIC_ARB_CHNL88_STATUS_ADDR A:0xcb80008
y.create.l HWIO_PMIC_ARB_CHNL89_STATUS_ADDR A:0xcb90008
y.create.l HWIO_PMIC_ARB_CHNL90_STATUS_ADDR A:0xcba0008
y.create.l HWIO_PMIC_ARB_CHNL91_STATUS_ADDR A:0xcbb0008
y.create.l HWIO_PMIC_ARB_CHNL92_STATUS_ADDR A:0xcbc0008
y.create.l HWIO_PMIC_ARB_CHNL93_STATUS_ADDR A:0xcbd0008
y.create.l HWIO_PMIC_ARB_CHNL94_STATUS_ADDR A:0xcbe0008
y.create.l HWIO_PMIC_ARB_CHNL95_STATUS_ADDR A:0xcbf0008
y.create.l HWIO_PMIC_ARB_CHNL96_STATUS_ADDR A:0xcc00008
y.create.l HWIO_PMIC_ARB_CHNL97_STATUS_ADDR A:0xcc10008
y.create.l HWIO_PMIC_ARB_CHNL98_STATUS_ADDR A:0xcc20008
y.create.l HWIO_PMIC_ARB_CHNL99_STATUS_ADDR A:0xcc30008
y.create.l HWIO_PMIC_ARB_CHNL100_STATUS_ADDR A:0xcc40008
y.create.l HWIO_PMIC_ARB_CHNL101_STATUS_ADDR A:0xcc50008
y.create.l HWIO_PMIC_ARB_CHNL102_STATUS_ADDR A:0xcc60008
y.create.l HWIO_PMIC_ARB_CHNL103_STATUS_ADDR A:0xcc70008
y.create.l HWIO_PMIC_ARB_CHNL104_STATUS_ADDR A:0xcc80008
y.create.l HWIO_PMIC_ARB_CHNL105_STATUS_ADDR A:0xcc90008
y.create.l HWIO_PMIC_ARB_CHNL106_STATUS_ADDR A:0xcca0008
y.create.l HWIO_PMIC_ARB_CHNL107_STATUS_ADDR A:0xccb0008
y.create.l HWIO_PMIC_ARB_CHNL108_STATUS_ADDR A:0xccc0008
y.create.l HWIO_PMIC_ARB_CHNL109_STATUS_ADDR A:0xccd0008
y.create.l HWIO_PMIC_ARB_CHNL110_STATUS_ADDR A:0xcce0008
y.create.l HWIO_PMIC_ARB_CHNL111_STATUS_ADDR A:0xccf0008
y.create.l HWIO_PMIC_ARB_CHNL112_STATUS_ADDR A:0xcd00008
y.create.l HWIO_PMIC_ARB_CHNL113_STATUS_ADDR A:0xcd10008
y.create.l HWIO_PMIC_ARB_CHNL114_STATUS_ADDR A:0xcd20008
y.create.l HWIO_PMIC_ARB_CHNL115_STATUS_ADDR A:0xcd30008
y.create.l HWIO_PMIC_ARB_CHNL116_STATUS_ADDR A:0xcd40008
y.create.l HWIO_PMIC_ARB_CHNL117_STATUS_ADDR A:0xcd50008
y.create.l HWIO_PMIC_ARB_CHNL118_STATUS_ADDR A:0xcd60008
y.create.l HWIO_PMIC_ARB_CHNL119_STATUS_ADDR A:0xcd70008
y.create.l HWIO_PMIC_ARB_CHNL120_STATUS_ADDR A:0xcd80008
y.create.l HWIO_PMIC_ARB_CHNL121_STATUS_ADDR A:0xcd90008
y.create.l HWIO_PMIC_ARB_CHNL122_STATUS_ADDR A:0xcda0008
y.create.l HWIO_PMIC_ARB_CHNL123_STATUS_ADDR A:0xcdb0008
y.create.l HWIO_PMIC_ARB_CHNL124_STATUS_ADDR A:0xcdc0008
y.create.l HWIO_PMIC_ARB_CHNL125_STATUS_ADDR A:0xcdd0008
y.create.l HWIO_PMIC_ARB_CHNL126_STATUS_ADDR A:0xcde0008
y.create.l HWIO_PMIC_ARB_CHNL127_STATUS_ADDR A:0xcdf0008
y.create.l HWIO_PMIC_ARB_CHNL128_STATUS_ADDR A:0xce00008
y.create.l HWIO_PMIC_ARB_CHNL129_STATUS_ADDR A:0xce10008
y.create.l HWIO_PMIC_ARB_CHNL130_STATUS_ADDR A:0xce20008
y.create.l HWIO_PMIC_ARB_CHNL131_STATUS_ADDR A:0xce30008
y.create.l HWIO_PMIC_ARB_CHNL132_STATUS_ADDR A:0xce40008
y.create.l HWIO_PMIC_ARB_CHNL133_STATUS_ADDR A:0xce50008
y.create.l HWIO_PMIC_ARB_CHNL134_STATUS_ADDR A:0xce60008
y.create.l HWIO_PMIC_ARB_CHNL135_STATUS_ADDR A:0xce70008
y.create.l HWIO_PMIC_ARB_CHNL136_STATUS_ADDR A:0xce80008
y.create.l HWIO_PMIC_ARB_CHNL137_STATUS_ADDR A:0xce90008
y.create.l HWIO_PMIC_ARB_CHNL138_STATUS_ADDR A:0xcea0008
y.create.l HWIO_PMIC_ARB_CHNL139_STATUS_ADDR A:0xceb0008
y.create.l HWIO_PMIC_ARB_CHNL140_STATUS_ADDR A:0xcec0008
y.create.l HWIO_PMIC_ARB_CHNL141_STATUS_ADDR A:0xced0008
y.create.l HWIO_PMIC_ARB_CHNL142_STATUS_ADDR A:0xcee0008
y.create.l HWIO_PMIC_ARB_CHNL143_STATUS_ADDR A:0xcef0008
y.create.l HWIO_PMIC_ARB_CHNL144_STATUS_ADDR A:0xcf00008
y.create.l HWIO_PMIC_ARB_CHNL145_STATUS_ADDR A:0xcf10008
y.create.l HWIO_PMIC_ARB_CHNL146_STATUS_ADDR A:0xcf20008
y.create.l HWIO_PMIC_ARB_CHNL147_STATUS_ADDR A:0xcf30008
y.create.l HWIO_PMIC_ARB_CHNL148_STATUS_ADDR A:0xcf40008
y.create.l HWIO_PMIC_ARB_CHNL149_STATUS_ADDR A:0xcf50008
y.create.l HWIO_PMIC_ARB_CHNL150_STATUS_ADDR A:0xcf60008
y.create.l HWIO_PMIC_ARB_CHNL151_STATUS_ADDR A:0xcf70008
y.create.l HWIO_PMIC_ARB_CHNL152_STATUS_ADDR A:0xcf80008
y.create.l HWIO_PMIC_ARB_CHNL153_STATUS_ADDR A:0xcf90008
y.create.l HWIO_PMIC_ARB_CHNL154_STATUS_ADDR A:0xcfa0008
y.create.l HWIO_PMIC_ARB_CHNL155_STATUS_ADDR A:0xcfb0008
y.create.l HWIO_PMIC_ARB_CHNL156_STATUS_ADDR A:0xcfc0008
y.create.l HWIO_PMIC_ARB_CHNL157_STATUS_ADDR A:0xcfd0008
y.create.l HWIO_PMIC_ARB_CHNL158_STATUS_ADDR A:0xcfe0008
y.create.l HWIO_PMIC_ARB_CHNL159_STATUS_ADDR A:0xcff0008
y.create.l HWIO_PMIC_ARB_CHNL160_STATUS_ADDR A:0xd000008
y.create.l HWIO_PMIC_ARB_CHNL161_STATUS_ADDR A:0xd010008
y.create.l HWIO_PMIC_ARB_CHNL162_STATUS_ADDR A:0xd020008
y.create.l HWIO_PMIC_ARB_CHNL163_STATUS_ADDR A:0xd030008
y.create.l HWIO_PMIC_ARB_CHNL164_STATUS_ADDR A:0xd040008
y.create.l HWIO_PMIC_ARB_CHNL165_STATUS_ADDR A:0xd050008
y.create.l HWIO_PMIC_ARB_CHNL166_STATUS_ADDR A:0xd060008
y.create.l HWIO_PMIC_ARB_CHNL167_STATUS_ADDR A:0xd070008
y.create.l HWIO_PMIC_ARB_CHNL168_STATUS_ADDR A:0xd080008
y.create.l HWIO_PMIC_ARB_CHNL169_STATUS_ADDR A:0xd090008
y.create.l HWIO_PMIC_ARB_CHNL170_STATUS_ADDR A:0xd0a0008
y.create.l HWIO_PMIC_ARB_CHNL171_STATUS_ADDR A:0xd0b0008
y.create.l HWIO_PMIC_ARB_CHNL172_STATUS_ADDR A:0xd0c0008
y.create.l HWIO_PMIC_ARB_CHNL173_STATUS_ADDR A:0xd0d0008
y.create.l HWIO_PMIC_ARB_CHNL174_STATUS_ADDR A:0xd0e0008
y.create.l HWIO_PMIC_ARB_CHNL175_STATUS_ADDR A:0xd0f0008
y.create.l HWIO_PMIC_ARB_CHNL176_STATUS_ADDR A:0xd100008
y.create.l HWIO_PMIC_ARB_CHNL177_STATUS_ADDR A:0xd110008
y.create.l HWIO_PMIC_ARB_CHNL178_STATUS_ADDR A:0xd120008
y.create.l HWIO_PMIC_ARB_CHNL179_STATUS_ADDR A:0xd130008
y.create.l HWIO_PMIC_ARB_CHNL180_STATUS_ADDR A:0xd140008
y.create.l HWIO_PMIC_ARB_CHNL181_STATUS_ADDR A:0xd150008
y.create.l HWIO_PMIC_ARB_CHNL182_STATUS_ADDR A:0xd160008
y.create.l HWIO_PMIC_ARB_CHNL183_STATUS_ADDR A:0xd170008
y.create.l HWIO_PMIC_ARB_CHNL184_STATUS_ADDR A:0xd180008
y.create.l HWIO_PMIC_ARB_CHNL185_STATUS_ADDR A:0xd190008
y.create.l HWIO_PMIC_ARB_CHNL186_STATUS_ADDR A:0xd1a0008
y.create.l HWIO_PMIC_ARB_CHNL187_STATUS_ADDR A:0xd1b0008
y.create.l HWIO_PMIC_ARB_CHNL188_STATUS_ADDR A:0xd1c0008
y.create.l HWIO_PMIC_ARB_CHNL189_STATUS_ADDR A:0xd1d0008
y.create.l HWIO_PMIC_ARB_CHNL190_STATUS_ADDR A:0xd1e0008
y.create.l HWIO_PMIC_ARB_CHNL191_STATUS_ADDR A:0xd1f0008
y.create.l HWIO_PMIC_ARB_CHNL192_STATUS_ADDR A:0xd200008
y.create.l HWIO_PMIC_ARB_CHNL193_STATUS_ADDR A:0xd210008
y.create.l HWIO_PMIC_ARB_CHNL194_STATUS_ADDR A:0xd220008
y.create.l HWIO_PMIC_ARB_CHNL195_STATUS_ADDR A:0xd230008
y.create.l HWIO_PMIC_ARB_CHNL196_STATUS_ADDR A:0xd240008
y.create.l HWIO_PMIC_ARB_CHNL197_STATUS_ADDR A:0xd250008
y.create.l HWIO_PMIC_ARB_CHNL198_STATUS_ADDR A:0xd260008
y.create.l HWIO_PMIC_ARB_CHNL199_STATUS_ADDR A:0xd270008
y.create.l HWIO_PMIC_ARB_CHNL200_STATUS_ADDR A:0xd280008
y.create.l HWIO_PMIC_ARB_CHNL201_STATUS_ADDR A:0xd290008
y.create.l HWIO_PMIC_ARB_CHNL202_STATUS_ADDR A:0xd2a0008
y.create.l HWIO_PMIC_ARB_CHNL203_STATUS_ADDR A:0xd2b0008
y.create.l HWIO_PMIC_ARB_CHNL204_STATUS_ADDR A:0xd2c0008
y.create.l HWIO_PMIC_ARB_CHNL205_STATUS_ADDR A:0xd2d0008
y.create.l HWIO_PMIC_ARB_CHNL206_STATUS_ADDR A:0xd2e0008
y.create.l HWIO_PMIC_ARB_CHNL207_STATUS_ADDR A:0xd2f0008
y.create.l HWIO_PMIC_ARB_CHNL208_STATUS_ADDR A:0xd300008
y.create.l HWIO_PMIC_ARB_CHNL209_STATUS_ADDR A:0xd310008
y.create.l HWIO_PMIC_ARB_CHNL210_STATUS_ADDR A:0xd320008
y.create.l HWIO_PMIC_ARB_CHNL211_STATUS_ADDR A:0xd330008
y.create.l HWIO_PMIC_ARB_CHNL212_STATUS_ADDR A:0xd340008
y.create.l HWIO_PMIC_ARB_CHNL213_STATUS_ADDR A:0xd350008
y.create.l HWIO_PMIC_ARB_CHNL214_STATUS_ADDR A:0xd360008
y.create.l HWIO_PMIC_ARB_CHNL215_STATUS_ADDR A:0xd370008
y.create.l HWIO_PMIC_ARB_CHNL216_STATUS_ADDR A:0xd380008
y.create.l HWIO_PMIC_ARB_CHNL217_STATUS_ADDR A:0xd390008
y.create.l HWIO_PMIC_ARB_CHNL218_STATUS_ADDR A:0xd3a0008
y.create.l HWIO_PMIC_ARB_CHNL219_STATUS_ADDR A:0xd3b0008
y.create.l HWIO_PMIC_ARB_CHNL220_STATUS_ADDR A:0xd3c0008
y.create.l HWIO_PMIC_ARB_CHNL221_STATUS_ADDR A:0xd3d0008
y.create.l HWIO_PMIC_ARB_CHNL222_STATUS_ADDR A:0xd3e0008
y.create.l HWIO_PMIC_ARB_CHNL223_STATUS_ADDR A:0xd3f0008
y.create.l HWIO_PMIC_ARB_CHNL224_STATUS_ADDR A:0xd400008
y.create.l HWIO_PMIC_ARB_CHNL225_STATUS_ADDR A:0xd410008
y.create.l HWIO_PMIC_ARB_CHNL226_STATUS_ADDR A:0xd420008
y.create.l HWIO_PMIC_ARB_CHNL227_STATUS_ADDR A:0xd430008
y.create.l HWIO_PMIC_ARB_CHNL228_STATUS_ADDR A:0xd440008
y.create.l HWIO_PMIC_ARB_CHNL229_STATUS_ADDR A:0xd450008
y.create.l HWIO_PMIC_ARB_CHNL230_STATUS_ADDR A:0xd460008
y.create.l HWIO_PMIC_ARB_CHNL231_STATUS_ADDR A:0xd470008
y.create.l HWIO_PMIC_ARB_CHNL232_STATUS_ADDR A:0xd480008
y.create.l HWIO_PMIC_ARB_CHNL233_STATUS_ADDR A:0xd490008
y.create.l HWIO_PMIC_ARB_CHNL234_STATUS_ADDR A:0xd4a0008
y.create.l HWIO_PMIC_ARB_CHNL235_STATUS_ADDR A:0xd4b0008
y.create.l HWIO_PMIC_ARB_CHNL236_STATUS_ADDR A:0xd4c0008
y.create.l HWIO_PMIC_ARB_CHNL237_STATUS_ADDR A:0xd4d0008
y.create.l HWIO_PMIC_ARB_CHNL238_STATUS_ADDR A:0xd4e0008
y.create.l HWIO_PMIC_ARB_CHNL239_STATUS_ADDR A:0xd4f0008
y.create.l HWIO_PMIC_ARB_CHNL240_STATUS_ADDR A:0xd500008
y.create.l HWIO_PMIC_ARB_CHNL241_STATUS_ADDR A:0xd510008
y.create.l HWIO_PMIC_ARB_CHNL242_STATUS_ADDR A:0xd520008
y.create.l HWIO_PMIC_ARB_CHNL243_STATUS_ADDR A:0xd530008
y.create.l HWIO_PMIC_ARB_CHNL244_STATUS_ADDR A:0xd540008
y.create.l HWIO_PMIC_ARB_CHNL245_STATUS_ADDR A:0xd550008
y.create.l HWIO_PMIC_ARB_CHNL246_STATUS_ADDR A:0xd560008
y.create.l HWIO_PMIC_ARB_CHNL247_STATUS_ADDR A:0xd570008
y.create.l HWIO_PMIC_ARB_CHNL248_STATUS_ADDR A:0xd580008
y.create.l HWIO_PMIC_ARB_CHNL249_STATUS_ADDR A:0xd590008
y.create.l HWIO_PMIC_ARB_CHNL250_STATUS_ADDR A:0xd5a0008
y.create.l HWIO_PMIC_ARB_CHNL251_STATUS_ADDR A:0xd5b0008
y.create.l HWIO_PMIC_ARB_CHNL252_STATUS_ADDR A:0xd5c0008
y.create.l HWIO_PMIC_ARB_CHNL253_STATUS_ADDR A:0xd5d0008
y.create.l HWIO_PMIC_ARB_CHNL254_STATUS_ADDR A:0xd5e0008
y.create.l HWIO_PMIC_ARB_CHNL255_STATUS_ADDR A:0xd5f0008
y.create.l HWIO_PMIC_ARB_CHNL0_WDATA0_ADDR A:0xc600010
y.create.l HWIO_PMIC_ARB_CHNL1_WDATA0_ADDR A:0xc610010
y.create.l HWIO_PMIC_ARB_CHNL2_WDATA0_ADDR A:0xc620010
y.create.l HWIO_PMIC_ARB_CHNL3_WDATA0_ADDR A:0xc630010
y.create.l HWIO_PMIC_ARB_CHNL4_WDATA0_ADDR A:0xc640010
y.create.l HWIO_PMIC_ARB_CHNL5_WDATA0_ADDR A:0xc650010
y.create.l HWIO_PMIC_ARB_CHNL6_WDATA0_ADDR A:0xc660010
y.create.l HWIO_PMIC_ARB_CHNL7_WDATA0_ADDR A:0xc670010
y.create.l HWIO_PMIC_ARB_CHNL8_WDATA0_ADDR A:0xc680010
y.create.l HWIO_PMIC_ARB_CHNL9_WDATA0_ADDR A:0xc690010
y.create.l HWIO_PMIC_ARB_CHNL10_WDATA0_ADDR A:0xc6a0010
y.create.l HWIO_PMIC_ARB_CHNL11_WDATA0_ADDR A:0xc6b0010
y.create.l HWIO_PMIC_ARB_CHNL12_WDATA0_ADDR A:0xc6c0010
y.create.l HWIO_PMIC_ARB_CHNL13_WDATA0_ADDR A:0xc6d0010
y.create.l HWIO_PMIC_ARB_CHNL14_WDATA0_ADDR A:0xc6e0010
y.create.l HWIO_PMIC_ARB_CHNL15_WDATA0_ADDR A:0xc6f0010
y.create.l HWIO_PMIC_ARB_CHNL16_WDATA0_ADDR A:0xc700010
y.create.l HWIO_PMIC_ARB_CHNL17_WDATA0_ADDR A:0xc710010
y.create.l HWIO_PMIC_ARB_CHNL18_WDATA0_ADDR A:0xc720010
y.create.l HWIO_PMIC_ARB_CHNL19_WDATA0_ADDR A:0xc730010
y.create.l HWIO_PMIC_ARB_CHNL20_WDATA0_ADDR A:0xc740010
y.create.l HWIO_PMIC_ARB_CHNL21_WDATA0_ADDR A:0xc750010
y.create.l HWIO_PMIC_ARB_CHNL22_WDATA0_ADDR A:0xc760010
y.create.l HWIO_PMIC_ARB_CHNL23_WDATA0_ADDR A:0xc770010
y.create.l HWIO_PMIC_ARB_CHNL24_WDATA0_ADDR A:0xc780010
y.create.l HWIO_PMIC_ARB_CHNL25_WDATA0_ADDR A:0xc790010
y.create.l HWIO_PMIC_ARB_CHNL26_WDATA0_ADDR A:0xc7a0010
y.create.l HWIO_PMIC_ARB_CHNL27_WDATA0_ADDR A:0xc7b0010
y.create.l HWIO_PMIC_ARB_CHNL28_WDATA0_ADDR A:0xc7c0010
y.create.l HWIO_PMIC_ARB_CHNL29_WDATA0_ADDR A:0xc7d0010
y.create.l HWIO_PMIC_ARB_CHNL30_WDATA0_ADDR A:0xc7e0010
y.create.l HWIO_PMIC_ARB_CHNL31_WDATA0_ADDR A:0xc7f0010
y.create.l HWIO_PMIC_ARB_CHNL32_WDATA0_ADDR A:0xc800010
y.create.l HWIO_PMIC_ARB_CHNL33_WDATA0_ADDR A:0xc810010
y.create.l HWIO_PMIC_ARB_CHNL34_WDATA0_ADDR A:0xc820010
y.create.l HWIO_PMIC_ARB_CHNL35_WDATA0_ADDR A:0xc830010
y.create.l HWIO_PMIC_ARB_CHNL36_WDATA0_ADDR A:0xc840010
y.create.l HWIO_PMIC_ARB_CHNL37_WDATA0_ADDR A:0xc850010
y.create.l HWIO_PMIC_ARB_CHNL38_WDATA0_ADDR A:0xc860010
y.create.l HWIO_PMIC_ARB_CHNL39_WDATA0_ADDR A:0xc870010
y.create.l HWIO_PMIC_ARB_CHNL40_WDATA0_ADDR A:0xc880010
y.create.l HWIO_PMIC_ARB_CHNL41_WDATA0_ADDR A:0xc890010
y.create.l HWIO_PMIC_ARB_CHNL42_WDATA0_ADDR A:0xc8a0010
y.create.l HWIO_PMIC_ARB_CHNL43_WDATA0_ADDR A:0xc8b0010
y.create.l HWIO_PMIC_ARB_CHNL44_WDATA0_ADDR A:0xc8c0010
y.create.l HWIO_PMIC_ARB_CHNL45_WDATA0_ADDR A:0xc8d0010
y.create.l HWIO_PMIC_ARB_CHNL46_WDATA0_ADDR A:0xc8e0010
y.create.l HWIO_PMIC_ARB_CHNL47_WDATA0_ADDR A:0xc8f0010
y.create.l HWIO_PMIC_ARB_CHNL48_WDATA0_ADDR A:0xc900010
y.create.l HWIO_PMIC_ARB_CHNL49_WDATA0_ADDR A:0xc910010
y.create.l HWIO_PMIC_ARB_CHNL50_WDATA0_ADDR A:0xc920010
y.create.l HWIO_PMIC_ARB_CHNL51_WDATA0_ADDR A:0xc930010
y.create.l HWIO_PMIC_ARB_CHNL52_WDATA0_ADDR A:0xc940010
y.create.l HWIO_PMIC_ARB_CHNL53_WDATA0_ADDR A:0xc950010
y.create.l HWIO_PMIC_ARB_CHNL54_WDATA0_ADDR A:0xc960010
y.create.l HWIO_PMIC_ARB_CHNL55_WDATA0_ADDR A:0xc970010
y.create.l HWIO_PMIC_ARB_CHNL56_WDATA0_ADDR A:0xc980010
y.create.l HWIO_PMIC_ARB_CHNL57_WDATA0_ADDR A:0xc990010
y.create.l HWIO_PMIC_ARB_CHNL58_WDATA0_ADDR A:0xc9a0010
y.create.l HWIO_PMIC_ARB_CHNL59_WDATA0_ADDR A:0xc9b0010
y.create.l HWIO_PMIC_ARB_CHNL60_WDATA0_ADDR A:0xc9c0010
y.create.l HWIO_PMIC_ARB_CHNL61_WDATA0_ADDR A:0xc9d0010
y.create.l HWIO_PMIC_ARB_CHNL62_WDATA0_ADDR A:0xc9e0010
y.create.l HWIO_PMIC_ARB_CHNL63_WDATA0_ADDR A:0xc9f0010
y.create.l HWIO_PMIC_ARB_CHNL64_WDATA0_ADDR A:0xca00010
y.create.l HWIO_PMIC_ARB_CHNL65_WDATA0_ADDR A:0xca10010
y.create.l HWIO_PMIC_ARB_CHNL66_WDATA0_ADDR A:0xca20010
y.create.l HWIO_PMIC_ARB_CHNL67_WDATA0_ADDR A:0xca30010
y.create.l HWIO_PMIC_ARB_CHNL68_WDATA0_ADDR A:0xca40010
y.create.l HWIO_PMIC_ARB_CHNL69_WDATA0_ADDR A:0xca50010
y.create.l HWIO_PMIC_ARB_CHNL70_WDATA0_ADDR A:0xca60010
y.create.l HWIO_PMIC_ARB_CHNL71_WDATA0_ADDR A:0xca70010
y.create.l HWIO_PMIC_ARB_CHNL72_WDATA0_ADDR A:0xca80010
y.create.l HWIO_PMIC_ARB_CHNL73_WDATA0_ADDR A:0xca90010
y.create.l HWIO_PMIC_ARB_CHNL74_WDATA0_ADDR A:0xcaa0010
y.create.l HWIO_PMIC_ARB_CHNL75_WDATA0_ADDR A:0xcab0010
y.create.l HWIO_PMIC_ARB_CHNL76_WDATA0_ADDR A:0xcac0010
y.create.l HWIO_PMIC_ARB_CHNL77_WDATA0_ADDR A:0xcad0010
y.create.l HWIO_PMIC_ARB_CHNL78_WDATA0_ADDR A:0xcae0010
y.create.l HWIO_PMIC_ARB_CHNL79_WDATA0_ADDR A:0xcaf0010
y.create.l HWIO_PMIC_ARB_CHNL80_WDATA0_ADDR A:0xcb00010
y.create.l HWIO_PMIC_ARB_CHNL81_WDATA0_ADDR A:0xcb10010
y.create.l HWIO_PMIC_ARB_CHNL82_WDATA0_ADDR A:0xcb20010
y.create.l HWIO_PMIC_ARB_CHNL83_WDATA0_ADDR A:0xcb30010
y.create.l HWIO_PMIC_ARB_CHNL84_WDATA0_ADDR A:0xcb40010
y.create.l HWIO_PMIC_ARB_CHNL85_WDATA0_ADDR A:0xcb50010
y.create.l HWIO_PMIC_ARB_CHNL86_WDATA0_ADDR A:0xcb60010
y.create.l HWIO_PMIC_ARB_CHNL87_WDATA0_ADDR A:0xcb70010
y.create.l HWIO_PMIC_ARB_CHNL88_WDATA0_ADDR A:0xcb80010
y.create.l HWIO_PMIC_ARB_CHNL89_WDATA0_ADDR A:0xcb90010
y.create.l HWIO_PMIC_ARB_CHNL90_WDATA0_ADDR A:0xcba0010
y.create.l HWIO_PMIC_ARB_CHNL91_WDATA0_ADDR A:0xcbb0010
y.create.l HWIO_PMIC_ARB_CHNL92_WDATA0_ADDR A:0xcbc0010
y.create.l HWIO_PMIC_ARB_CHNL93_WDATA0_ADDR A:0xcbd0010
y.create.l HWIO_PMIC_ARB_CHNL94_WDATA0_ADDR A:0xcbe0010
y.create.l HWIO_PMIC_ARB_CHNL95_WDATA0_ADDR A:0xcbf0010
y.create.l HWIO_PMIC_ARB_CHNL96_WDATA0_ADDR A:0xcc00010
y.create.l HWIO_PMIC_ARB_CHNL97_WDATA0_ADDR A:0xcc10010
y.create.l HWIO_PMIC_ARB_CHNL98_WDATA0_ADDR A:0xcc20010
y.create.l HWIO_PMIC_ARB_CHNL99_WDATA0_ADDR A:0xcc30010
y.create.l HWIO_PMIC_ARB_CHNL100_WDATA0_ADDR A:0xcc40010
y.create.l HWIO_PMIC_ARB_CHNL101_WDATA0_ADDR A:0xcc50010
y.create.l HWIO_PMIC_ARB_CHNL102_WDATA0_ADDR A:0xcc60010
y.create.l HWIO_PMIC_ARB_CHNL103_WDATA0_ADDR A:0xcc70010
y.create.l HWIO_PMIC_ARB_CHNL104_WDATA0_ADDR A:0xcc80010
y.create.l HWIO_PMIC_ARB_CHNL105_WDATA0_ADDR A:0xcc90010
y.create.l HWIO_PMIC_ARB_CHNL106_WDATA0_ADDR A:0xcca0010
y.create.l HWIO_PMIC_ARB_CHNL107_WDATA0_ADDR A:0xccb0010
y.create.l HWIO_PMIC_ARB_CHNL108_WDATA0_ADDR A:0xccc0010
y.create.l HWIO_PMIC_ARB_CHNL109_WDATA0_ADDR A:0xccd0010
y.create.l HWIO_PMIC_ARB_CHNL110_WDATA0_ADDR A:0xcce0010
y.create.l HWIO_PMIC_ARB_CHNL111_WDATA0_ADDR A:0xccf0010
y.create.l HWIO_PMIC_ARB_CHNL112_WDATA0_ADDR A:0xcd00010
y.create.l HWIO_PMIC_ARB_CHNL113_WDATA0_ADDR A:0xcd10010
y.create.l HWIO_PMIC_ARB_CHNL114_WDATA0_ADDR A:0xcd20010
y.create.l HWIO_PMIC_ARB_CHNL115_WDATA0_ADDR A:0xcd30010
y.create.l HWIO_PMIC_ARB_CHNL116_WDATA0_ADDR A:0xcd40010
y.create.l HWIO_PMIC_ARB_CHNL117_WDATA0_ADDR A:0xcd50010
y.create.l HWIO_PMIC_ARB_CHNL118_WDATA0_ADDR A:0xcd60010
y.create.l HWIO_PMIC_ARB_CHNL119_WDATA0_ADDR A:0xcd70010
y.create.l HWIO_PMIC_ARB_CHNL120_WDATA0_ADDR A:0xcd80010
y.create.l HWIO_PMIC_ARB_CHNL121_WDATA0_ADDR A:0xcd90010
y.create.l HWIO_PMIC_ARB_CHNL122_WDATA0_ADDR A:0xcda0010
y.create.l HWIO_PMIC_ARB_CHNL123_WDATA0_ADDR A:0xcdb0010
y.create.l HWIO_PMIC_ARB_CHNL124_WDATA0_ADDR A:0xcdc0010
y.create.l HWIO_PMIC_ARB_CHNL125_WDATA0_ADDR A:0xcdd0010
y.create.l HWIO_PMIC_ARB_CHNL126_WDATA0_ADDR A:0xcde0010
y.create.l HWIO_PMIC_ARB_CHNL127_WDATA0_ADDR A:0xcdf0010
y.create.l HWIO_PMIC_ARB_CHNL128_WDATA0_ADDR A:0xce00010
y.create.l HWIO_PMIC_ARB_CHNL129_WDATA0_ADDR A:0xce10010
y.create.l HWIO_PMIC_ARB_CHNL130_WDATA0_ADDR A:0xce20010
y.create.l HWIO_PMIC_ARB_CHNL131_WDATA0_ADDR A:0xce30010
y.create.l HWIO_PMIC_ARB_CHNL132_WDATA0_ADDR A:0xce40010
y.create.l HWIO_PMIC_ARB_CHNL133_WDATA0_ADDR A:0xce50010
y.create.l HWIO_PMIC_ARB_CHNL134_WDATA0_ADDR A:0xce60010
y.create.l HWIO_PMIC_ARB_CHNL135_WDATA0_ADDR A:0xce70010
y.create.l HWIO_PMIC_ARB_CHNL136_WDATA0_ADDR A:0xce80010
y.create.l HWIO_PMIC_ARB_CHNL137_WDATA0_ADDR A:0xce90010
y.create.l HWIO_PMIC_ARB_CHNL138_WDATA0_ADDR A:0xcea0010
y.create.l HWIO_PMIC_ARB_CHNL139_WDATA0_ADDR A:0xceb0010
y.create.l HWIO_PMIC_ARB_CHNL140_WDATA0_ADDR A:0xcec0010
y.create.l HWIO_PMIC_ARB_CHNL141_WDATA0_ADDR A:0xced0010
y.create.l HWIO_PMIC_ARB_CHNL142_WDATA0_ADDR A:0xcee0010
y.create.l HWIO_PMIC_ARB_CHNL143_WDATA0_ADDR A:0xcef0010
y.create.l HWIO_PMIC_ARB_CHNL144_WDATA0_ADDR A:0xcf00010
y.create.l HWIO_PMIC_ARB_CHNL145_WDATA0_ADDR A:0xcf10010
y.create.l HWIO_PMIC_ARB_CHNL146_WDATA0_ADDR A:0xcf20010
y.create.l HWIO_PMIC_ARB_CHNL147_WDATA0_ADDR A:0xcf30010
y.create.l HWIO_PMIC_ARB_CHNL148_WDATA0_ADDR A:0xcf40010
y.create.l HWIO_PMIC_ARB_CHNL149_WDATA0_ADDR A:0xcf50010
y.create.l HWIO_PMIC_ARB_CHNL150_WDATA0_ADDR A:0xcf60010
y.create.l HWIO_PMIC_ARB_CHNL151_WDATA0_ADDR A:0xcf70010
y.create.l HWIO_PMIC_ARB_CHNL152_WDATA0_ADDR A:0xcf80010
y.create.l HWIO_PMIC_ARB_CHNL153_WDATA0_ADDR A:0xcf90010
y.create.l HWIO_PMIC_ARB_CHNL154_WDATA0_ADDR A:0xcfa0010
y.create.l HWIO_PMIC_ARB_CHNL155_WDATA0_ADDR A:0xcfb0010
y.create.l HWIO_PMIC_ARB_CHNL156_WDATA0_ADDR A:0xcfc0010
y.create.l HWIO_PMIC_ARB_CHNL157_WDATA0_ADDR A:0xcfd0010
y.create.l HWIO_PMIC_ARB_CHNL158_WDATA0_ADDR A:0xcfe0010
y.create.l HWIO_PMIC_ARB_CHNL159_WDATA0_ADDR A:0xcff0010
y.create.l HWIO_PMIC_ARB_CHNL160_WDATA0_ADDR A:0xd000010
y.create.l HWIO_PMIC_ARB_CHNL161_WDATA0_ADDR A:0xd010010
y.create.l HWIO_PMIC_ARB_CHNL162_WDATA0_ADDR A:0xd020010
y.create.l HWIO_PMIC_ARB_CHNL163_WDATA0_ADDR A:0xd030010
y.create.l HWIO_PMIC_ARB_CHNL164_WDATA0_ADDR A:0xd040010
y.create.l HWIO_PMIC_ARB_CHNL165_WDATA0_ADDR A:0xd050010
y.create.l HWIO_PMIC_ARB_CHNL166_WDATA0_ADDR A:0xd060010
y.create.l HWIO_PMIC_ARB_CHNL167_WDATA0_ADDR A:0xd070010
y.create.l HWIO_PMIC_ARB_CHNL168_WDATA0_ADDR A:0xd080010
y.create.l HWIO_PMIC_ARB_CHNL169_WDATA0_ADDR A:0xd090010
y.create.l HWIO_PMIC_ARB_CHNL170_WDATA0_ADDR A:0xd0a0010
y.create.l HWIO_PMIC_ARB_CHNL171_WDATA0_ADDR A:0xd0b0010
y.create.l HWIO_PMIC_ARB_CHNL172_WDATA0_ADDR A:0xd0c0010
y.create.l HWIO_PMIC_ARB_CHNL173_WDATA0_ADDR A:0xd0d0010
y.create.l HWIO_PMIC_ARB_CHNL174_WDATA0_ADDR A:0xd0e0010
y.create.l HWIO_PMIC_ARB_CHNL175_WDATA0_ADDR A:0xd0f0010
y.create.l HWIO_PMIC_ARB_CHNL176_WDATA0_ADDR A:0xd100010
y.create.l HWIO_PMIC_ARB_CHNL177_WDATA0_ADDR A:0xd110010
y.create.l HWIO_PMIC_ARB_CHNL178_WDATA0_ADDR A:0xd120010
y.create.l HWIO_PMIC_ARB_CHNL179_WDATA0_ADDR A:0xd130010
y.create.l HWIO_PMIC_ARB_CHNL180_WDATA0_ADDR A:0xd140010
y.create.l HWIO_PMIC_ARB_CHNL181_WDATA0_ADDR A:0xd150010
y.create.l HWIO_PMIC_ARB_CHNL182_WDATA0_ADDR A:0xd160010
y.create.l HWIO_PMIC_ARB_CHNL183_WDATA0_ADDR A:0xd170010
y.create.l HWIO_PMIC_ARB_CHNL184_WDATA0_ADDR A:0xd180010
y.create.l HWIO_PMIC_ARB_CHNL185_WDATA0_ADDR A:0xd190010
y.create.l HWIO_PMIC_ARB_CHNL186_WDATA0_ADDR A:0xd1a0010
y.create.l HWIO_PMIC_ARB_CHNL187_WDATA0_ADDR A:0xd1b0010
y.create.l HWIO_PMIC_ARB_CHNL188_WDATA0_ADDR A:0xd1c0010
y.create.l HWIO_PMIC_ARB_CHNL189_WDATA0_ADDR A:0xd1d0010
y.create.l HWIO_PMIC_ARB_CHNL190_WDATA0_ADDR A:0xd1e0010
y.create.l HWIO_PMIC_ARB_CHNL191_WDATA0_ADDR A:0xd1f0010
y.create.l HWIO_PMIC_ARB_CHNL192_WDATA0_ADDR A:0xd200010
y.create.l HWIO_PMIC_ARB_CHNL193_WDATA0_ADDR A:0xd210010
y.create.l HWIO_PMIC_ARB_CHNL194_WDATA0_ADDR A:0xd220010
y.create.l HWIO_PMIC_ARB_CHNL195_WDATA0_ADDR A:0xd230010
y.create.l HWIO_PMIC_ARB_CHNL196_WDATA0_ADDR A:0xd240010
y.create.l HWIO_PMIC_ARB_CHNL197_WDATA0_ADDR A:0xd250010
y.create.l HWIO_PMIC_ARB_CHNL198_WDATA0_ADDR A:0xd260010
y.create.l HWIO_PMIC_ARB_CHNL199_WDATA0_ADDR A:0xd270010
y.create.l HWIO_PMIC_ARB_CHNL200_WDATA0_ADDR A:0xd280010
y.create.l HWIO_PMIC_ARB_CHNL201_WDATA0_ADDR A:0xd290010
y.create.l HWIO_PMIC_ARB_CHNL202_WDATA0_ADDR A:0xd2a0010
y.create.l HWIO_PMIC_ARB_CHNL203_WDATA0_ADDR A:0xd2b0010
y.create.l HWIO_PMIC_ARB_CHNL204_WDATA0_ADDR A:0xd2c0010
y.create.l HWIO_PMIC_ARB_CHNL205_WDATA0_ADDR A:0xd2d0010
y.create.l HWIO_PMIC_ARB_CHNL206_WDATA0_ADDR A:0xd2e0010
y.create.l HWIO_PMIC_ARB_CHNL207_WDATA0_ADDR A:0xd2f0010
y.create.l HWIO_PMIC_ARB_CHNL208_WDATA0_ADDR A:0xd300010
y.create.l HWIO_PMIC_ARB_CHNL209_WDATA0_ADDR A:0xd310010
y.create.l HWIO_PMIC_ARB_CHNL210_WDATA0_ADDR A:0xd320010
y.create.l HWIO_PMIC_ARB_CHNL211_WDATA0_ADDR A:0xd330010
y.create.l HWIO_PMIC_ARB_CHNL212_WDATA0_ADDR A:0xd340010
y.create.l HWIO_PMIC_ARB_CHNL213_WDATA0_ADDR A:0xd350010
y.create.l HWIO_PMIC_ARB_CHNL214_WDATA0_ADDR A:0xd360010
y.create.l HWIO_PMIC_ARB_CHNL215_WDATA0_ADDR A:0xd370010
y.create.l HWIO_PMIC_ARB_CHNL216_WDATA0_ADDR A:0xd380010
y.create.l HWIO_PMIC_ARB_CHNL217_WDATA0_ADDR A:0xd390010
y.create.l HWIO_PMIC_ARB_CHNL218_WDATA0_ADDR A:0xd3a0010
y.create.l HWIO_PMIC_ARB_CHNL219_WDATA0_ADDR A:0xd3b0010
y.create.l HWIO_PMIC_ARB_CHNL220_WDATA0_ADDR A:0xd3c0010
y.create.l HWIO_PMIC_ARB_CHNL221_WDATA0_ADDR A:0xd3d0010
y.create.l HWIO_PMIC_ARB_CHNL222_WDATA0_ADDR A:0xd3e0010
y.create.l HWIO_PMIC_ARB_CHNL223_WDATA0_ADDR A:0xd3f0010
y.create.l HWIO_PMIC_ARB_CHNL224_WDATA0_ADDR A:0xd400010
y.create.l HWIO_PMIC_ARB_CHNL225_WDATA0_ADDR A:0xd410010
y.create.l HWIO_PMIC_ARB_CHNL226_WDATA0_ADDR A:0xd420010
y.create.l HWIO_PMIC_ARB_CHNL227_WDATA0_ADDR A:0xd430010
y.create.l HWIO_PMIC_ARB_CHNL228_WDATA0_ADDR A:0xd440010
y.create.l HWIO_PMIC_ARB_CHNL229_WDATA0_ADDR A:0xd450010
y.create.l HWIO_PMIC_ARB_CHNL230_WDATA0_ADDR A:0xd460010
y.create.l HWIO_PMIC_ARB_CHNL231_WDATA0_ADDR A:0xd470010
y.create.l HWIO_PMIC_ARB_CHNL232_WDATA0_ADDR A:0xd480010
y.create.l HWIO_PMIC_ARB_CHNL233_WDATA0_ADDR A:0xd490010
y.create.l HWIO_PMIC_ARB_CHNL234_WDATA0_ADDR A:0xd4a0010
y.create.l HWIO_PMIC_ARB_CHNL235_WDATA0_ADDR A:0xd4b0010
y.create.l HWIO_PMIC_ARB_CHNL236_WDATA0_ADDR A:0xd4c0010
y.create.l HWIO_PMIC_ARB_CHNL237_WDATA0_ADDR A:0xd4d0010
y.create.l HWIO_PMIC_ARB_CHNL238_WDATA0_ADDR A:0xd4e0010
y.create.l HWIO_PMIC_ARB_CHNL239_WDATA0_ADDR A:0xd4f0010
y.create.l HWIO_PMIC_ARB_CHNL240_WDATA0_ADDR A:0xd500010
y.create.l HWIO_PMIC_ARB_CHNL241_WDATA0_ADDR A:0xd510010
y.create.l HWIO_PMIC_ARB_CHNL242_WDATA0_ADDR A:0xd520010
y.create.l HWIO_PMIC_ARB_CHNL243_WDATA0_ADDR A:0xd530010
y.create.l HWIO_PMIC_ARB_CHNL244_WDATA0_ADDR A:0xd540010
y.create.l HWIO_PMIC_ARB_CHNL245_WDATA0_ADDR A:0xd550010
y.create.l HWIO_PMIC_ARB_CHNL246_WDATA0_ADDR A:0xd560010
y.create.l HWIO_PMIC_ARB_CHNL247_WDATA0_ADDR A:0xd570010
y.create.l HWIO_PMIC_ARB_CHNL248_WDATA0_ADDR A:0xd580010
y.create.l HWIO_PMIC_ARB_CHNL249_WDATA0_ADDR A:0xd590010
y.create.l HWIO_PMIC_ARB_CHNL250_WDATA0_ADDR A:0xd5a0010
y.create.l HWIO_PMIC_ARB_CHNL251_WDATA0_ADDR A:0xd5b0010
y.create.l HWIO_PMIC_ARB_CHNL252_WDATA0_ADDR A:0xd5c0010
y.create.l HWIO_PMIC_ARB_CHNL253_WDATA0_ADDR A:0xd5d0010
y.create.l HWIO_PMIC_ARB_CHNL254_WDATA0_ADDR A:0xd5e0010
y.create.l HWIO_PMIC_ARB_CHNL255_WDATA0_ADDR A:0xd5f0010
y.create.l HWIO_PMIC_ARB_CHNL0_WDATA1_ADDR A:0xc600014
y.create.l HWIO_PMIC_ARB_CHNL1_WDATA1_ADDR A:0xc610014
y.create.l HWIO_PMIC_ARB_CHNL2_WDATA1_ADDR A:0xc620014
y.create.l HWIO_PMIC_ARB_CHNL3_WDATA1_ADDR A:0xc630014
y.create.l HWIO_PMIC_ARB_CHNL4_WDATA1_ADDR A:0xc640014
y.create.l HWIO_PMIC_ARB_CHNL5_WDATA1_ADDR A:0xc650014
y.create.l HWIO_PMIC_ARB_CHNL6_WDATA1_ADDR A:0xc660014
y.create.l HWIO_PMIC_ARB_CHNL7_WDATA1_ADDR A:0xc670014
y.create.l HWIO_PMIC_ARB_CHNL8_WDATA1_ADDR A:0xc680014
y.create.l HWIO_PMIC_ARB_CHNL9_WDATA1_ADDR A:0xc690014
y.create.l HWIO_PMIC_ARB_CHNL10_WDATA1_ADDR A:0xc6a0014
y.create.l HWIO_PMIC_ARB_CHNL11_WDATA1_ADDR A:0xc6b0014
y.create.l HWIO_PMIC_ARB_CHNL12_WDATA1_ADDR A:0xc6c0014
y.create.l HWIO_PMIC_ARB_CHNL13_WDATA1_ADDR A:0xc6d0014
y.create.l HWIO_PMIC_ARB_CHNL14_WDATA1_ADDR A:0xc6e0014
y.create.l HWIO_PMIC_ARB_CHNL15_WDATA1_ADDR A:0xc6f0014
y.create.l HWIO_PMIC_ARB_CHNL16_WDATA1_ADDR A:0xc700014
y.create.l HWIO_PMIC_ARB_CHNL17_WDATA1_ADDR A:0xc710014
y.create.l HWIO_PMIC_ARB_CHNL18_WDATA1_ADDR A:0xc720014
y.create.l HWIO_PMIC_ARB_CHNL19_WDATA1_ADDR A:0xc730014
y.create.l HWIO_PMIC_ARB_CHNL20_WDATA1_ADDR A:0xc740014
y.create.l HWIO_PMIC_ARB_CHNL21_WDATA1_ADDR A:0xc750014
y.create.l HWIO_PMIC_ARB_CHNL22_WDATA1_ADDR A:0xc760014
y.create.l HWIO_PMIC_ARB_CHNL23_WDATA1_ADDR A:0xc770014
y.create.l HWIO_PMIC_ARB_CHNL24_WDATA1_ADDR A:0xc780014
y.create.l HWIO_PMIC_ARB_CHNL25_WDATA1_ADDR A:0xc790014
y.create.l HWIO_PMIC_ARB_CHNL26_WDATA1_ADDR A:0xc7a0014
y.create.l HWIO_PMIC_ARB_CHNL27_WDATA1_ADDR A:0xc7b0014
y.create.l HWIO_PMIC_ARB_CHNL28_WDATA1_ADDR A:0xc7c0014
y.create.l HWIO_PMIC_ARB_CHNL29_WDATA1_ADDR A:0xc7d0014
y.create.l HWIO_PMIC_ARB_CHNL30_WDATA1_ADDR A:0xc7e0014
y.create.l HWIO_PMIC_ARB_CHNL31_WDATA1_ADDR A:0xc7f0014
y.create.l HWIO_PMIC_ARB_CHNL32_WDATA1_ADDR A:0xc800014
y.create.l HWIO_PMIC_ARB_CHNL33_WDATA1_ADDR A:0xc810014
y.create.l HWIO_PMIC_ARB_CHNL34_WDATA1_ADDR A:0xc820014
y.create.l HWIO_PMIC_ARB_CHNL35_WDATA1_ADDR A:0xc830014
y.create.l HWIO_PMIC_ARB_CHNL36_WDATA1_ADDR A:0xc840014
y.create.l HWIO_PMIC_ARB_CHNL37_WDATA1_ADDR A:0xc850014
y.create.l HWIO_PMIC_ARB_CHNL38_WDATA1_ADDR A:0xc860014
y.create.l HWIO_PMIC_ARB_CHNL39_WDATA1_ADDR A:0xc870014
y.create.l HWIO_PMIC_ARB_CHNL40_WDATA1_ADDR A:0xc880014
y.create.l HWIO_PMIC_ARB_CHNL41_WDATA1_ADDR A:0xc890014
y.create.l HWIO_PMIC_ARB_CHNL42_WDATA1_ADDR A:0xc8a0014
y.create.l HWIO_PMIC_ARB_CHNL43_WDATA1_ADDR A:0xc8b0014
y.create.l HWIO_PMIC_ARB_CHNL44_WDATA1_ADDR A:0xc8c0014
y.create.l HWIO_PMIC_ARB_CHNL45_WDATA1_ADDR A:0xc8d0014
y.create.l HWIO_PMIC_ARB_CHNL46_WDATA1_ADDR A:0xc8e0014
y.create.l HWIO_PMIC_ARB_CHNL47_WDATA1_ADDR A:0xc8f0014
y.create.l HWIO_PMIC_ARB_CHNL48_WDATA1_ADDR A:0xc900014
y.create.l HWIO_PMIC_ARB_CHNL49_WDATA1_ADDR A:0xc910014
y.create.l HWIO_PMIC_ARB_CHNL50_WDATA1_ADDR A:0xc920014
y.create.l HWIO_PMIC_ARB_CHNL51_WDATA1_ADDR A:0xc930014
y.create.l HWIO_PMIC_ARB_CHNL52_WDATA1_ADDR A:0xc940014
y.create.l HWIO_PMIC_ARB_CHNL53_WDATA1_ADDR A:0xc950014
y.create.l HWIO_PMIC_ARB_CHNL54_WDATA1_ADDR A:0xc960014
y.create.l HWIO_PMIC_ARB_CHNL55_WDATA1_ADDR A:0xc970014
y.create.l HWIO_PMIC_ARB_CHNL56_WDATA1_ADDR A:0xc980014
y.create.l HWIO_PMIC_ARB_CHNL57_WDATA1_ADDR A:0xc990014
y.create.l HWIO_PMIC_ARB_CHNL58_WDATA1_ADDR A:0xc9a0014
y.create.l HWIO_PMIC_ARB_CHNL59_WDATA1_ADDR A:0xc9b0014
y.create.l HWIO_PMIC_ARB_CHNL60_WDATA1_ADDR A:0xc9c0014
y.create.l HWIO_PMIC_ARB_CHNL61_WDATA1_ADDR A:0xc9d0014
y.create.l HWIO_PMIC_ARB_CHNL62_WDATA1_ADDR A:0xc9e0014
y.create.l HWIO_PMIC_ARB_CHNL63_WDATA1_ADDR A:0xc9f0014
y.create.l HWIO_PMIC_ARB_CHNL64_WDATA1_ADDR A:0xca00014
y.create.l HWIO_PMIC_ARB_CHNL65_WDATA1_ADDR A:0xca10014
y.create.l HWIO_PMIC_ARB_CHNL66_WDATA1_ADDR A:0xca20014
y.create.l HWIO_PMIC_ARB_CHNL67_WDATA1_ADDR A:0xca30014
y.create.l HWIO_PMIC_ARB_CHNL68_WDATA1_ADDR A:0xca40014
y.create.l HWIO_PMIC_ARB_CHNL69_WDATA1_ADDR A:0xca50014
y.create.l HWIO_PMIC_ARB_CHNL70_WDATA1_ADDR A:0xca60014
y.create.l HWIO_PMIC_ARB_CHNL71_WDATA1_ADDR A:0xca70014
y.create.l HWIO_PMIC_ARB_CHNL72_WDATA1_ADDR A:0xca80014
y.create.l HWIO_PMIC_ARB_CHNL73_WDATA1_ADDR A:0xca90014
y.create.l HWIO_PMIC_ARB_CHNL74_WDATA1_ADDR A:0xcaa0014
y.create.l HWIO_PMIC_ARB_CHNL75_WDATA1_ADDR A:0xcab0014
y.create.l HWIO_PMIC_ARB_CHNL76_WDATA1_ADDR A:0xcac0014
y.create.l HWIO_PMIC_ARB_CHNL77_WDATA1_ADDR A:0xcad0014
y.create.l HWIO_PMIC_ARB_CHNL78_WDATA1_ADDR A:0xcae0014
y.create.l HWIO_PMIC_ARB_CHNL79_WDATA1_ADDR A:0xcaf0014
y.create.l HWIO_PMIC_ARB_CHNL80_WDATA1_ADDR A:0xcb00014
y.create.l HWIO_PMIC_ARB_CHNL81_WDATA1_ADDR A:0xcb10014
y.create.l HWIO_PMIC_ARB_CHNL82_WDATA1_ADDR A:0xcb20014
y.create.l HWIO_PMIC_ARB_CHNL83_WDATA1_ADDR A:0xcb30014
y.create.l HWIO_PMIC_ARB_CHNL84_WDATA1_ADDR A:0xcb40014
y.create.l HWIO_PMIC_ARB_CHNL85_WDATA1_ADDR A:0xcb50014
y.create.l HWIO_PMIC_ARB_CHNL86_WDATA1_ADDR A:0xcb60014
y.create.l HWIO_PMIC_ARB_CHNL87_WDATA1_ADDR A:0xcb70014
y.create.l HWIO_PMIC_ARB_CHNL88_WDATA1_ADDR A:0xcb80014
y.create.l HWIO_PMIC_ARB_CHNL89_WDATA1_ADDR A:0xcb90014
y.create.l HWIO_PMIC_ARB_CHNL90_WDATA1_ADDR A:0xcba0014
y.create.l HWIO_PMIC_ARB_CHNL91_WDATA1_ADDR A:0xcbb0014
y.create.l HWIO_PMIC_ARB_CHNL92_WDATA1_ADDR A:0xcbc0014
y.create.l HWIO_PMIC_ARB_CHNL93_WDATA1_ADDR A:0xcbd0014
y.create.l HWIO_PMIC_ARB_CHNL94_WDATA1_ADDR A:0xcbe0014
y.create.l HWIO_PMIC_ARB_CHNL95_WDATA1_ADDR A:0xcbf0014
y.create.l HWIO_PMIC_ARB_CHNL96_WDATA1_ADDR A:0xcc00014
y.create.l HWIO_PMIC_ARB_CHNL97_WDATA1_ADDR A:0xcc10014
y.create.l HWIO_PMIC_ARB_CHNL98_WDATA1_ADDR A:0xcc20014
y.create.l HWIO_PMIC_ARB_CHNL99_WDATA1_ADDR A:0xcc30014
y.create.l HWIO_PMIC_ARB_CHNL100_WDATA1_ADDR A:0xcc40014
y.create.l HWIO_PMIC_ARB_CHNL101_WDATA1_ADDR A:0xcc50014
y.create.l HWIO_PMIC_ARB_CHNL102_WDATA1_ADDR A:0xcc60014
y.create.l HWIO_PMIC_ARB_CHNL103_WDATA1_ADDR A:0xcc70014
y.create.l HWIO_PMIC_ARB_CHNL104_WDATA1_ADDR A:0xcc80014
y.create.l HWIO_PMIC_ARB_CHNL105_WDATA1_ADDR A:0xcc90014
y.create.l HWIO_PMIC_ARB_CHNL106_WDATA1_ADDR A:0xcca0014
y.create.l HWIO_PMIC_ARB_CHNL107_WDATA1_ADDR A:0xccb0014
y.create.l HWIO_PMIC_ARB_CHNL108_WDATA1_ADDR A:0xccc0014
y.create.l HWIO_PMIC_ARB_CHNL109_WDATA1_ADDR A:0xccd0014
y.create.l HWIO_PMIC_ARB_CHNL110_WDATA1_ADDR A:0xcce0014
y.create.l HWIO_PMIC_ARB_CHNL111_WDATA1_ADDR A:0xccf0014
y.create.l HWIO_PMIC_ARB_CHNL112_WDATA1_ADDR A:0xcd00014
y.create.l HWIO_PMIC_ARB_CHNL113_WDATA1_ADDR A:0xcd10014
y.create.l HWIO_PMIC_ARB_CHNL114_WDATA1_ADDR A:0xcd20014
y.create.l HWIO_PMIC_ARB_CHNL115_WDATA1_ADDR A:0xcd30014
y.create.l HWIO_PMIC_ARB_CHNL116_WDATA1_ADDR A:0xcd40014
y.create.l HWIO_PMIC_ARB_CHNL117_WDATA1_ADDR A:0xcd50014
y.create.l HWIO_PMIC_ARB_CHNL118_WDATA1_ADDR A:0xcd60014
y.create.l HWIO_PMIC_ARB_CHNL119_WDATA1_ADDR A:0xcd70014
y.create.l HWIO_PMIC_ARB_CHNL120_WDATA1_ADDR A:0xcd80014
y.create.l HWIO_PMIC_ARB_CHNL121_WDATA1_ADDR A:0xcd90014
y.create.l HWIO_PMIC_ARB_CHNL122_WDATA1_ADDR A:0xcda0014
y.create.l HWIO_PMIC_ARB_CHNL123_WDATA1_ADDR A:0xcdb0014
y.create.l HWIO_PMIC_ARB_CHNL124_WDATA1_ADDR A:0xcdc0014
y.create.l HWIO_PMIC_ARB_CHNL125_WDATA1_ADDR A:0xcdd0014
y.create.l HWIO_PMIC_ARB_CHNL126_WDATA1_ADDR A:0xcde0014
y.create.l HWIO_PMIC_ARB_CHNL127_WDATA1_ADDR A:0xcdf0014
y.create.l HWIO_PMIC_ARB_CHNL128_WDATA1_ADDR A:0xce00014
y.create.l HWIO_PMIC_ARB_CHNL129_WDATA1_ADDR A:0xce10014
y.create.l HWIO_PMIC_ARB_CHNL130_WDATA1_ADDR A:0xce20014
y.create.l HWIO_PMIC_ARB_CHNL131_WDATA1_ADDR A:0xce30014
y.create.l HWIO_PMIC_ARB_CHNL132_WDATA1_ADDR A:0xce40014
y.create.l HWIO_PMIC_ARB_CHNL133_WDATA1_ADDR A:0xce50014
y.create.l HWIO_PMIC_ARB_CHNL134_WDATA1_ADDR A:0xce60014
y.create.l HWIO_PMIC_ARB_CHNL135_WDATA1_ADDR A:0xce70014
y.create.l HWIO_PMIC_ARB_CHNL136_WDATA1_ADDR A:0xce80014
y.create.l HWIO_PMIC_ARB_CHNL137_WDATA1_ADDR A:0xce90014
y.create.l HWIO_PMIC_ARB_CHNL138_WDATA1_ADDR A:0xcea0014
y.create.l HWIO_PMIC_ARB_CHNL139_WDATA1_ADDR A:0xceb0014
y.create.l HWIO_PMIC_ARB_CHNL140_WDATA1_ADDR A:0xcec0014
y.create.l HWIO_PMIC_ARB_CHNL141_WDATA1_ADDR A:0xced0014
y.create.l HWIO_PMIC_ARB_CHNL142_WDATA1_ADDR A:0xcee0014
y.create.l HWIO_PMIC_ARB_CHNL143_WDATA1_ADDR A:0xcef0014
y.create.l HWIO_PMIC_ARB_CHNL144_WDATA1_ADDR A:0xcf00014
y.create.l HWIO_PMIC_ARB_CHNL145_WDATA1_ADDR A:0xcf10014
y.create.l HWIO_PMIC_ARB_CHNL146_WDATA1_ADDR A:0xcf20014
y.create.l HWIO_PMIC_ARB_CHNL147_WDATA1_ADDR A:0xcf30014
y.create.l HWIO_PMIC_ARB_CHNL148_WDATA1_ADDR A:0xcf40014
y.create.l HWIO_PMIC_ARB_CHNL149_WDATA1_ADDR A:0xcf50014
y.create.l HWIO_PMIC_ARB_CHNL150_WDATA1_ADDR A:0xcf60014
y.create.l HWIO_PMIC_ARB_CHNL151_WDATA1_ADDR A:0xcf70014
y.create.l HWIO_PMIC_ARB_CHNL152_WDATA1_ADDR A:0xcf80014
y.create.l HWIO_PMIC_ARB_CHNL153_WDATA1_ADDR A:0xcf90014
y.create.l HWIO_PMIC_ARB_CHNL154_WDATA1_ADDR A:0xcfa0014
y.create.l HWIO_PMIC_ARB_CHNL155_WDATA1_ADDR A:0xcfb0014
y.create.l HWIO_PMIC_ARB_CHNL156_WDATA1_ADDR A:0xcfc0014
y.create.l HWIO_PMIC_ARB_CHNL157_WDATA1_ADDR A:0xcfd0014
y.create.l HWIO_PMIC_ARB_CHNL158_WDATA1_ADDR A:0xcfe0014
y.create.l HWIO_PMIC_ARB_CHNL159_WDATA1_ADDR A:0xcff0014
y.create.l HWIO_PMIC_ARB_CHNL160_WDATA1_ADDR A:0xd000014
y.create.l HWIO_PMIC_ARB_CHNL161_WDATA1_ADDR A:0xd010014
y.create.l HWIO_PMIC_ARB_CHNL162_WDATA1_ADDR A:0xd020014
y.create.l HWIO_PMIC_ARB_CHNL163_WDATA1_ADDR A:0xd030014
y.create.l HWIO_PMIC_ARB_CHNL164_WDATA1_ADDR A:0xd040014
y.create.l HWIO_PMIC_ARB_CHNL165_WDATA1_ADDR A:0xd050014
y.create.l HWIO_PMIC_ARB_CHNL166_WDATA1_ADDR A:0xd060014
y.create.l HWIO_PMIC_ARB_CHNL167_WDATA1_ADDR A:0xd070014
y.create.l HWIO_PMIC_ARB_CHNL168_WDATA1_ADDR A:0xd080014
y.create.l HWIO_PMIC_ARB_CHNL169_WDATA1_ADDR A:0xd090014
y.create.l HWIO_PMIC_ARB_CHNL170_WDATA1_ADDR A:0xd0a0014
y.create.l HWIO_PMIC_ARB_CHNL171_WDATA1_ADDR A:0xd0b0014
y.create.l HWIO_PMIC_ARB_CHNL172_WDATA1_ADDR A:0xd0c0014
y.create.l HWIO_PMIC_ARB_CHNL173_WDATA1_ADDR A:0xd0d0014
y.create.l HWIO_PMIC_ARB_CHNL174_WDATA1_ADDR A:0xd0e0014
y.create.l HWIO_PMIC_ARB_CHNL175_WDATA1_ADDR A:0xd0f0014
y.create.l HWIO_PMIC_ARB_CHNL176_WDATA1_ADDR A:0xd100014
y.create.l HWIO_PMIC_ARB_CHNL177_WDATA1_ADDR A:0xd110014
y.create.l HWIO_PMIC_ARB_CHNL178_WDATA1_ADDR A:0xd120014
y.create.l HWIO_PMIC_ARB_CHNL179_WDATA1_ADDR A:0xd130014
y.create.l HWIO_PMIC_ARB_CHNL180_WDATA1_ADDR A:0xd140014
y.create.l HWIO_PMIC_ARB_CHNL181_WDATA1_ADDR A:0xd150014
y.create.l HWIO_PMIC_ARB_CHNL182_WDATA1_ADDR A:0xd160014
y.create.l HWIO_PMIC_ARB_CHNL183_WDATA1_ADDR A:0xd170014
y.create.l HWIO_PMIC_ARB_CHNL184_WDATA1_ADDR A:0xd180014
y.create.l HWIO_PMIC_ARB_CHNL185_WDATA1_ADDR A:0xd190014
y.create.l HWIO_PMIC_ARB_CHNL186_WDATA1_ADDR A:0xd1a0014
y.create.l HWIO_PMIC_ARB_CHNL187_WDATA1_ADDR A:0xd1b0014
y.create.l HWIO_PMIC_ARB_CHNL188_WDATA1_ADDR A:0xd1c0014
y.create.l HWIO_PMIC_ARB_CHNL189_WDATA1_ADDR A:0xd1d0014
y.create.l HWIO_PMIC_ARB_CHNL190_WDATA1_ADDR A:0xd1e0014
y.create.l HWIO_PMIC_ARB_CHNL191_WDATA1_ADDR A:0xd1f0014
y.create.l HWIO_PMIC_ARB_CHNL192_WDATA1_ADDR A:0xd200014
y.create.l HWIO_PMIC_ARB_CHNL193_WDATA1_ADDR A:0xd210014
y.create.l HWIO_PMIC_ARB_CHNL194_WDATA1_ADDR A:0xd220014
y.create.l HWIO_PMIC_ARB_CHNL195_WDATA1_ADDR A:0xd230014
y.create.l HWIO_PMIC_ARB_CHNL196_WDATA1_ADDR A:0xd240014
y.create.l HWIO_PMIC_ARB_CHNL197_WDATA1_ADDR A:0xd250014
y.create.l HWIO_PMIC_ARB_CHNL198_WDATA1_ADDR A:0xd260014
y.create.l HWIO_PMIC_ARB_CHNL199_WDATA1_ADDR A:0xd270014
y.create.l HWIO_PMIC_ARB_CHNL200_WDATA1_ADDR A:0xd280014
y.create.l HWIO_PMIC_ARB_CHNL201_WDATA1_ADDR A:0xd290014
y.create.l HWIO_PMIC_ARB_CHNL202_WDATA1_ADDR A:0xd2a0014
y.create.l HWIO_PMIC_ARB_CHNL203_WDATA1_ADDR A:0xd2b0014
y.create.l HWIO_PMIC_ARB_CHNL204_WDATA1_ADDR A:0xd2c0014
y.create.l HWIO_PMIC_ARB_CHNL205_WDATA1_ADDR A:0xd2d0014
y.create.l HWIO_PMIC_ARB_CHNL206_WDATA1_ADDR A:0xd2e0014
y.create.l HWIO_PMIC_ARB_CHNL207_WDATA1_ADDR A:0xd2f0014
y.create.l HWIO_PMIC_ARB_CHNL208_WDATA1_ADDR A:0xd300014
y.create.l HWIO_PMIC_ARB_CHNL209_WDATA1_ADDR A:0xd310014
y.create.l HWIO_PMIC_ARB_CHNL210_WDATA1_ADDR A:0xd320014
y.create.l HWIO_PMIC_ARB_CHNL211_WDATA1_ADDR A:0xd330014
y.create.l HWIO_PMIC_ARB_CHNL212_WDATA1_ADDR A:0xd340014
y.create.l HWIO_PMIC_ARB_CHNL213_WDATA1_ADDR A:0xd350014
y.create.l HWIO_PMIC_ARB_CHNL214_WDATA1_ADDR A:0xd360014
y.create.l HWIO_PMIC_ARB_CHNL215_WDATA1_ADDR A:0xd370014
y.create.l HWIO_PMIC_ARB_CHNL216_WDATA1_ADDR A:0xd380014
y.create.l HWIO_PMIC_ARB_CHNL217_WDATA1_ADDR A:0xd390014
y.create.l HWIO_PMIC_ARB_CHNL218_WDATA1_ADDR A:0xd3a0014
y.create.l HWIO_PMIC_ARB_CHNL219_WDATA1_ADDR A:0xd3b0014
y.create.l HWIO_PMIC_ARB_CHNL220_WDATA1_ADDR A:0xd3c0014
y.create.l HWIO_PMIC_ARB_CHNL221_WDATA1_ADDR A:0xd3d0014
y.create.l HWIO_PMIC_ARB_CHNL222_WDATA1_ADDR A:0xd3e0014
y.create.l HWIO_PMIC_ARB_CHNL223_WDATA1_ADDR A:0xd3f0014
y.create.l HWIO_PMIC_ARB_CHNL224_WDATA1_ADDR A:0xd400014
y.create.l HWIO_PMIC_ARB_CHNL225_WDATA1_ADDR A:0xd410014
y.create.l HWIO_PMIC_ARB_CHNL226_WDATA1_ADDR A:0xd420014
y.create.l HWIO_PMIC_ARB_CHNL227_WDATA1_ADDR A:0xd430014
y.create.l HWIO_PMIC_ARB_CHNL228_WDATA1_ADDR A:0xd440014
y.create.l HWIO_PMIC_ARB_CHNL229_WDATA1_ADDR A:0xd450014
y.create.l HWIO_PMIC_ARB_CHNL230_WDATA1_ADDR A:0xd460014
y.create.l HWIO_PMIC_ARB_CHNL231_WDATA1_ADDR A:0xd470014
y.create.l HWIO_PMIC_ARB_CHNL232_WDATA1_ADDR A:0xd480014
y.create.l HWIO_PMIC_ARB_CHNL233_WDATA1_ADDR A:0xd490014
y.create.l HWIO_PMIC_ARB_CHNL234_WDATA1_ADDR A:0xd4a0014
y.create.l HWIO_PMIC_ARB_CHNL235_WDATA1_ADDR A:0xd4b0014
y.create.l HWIO_PMIC_ARB_CHNL236_WDATA1_ADDR A:0xd4c0014
y.create.l HWIO_PMIC_ARB_CHNL237_WDATA1_ADDR A:0xd4d0014
y.create.l HWIO_PMIC_ARB_CHNL238_WDATA1_ADDR A:0xd4e0014
y.create.l HWIO_PMIC_ARB_CHNL239_WDATA1_ADDR A:0xd4f0014
y.create.l HWIO_PMIC_ARB_CHNL240_WDATA1_ADDR A:0xd500014
y.create.l HWIO_PMIC_ARB_CHNL241_WDATA1_ADDR A:0xd510014
y.create.l HWIO_PMIC_ARB_CHNL242_WDATA1_ADDR A:0xd520014
y.create.l HWIO_PMIC_ARB_CHNL243_WDATA1_ADDR A:0xd530014
y.create.l HWIO_PMIC_ARB_CHNL244_WDATA1_ADDR A:0xd540014
y.create.l HWIO_PMIC_ARB_CHNL245_WDATA1_ADDR A:0xd550014
y.create.l HWIO_PMIC_ARB_CHNL246_WDATA1_ADDR A:0xd560014
y.create.l HWIO_PMIC_ARB_CHNL247_WDATA1_ADDR A:0xd570014
y.create.l HWIO_PMIC_ARB_CHNL248_WDATA1_ADDR A:0xd580014
y.create.l HWIO_PMIC_ARB_CHNL249_WDATA1_ADDR A:0xd590014
y.create.l HWIO_PMIC_ARB_CHNL250_WDATA1_ADDR A:0xd5a0014
y.create.l HWIO_PMIC_ARB_CHNL251_WDATA1_ADDR A:0xd5b0014
y.create.l HWIO_PMIC_ARB_CHNL252_WDATA1_ADDR A:0xd5c0014
y.create.l HWIO_PMIC_ARB_CHNL253_WDATA1_ADDR A:0xd5d0014
y.create.l HWIO_PMIC_ARB_CHNL254_WDATA1_ADDR A:0xd5e0014
y.create.l HWIO_PMIC_ARB_CHNL255_WDATA1_ADDR A:0xd5f0014
y.create.l HWIO_PMIC_ARB_CHNL0_RDATA0_ADDR A:0xc600018
y.create.l HWIO_PMIC_ARB_CHNL1_RDATA0_ADDR A:0xc610018
y.create.l HWIO_PMIC_ARB_CHNL2_RDATA0_ADDR A:0xc620018
y.create.l HWIO_PMIC_ARB_CHNL3_RDATA0_ADDR A:0xc630018
y.create.l HWIO_PMIC_ARB_CHNL4_RDATA0_ADDR A:0xc640018
y.create.l HWIO_PMIC_ARB_CHNL5_RDATA0_ADDR A:0xc650018
y.create.l HWIO_PMIC_ARB_CHNL6_RDATA0_ADDR A:0xc660018
y.create.l HWIO_PMIC_ARB_CHNL7_RDATA0_ADDR A:0xc670018
y.create.l HWIO_PMIC_ARB_CHNL8_RDATA0_ADDR A:0xc680018
y.create.l HWIO_PMIC_ARB_CHNL9_RDATA0_ADDR A:0xc690018
y.create.l HWIO_PMIC_ARB_CHNL10_RDATA0_ADDR A:0xc6a0018
y.create.l HWIO_PMIC_ARB_CHNL11_RDATA0_ADDR A:0xc6b0018
y.create.l HWIO_PMIC_ARB_CHNL12_RDATA0_ADDR A:0xc6c0018
y.create.l HWIO_PMIC_ARB_CHNL13_RDATA0_ADDR A:0xc6d0018
y.create.l HWIO_PMIC_ARB_CHNL14_RDATA0_ADDR A:0xc6e0018
y.create.l HWIO_PMIC_ARB_CHNL15_RDATA0_ADDR A:0xc6f0018
y.create.l HWIO_PMIC_ARB_CHNL16_RDATA0_ADDR A:0xc700018
y.create.l HWIO_PMIC_ARB_CHNL17_RDATA0_ADDR A:0xc710018
y.create.l HWIO_PMIC_ARB_CHNL18_RDATA0_ADDR A:0xc720018
y.create.l HWIO_PMIC_ARB_CHNL19_RDATA0_ADDR A:0xc730018
y.create.l HWIO_PMIC_ARB_CHNL20_RDATA0_ADDR A:0xc740018
y.create.l HWIO_PMIC_ARB_CHNL21_RDATA0_ADDR A:0xc750018
y.create.l HWIO_PMIC_ARB_CHNL22_RDATA0_ADDR A:0xc760018
y.create.l HWIO_PMIC_ARB_CHNL23_RDATA0_ADDR A:0xc770018
y.create.l HWIO_PMIC_ARB_CHNL24_RDATA0_ADDR A:0xc780018
y.create.l HWIO_PMIC_ARB_CHNL25_RDATA0_ADDR A:0xc790018
y.create.l HWIO_PMIC_ARB_CHNL26_RDATA0_ADDR A:0xc7a0018
y.create.l HWIO_PMIC_ARB_CHNL27_RDATA0_ADDR A:0xc7b0018
y.create.l HWIO_PMIC_ARB_CHNL28_RDATA0_ADDR A:0xc7c0018
y.create.l HWIO_PMIC_ARB_CHNL29_RDATA0_ADDR A:0xc7d0018
y.create.l HWIO_PMIC_ARB_CHNL30_RDATA0_ADDR A:0xc7e0018
y.create.l HWIO_PMIC_ARB_CHNL31_RDATA0_ADDR A:0xc7f0018
y.create.l HWIO_PMIC_ARB_CHNL32_RDATA0_ADDR A:0xc800018
y.create.l HWIO_PMIC_ARB_CHNL33_RDATA0_ADDR A:0xc810018
y.create.l HWIO_PMIC_ARB_CHNL34_RDATA0_ADDR A:0xc820018
y.create.l HWIO_PMIC_ARB_CHNL35_RDATA0_ADDR A:0xc830018
y.create.l HWIO_PMIC_ARB_CHNL36_RDATA0_ADDR A:0xc840018
y.create.l HWIO_PMIC_ARB_CHNL37_RDATA0_ADDR A:0xc850018
y.create.l HWIO_PMIC_ARB_CHNL38_RDATA0_ADDR A:0xc860018
y.create.l HWIO_PMIC_ARB_CHNL39_RDATA0_ADDR A:0xc870018
y.create.l HWIO_PMIC_ARB_CHNL40_RDATA0_ADDR A:0xc880018
y.create.l HWIO_PMIC_ARB_CHNL41_RDATA0_ADDR A:0xc890018
y.create.l HWIO_PMIC_ARB_CHNL42_RDATA0_ADDR A:0xc8a0018
y.create.l HWIO_PMIC_ARB_CHNL43_RDATA0_ADDR A:0xc8b0018
y.create.l HWIO_PMIC_ARB_CHNL44_RDATA0_ADDR A:0xc8c0018
y.create.l HWIO_PMIC_ARB_CHNL45_RDATA0_ADDR A:0xc8d0018
y.create.l HWIO_PMIC_ARB_CHNL46_RDATA0_ADDR A:0xc8e0018
y.create.l HWIO_PMIC_ARB_CHNL47_RDATA0_ADDR A:0xc8f0018
y.create.l HWIO_PMIC_ARB_CHNL48_RDATA0_ADDR A:0xc900018
y.create.l HWIO_PMIC_ARB_CHNL49_RDATA0_ADDR A:0xc910018
y.create.l HWIO_PMIC_ARB_CHNL50_RDATA0_ADDR A:0xc920018
y.create.l HWIO_PMIC_ARB_CHNL51_RDATA0_ADDR A:0xc930018
y.create.l HWIO_PMIC_ARB_CHNL52_RDATA0_ADDR A:0xc940018
y.create.l HWIO_PMIC_ARB_CHNL53_RDATA0_ADDR A:0xc950018
y.create.l HWIO_PMIC_ARB_CHNL54_RDATA0_ADDR A:0xc960018
y.create.l HWIO_PMIC_ARB_CHNL55_RDATA0_ADDR A:0xc970018
y.create.l HWIO_PMIC_ARB_CHNL56_RDATA0_ADDR A:0xc980018
y.create.l HWIO_PMIC_ARB_CHNL57_RDATA0_ADDR A:0xc990018
y.create.l HWIO_PMIC_ARB_CHNL58_RDATA0_ADDR A:0xc9a0018
y.create.l HWIO_PMIC_ARB_CHNL59_RDATA0_ADDR A:0xc9b0018
y.create.l HWIO_PMIC_ARB_CHNL60_RDATA0_ADDR A:0xc9c0018
y.create.l HWIO_PMIC_ARB_CHNL61_RDATA0_ADDR A:0xc9d0018
y.create.l HWIO_PMIC_ARB_CHNL62_RDATA0_ADDR A:0xc9e0018
y.create.l HWIO_PMIC_ARB_CHNL63_RDATA0_ADDR A:0xc9f0018
y.create.l HWIO_PMIC_ARB_CHNL64_RDATA0_ADDR A:0xca00018
y.create.l HWIO_PMIC_ARB_CHNL65_RDATA0_ADDR A:0xca10018
y.create.l HWIO_PMIC_ARB_CHNL66_RDATA0_ADDR A:0xca20018
y.create.l HWIO_PMIC_ARB_CHNL67_RDATA0_ADDR A:0xca30018
y.create.l HWIO_PMIC_ARB_CHNL68_RDATA0_ADDR A:0xca40018
y.create.l HWIO_PMIC_ARB_CHNL69_RDATA0_ADDR A:0xca50018
y.create.l HWIO_PMIC_ARB_CHNL70_RDATA0_ADDR A:0xca60018
y.create.l HWIO_PMIC_ARB_CHNL71_RDATA0_ADDR A:0xca70018
y.create.l HWIO_PMIC_ARB_CHNL72_RDATA0_ADDR A:0xca80018
y.create.l HWIO_PMIC_ARB_CHNL73_RDATA0_ADDR A:0xca90018
y.create.l HWIO_PMIC_ARB_CHNL74_RDATA0_ADDR A:0xcaa0018
y.create.l HWIO_PMIC_ARB_CHNL75_RDATA0_ADDR A:0xcab0018
y.create.l HWIO_PMIC_ARB_CHNL76_RDATA0_ADDR A:0xcac0018
y.create.l HWIO_PMIC_ARB_CHNL77_RDATA0_ADDR A:0xcad0018
y.create.l HWIO_PMIC_ARB_CHNL78_RDATA0_ADDR A:0xcae0018
y.create.l HWIO_PMIC_ARB_CHNL79_RDATA0_ADDR A:0xcaf0018
y.create.l HWIO_PMIC_ARB_CHNL80_RDATA0_ADDR A:0xcb00018
y.create.l HWIO_PMIC_ARB_CHNL81_RDATA0_ADDR A:0xcb10018
y.create.l HWIO_PMIC_ARB_CHNL82_RDATA0_ADDR A:0xcb20018
y.create.l HWIO_PMIC_ARB_CHNL83_RDATA0_ADDR A:0xcb30018
y.create.l HWIO_PMIC_ARB_CHNL84_RDATA0_ADDR A:0xcb40018
y.create.l HWIO_PMIC_ARB_CHNL85_RDATA0_ADDR A:0xcb50018
y.create.l HWIO_PMIC_ARB_CHNL86_RDATA0_ADDR A:0xcb60018
y.create.l HWIO_PMIC_ARB_CHNL87_RDATA0_ADDR A:0xcb70018
y.create.l HWIO_PMIC_ARB_CHNL88_RDATA0_ADDR A:0xcb80018
y.create.l HWIO_PMIC_ARB_CHNL89_RDATA0_ADDR A:0xcb90018
y.create.l HWIO_PMIC_ARB_CHNL90_RDATA0_ADDR A:0xcba0018
y.create.l HWIO_PMIC_ARB_CHNL91_RDATA0_ADDR A:0xcbb0018
y.create.l HWIO_PMIC_ARB_CHNL92_RDATA0_ADDR A:0xcbc0018
y.create.l HWIO_PMIC_ARB_CHNL93_RDATA0_ADDR A:0xcbd0018
y.create.l HWIO_PMIC_ARB_CHNL94_RDATA0_ADDR A:0xcbe0018
y.create.l HWIO_PMIC_ARB_CHNL95_RDATA0_ADDR A:0xcbf0018
y.create.l HWIO_PMIC_ARB_CHNL96_RDATA0_ADDR A:0xcc00018
y.create.l HWIO_PMIC_ARB_CHNL97_RDATA0_ADDR A:0xcc10018
y.create.l HWIO_PMIC_ARB_CHNL98_RDATA0_ADDR A:0xcc20018
y.create.l HWIO_PMIC_ARB_CHNL99_RDATA0_ADDR A:0xcc30018
y.create.l HWIO_PMIC_ARB_CHNL100_RDATA0_ADDR A:0xcc40018
y.create.l HWIO_PMIC_ARB_CHNL101_RDATA0_ADDR A:0xcc50018
y.create.l HWIO_PMIC_ARB_CHNL102_RDATA0_ADDR A:0xcc60018
y.create.l HWIO_PMIC_ARB_CHNL103_RDATA0_ADDR A:0xcc70018
y.create.l HWIO_PMIC_ARB_CHNL104_RDATA0_ADDR A:0xcc80018
y.create.l HWIO_PMIC_ARB_CHNL105_RDATA0_ADDR A:0xcc90018
y.create.l HWIO_PMIC_ARB_CHNL106_RDATA0_ADDR A:0xcca0018
y.create.l HWIO_PMIC_ARB_CHNL107_RDATA0_ADDR A:0xccb0018
y.create.l HWIO_PMIC_ARB_CHNL108_RDATA0_ADDR A:0xccc0018
y.create.l HWIO_PMIC_ARB_CHNL109_RDATA0_ADDR A:0xccd0018
y.create.l HWIO_PMIC_ARB_CHNL110_RDATA0_ADDR A:0xcce0018
y.create.l HWIO_PMIC_ARB_CHNL111_RDATA0_ADDR A:0xccf0018
y.create.l HWIO_PMIC_ARB_CHNL112_RDATA0_ADDR A:0xcd00018
y.create.l HWIO_PMIC_ARB_CHNL113_RDATA0_ADDR A:0xcd10018
y.create.l HWIO_PMIC_ARB_CHNL114_RDATA0_ADDR A:0xcd20018
y.create.l HWIO_PMIC_ARB_CHNL115_RDATA0_ADDR A:0xcd30018
y.create.l HWIO_PMIC_ARB_CHNL116_RDATA0_ADDR A:0xcd40018
y.create.l HWIO_PMIC_ARB_CHNL117_RDATA0_ADDR A:0xcd50018
y.create.l HWIO_PMIC_ARB_CHNL118_RDATA0_ADDR A:0xcd60018
y.create.l HWIO_PMIC_ARB_CHNL119_RDATA0_ADDR A:0xcd70018
y.create.l HWIO_PMIC_ARB_CHNL120_RDATA0_ADDR A:0xcd80018
y.create.l HWIO_PMIC_ARB_CHNL121_RDATA0_ADDR A:0xcd90018
y.create.l HWIO_PMIC_ARB_CHNL122_RDATA0_ADDR A:0xcda0018
y.create.l HWIO_PMIC_ARB_CHNL123_RDATA0_ADDR A:0xcdb0018
y.create.l HWIO_PMIC_ARB_CHNL124_RDATA0_ADDR A:0xcdc0018
y.create.l HWIO_PMIC_ARB_CHNL125_RDATA0_ADDR A:0xcdd0018
y.create.l HWIO_PMIC_ARB_CHNL126_RDATA0_ADDR A:0xcde0018
y.create.l HWIO_PMIC_ARB_CHNL127_RDATA0_ADDR A:0xcdf0018
y.create.l HWIO_PMIC_ARB_CHNL128_RDATA0_ADDR A:0xce00018
y.create.l HWIO_PMIC_ARB_CHNL129_RDATA0_ADDR A:0xce10018
y.create.l HWIO_PMIC_ARB_CHNL130_RDATA0_ADDR A:0xce20018
y.create.l HWIO_PMIC_ARB_CHNL131_RDATA0_ADDR A:0xce30018
y.create.l HWIO_PMIC_ARB_CHNL132_RDATA0_ADDR A:0xce40018
y.create.l HWIO_PMIC_ARB_CHNL133_RDATA0_ADDR A:0xce50018
y.create.l HWIO_PMIC_ARB_CHNL134_RDATA0_ADDR A:0xce60018
y.create.l HWIO_PMIC_ARB_CHNL135_RDATA0_ADDR A:0xce70018
y.create.l HWIO_PMIC_ARB_CHNL136_RDATA0_ADDR A:0xce80018
y.create.l HWIO_PMIC_ARB_CHNL137_RDATA0_ADDR A:0xce90018
y.create.l HWIO_PMIC_ARB_CHNL138_RDATA0_ADDR A:0xcea0018
y.create.l HWIO_PMIC_ARB_CHNL139_RDATA0_ADDR A:0xceb0018
y.create.l HWIO_PMIC_ARB_CHNL140_RDATA0_ADDR A:0xcec0018
y.create.l HWIO_PMIC_ARB_CHNL141_RDATA0_ADDR A:0xced0018
y.create.l HWIO_PMIC_ARB_CHNL142_RDATA0_ADDR A:0xcee0018
y.create.l HWIO_PMIC_ARB_CHNL143_RDATA0_ADDR A:0xcef0018
y.create.l HWIO_PMIC_ARB_CHNL144_RDATA0_ADDR A:0xcf00018
y.create.l HWIO_PMIC_ARB_CHNL145_RDATA0_ADDR A:0xcf10018
y.create.l HWIO_PMIC_ARB_CHNL146_RDATA0_ADDR A:0xcf20018
y.create.l HWIO_PMIC_ARB_CHNL147_RDATA0_ADDR A:0xcf30018
y.create.l HWIO_PMIC_ARB_CHNL148_RDATA0_ADDR A:0xcf40018
y.create.l HWIO_PMIC_ARB_CHNL149_RDATA0_ADDR A:0xcf50018
y.create.l HWIO_PMIC_ARB_CHNL150_RDATA0_ADDR A:0xcf60018
y.create.l HWIO_PMIC_ARB_CHNL151_RDATA0_ADDR A:0xcf70018
y.create.l HWIO_PMIC_ARB_CHNL152_RDATA0_ADDR A:0xcf80018
y.create.l HWIO_PMIC_ARB_CHNL153_RDATA0_ADDR A:0xcf90018
y.create.l HWIO_PMIC_ARB_CHNL154_RDATA0_ADDR A:0xcfa0018
y.create.l HWIO_PMIC_ARB_CHNL155_RDATA0_ADDR A:0xcfb0018
y.create.l HWIO_PMIC_ARB_CHNL156_RDATA0_ADDR A:0xcfc0018
y.create.l HWIO_PMIC_ARB_CHNL157_RDATA0_ADDR A:0xcfd0018
y.create.l HWIO_PMIC_ARB_CHNL158_RDATA0_ADDR A:0xcfe0018
y.create.l HWIO_PMIC_ARB_CHNL159_RDATA0_ADDR A:0xcff0018
y.create.l HWIO_PMIC_ARB_CHNL160_RDATA0_ADDR A:0xd000018
y.create.l HWIO_PMIC_ARB_CHNL161_RDATA0_ADDR A:0xd010018
y.create.l HWIO_PMIC_ARB_CHNL162_RDATA0_ADDR A:0xd020018
y.create.l HWIO_PMIC_ARB_CHNL163_RDATA0_ADDR A:0xd030018
y.create.l HWIO_PMIC_ARB_CHNL164_RDATA0_ADDR A:0xd040018
y.create.l HWIO_PMIC_ARB_CHNL165_RDATA0_ADDR A:0xd050018
y.create.l HWIO_PMIC_ARB_CHNL166_RDATA0_ADDR A:0xd060018
y.create.l HWIO_PMIC_ARB_CHNL167_RDATA0_ADDR A:0xd070018
y.create.l HWIO_PMIC_ARB_CHNL168_RDATA0_ADDR A:0xd080018
y.create.l HWIO_PMIC_ARB_CHNL169_RDATA0_ADDR A:0xd090018
y.create.l HWIO_PMIC_ARB_CHNL170_RDATA0_ADDR A:0xd0a0018
y.create.l HWIO_PMIC_ARB_CHNL171_RDATA0_ADDR A:0xd0b0018
y.create.l HWIO_PMIC_ARB_CHNL172_RDATA0_ADDR A:0xd0c0018
y.create.l HWIO_PMIC_ARB_CHNL173_RDATA0_ADDR A:0xd0d0018
y.create.l HWIO_PMIC_ARB_CHNL174_RDATA0_ADDR A:0xd0e0018
y.create.l HWIO_PMIC_ARB_CHNL175_RDATA0_ADDR A:0xd0f0018
y.create.l HWIO_PMIC_ARB_CHNL176_RDATA0_ADDR A:0xd100018
y.create.l HWIO_PMIC_ARB_CHNL177_RDATA0_ADDR A:0xd110018
y.create.l HWIO_PMIC_ARB_CHNL178_RDATA0_ADDR A:0xd120018
y.create.l HWIO_PMIC_ARB_CHNL179_RDATA0_ADDR A:0xd130018
y.create.l HWIO_PMIC_ARB_CHNL180_RDATA0_ADDR A:0xd140018
y.create.l HWIO_PMIC_ARB_CHNL181_RDATA0_ADDR A:0xd150018
y.create.l HWIO_PMIC_ARB_CHNL182_RDATA0_ADDR A:0xd160018
y.create.l HWIO_PMIC_ARB_CHNL183_RDATA0_ADDR A:0xd170018
y.create.l HWIO_PMIC_ARB_CHNL184_RDATA0_ADDR A:0xd180018
y.create.l HWIO_PMIC_ARB_CHNL185_RDATA0_ADDR A:0xd190018
y.create.l HWIO_PMIC_ARB_CHNL186_RDATA0_ADDR A:0xd1a0018
y.create.l HWIO_PMIC_ARB_CHNL187_RDATA0_ADDR A:0xd1b0018
y.create.l HWIO_PMIC_ARB_CHNL188_RDATA0_ADDR A:0xd1c0018
y.create.l HWIO_PMIC_ARB_CHNL189_RDATA0_ADDR A:0xd1d0018
y.create.l HWIO_PMIC_ARB_CHNL190_RDATA0_ADDR A:0xd1e0018
y.create.l HWIO_PMIC_ARB_CHNL191_RDATA0_ADDR A:0xd1f0018
y.create.l HWIO_PMIC_ARB_CHNL192_RDATA0_ADDR A:0xd200018
y.create.l HWIO_PMIC_ARB_CHNL193_RDATA0_ADDR A:0xd210018
y.create.l HWIO_PMIC_ARB_CHNL194_RDATA0_ADDR A:0xd220018
y.create.l HWIO_PMIC_ARB_CHNL195_RDATA0_ADDR A:0xd230018
y.create.l HWIO_PMIC_ARB_CHNL196_RDATA0_ADDR A:0xd240018
y.create.l HWIO_PMIC_ARB_CHNL197_RDATA0_ADDR A:0xd250018
y.create.l HWIO_PMIC_ARB_CHNL198_RDATA0_ADDR A:0xd260018
y.create.l HWIO_PMIC_ARB_CHNL199_RDATA0_ADDR A:0xd270018
y.create.l HWIO_PMIC_ARB_CHNL200_RDATA0_ADDR A:0xd280018
y.create.l HWIO_PMIC_ARB_CHNL201_RDATA0_ADDR A:0xd290018
y.create.l HWIO_PMIC_ARB_CHNL202_RDATA0_ADDR A:0xd2a0018
y.create.l HWIO_PMIC_ARB_CHNL203_RDATA0_ADDR A:0xd2b0018
y.create.l HWIO_PMIC_ARB_CHNL204_RDATA0_ADDR A:0xd2c0018
y.create.l HWIO_PMIC_ARB_CHNL205_RDATA0_ADDR A:0xd2d0018
y.create.l HWIO_PMIC_ARB_CHNL206_RDATA0_ADDR A:0xd2e0018
y.create.l HWIO_PMIC_ARB_CHNL207_RDATA0_ADDR A:0xd2f0018
y.create.l HWIO_PMIC_ARB_CHNL208_RDATA0_ADDR A:0xd300018
y.create.l HWIO_PMIC_ARB_CHNL209_RDATA0_ADDR A:0xd310018
y.create.l HWIO_PMIC_ARB_CHNL210_RDATA0_ADDR A:0xd320018
y.create.l HWIO_PMIC_ARB_CHNL211_RDATA0_ADDR A:0xd330018
y.create.l HWIO_PMIC_ARB_CHNL212_RDATA0_ADDR A:0xd340018
y.create.l HWIO_PMIC_ARB_CHNL213_RDATA0_ADDR A:0xd350018
y.create.l HWIO_PMIC_ARB_CHNL214_RDATA0_ADDR A:0xd360018
y.create.l HWIO_PMIC_ARB_CHNL215_RDATA0_ADDR A:0xd370018
y.create.l HWIO_PMIC_ARB_CHNL216_RDATA0_ADDR A:0xd380018
y.create.l HWIO_PMIC_ARB_CHNL217_RDATA0_ADDR A:0xd390018
y.create.l HWIO_PMIC_ARB_CHNL218_RDATA0_ADDR A:0xd3a0018
y.create.l HWIO_PMIC_ARB_CHNL219_RDATA0_ADDR A:0xd3b0018
y.create.l HWIO_PMIC_ARB_CHNL220_RDATA0_ADDR A:0xd3c0018
y.create.l HWIO_PMIC_ARB_CHNL221_RDATA0_ADDR A:0xd3d0018
y.create.l HWIO_PMIC_ARB_CHNL222_RDATA0_ADDR A:0xd3e0018
y.create.l HWIO_PMIC_ARB_CHNL223_RDATA0_ADDR A:0xd3f0018
y.create.l HWIO_PMIC_ARB_CHNL224_RDATA0_ADDR A:0xd400018
y.create.l HWIO_PMIC_ARB_CHNL225_RDATA0_ADDR A:0xd410018
y.create.l HWIO_PMIC_ARB_CHNL226_RDATA0_ADDR A:0xd420018
y.create.l HWIO_PMIC_ARB_CHNL227_RDATA0_ADDR A:0xd430018
y.create.l HWIO_PMIC_ARB_CHNL228_RDATA0_ADDR A:0xd440018
y.create.l HWIO_PMIC_ARB_CHNL229_RDATA0_ADDR A:0xd450018
y.create.l HWIO_PMIC_ARB_CHNL230_RDATA0_ADDR A:0xd460018
y.create.l HWIO_PMIC_ARB_CHNL231_RDATA0_ADDR A:0xd470018
y.create.l HWIO_PMIC_ARB_CHNL232_RDATA0_ADDR A:0xd480018
y.create.l HWIO_PMIC_ARB_CHNL233_RDATA0_ADDR A:0xd490018
y.create.l HWIO_PMIC_ARB_CHNL234_RDATA0_ADDR A:0xd4a0018
y.create.l HWIO_PMIC_ARB_CHNL235_RDATA0_ADDR A:0xd4b0018
y.create.l HWIO_PMIC_ARB_CHNL236_RDATA0_ADDR A:0xd4c0018
y.create.l HWIO_PMIC_ARB_CHNL237_RDATA0_ADDR A:0xd4d0018
y.create.l HWIO_PMIC_ARB_CHNL238_RDATA0_ADDR A:0xd4e0018
y.create.l HWIO_PMIC_ARB_CHNL239_RDATA0_ADDR A:0xd4f0018
y.create.l HWIO_PMIC_ARB_CHNL240_RDATA0_ADDR A:0xd500018
y.create.l HWIO_PMIC_ARB_CHNL241_RDATA0_ADDR A:0xd510018
y.create.l HWIO_PMIC_ARB_CHNL242_RDATA0_ADDR A:0xd520018
y.create.l HWIO_PMIC_ARB_CHNL243_RDATA0_ADDR A:0xd530018
y.create.l HWIO_PMIC_ARB_CHNL244_RDATA0_ADDR A:0xd540018
y.create.l HWIO_PMIC_ARB_CHNL245_RDATA0_ADDR A:0xd550018
y.create.l HWIO_PMIC_ARB_CHNL246_RDATA0_ADDR A:0xd560018
y.create.l HWIO_PMIC_ARB_CHNL247_RDATA0_ADDR A:0xd570018
y.create.l HWIO_PMIC_ARB_CHNL248_RDATA0_ADDR A:0xd580018
y.create.l HWIO_PMIC_ARB_CHNL249_RDATA0_ADDR A:0xd590018
y.create.l HWIO_PMIC_ARB_CHNL250_RDATA0_ADDR A:0xd5a0018
y.create.l HWIO_PMIC_ARB_CHNL251_RDATA0_ADDR A:0xd5b0018
y.create.l HWIO_PMIC_ARB_CHNL252_RDATA0_ADDR A:0xd5c0018
y.create.l HWIO_PMIC_ARB_CHNL253_RDATA0_ADDR A:0xd5d0018
y.create.l HWIO_PMIC_ARB_CHNL254_RDATA0_ADDR A:0xd5e0018
y.create.l HWIO_PMIC_ARB_CHNL255_RDATA0_ADDR A:0xd5f0018
y.create.l HWIO_PMIC_ARB_CHNL0_RDATA1_ADDR A:0xc60001c
y.create.l HWIO_PMIC_ARB_CHNL1_RDATA1_ADDR A:0xc61001c
y.create.l HWIO_PMIC_ARB_CHNL2_RDATA1_ADDR A:0xc62001c
y.create.l HWIO_PMIC_ARB_CHNL3_RDATA1_ADDR A:0xc63001c
y.create.l HWIO_PMIC_ARB_CHNL4_RDATA1_ADDR A:0xc64001c
y.create.l HWIO_PMIC_ARB_CHNL5_RDATA1_ADDR A:0xc65001c
y.create.l HWIO_PMIC_ARB_CHNL6_RDATA1_ADDR A:0xc66001c
y.create.l HWIO_PMIC_ARB_CHNL7_RDATA1_ADDR A:0xc67001c
y.create.l HWIO_PMIC_ARB_CHNL8_RDATA1_ADDR A:0xc68001c
y.create.l HWIO_PMIC_ARB_CHNL9_RDATA1_ADDR A:0xc69001c
y.create.l HWIO_PMIC_ARB_CHNL10_RDATA1_ADDR A:0xc6a001c
y.create.l HWIO_PMIC_ARB_CHNL11_RDATA1_ADDR A:0xc6b001c
y.create.l HWIO_PMIC_ARB_CHNL12_RDATA1_ADDR A:0xc6c001c
y.create.l HWIO_PMIC_ARB_CHNL13_RDATA1_ADDR A:0xc6d001c
y.create.l HWIO_PMIC_ARB_CHNL14_RDATA1_ADDR A:0xc6e001c
y.create.l HWIO_PMIC_ARB_CHNL15_RDATA1_ADDR A:0xc6f001c
y.create.l HWIO_PMIC_ARB_CHNL16_RDATA1_ADDR A:0xc70001c
y.create.l HWIO_PMIC_ARB_CHNL17_RDATA1_ADDR A:0xc71001c
y.create.l HWIO_PMIC_ARB_CHNL18_RDATA1_ADDR A:0xc72001c
y.create.l HWIO_PMIC_ARB_CHNL19_RDATA1_ADDR A:0xc73001c
y.create.l HWIO_PMIC_ARB_CHNL20_RDATA1_ADDR A:0xc74001c
y.create.l HWIO_PMIC_ARB_CHNL21_RDATA1_ADDR A:0xc75001c
y.create.l HWIO_PMIC_ARB_CHNL22_RDATA1_ADDR A:0xc76001c
y.create.l HWIO_PMIC_ARB_CHNL23_RDATA1_ADDR A:0xc77001c
y.create.l HWIO_PMIC_ARB_CHNL24_RDATA1_ADDR A:0xc78001c
y.create.l HWIO_PMIC_ARB_CHNL25_RDATA1_ADDR A:0xc79001c
y.create.l HWIO_PMIC_ARB_CHNL26_RDATA1_ADDR A:0xc7a001c
y.create.l HWIO_PMIC_ARB_CHNL27_RDATA1_ADDR A:0xc7b001c
y.create.l HWIO_PMIC_ARB_CHNL28_RDATA1_ADDR A:0xc7c001c
y.create.l HWIO_PMIC_ARB_CHNL29_RDATA1_ADDR A:0xc7d001c
y.create.l HWIO_PMIC_ARB_CHNL30_RDATA1_ADDR A:0xc7e001c
y.create.l HWIO_PMIC_ARB_CHNL31_RDATA1_ADDR A:0xc7f001c
y.create.l HWIO_PMIC_ARB_CHNL32_RDATA1_ADDR A:0xc80001c
y.create.l HWIO_PMIC_ARB_CHNL33_RDATA1_ADDR A:0xc81001c
y.create.l HWIO_PMIC_ARB_CHNL34_RDATA1_ADDR A:0xc82001c
y.create.l HWIO_PMIC_ARB_CHNL35_RDATA1_ADDR A:0xc83001c
y.create.l HWIO_PMIC_ARB_CHNL36_RDATA1_ADDR A:0xc84001c
y.create.l HWIO_PMIC_ARB_CHNL37_RDATA1_ADDR A:0xc85001c
y.create.l HWIO_PMIC_ARB_CHNL38_RDATA1_ADDR A:0xc86001c
y.create.l HWIO_PMIC_ARB_CHNL39_RDATA1_ADDR A:0xc87001c
y.create.l HWIO_PMIC_ARB_CHNL40_RDATA1_ADDR A:0xc88001c
y.create.l HWIO_PMIC_ARB_CHNL41_RDATA1_ADDR A:0xc89001c
y.create.l HWIO_PMIC_ARB_CHNL42_RDATA1_ADDR A:0xc8a001c
y.create.l HWIO_PMIC_ARB_CHNL43_RDATA1_ADDR A:0xc8b001c
y.create.l HWIO_PMIC_ARB_CHNL44_RDATA1_ADDR A:0xc8c001c
y.create.l HWIO_PMIC_ARB_CHNL45_RDATA1_ADDR A:0xc8d001c
y.create.l HWIO_PMIC_ARB_CHNL46_RDATA1_ADDR A:0xc8e001c
y.create.l HWIO_PMIC_ARB_CHNL47_RDATA1_ADDR A:0xc8f001c
y.create.l HWIO_PMIC_ARB_CHNL48_RDATA1_ADDR A:0xc90001c
y.create.l HWIO_PMIC_ARB_CHNL49_RDATA1_ADDR A:0xc91001c
y.create.l HWIO_PMIC_ARB_CHNL50_RDATA1_ADDR A:0xc92001c
y.create.l HWIO_PMIC_ARB_CHNL51_RDATA1_ADDR A:0xc93001c
y.create.l HWIO_PMIC_ARB_CHNL52_RDATA1_ADDR A:0xc94001c
y.create.l HWIO_PMIC_ARB_CHNL53_RDATA1_ADDR A:0xc95001c
y.create.l HWIO_PMIC_ARB_CHNL54_RDATA1_ADDR A:0xc96001c
y.create.l HWIO_PMIC_ARB_CHNL55_RDATA1_ADDR A:0xc97001c
y.create.l HWIO_PMIC_ARB_CHNL56_RDATA1_ADDR A:0xc98001c
y.create.l HWIO_PMIC_ARB_CHNL57_RDATA1_ADDR A:0xc99001c
y.create.l HWIO_PMIC_ARB_CHNL58_RDATA1_ADDR A:0xc9a001c
y.create.l HWIO_PMIC_ARB_CHNL59_RDATA1_ADDR A:0xc9b001c
y.create.l HWIO_PMIC_ARB_CHNL60_RDATA1_ADDR A:0xc9c001c
y.create.l HWIO_PMIC_ARB_CHNL61_RDATA1_ADDR A:0xc9d001c
y.create.l HWIO_PMIC_ARB_CHNL62_RDATA1_ADDR A:0xc9e001c
y.create.l HWIO_PMIC_ARB_CHNL63_RDATA1_ADDR A:0xc9f001c
y.create.l HWIO_PMIC_ARB_CHNL64_RDATA1_ADDR A:0xca0001c
y.create.l HWIO_PMIC_ARB_CHNL65_RDATA1_ADDR A:0xca1001c
y.create.l HWIO_PMIC_ARB_CHNL66_RDATA1_ADDR A:0xca2001c
y.create.l HWIO_PMIC_ARB_CHNL67_RDATA1_ADDR A:0xca3001c
y.create.l HWIO_PMIC_ARB_CHNL68_RDATA1_ADDR A:0xca4001c
y.create.l HWIO_PMIC_ARB_CHNL69_RDATA1_ADDR A:0xca5001c
y.create.l HWIO_PMIC_ARB_CHNL70_RDATA1_ADDR A:0xca6001c
y.create.l HWIO_PMIC_ARB_CHNL71_RDATA1_ADDR A:0xca7001c
y.create.l HWIO_PMIC_ARB_CHNL72_RDATA1_ADDR A:0xca8001c
y.create.l HWIO_PMIC_ARB_CHNL73_RDATA1_ADDR A:0xca9001c
y.create.l HWIO_PMIC_ARB_CHNL74_RDATA1_ADDR A:0xcaa001c
y.create.l HWIO_PMIC_ARB_CHNL75_RDATA1_ADDR A:0xcab001c
y.create.l HWIO_PMIC_ARB_CHNL76_RDATA1_ADDR A:0xcac001c
y.create.l HWIO_PMIC_ARB_CHNL77_RDATA1_ADDR A:0xcad001c
y.create.l HWIO_PMIC_ARB_CHNL78_RDATA1_ADDR A:0xcae001c
y.create.l HWIO_PMIC_ARB_CHNL79_RDATA1_ADDR A:0xcaf001c
y.create.l HWIO_PMIC_ARB_CHNL80_RDATA1_ADDR A:0xcb0001c
y.create.l HWIO_PMIC_ARB_CHNL81_RDATA1_ADDR A:0xcb1001c
y.create.l HWIO_PMIC_ARB_CHNL82_RDATA1_ADDR A:0xcb2001c
y.create.l HWIO_PMIC_ARB_CHNL83_RDATA1_ADDR A:0xcb3001c
y.create.l HWIO_PMIC_ARB_CHNL84_RDATA1_ADDR A:0xcb4001c
y.create.l HWIO_PMIC_ARB_CHNL85_RDATA1_ADDR A:0xcb5001c
y.create.l HWIO_PMIC_ARB_CHNL86_RDATA1_ADDR A:0xcb6001c
y.create.l HWIO_PMIC_ARB_CHNL87_RDATA1_ADDR A:0xcb7001c
y.create.l HWIO_PMIC_ARB_CHNL88_RDATA1_ADDR A:0xcb8001c
y.create.l HWIO_PMIC_ARB_CHNL89_RDATA1_ADDR A:0xcb9001c
y.create.l HWIO_PMIC_ARB_CHNL90_RDATA1_ADDR A:0xcba001c
y.create.l HWIO_PMIC_ARB_CHNL91_RDATA1_ADDR A:0xcbb001c
y.create.l HWIO_PMIC_ARB_CHNL92_RDATA1_ADDR A:0xcbc001c
y.create.l HWIO_PMIC_ARB_CHNL93_RDATA1_ADDR A:0xcbd001c
y.create.l HWIO_PMIC_ARB_CHNL94_RDATA1_ADDR A:0xcbe001c
y.create.l HWIO_PMIC_ARB_CHNL95_RDATA1_ADDR A:0xcbf001c
y.create.l HWIO_PMIC_ARB_CHNL96_RDATA1_ADDR A:0xcc0001c
y.create.l HWIO_PMIC_ARB_CHNL97_RDATA1_ADDR A:0xcc1001c
y.create.l HWIO_PMIC_ARB_CHNL98_RDATA1_ADDR A:0xcc2001c
y.create.l HWIO_PMIC_ARB_CHNL99_RDATA1_ADDR A:0xcc3001c
y.create.l HWIO_PMIC_ARB_CHNL100_RDATA1_ADDR A:0xcc4001c
y.create.l HWIO_PMIC_ARB_CHNL101_RDATA1_ADDR A:0xcc5001c
y.create.l HWIO_PMIC_ARB_CHNL102_RDATA1_ADDR A:0xcc6001c
y.create.l HWIO_PMIC_ARB_CHNL103_RDATA1_ADDR A:0xcc7001c
y.create.l HWIO_PMIC_ARB_CHNL104_RDATA1_ADDR A:0xcc8001c
y.create.l HWIO_PMIC_ARB_CHNL105_RDATA1_ADDR A:0xcc9001c
y.create.l HWIO_PMIC_ARB_CHNL106_RDATA1_ADDR A:0xcca001c
y.create.l HWIO_PMIC_ARB_CHNL107_RDATA1_ADDR A:0xccb001c
y.create.l HWIO_PMIC_ARB_CHNL108_RDATA1_ADDR A:0xccc001c
y.create.l HWIO_PMIC_ARB_CHNL109_RDATA1_ADDR A:0xccd001c
y.create.l HWIO_PMIC_ARB_CHNL110_RDATA1_ADDR A:0xcce001c
y.create.l HWIO_PMIC_ARB_CHNL111_RDATA1_ADDR A:0xccf001c
y.create.l HWIO_PMIC_ARB_CHNL112_RDATA1_ADDR A:0xcd0001c
y.create.l HWIO_PMIC_ARB_CHNL113_RDATA1_ADDR A:0xcd1001c
y.create.l HWIO_PMIC_ARB_CHNL114_RDATA1_ADDR A:0xcd2001c
y.create.l HWIO_PMIC_ARB_CHNL115_RDATA1_ADDR A:0xcd3001c
y.create.l HWIO_PMIC_ARB_CHNL116_RDATA1_ADDR A:0xcd4001c
y.create.l HWIO_PMIC_ARB_CHNL117_RDATA1_ADDR A:0xcd5001c
y.create.l HWIO_PMIC_ARB_CHNL118_RDATA1_ADDR A:0xcd6001c
y.create.l HWIO_PMIC_ARB_CHNL119_RDATA1_ADDR A:0xcd7001c
y.create.l HWIO_PMIC_ARB_CHNL120_RDATA1_ADDR A:0xcd8001c
y.create.l HWIO_PMIC_ARB_CHNL121_RDATA1_ADDR A:0xcd9001c
y.create.l HWIO_PMIC_ARB_CHNL122_RDATA1_ADDR A:0xcda001c
y.create.l HWIO_PMIC_ARB_CHNL123_RDATA1_ADDR A:0xcdb001c
y.create.l HWIO_PMIC_ARB_CHNL124_RDATA1_ADDR A:0xcdc001c
y.create.l HWIO_PMIC_ARB_CHNL125_RDATA1_ADDR A:0xcdd001c
y.create.l HWIO_PMIC_ARB_CHNL126_RDATA1_ADDR A:0xcde001c
y.create.l HWIO_PMIC_ARB_CHNL127_RDATA1_ADDR A:0xcdf001c
y.create.l HWIO_PMIC_ARB_CHNL128_RDATA1_ADDR A:0xce0001c
y.create.l HWIO_PMIC_ARB_CHNL129_RDATA1_ADDR A:0xce1001c
y.create.l HWIO_PMIC_ARB_CHNL130_RDATA1_ADDR A:0xce2001c
y.create.l HWIO_PMIC_ARB_CHNL131_RDATA1_ADDR A:0xce3001c
y.create.l HWIO_PMIC_ARB_CHNL132_RDATA1_ADDR A:0xce4001c
y.create.l HWIO_PMIC_ARB_CHNL133_RDATA1_ADDR A:0xce5001c
y.create.l HWIO_PMIC_ARB_CHNL134_RDATA1_ADDR A:0xce6001c
y.create.l HWIO_PMIC_ARB_CHNL135_RDATA1_ADDR A:0xce7001c
y.create.l HWIO_PMIC_ARB_CHNL136_RDATA1_ADDR A:0xce8001c
y.create.l HWIO_PMIC_ARB_CHNL137_RDATA1_ADDR A:0xce9001c
y.create.l HWIO_PMIC_ARB_CHNL138_RDATA1_ADDR A:0xcea001c
y.create.l HWIO_PMIC_ARB_CHNL139_RDATA1_ADDR A:0xceb001c
y.create.l HWIO_PMIC_ARB_CHNL140_RDATA1_ADDR A:0xcec001c
y.create.l HWIO_PMIC_ARB_CHNL141_RDATA1_ADDR A:0xced001c
y.create.l HWIO_PMIC_ARB_CHNL142_RDATA1_ADDR A:0xcee001c
y.create.l HWIO_PMIC_ARB_CHNL143_RDATA1_ADDR A:0xcef001c
y.create.l HWIO_PMIC_ARB_CHNL144_RDATA1_ADDR A:0xcf0001c
y.create.l HWIO_PMIC_ARB_CHNL145_RDATA1_ADDR A:0xcf1001c
y.create.l HWIO_PMIC_ARB_CHNL146_RDATA1_ADDR A:0xcf2001c
y.create.l HWIO_PMIC_ARB_CHNL147_RDATA1_ADDR A:0xcf3001c
y.create.l HWIO_PMIC_ARB_CHNL148_RDATA1_ADDR A:0xcf4001c
y.create.l HWIO_PMIC_ARB_CHNL149_RDATA1_ADDR A:0xcf5001c
y.create.l HWIO_PMIC_ARB_CHNL150_RDATA1_ADDR A:0xcf6001c
y.create.l HWIO_PMIC_ARB_CHNL151_RDATA1_ADDR A:0xcf7001c
y.create.l HWIO_PMIC_ARB_CHNL152_RDATA1_ADDR A:0xcf8001c
y.create.l HWIO_PMIC_ARB_CHNL153_RDATA1_ADDR A:0xcf9001c
y.create.l HWIO_PMIC_ARB_CHNL154_RDATA1_ADDR A:0xcfa001c
y.create.l HWIO_PMIC_ARB_CHNL155_RDATA1_ADDR A:0xcfb001c
y.create.l HWIO_PMIC_ARB_CHNL156_RDATA1_ADDR A:0xcfc001c
y.create.l HWIO_PMIC_ARB_CHNL157_RDATA1_ADDR A:0xcfd001c
y.create.l HWIO_PMIC_ARB_CHNL158_RDATA1_ADDR A:0xcfe001c
y.create.l HWIO_PMIC_ARB_CHNL159_RDATA1_ADDR A:0xcff001c
y.create.l HWIO_PMIC_ARB_CHNL160_RDATA1_ADDR A:0xd00001c
y.create.l HWIO_PMIC_ARB_CHNL161_RDATA1_ADDR A:0xd01001c
y.create.l HWIO_PMIC_ARB_CHNL162_RDATA1_ADDR A:0xd02001c
y.create.l HWIO_PMIC_ARB_CHNL163_RDATA1_ADDR A:0xd03001c
y.create.l HWIO_PMIC_ARB_CHNL164_RDATA1_ADDR A:0xd04001c
y.create.l HWIO_PMIC_ARB_CHNL165_RDATA1_ADDR A:0xd05001c
y.create.l HWIO_PMIC_ARB_CHNL166_RDATA1_ADDR A:0xd06001c
y.create.l HWIO_PMIC_ARB_CHNL167_RDATA1_ADDR A:0xd07001c
y.create.l HWIO_PMIC_ARB_CHNL168_RDATA1_ADDR A:0xd08001c
y.create.l HWIO_PMIC_ARB_CHNL169_RDATA1_ADDR A:0xd09001c
y.create.l HWIO_PMIC_ARB_CHNL170_RDATA1_ADDR A:0xd0a001c
y.create.l HWIO_PMIC_ARB_CHNL171_RDATA1_ADDR A:0xd0b001c
y.create.l HWIO_PMIC_ARB_CHNL172_RDATA1_ADDR A:0xd0c001c
y.create.l HWIO_PMIC_ARB_CHNL173_RDATA1_ADDR A:0xd0d001c
y.create.l HWIO_PMIC_ARB_CHNL174_RDATA1_ADDR A:0xd0e001c
y.create.l HWIO_PMIC_ARB_CHNL175_RDATA1_ADDR A:0xd0f001c
y.create.l HWIO_PMIC_ARB_CHNL176_RDATA1_ADDR A:0xd10001c
y.create.l HWIO_PMIC_ARB_CHNL177_RDATA1_ADDR A:0xd11001c
y.create.l HWIO_PMIC_ARB_CHNL178_RDATA1_ADDR A:0xd12001c
y.create.l HWIO_PMIC_ARB_CHNL179_RDATA1_ADDR A:0xd13001c
y.create.l HWIO_PMIC_ARB_CHNL180_RDATA1_ADDR A:0xd14001c
y.create.l HWIO_PMIC_ARB_CHNL181_RDATA1_ADDR A:0xd15001c
y.create.l HWIO_PMIC_ARB_CHNL182_RDATA1_ADDR A:0xd16001c
y.create.l HWIO_PMIC_ARB_CHNL183_RDATA1_ADDR A:0xd17001c
y.create.l HWIO_PMIC_ARB_CHNL184_RDATA1_ADDR A:0xd18001c
y.create.l HWIO_PMIC_ARB_CHNL185_RDATA1_ADDR A:0xd19001c
y.create.l HWIO_PMIC_ARB_CHNL186_RDATA1_ADDR A:0xd1a001c
y.create.l HWIO_PMIC_ARB_CHNL187_RDATA1_ADDR A:0xd1b001c
y.create.l HWIO_PMIC_ARB_CHNL188_RDATA1_ADDR A:0xd1c001c
y.create.l HWIO_PMIC_ARB_CHNL189_RDATA1_ADDR A:0xd1d001c
y.create.l HWIO_PMIC_ARB_CHNL190_RDATA1_ADDR A:0xd1e001c
y.create.l HWIO_PMIC_ARB_CHNL191_RDATA1_ADDR A:0xd1f001c
y.create.l HWIO_PMIC_ARB_CHNL192_RDATA1_ADDR A:0xd20001c
y.create.l HWIO_PMIC_ARB_CHNL193_RDATA1_ADDR A:0xd21001c
y.create.l HWIO_PMIC_ARB_CHNL194_RDATA1_ADDR A:0xd22001c
y.create.l HWIO_PMIC_ARB_CHNL195_RDATA1_ADDR A:0xd23001c
y.create.l HWIO_PMIC_ARB_CHNL196_RDATA1_ADDR A:0xd24001c
y.create.l HWIO_PMIC_ARB_CHNL197_RDATA1_ADDR A:0xd25001c
y.create.l HWIO_PMIC_ARB_CHNL198_RDATA1_ADDR A:0xd26001c
y.create.l HWIO_PMIC_ARB_CHNL199_RDATA1_ADDR A:0xd27001c
y.create.l HWIO_PMIC_ARB_CHNL200_RDATA1_ADDR A:0xd28001c
y.create.l HWIO_PMIC_ARB_CHNL201_RDATA1_ADDR A:0xd29001c
y.create.l HWIO_PMIC_ARB_CHNL202_RDATA1_ADDR A:0xd2a001c
y.create.l HWIO_PMIC_ARB_CHNL203_RDATA1_ADDR A:0xd2b001c
y.create.l HWIO_PMIC_ARB_CHNL204_RDATA1_ADDR A:0xd2c001c
y.create.l HWIO_PMIC_ARB_CHNL205_RDATA1_ADDR A:0xd2d001c
y.create.l HWIO_PMIC_ARB_CHNL206_RDATA1_ADDR A:0xd2e001c
y.create.l HWIO_PMIC_ARB_CHNL207_RDATA1_ADDR A:0xd2f001c
y.create.l HWIO_PMIC_ARB_CHNL208_RDATA1_ADDR A:0xd30001c
y.create.l HWIO_PMIC_ARB_CHNL209_RDATA1_ADDR A:0xd31001c
y.create.l HWIO_PMIC_ARB_CHNL210_RDATA1_ADDR A:0xd32001c
y.create.l HWIO_PMIC_ARB_CHNL211_RDATA1_ADDR A:0xd33001c
y.create.l HWIO_PMIC_ARB_CHNL212_RDATA1_ADDR A:0xd34001c
y.create.l HWIO_PMIC_ARB_CHNL213_RDATA1_ADDR A:0xd35001c
y.create.l HWIO_PMIC_ARB_CHNL214_RDATA1_ADDR A:0xd36001c
y.create.l HWIO_PMIC_ARB_CHNL215_RDATA1_ADDR A:0xd37001c
y.create.l HWIO_PMIC_ARB_CHNL216_RDATA1_ADDR A:0xd38001c
y.create.l HWIO_PMIC_ARB_CHNL217_RDATA1_ADDR A:0xd39001c
y.create.l HWIO_PMIC_ARB_CHNL218_RDATA1_ADDR A:0xd3a001c
y.create.l HWIO_PMIC_ARB_CHNL219_RDATA1_ADDR A:0xd3b001c
y.create.l HWIO_PMIC_ARB_CHNL220_RDATA1_ADDR A:0xd3c001c
y.create.l HWIO_PMIC_ARB_CHNL221_RDATA1_ADDR A:0xd3d001c
y.create.l HWIO_PMIC_ARB_CHNL222_RDATA1_ADDR A:0xd3e001c
y.create.l HWIO_PMIC_ARB_CHNL223_RDATA1_ADDR A:0xd3f001c
y.create.l HWIO_PMIC_ARB_CHNL224_RDATA1_ADDR A:0xd40001c
y.create.l HWIO_PMIC_ARB_CHNL225_RDATA1_ADDR A:0xd41001c
y.create.l HWIO_PMIC_ARB_CHNL226_RDATA1_ADDR A:0xd42001c
y.create.l HWIO_PMIC_ARB_CHNL227_RDATA1_ADDR A:0xd43001c
y.create.l HWIO_PMIC_ARB_CHNL228_RDATA1_ADDR A:0xd44001c
y.create.l HWIO_PMIC_ARB_CHNL229_RDATA1_ADDR A:0xd45001c
y.create.l HWIO_PMIC_ARB_CHNL230_RDATA1_ADDR A:0xd46001c
y.create.l HWIO_PMIC_ARB_CHNL231_RDATA1_ADDR A:0xd47001c
y.create.l HWIO_PMIC_ARB_CHNL232_RDATA1_ADDR A:0xd48001c
y.create.l HWIO_PMIC_ARB_CHNL233_RDATA1_ADDR A:0xd49001c
y.create.l HWIO_PMIC_ARB_CHNL234_RDATA1_ADDR A:0xd4a001c
y.create.l HWIO_PMIC_ARB_CHNL235_RDATA1_ADDR A:0xd4b001c
y.create.l HWIO_PMIC_ARB_CHNL236_RDATA1_ADDR A:0xd4c001c
y.create.l HWIO_PMIC_ARB_CHNL237_RDATA1_ADDR A:0xd4d001c
y.create.l HWIO_PMIC_ARB_CHNL238_RDATA1_ADDR A:0xd4e001c
y.create.l HWIO_PMIC_ARB_CHNL239_RDATA1_ADDR A:0xd4f001c
y.create.l HWIO_PMIC_ARB_CHNL240_RDATA1_ADDR A:0xd50001c
y.create.l HWIO_PMIC_ARB_CHNL241_RDATA1_ADDR A:0xd51001c
y.create.l HWIO_PMIC_ARB_CHNL242_RDATA1_ADDR A:0xd52001c
y.create.l HWIO_PMIC_ARB_CHNL243_RDATA1_ADDR A:0xd53001c
y.create.l HWIO_PMIC_ARB_CHNL244_RDATA1_ADDR A:0xd54001c
y.create.l HWIO_PMIC_ARB_CHNL245_RDATA1_ADDR A:0xd55001c
y.create.l HWIO_PMIC_ARB_CHNL246_RDATA1_ADDR A:0xd56001c
y.create.l HWIO_PMIC_ARB_CHNL247_RDATA1_ADDR A:0xd57001c
y.create.l HWIO_PMIC_ARB_CHNL248_RDATA1_ADDR A:0xd58001c
y.create.l HWIO_PMIC_ARB_CHNL249_RDATA1_ADDR A:0xd59001c
y.create.l HWIO_PMIC_ARB_CHNL250_RDATA1_ADDR A:0xd5a001c
y.create.l HWIO_PMIC_ARB_CHNL251_RDATA1_ADDR A:0xd5b001c
y.create.l HWIO_PMIC_ARB_CHNL252_RDATA1_ADDR A:0xd5c001c
y.create.l HWIO_PMIC_ARB_CHNL253_RDATA1_ADDR A:0xd5d001c
y.create.l HWIO_PMIC_ARB_CHNL254_RDATA1_ADDR A:0xd5e001c
y.create.l HWIO_PMIC_ARB_CHNL255_RDATA1_ADDR A:0xd5f001c
y.create.l HWIO_PMIC_ARB_CHNL0_RDATA2_ADDR A:0xc600020
y.create.l HWIO_PMIC_ARB_CHNL1_RDATA2_ADDR A:0xc610020
y.create.l HWIO_PMIC_ARB_CHNL2_RDATA2_ADDR A:0xc620020
y.create.l HWIO_PMIC_ARB_CHNL3_RDATA2_ADDR A:0xc630020
y.create.l HWIO_PMIC_ARB_CHNL4_RDATA2_ADDR A:0xc640020
y.create.l HWIO_PMIC_ARB_CHNL5_RDATA2_ADDR A:0xc650020
y.create.l HWIO_PMIC_ARB_CHNL6_RDATA2_ADDR A:0xc660020
y.create.l HWIO_PMIC_ARB_CHNL7_RDATA2_ADDR A:0xc670020
y.create.l HWIO_PMIC_ARB_CHNL8_RDATA2_ADDR A:0xc680020
y.create.l HWIO_PMIC_ARB_CHNL9_RDATA2_ADDR A:0xc690020
y.create.l HWIO_PMIC_ARB_CHNL10_RDATA2_ADDR A:0xc6a0020
y.create.l HWIO_PMIC_ARB_CHNL11_RDATA2_ADDR A:0xc6b0020
y.create.l HWIO_PMIC_ARB_CHNL12_RDATA2_ADDR A:0xc6c0020
y.create.l HWIO_PMIC_ARB_CHNL13_RDATA2_ADDR A:0xc6d0020
y.create.l HWIO_PMIC_ARB_CHNL14_RDATA2_ADDR A:0xc6e0020
y.create.l HWIO_PMIC_ARB_CHNL15_RDATA2_ADDR A:0xc6f0020
y.create.l HWIO_PMIC_ARB_CHNL16_RDATA2_ADDR A:0xc700020
y.create.l HWIO_PMIC_ARB_CHNL17_RDATA2_ADDR A:0xc710020
y.create.l HWIO_PMIC_ARB_CHNL18_RDATA2_ADDR A:0xc720020
y.create.l HWIO_PMIC_ARB_CHNL19_RDATA2_ADDR A:0xc730020
y.create.l HWIO_PMIC_ARB_CHNL20_RDATA2_ADDR A:0xc740020
y.create.l HWIO_PMIC_ARB_CHNL21_RDATA2_ADDR A:0xc750020
y.create.l HWIO_PMIC_ARB_CHNL22_RDATA2_ADDR A:0xc760020
y.create.l HWIO_PMIC_ARB_CHNL23_RDATA2_ADDR A:0xc770020
y.create.l HWIO_PMIC_ARB_CHNL24_RDATA2_ADDR A:0xc780020
y.create.l HWIO_PMIC_ARB_CHNL25_RDATA2_ADDR A:0xc790020
y.create.l HWIO_PMIC_ARB_CHNL26_RDATA2_ADDR A:0xc7a0020
y.create.l HWIO_PMIC_ARB_CHNL27_RDATA2_ADDR A:0xc7b0020
y.create.l HWIO_PMIC_ARB_CHNL28_RDATA2_ADDR A:0xc7c0020
y.create.l HWIO_PMIC_ARB_CHNL29_RDATA2_ADDR A:0xc7d0020
y.create.l HWIO_PMIC_ARB_CHNL30_RDATA2_ADDR A:0xc7e0020
y.create.l HWIO_PMIC_ARB_CHNL31_RDATA2_ADDR A:0xc7f0020
y.create.l HWIO_PMIC_ARB_CHNL32_RDATA2_ADDR A:0xc800020
y.create.l HWIO_PMIC_ARB_CHNL33_RDATA2_ADDR A:0xc810020
y.create.l HWIO_PMIC_ARB_CHNL34_RDATA2_ADDR A:0xc820020
y.create.l HWIO_PMIC_ARB_CHNL35_RDATA2_ADDR A:0xc830020
y.create.l HWIO_PMIC_ARB_CHNL36_RDATA2_ADDR A:0xc840020
y.create.l HWIO_PMIC_ARB_CHNL37_RDATA2_ADDR A:0xc850020
y.create.l HWIO_PMIC_ARB_CHNL38_RDATA2_ADDR A:0xc860020
y.create.l HWIO_PMIC_ARB_CHNL39_RDATA2_ADDR A:0xc870020
y.create.l HWIO_PMIC_ARB_CHNL40_RDATA2_ADDR A:0xc880020
y.create.l HWIO_PMIC_ARB_CHNL41_RDATA2_ADDR A:0xc890020
y.create.l HWIO_PMIC_ARB_CHNL42_RDATA2_ADDR A:0xc8a0020
y.create.l HWIO_PMIC_ARB_CHNL43_RDATA2_ADDR A:0xc8b0020
y.create.l HWIO_PMIC_ARB_CHNL44_RDATA2_ADDR A:0xc8c0020
y.create.l HWIO_PMIC_ARB_CHNL45_RDATA2_ADDR A:0xc8d0020
y.create.l HWIO_PMIC_ARB_CHNL46_RDATA2_ADDR A:0xc8e0020
y.create.l HWIO_PMIC_ARB_CHNL47_RDATA2_ADDR A:0xc8f0020
y.create.l HWIO_PMIC_ARB_CHNL48_RDATA2_ADDR A:0xc900020
y.create.l HWIO_PMIC_ARB_CHNL49_RDATA2_ADDR A:0xc910020
y.create.l HWIO_PMIC_ARB_CHNL50_RDATA2_ADDR A:0xc920020
y.create.l HWIO_PMIC_ARB_CHNL51_RDATA2_ADDR A:0xc930020
y.create.l HWIO_PMIC_ARB_CHNL52_RDATA2_ADDR A:0xc940020
y.create.l HWIO_PMIC_ARB_CHNL53_RDATA2_ADDR A:0xc950020
y.create.l HWIO_PMIC_ARB_CHNL54_RDATA2_ADDR A:0xc960020
y.create.l HWIO_PMIC_ARB_CHNL55_RDATA2_ADDR A:0xc970020
y.create.l HWIO_PMIC_ARB_CHNL56_RDATA2_ADDR A:0xc980020
y.create.l HWIO_PMIC_ARB_CHNL57_RDATA2_ADDR A:0xc990020
y.create.l HWIO_PMIC_ARB_CHNL58_RDATA2_ADDR A:0xc9a0020
y.create.l HWIO_PMIC_ARB_CHNL59_RDATA2_ADDR A:0xc9b0020
y.create.l HWIO_PMIC_ARB_CHNL60_RDATA2_ADDR A:0xc9c0020
y.create.l HWIO_PMIC_ARB_CHNL61_RDATA2_ADDR A:0xc9d0020
y.create.l HWIO_PMIC_ARB_CHNL62_RDATA2_ADDR A:0xc9e0020
y.create.l HWIO_PMIC_ARB_CHNL63_RDATA2_ADDR A:0xc9f0020
y.create.l HWIO_PMIC_ARB_CHNL64_RDATA2_ADDR A:0xca00020
y.create.l HWIO_PMIC_ARB_CHNL65_RDATA2_ADDR A:0xca10020
y.create.l HWIO_PMIC_ARB_CHNL66_RDATA2_ADDR A:0xca20020
y.create.l HWIO_PMIC_ARB_CHNL67_RDATA2_ADDR A:0xca30020
y.create.l HWIO_PMIC_ARB_CHNL68_RDATA2_ADDR A:0xca40020
y.create.l HWIO_PMIC_ARB_CHNL69_RDATA2_ADDR A:0xca50020
y.create.l HWIO_PMIC_ARB_CHNL70_RDATA2_ADDR A:0xca60020
y.create.l HWIO_PMIC_ARB_CHNL71_RDATA2_ADDR A:0xca70020
y.create.l HWIO_PMIC_ARB_CHNL72_RDATA2_ADDR A:0xca80020
y.create.l HWIO_PMIC_ARB_CHNL73_RDATA2_ADDR A:0xca90020
y.create.l HWIO_PMIC_ARB_CHNL74_RDATA2_ADDR A:0xcaa0020
y.create.l HWIO_PMIC_ARB_CHNL75_RDATA2_ADDR A:0xcab0020
y.create.l HWIO_PMIC_ARB_CHNL76_RDATA2_ADDR A:0xcac0020
y.create.l HWIO_PMIC_ARB_CHNL77_RDATA2_ADDR A:0xcad0020
y.create.l HWIO_PMIC_ARB_CHNL78_RDATA2_ADDR A:0xcae0020
y.create.l HWIO_PMIC_ARB_CHNL79_RDATA2_ADDR A:0xcaf0020
y.create.l HWIO_PMIC_ARB_CHNL80_RDATA2_ADDR A:0xcb00020
y.create.l HWIO_PMIC_ARB_CHNL81_RDATA2_ADDR A:0xcb10020
y.create.l HWIO_PMIC_ARB_CHNL82_RDATA2_ADDR A:0xcb20020
y.create.l HWIO_PMIC_ARB_CHNL83_RDATA2_ADDR A:0xcb30020
y.create.l HWIO_PMIC_ARB_CHNL84_RDATA2_ADDR A:0xcb40020
y.create.l HWIO_PMIC_ARB_CHNL85_RDATA2_ADDR A:0xcb50020
y.create.l HWIO_PMIC_ARB_CHNL86_RDATA2_ADDR A:0xcb60020
y.create.l HWIO_PMIC_ARB_CHNL87_RDATA2_ADDR A:0xcb70020
y.create.l HWIO_PMIC_ARB_CHNL88_RDATA2_ADDR A:0xcb80020
y.create.l HWIO_PMIC_ARB_CHNL89_RDATA2_ADDR A:0xcb90020
y.create.l HWIO_PMIC_ARB_CHNL90_RDATA2_ADDR A:0xcba0020
y.create.l HWIO_PMIC_ARB_CHNL91_RDATA2_ADDR A:0xcbb0020
y.create.l HWIO_PMIC_ARB_CHNL92_RDATA2_ADDR A:0xcbc0020
y.create.l HWIO_PMIC_ARB_CHNL93_RDATA2_ADDR A:0xcbd0020
y.create.l HWIO_PMIC_ARB_CHNL94_RDATA2_ADDR A:0xcbe0020
y.create.l HWIO_PMIC_ARB_CHNL95_RDATA2_ADDR A:0xcbf0020
y.create.l HWIO_PMIC_ARB_CHNL96_RDATA2_ADDR A:0xcc00020
y.create.l HWIO_PMIC_ARB_CHNL97_RDATA2_ADDR A:0xcc10020
y.create.l HWIO_PMIC_ARB_CHNL98_RDATA2_ADDR A:0xcc20020
y.create.l HWIO_PMIC_ARB_CHNL99_RDATA2_ADDR A:0xcc30020
y.create.l HWIO_PMIC_ARB_CHNL100_RDATA2_ADDR A:0xcc40020
y.create.l HWIO_PMIC_ARB_CHNL101_RDATA2_ADDR A:0xcc50020
y.create.l HWIO_PMIC_ARB_CHNL102_RDATA2_ADDR A:0xcc60020
y.create.l HWIO_PMIC_ARB_CHNL103_RDATA2_ADDR A:0xcc70020
y.create.l HWIO_PMIC_ARB_CHNL104_RDATA2_ADDR A:0xcc80020
y.create.l HWIO_PMIC_ARB_CHNL105_RDATA2_ADDR A:0xcc90020
y.create.l HWIO_PMIC_ARB_CHNL106_RDATA2_ADDR A:0xcca0020
y.create.l HWIO_PMIC_ARB_CHNL107_RDATA2_ADDR A:0xccb0020
y.create.l HWIO_PMIC_ARB_CHNL108_RDATA2_ADDR A:0xccc0020
y.create.l HWIO_PMIC_ARB_CHNL109_RDATA2_ADDR A:0xccd0020
y.create.l HWIO_PMIC_ARB_CHNL110_RDATA2_ADDR A:0xcce0020
y.create.l HWIO_PMIC_ARB_CHNL111_RDATA2_ADDR A:0xccf0020
y.create.l HWIO_PMIC_ARB_CHNL112_RDATA2_ADDR A:0xcd00020
y.create.l HWIO_PMIC_ARB_CHNL113_RDATA2_ADDR A:0xcd10020
y.create.l HWIO_PMIC_ARB_CHNL114_RDATA2_ADDR A:0xcd20020
y.create.l HWIO_PMIC_ARB_CHNL115_RDATA2_ADDR A:0xcd30020
y.create.l HWIO_PMIC_ARB_CHNL116_RDATA2_ADDR A:0xcd40020
y.create.l HWIO_PMIC_ARB_CHNL117_RDATA2_ADDR A:0xcd50020
y.create.l HWIO_PMIC_ARB_CHNL118_RDATA2_ADDR A:0xcd60020
y.create.l HWIO_PMIC_ARB_CHNL119_RDATA2_ADDR A:0xcd70020
y.create.l HWIO_PMIC_ARB_CHNL120_RDATA2_ADDR A:0xcd80020
y.create.l HWIO_PMIC_ARB_CHNL121_RDATA2_ADDR A:0xcd90020
y.create.l HWIO_PMIC_ARB_CHNL122_RDATA2_ADDR A:0xcda0020
y.create.l HWIO_PMIC_ARB_CHNL123_RDATA2_ADDR A:0xcdb0020
y.create.l HWIO_PMIC_ARB_CHNL124_RDATA2_ADDR A:0xcdc0020
y.create.l HWIO_PMIC_ARB_CHNL125_RDATA2_ADDR A:0xcdd0020
y.create.l HWIO_PMIC_ARB_CHNL126_RDATA2_ADDR A:0xcde0020
y.create.l HWIO_PMIC_ARB_CHNL127_RDATA2_ADDR A:0xcdf0020
y.create.l HWIO_PMIC_ARB_CHNL128_RDATA2_ADDR A:0xce00020
y.create.l HWIO_PMIC_ARB_CHNL129_RDATA2_ADDR A:0xce10020
y.create.l HWIO_PMIC_ARB_CHNL130_RDATA2_ADDR A:0xce20020
y.create.l HWIO_PMIC_ARB_CHNL131_RDATA2_ADDR A:0xce30020
y.create.l HWIO_PMIC_ARB_CHNL132_RDATA2_ADDR A:0xce40020
y.create.l HWIO_PMIC_ARB_CHNL133_RDATA2_ADDR A:0xce50020
y.create.l HWIO_PMIC_ARB_CHNL134_RDATA2_ADDR A:0xce60020
y.create.l HWIO_PMIC_ARB_CHNL135_RDATA2_ADDR A:0xce70020
y.create.l HWIO_PMIC_ARB_CHNL136_RDATA2_ADDR A:0xce80020
y.create.l HWIO_PMIC_ARB_CHNL137_RDATA2_ADDR A:0xce90020
y.create.l HWIO_PMIC_ARB_CHNL138_RDATA2_ADDR A:0xcea0020
y.create.l HWIO_PMIC_ARB_CHNL139_RDATA2_ADDR A:0xceb0020
y.create.l HWIO_PMIC_ARB_CHNL140_RDATA2_ADDR A:0xcec0020
y.create.l HWIO_PMIC_ARB_CHNL141_RDATA2_ADDR A:0xced0020
y.create.l HWIO_PMIC_ARB_CHNL142_RDATA2_ADDR A:0xcee0020
y.create.l HWIO_PMIC_ARB_CHNL143_RDATA2_ADDR A:0xcef0020
y.create.l HWIO_PMIC_ARB_CHNL144_RDATA2_ADDR A:0xcf00020
y.create.l HWIO_PMIC_ARB_CHNL145_RDATA2_ADDR A:0xcf10020
y.create.l HWIO_PMIC_ARB_CHNL146_RDATA2_ADDR A:0xcf20020
y.create.l HWIO_PMIC_ARB_CHNL147_RDATA2_ADDR A:0xcf30020
y.create.l HWIO_PMIC_ARB_CHNL148_RDATA2_ADDR A:0xcf40020
y.create.l HWIO_PMIC_ARB_CHNL149_RDATA2_ADDR A:0xcf50020
y.create.l HWIO_PMIC_ARB_CHNL150_RDATA2_ADDR A:0xcf60020
y.create.l HWIO_PMIC_ARB_CHNL151_RDATA2_ADDR A:0xcf70020
y.create.l HWIO_PMIC_ARB_CHNL152_RDATA2_ADDR A:0xcf80020
y.create.l HWIO_PMIC_ARB_CHNL153_RDATA2_ADDR A:0xcf90020
y.create.l HWIO_PMIC_ARB_CHNL154_RDATA2_ADDR A:0xcfa0020
y.create.l HWIO_PMIC_ARB_CHNL155_RDATA2_ADDR A:0xcfb0020
y.create.l HWIO_PMIC_ARB_CHNL156_RDATA2_ADDR A:0xcfc0020
y.create.l HWIO_PMIC_ARB_CHNL157_RDATA2_ADDR A:0xcfd0020
y.create.l HWIO_PMIC_ARB_CHNL158_RDATA2_ADDR A:0xcfe0020
y.create.l HWIO_PMIC_ARB_CHNL159_RDATA2_ADDR A:0xcff0020
y.create.l HWIO_PMIC_ARB_CHNL160_RDATA2_ADDR A:0xd000020
y.create.l HWIO_PMIC_ARB_CHNL161_RDATA2_ADDR A:0xd010020
y.create.l HWIO_PMIC_ARB_CHNL162_RDATA2_ADDR A:0xd020020
y.create.l HWIO_PMIC_ARB_CHNL163_RDATA2_ADDR A:0xd030020
y.create.l HWIO_PMIC_ARB_CHNL164_RDATA2_ADDR A:0xd040020
y.create.l HWIO_PMIC_ARB_CHNL165_RDATA2_ADDR A:0xd050020
y.create.l HWIO_PMIC_ARB_CHNL166_RDATA2_ADDR A:0xd060020
y.create.l HWIO_PMIC_ARB_CHNL167_RDATA2_ADDR A:0xd070020
y.create.l HWIO_PMIC_ARB_CHNL168_RDATA2_ADDR A:0xd080020
y.create.l HWIO_PMIC_ARB_CHNL169_RDATA2_ADDR A:0xd090020
y.create.l HWIO_PMIC_ARB_CHNL170_RDATA2_ADDR A:0xd0a0020
y.create.l HWIO_PMIC_ARB_CHNL171_RDATA2_ADDR A:0xd0b0020
y.create.l HWIO_PMIC_ARB_CHNL172_RDATA2_ADDR A:0xd0c0020
y.create.l HWIO_PMIC_ARB_CHNL173_RDATA2_ADDR A:0xd0d0020
y.create.l HWIO_PMIC_ARB_CHNL174_RDATA2_ADDR A:0xd0e0020
y.create.l HWIO_PMIC_ARB_CHNL175_RDATA2_ADDR A:0xd0f0020
y.create.l HWIO_PMIC_ARB_CHNL176_RDATA2_ADDR A:0xd100020
y.create.l HWIO_PMIC_ARB_CHNL177_RDATA2_ADDR A:0xd110020
y.create.l HWIO_PMIC_ARB_CHNL178_RDATA2_ADDR A:0xd120020
y.create.l HWIO_PMIC_ARB_CHNL179_RDATA2_ADDR A:0xd130020
y.create.l HWIO_PMIC_ARB_CHNL180_RDATA2_ADDR A:0xd140020
y.create.l HWIO_PMIC_ARB_CHNL181_RDATA2_ADDR A:0xd150020
y.create.l HWIO_PMIC_ARB_CHNL182_RDATA2_ADDR A:0xd160020
y.create.l HWIO_PMIC_ARB_CHNL183_RDATA2_ADDR A:0xd170020
y.create.l HWIO_PMIC_ARB_CHNL184_RDATA2_ADDR A:0xd180020
y.create.l HWIO_PMIC_ARB_CHNL185_RDATA2_ADDR A:0xd190020
y.create.l HWIO_PMIC_ARB_CHNL186_RDATA2_ADDR A:0xd1a0020
y.create.l HWIO_PMIC_ARB_CHNL187_RDATA2_ADDR A:0xd1b0020
y.create.l HWIO_PMIC_ARB_CHNL188_RDATA2_ADDR A:0xd1c0020
y.create.l HWIO_PMIC_ARB_CHNL189_RDATA2_ADDR A:0xd1d0020
y.create.l HWIO_PMIC_ARB_CHNL190_RDATA2_ADDR A:0xd1e0020
y.create.l HWIO_PMIC_ARB_CHNL191_RDATA2_ADDR A:0xd1f0020
y.create.l HWIO_PMIC_ARB_CHNL192_RDATA2_ADDR A:0xd200020
y.create.l HWIO_PMIC_ARB_CHNL193_RDATA2_ADDR A:0xd210020
y.create.l HWIO_PMIC_ARB_CHNL194_RDATA2_ADDR A:0xd220020
y.create.l HWIO_PMIC_ARB_CHNL195_RDATA2_ADDR A:0xd230020
y.create.l HWIO_PMIC_ARB_CHNL196_RDATA2_ADDR A:0xd240020
y.create.l HWIO_PMIC_ARB_CHNL197_RDATA2_ADDR A:0xd250020
y.create.l HWIO_PMIC_ARB_CHNL198_RDATA2_ADDR A:0xd260020
y.create.l HWIO_PMIC_ARB_CHNL199_RDATA2_ADDR A:0xd270020
y.create.l HWIO_PMIC_ARB_CHNL200_RDATA2_ADDR A:0xd280020
y.create.l HWIO_PMIC_ARB_CHNL201_RDATA2_ADDR A:0xd290020
y.create.l HWIO_PMIC_ARB_CHNL202_RDATA2_ADDR A:0xd2a0020
y.create.l HWIO_PMIC_ARB_CHNL203_RDATA2_ADDR A:0xd2b0020
y.create.l HWIO_PMIC_ARB_CHNL204_RDATA2_ADDR A:0xd2c0020
y.create.l HWIO_PMIC_ARB_CHNL205_RDATA2_ADDR A:0xd2d0020
y.create.l HWIO_PMIC_ARB_CHNL206_RDATA2_ADDR A:0xd2e0020
y.create.l HWIO_PMIC_ARB_CHNL207_RDATA2_ADDR A:0xd2f0020
y.create.l HWIO_PMIC_ARB_CHNL208_RDATA2_ADDR A:0xd300020
y.create.l HWIO_PMIC_ARB_CHNL209_RDATA2_ADDR A:0xd310020
y.create.l HWIO_PMIC_ARB_CHNL210_RDATA2_ADDR A:0xd320020
y.create.l HWIO_PMIC_ARB_CHNL211_RDATA2_ADDR A:0xd330020
y.create.l HWIO_PMIC_ARB_CHNL212_RDATA2_ADDR A:0xd340020
y.create.l HWIO_PMIC_ARB_CHNL213_RDATA2_ADDR A:0xd350020
y.create.l HWIO_PMIC_ARB_CHNL214_RDATA2_ADDR A:0xd360020
y.create.l HWIO_PMIC_ARB_CHNL215_RDATA2_ADDR A:0xd370020
y.create.l HWIO_PMIC_ARB_CHNL216_RDATA2_ADDR A:0xd380020
y.create.l HWIO_PMIC_ARB_CHNL217_RDATA2_ADDR A:0xd390020
y.create.l HWIO_PMIC_ARB_CHNL218_RDATA2_ADDR A:0xd3a0020
y.create.l HWIO_PMIC_ARB_CHNL219_RDATA2_ADDR A:0xd3b0020
y.create.l HWIO_PMIC_ARB_CHNL220_RDATA2_ADDR A:0xd3c0020
y.create.l HWIO_PMIC_ARB_CHNL221_RDATA2_ADDR A:0xd3d0020
y.create.l HWIO_PMIC_ARB_CHNL222_RDATA2_ADDR A:0xd3e0020
y.create.l HWIO_PMIC_ARB_CHNL223_RDATA2_ADDR A:0xd3f0020
y.create.l HWIO_PMIC_ARB_CHNL224_RDATA2_ADDR A:0xd400020
y.create.l HWIO_PMIC_ARB_CHNL225_RDATA2_ADDR A:0xd410020
y.create.l HWIO_PMIC_ARB_CHNL226_RDATA2_ADDR A:0xd420020
y.create.l HWIO_PMIC_ARB_CHNL227_RDATA2_ADDR A:0xd430020
y.create.l HWIO_PMIC_ARB_CHNL228_RDATA2_ADDR A:0xd440020
y.create.l HWIO_PMIC_ARB_CHNL229_RDATA2_ADDR A:0xd450020
y.create.l HWIO_PMIC_ARB_CHNL230_RDATA2_ADDR A:0xd460020
y.create.l HWIO_PMIC_ARB_CHNL231_RDATA2_ADDR A:0xd470020
y.create.l HWIO_PMIC_ARB_CHNL232_RDATA2_ADDR A:0xd480020
y.create.l HWIO_PMIC_ARB_CHNL233_RDATA2_ADDR A:0xd490020
y.create.l HWIO_PMIC_ARB_CHNL234_RDATA2_ADDR A:0xd4a0020
y.create.l HWIO_PMIC_ARB_CHNL235_RDATA2_ADDR A:0xd4b0020
y.create.l HWIO_PMIC_ARB_CHNL236_RDATA2_ADDR A:0xd4c0020
y.create.l HWIO_PMIC_ARB_CHNL237_RDATA2_ADDR A:0xd4d0020
y.create.l HWIO_PMIC_ARB_CHNL238_RDATA2_ADDR A:0xd4e0020
y.create.l HWIO_PMIC_ARB_CHNL239_RDATA2_ADDR A:0xd4f0020
y.create.l HWIO_PMIC_ARB_CHNL240_RDATA2_ADDR A:0xd500020
y.create.l HWIO_PMIC_ARB_CHNL241_RDATA2_ADDR A:0xd510020
y.create.l HWIO_PMIC_ARB_CHNL242_RDATA2_ADDR A:0xd520020
y.create.l HWIO_PMIC_ARB_CHNL243_RDATA2_ADDR A:0xd530020
y.create.l HWIO_PMIC_ARB_CHNL244_RDATA2_ADDR A:0xd540020
y.create.l HWIO_PMIC_ARB_CHNL245_RDATA2_ADDR A:0xd550020
y.create.l HWIO_PMIC_ARB_CHNL246_RDATA2_ADDR A:0xd560020
y.create.l HWIO_PMIC_ARB_CHNL247_RDATA2_ADDR A:0xd570020
y.create.l HWIO_PMIC_ARB_CHNL248_RDATA2_ADDR A:0xd580020
y.create.l HWIO_PMIC_ARB_CHNL249_RDATA2_ADDR A:0xd590020
y.create.l HWIO_PMIC_ARB_CHNL250_RDATA2_ADDR A:0xd5a0020
y.create.l HWIO_PMIC_ARB_CHNL251_RDATA2_ADDR A:0xd5b0020
y.create.l HWIO_PMIC_ARB_CHNL252_RDATA2_ADDR A:0xd5c0020
y.create.l HWIO_PMIC_ARB_CHNL253_RDATA2_ADDR A:0xd5d0020
y.create.l HWIO_PMIC_ARB_CHNL254_RDATA2_ADDR A:0xd5e0020
y.create.l HWIO_PMIC_ARB_CHNL255_RDATA2_ADDR A:0xd5f0020
y.create.l HWIO_SPMI_PIC_ACC_ENABLE0_ADDR A:0xc600100
y.create.l HWIO_SPMI_PIC_ACC_ENABLE1_ADDR A:0xc610100
y.create.l HWIO_SPMI_PIC_ACC_ENABLE2_ADDR A:0xc620100
y.create.l HWIO_SPMI_PIC_ACC_ENABLE3_ADDR A:0xc630100
y.create.l HWIO_SPMI_PIC_ACC_ENABLE4_ADDR A:0xc640100
y.create.l HWIO_SPMI_PIC_ACC_ENABLE5_ADDR A:0xc650100
y.create.l HWIO_SPMI_PIC_ACC_ENABLE6_ADDR A:0xc660100
y.create.l HWIO_SPMI_PIC_ACC_ENABLE7_ADDR A:0xc670100
y.create.l HWIO_SPMI_PIC_ACC_ENABLE8_ADDR A:0xc680100
y.create.l HWIO_SPMI_PIC_ACC_ENABLE9_ADDR A:0xc690100
y.create.l HWIO_SPMI_PIC_ACC_ENABLE10_ADDR A:0xc6a0100
y.create.l HWIO_SPMI_PIC_ACC_ENABLE11_ADDR A:0xc6b0100
y.create.l HWIO_SPMI_PIC_ACC_ENABLE12_ADDR A:0xc6c0100
y.create.l HWIO_SPMI_PIC_ACC_ENABLE13_ADDR A:0xc6d0100
y.create.l HWIO_SPMI_PIC_ACC_ENABLE14_ADDR A:0xc6e0100
y.create.l HWIO_SPMI_PIC_ACC_ENABLE15_ADDR A:0xc6f0100
y.create.l HWIO_SPMI_PIC_ACC_ENABLE16_ADDR A:0xc700100
y.create.l HWIO_SPMI_PIC_ACC_ENABLE17_ADDR A:0xc710100
y.create.l HWIO_SPMI_PIC_ACC_ENABLE18_ADDR A:0xc720100
y.create.l HWIO_SPMI_PIC_ACC_ENABLE19_ADDR A:0xc730100
y.create.l HWIO_SPMI_PIC_ACC_ENABLE20_ADDR A:0xc740100
y.create.l HWIO_SPMI_PIC_ACC_ENABLE21_ADDR A:0xc750100
y.create.l HWIO_SPMI_PIC_ACC_ENABLE22_ADDR A:0xc760100
y.create.l HWIO_SPMI_PIC_ACC_ENABLE23_ADDR A:0xc770100
y.create.l HWIO_SPMI_PIC_ACC_ENABLE24_ADDR A:0xc780100
y.create.l HWIO_SPMI_PIC_ACC_ENABLE25_ADDR A:0xc790100
y.create.l HWIO_SPMI_PIC_ACC_ENABLE26_ADDR A:0xc7a0100
y.create.l HWIO_SPMI_PIC_ACC_ENABLE27_ADDR A:0xc7b0100
y.create.l HWIO_SPMI_PIC_ACC_ENABLE28_ADDR A:0xc7c0100
y.create.l HWIO_SPMI_PIC_ACC_ENABLE29_ADDR A:0xc7d0100
y.create.l HWIO_SPMI_PIC_ACC_ENABLE30_ADDR A:0xc7e0100
y.create.l HWIO_SPMI_PIC_ACC_ENABLE31_ADDR A:0xc7f0100
y.create.l HWIO_SPMI_PIC_ACC_ENABLE32_ADDR A:0xc800100
y.create.l HWIO_SPMI_PIC_ACC_ENABLE33_ADDR A:0xc810100
y.create.l HWIO_SPMI_PIC_ACC_ENABLE34_ADDR A:0xc820100
y.create.l HWIO_SPMI_PIC_ACC_ENABLE35_ADDR A:0xc830100
y.create.l HWIO_SPMI_PIC_ACC_ENABLE36_ADDR A:0xc840100
y.create.l HWIO_SPMI_PIC_ACC_ENABLE37_ADDR A:0xc850100
y.create.l HWIO_SPMI_PIC_ACC_ENABLE38_ADDR A:0xc860100
y.create.l HWIO_SPMI_PIC_ACC_ENABLE39_ADDR A:0xc870100
y.create.l HWIO_SPMI_PIC_ACC_ENABLE40_ADDR A:0xc880100
y.create.l HWIO_SPMI_PIC_ACC_ENABLE41_ADDR A:0xc890100
y.create.l HWIO_SPMI_PIC_ACC_ENABLE42_ADDR A:0xc8a0100
y.create.l HWIO_SPMI_PIC_ACC_ENABLE43_ADDR A:0xc8b0100
y.create.l HWIO_SPMI_PIC_ACC_ENABLE44_ADDR A:0xc8c0100
y.create.l HWIO_SPMI_PIC_ACC_ENABLE45_ADDR A:0xc8d0100
y.create.l HWIO_SPMI_PIC_ACC_ENABLE46_ADDR A:0xc8e0100
y.create.l HWIO_SPMI_PIC_ACC_ENABLE47_ADDR A:0xc8f0100
y.create.l HWIO_SPMI_PIC_ACC_ENABLE48_ADDR A:0xc900100
y.create.l HWIO_SPMI_PIC_ACC_ENABLE49_ADDR A:0xc910100
y.create.l HWIO_SPMI_PIC_ACC_ENABLE50_ADDR A:0xc920100
y.create.l HWIO_SPMI_PIC_ACC_ENABLE51_ADDR A:0xc930100
y.create.l HWIO_SPMI_PIC_ACC_ENABLE52_ADDR A:0xc940100
y.create.l HWIO_SPMI_PIC_ACC_ENABLE53_ADDR A:0xc950100
y.create.l HWIO_SPMI_PIC_ACC_ENABLE54_ADDR A:0xc960100
y.create.l HWIO_SPMI_PIC_ACC_ENABLE55_ADDR A:0xc970100
y.create.l HWIO_SPMI_PIC_ACC_ENABLE56_ADDR A:0xc980100
y.create.l HWIO_SPMI_PIC_ACC_ENABLE57_ADDR A:0xc990100
y.create.l HWIO_SPMI_PIC_ACC_ENABLE58_ADDR A:0xc9a0100
y.create.l HWIO_SPMI_PIC_ACC_ENABLE59_ADDR A:0xc9b0100
y.create.l HWIO_SPMI_PIC_ACC_ENABLE60_ADDR A:0xc9c0100
y.create.l HWIO_SPMI_PIC_ACC_ENABLE61_ADDR A:0xc9d0100
y.create.l HWIO_SPMI_PIC_ACC_ENABLE62_ADDR A:0xc9e0100
y.create.l HWIO_SPMI_PIC_ACC_ENABLE63_ADDR A:0xc9f0100
y.create.l HWIO_SPMI_PIC_ACC_ENABLE64_ADDR A:0xca00100
y.create.l HWIO_SPMI_PIC_ACC_ENABLE65_ADDR A:0xca10100
y.create.l HWIO_SPMI_PIC_ACC_ENABLE66_ADDR A:0xca20100
y.create.l HWIO_SPMI_PIC_ACC_ENABLE67_ADDR A:0xca30100
y.create.l HWIO_SPMI_PIC_ACC_ENABLE68_ADDR A:0xca40100
y.create.l HWIO_SPMI_PIC_ACC_ENABLE69_ADDR A:0xca50100
y.create.l HWIO_SPMI_PIC_ACC_ENABLE70_ADDR A:0xca60100
y.create.l HWIO_SPMI_PIC_ACC_ENABLE71_ADDR A:0xca70100
y.create.l HWIO_SPMI_PIC_ACC_ENABLE72_ADDR A:0xca80100
y.create.l HWIO_SPMI_PIC_ACC_ENABLE73_ADDR A:0xca90100
y.create.l HWIO_SPMI_PIC_ACC_ENABLE74_ADDR A:0xcaa0100
y.create.l HWIO_SPMI_PIC_ACC_ENABLE75_ADDR A:0xcab0100
y.create.l HWIO_SPMI_PIC_ACC_ENABLE76_ADDR A:0xcac0100
y.create.l HWIO_SPMI_PIC_ACC_ENABLE77_ADDR A:0xcad0100
y.create.l HWIO_SPMI_PIC_ACC_ENABLE78_ADDR A:0xcae0100
y.create.l HWIO_SPMI_PIC_ACC_ENABLE79_ADDR A:0xcaf0100
y.create.l HWIO_SPMI_PIC_ACC_ENABLE80_ADDR A:0xcb00100
y.create.l HWIO_SPMI_PIC_ACC_ENABLE81_ADDR A:0xcb10100
y.create.l HWIO_SPMI_PIC_ACC_ENABLE82_ADDR A:0xcb20100
y.create.l HWIO_SPMI_PIC_ACC_ENABLE83_ADDR A:0xcb30100
y.create.l HWIO_SPMI_PIC_ACC_ENABLE84_ADDR A:0xcb40100
y.create.l HWIO_SPMI_PIC_ACC_ENABLE85_ADDR A:0xcb50100
y.create.l HWIO_SPMI_PIC_ACC_ENABLE86_ADDR A:0xcb60100
y.create.l HWIO_SPMI_PIC_ACC_ENABLE87_ADDR A:0xcb70100
y.create.l HWIO_SPMI_PIC_ACC_ENABLE88_ADDR A:0xcb80100
y.create.l HWIO_SPMI_PIC_ACC_ENABLE89_ADDR A:0xcb90100
y.create.l HWIO_SPMI_PIC_ACC_ENABLE90_ADDR A:0xcba0100
y.create.l HWIO_SPMI_PIC_ACC_ENABLE91_ADDR A:0xcbb0100
y.create.l HWIO_SPMI_PIC_ACC_ENABLE92_ADDR A:0xcbc0100
y.create.l HWIO_SPMI_PIC_ACC_ENABLE93_ADDR A:0xcbd0100
y.create.l HWIO_SPMI_PIC_ACC_ENABLE94_ADDR A:0xcbe0100
y.create.l HWIO_SPMI_PIC_ACC_ENABLE95_ADDR A:0xcbf0100
y.create.l HWIO_SPMI_PIC_ACC_ENABLE96_ADDR A:0xcc00100
y.create.l HWIO_SPMI_PIC_ACC_ENABLE97_ADDR A:0xcc10100
y.create.l HWIO_SPMI_PIC_ACC_ENABLE98_ADDR A:0xcc20100
y.create.l HWIO_SPMI_PIC_ACC_ENABLE99_ADDR A:0xcc30100
y.create.l HWIO_SPMI_PIC_ACC_ENABLE100_ADDR A:0xcc40100
y.create.l HWIO_SPMI_PIC_ACC_ENABLE101_ADDR A:0xcc50100
y.create.l HWIO_SPMI_PIC_ACC_ENABLE102_ADDR A:0xcc60100
y.create.l HWIO_SPMI_PIC_ACC_ENABLE103_ADDR A:0xcc70100
y.create.l HWIO_SPMI_PIC_ACC_ENABLE104_ADDR A:0xcc80100
y.create.l HWIO_SPMI_PIC_ACC_ENABLE105_ADDR A:0xcc90100
y.create.l HWIO_SPMI_PIC_ACC_ENABLE106_ADDR A:0xcca0100
y.create.l HWIO_SPMI_PIC_ACC_ENABLE107_ADDR A:0xccb0100
y.create.l HWIO_SPMI_PIC_ACC_ENABLE108_ADDR A:0xccc0100
y.create.l HWIO_SPMI_PIC_ACC_ENABLE109_ADDR A:0xccd0100
y.create.l HWIO_SPMI_PIC_ACC_ENABLE110_ADDR A:0xcce0100
y.create.l HWIO_SPMI_PIC_ACC_ENABLE111_ADDR A:0xccf0100
y.create.l HWIO_SPMI_PIC_ACC_ENABLE112_ADDR A:0xcd00100
y.create.l HWIO_SPMI_PIC_ACC_ENABLE113_ADDR A:0xcd10100
y.create.l HWIO_SPMI_PIC_ACC_ENABLE114_ADDR A:0xcd20100
y.create.l HWIO_SPMI_PIC_ACC_ENABLE115_ADDR A:0xcd30100
y.create.l HWIO_SPMI_PIC_ACC_ENABLE116_ADDR A:0xcd40100
y.create.l HWIO_SPMI_PIC_ACC_ENABLE117_ADDR A:0xcd50100
y.create.l HWIO_SPMI_PIC_ACC_ENABLE118_ADDR A:0xcd60100
y.create.l HWIO_SPMI_PIC_ACC_ENABLE119_ADDR A:0xcd70100
y.create.l HWIO_SPMI_PIC_ACC_ENABLE120_ADDR A:0xcd80100
y.create.l HWIO_SPMI_PIC_ACC_ENABLE121_ADDR A:0xcd90100
y.create.l HWIO_SPMI_PIC_ACC_ENABLE122_ADDR A:0xcda0100
y.create.l HWIO_SPMI_PIC_ACC_ENABLE123_ADDR A:0xcdb0100
y.create.l HWIO_SPMI_PIC_ACC_ENABLE124_ADDR A:0xcdc0100
y.create.l HWIO_SPMI_PIC_ACC_ENABLE125_ADDR A:0xcdd0100
y.create.l HWIO_SPMI_PIC_ACC_ENABLE126_ADDR A:0xcde0100
y.create.l HWIO_SPMI_PIC_ACC_ENABLE127_ADDR A:0xcdf0100
y.create.l HWIO_SPMI_PIC_ACC_ENABLE128_ADDR A:0xce00100
y.create.l HWIO_SPMI_PIC_ACC_ENABLE129_ADDR A:0xce10100
y.create.l HWIO_SPMI_PIC_ACC_ENABLE130_ADDR A:0xce20100
y.create.l HWIO_SPMI_PIC_ACC_ENABLE131_ADDR A:0xce30100
y.create.l HWIO_SPMI_PIC_ACC_ENABLE132_ADDR A:0xce40100
y.create.l HWIO_SPMI_PIC_ACC_ENABLE133_ADDR A:0xce50100
y.create.l HWIO_SPMI_PIC_ACC_ENABLE134_ADDR A:0xce60100
y.create.l HWIO_SPMI_PIC_ACC_ENABLE135_ADDR A:0xce70100
y.create.l HWIO_SPMI_PIC_ACC_ENABLE136_ADDR A:0xce80100
y.create.l HWIO_SPMI_PIC_ACC_ENABLE137_ADDR A:0xce90100
y.create.l HWIO_SPMI_PIC_ACC_ENABLE138_ADDR A:0xcea0100
y.create.l HWIO_SPMI_PIC_ACC_ENABLE139_ADDR A:0xceb0100
y.create.l HWIO_SPMI_PIC_ACC_ENABLE140_ADDR A:0xcec0100
y.create.l HWIO_SPMI_PIC_ACC_ENABLE141_ADDR A:0xced0100
y.create.l HWIO_SPMI_PIC_ACC_ENABLE142_ADDR A:0xcee0100
y.create.l HWIO_SPMI_PIC_ACC_ENABLE143_ADDR A:0xcef0100
y.create.l HWIO_SPMI_PIC_ACC_ENABLE144_ADDR A:0xcf00100
y.create.l HWIO_SPMI_PIC_ACC_ENABLE145_ADDR A:0xcf10100
y.create.l HWIO_SPMI_PIC_ACC_ENABLE146_ADDR A:0xcf20100
y.create.l HWIO_SPMI_PIC_ACC_ENABLE147_ADDR A:0xcf30100
y.create.l HWIO_SPMI_PIC_ACC_ENABLE148_ADDR A:0xcf40100
y.create.l HWIO_SPMI_PIC_ACC_ENABLE149_ADDR A:0xcf50100
y.create.l HWIO_SPMI_PIC_ACC_ENABLE150_ADDR A:0xcf60100
y.create.l HWIO_SPMI_PIC_ACC_ENABLE151_ADDR A:0xcf70100
y.create.l HWIO_SPMI_PIC_ACC_ENABLE152_ADDR A:0xcf80100
y.create.l HWIO_SPMI_PIC_ACC_ENABLE153_ADDR A:0xcf90100
y.create.l HWIO_SPMI_PIC_ACC_ENABLE154_ADDR A:0xcfa0100
y.create.l HWIO_SPMI_PIC_ACC_ENABLE155_ADDR A:0xcfb0100
y.create.l HWIO_SPMI_PIC_ACC_ENABLE156_ADDR A:0xcfc0100
y.create.l HWIO_SPMI_PIC_ACC_ENABLE157_ADDR A:0xcfd0100
y.create.l HWIO_SPMI_PIC_ACC_ENABLE158_ADDR A:0xcfe0100
y.create.l HWIO_SPMI_PIC_ACC_ENABLE159_ADDR A:0xcff0100
y.create.l HWIO_SPMI_PIC_ACC_ENABLE160_ADDR A:0xd000100
y.create.l HWIO_SPMI_PIC_ACC_ENABLE161_ADDR A:0xd010100
y.create.l HWIO_SPMI_PIC_ACC_ENABLE162_ADDR A:0xd020100
y.create.l HWIO_SPMI_PIC_ACC_ENABLE163_ADDR A:0xd030100
y.create.l HWIO_SPMI_PIC_ACC_ENABLE164_ADDR A:0xd040100
y.create.l HWIO_SPMI_PIC_ACC_ENABLE165_ADDR A:0xd050100
y.create.l HWIO_SPMI_PIC_ACC_ENABLE166_ADDR A:0xd060100
y.create.l HWIO_SPMI_PIC_ACC_ENABLE167_ADDR A:0xd070100
y.create.l HWIO_SPMI_PIC_ACC_ENABLE168_ADDR A:0xd080100
y.create.l HWIO_SPMI_PIC_ACC_ENABLE169_ADDR A:0xd090100
y.create.l HWIO_SPMI_PIC_ACC_ENABLE170_ADDR A:0xd0a0100
y.create.l HWIO_SPMI_PIC_ACC_ENABLE171_ADDR A:0xd0b0100
y.create.l HWIO_SPMI_PIC_ACC_ENABLE172_ADDR A:0xd0c0100
y.create.l HWIO_SPMI_PIC_ACC_ENABLE173_ADDR A:0xd0d0100
y.create.l HWIO_SPMI_PIC_ACC_ENABLE174_ADDR A:0xd0e0100
y.create.l HWIO_SPMI_PIC_ACC_ENABLE175_ADDR A:0xd0f0100
y.create.l HWIO_SPMI_PIC_ACC_ENABLE176_ADDR A:0xd100100
y.create.l HWIO_SPMI_PIC_ACC_ENABLE177_ADDR A:0xd110100
y.create.l HWIO_SPMI_PIC_ACC_ENABLE178_ADDR A:0xd120100
y.create.l HWIO_SPMI_PIC_ACC_ENABLE179_ADDR A:0xd130100
y.create.l HWIO_SPMI_PIC_ACC_ENABLE180_ADDR A:0xd140100
y.create.l HWIO_SPMI_PIC_ACC_ENABLE181_ADDR A:0xd150100
y.create.l HWIO_SPMI_PIC_ACC_ENABLE182_ADDR A:0xd160100
y.create.l HWIO_SPMI_PIC_ACC_ENABLE183_ADDR A:0xd170100
y.create.l HWIO_SPMI_PIC_ACC_ENABLE184_ADDR A:0xd180100
y.create.l HWIO_SPMI_PIC_ACC_ENABLE185_ADDR A:0xd190100
y.create.l HWIO_SPMI_PIC_ACC_ENABLE186_ADDR A:0xd1a0100
y.create.l HWIO_SPMI_PIC_ACC_ENABLE187_ADDR A:0xd1b0100
y.create.l HWIO_SPMI_PIC_ACC_ENABLE188_ADDR A:0xd1c0100
y.create.l HWIO_SPMI_PIC_ACC_ENABLE189_ADDR A:0xd1d0100
y.create.l HWIO_SPMI_PIC_ACC_ENABLE190_ADDR A:0xd1e0100
y.create.l HWIO_SPMI_PIC_ACC_ENABLE191_ADDR A:0xd1f0100
y.create.l HWIO_SPMI_PIC_ACC_ENABLE192_ADDR A:0xd200100
y.create.l HWIO_SPMI_PIC_ACC_ENABLE193_ADDR A:0xd210100
y.create.l HWIO_SPMI_PIC_ACC_ENABLE194_ADDR A:0xd220100
y.create.l HWIO_SPMI_PIC_ACC_ENABLE195_ADDR A:0xd230100
y.create.l HWIO_SPMI_PIC_ACC_ENABLE196_ADDR A:0xd240100
y.create.l HWIO_SPMI_PIC_ACC_ENABLE197_ADDR A:0xd250100
y.create.l HWIO_SPMI_PIC_ACC_ENABLE198_ADDR A:0xd260100
y.create.l HWIO_SPMI_PIC_ACC_ENABLE199_ADDR A:0xd270100
y.create.l HWIO_SPMI_PIC_ACC_ENABLE200_ADDR A:0xd280100
y.create.l HWIO_SPMI_PIC_ACC_ENABLE201_ADDR A:0xd290100
y.create.l HWIO_SPMI_PIC_ACC_ENABLE202_ADDR A:0xd2a0100
y.create.l HWIO_SPMI_PIC_ACC_ENABLE203_ADDR A:0xd2b0100
y.create.l HWIO_SPMI_PIC_ACC_ENABLE204_ADDR A:0xd2c0100
y.create.l HWIO_SPMI_PIC_ACC_ENABLE205_ADDR A:0xd2d0100
y.create.l HWIO_SPMI_PIC_ACC_ENABLE206_ADDR A:0xd2e0100
y.create.l HWIO_SPMI_PIC_ACC_ENABLE207_ADDR A:0xd2f0100
y.create.l HWIO_SPMI_PIC_ACC_ENABLE208_ADDR A:0xd300100
y.create.l HWIO_SPMI_PIC_ACC_ENABLE209_ADDR A:0xd310100
y.create.l HWIO_SPMI_PIC_ACC_ENABLE210_ADDR A:0xd320100
y.create.l HWIO_SPMI_PIC_ACC_ENABLE211_ADDR A:0xd330100
y.create.l HWIO_SPMI_PIC_ACC_ENABLE212_ADDR A:0xd340100
y.create.l HWIO_SPMI_PIC_ACC_ENABLE213_ADDR A:0xd350100
y.create.l HWIO_SPMI_PIC_ACC_ENABLE214_ADDR A:0xd360100
y.create.l HWIO_SPMI_PIC_ACC_ENABLE215_ADDR A:0xd370100
y.create.l HWIO_SPMI_PIC_ACC_ENABLE216_ADDR A:0xd380100
y.create.l HWIO_SPMI_PIC_ACC_ENABLE217_ADDR A:0xd390100
y.create.l HWIO_SPMI_PIC_ACC_ENABLE218_ADDR A:0xd3a0100
y.create.l HWIO_SPMI_PIC_ACC_ENABLE219_ADDR A:0xd3b0100
y.create.l HWIO_SPMI_PIC_ACC_ENABLE220_ADDR A:0xd3c0100
y.create.l HWIO_SPMI_PIC_ACC_ENABLE221_ADDR A:0xd3d0100
y.create.l HWIO_SPMI_PIC_ACC_ENABLE222_ADDR A:0xd3e0100
y.create.l HWIO_SPMI_PIC_ACC_ENABLE223_ADDR A:0xd3f0100
y.create.l HWIO_SPMI_PIC_ACC_ENABLE224_ADDR A:0xd400100
y.create.l HWIO_SPMI_PIC_ACC_ENABLE225_ADDR A:0xd410100
y.create.l HWIO_SPMI_PIC_ACC_ENABLE226_ADDR A:0xd420100
y.create.l HWIO_SPMI_PIC_ACC_ENABLE227_ADDR A:0xd430100
y.create.l HWIO_SPMI_PIC_ACC_ENABLE228_ADDR A:0xd440100
y.create.l HWIO_SPMI_PIC_ACC_ENABLE229_ADDR A:0xd450100
y.create.l HWIO_SPMI_PIC_ACC_ENABLE230_ADDR A:0xd460100
y.create.l HWIO_SPMI_PIC_ACC_ENABLE231_ADDR A:0xd470100
y.create.l HWIO_SPMI_PIC_ACC_ENABLE232_ADDR A:0xd480100
y.create.l HWIO_SPMI_PIC_ACC_ENABLE233_ADDR A:0xd490100
y.create.l HWIO_SPMI_PIC_ACC_ENABLE234_ADDR A:0xd4a0100
y.create.l HWIO_SPMI_PIC_ACC_ENABLE235_ADDR A:0xd4b0100
y.create.l HWIO_SPMI_PIC_ACC_ENABLE236_ADDR A:0xd4c0100
y.create.l HWIO_SPMI_PIC_ACC_ENABLE237_ADDR A:0xd4d0100
y.create.l HWIO_SPMI_PIC_ACC_ENABLE238_ADDR A:0xd4e0100
y.create.l HWIO_SPMI_PIC_ACC_ENABLE239_ADDR A:0xd4f0100
y.create.l HWIO_SPMI_PIC_ACC_ENABLE240_ADDR A:0xd500100
y.create.l HWIO_SPMI_PIC_ACC_ENABLE241_ADDR A:0xd510100
y.create.l HWIO_SPMI_PIC_ACC_ENABLE242_ADDR A:0xd520100
y.create.l HWIO_SPMI_PIC_ACC_ENABLE243_ADDR A:0xd530100
y.create.l HWIO_SPMI_PIC_ACC_ENABLE244_ADDR A:0xd540100
y.create.l HWIO_SPMI_PIC_ACC_ENABLE245_ADDR A:0xd550100
y.create.l HWIO_SPMI_PIC_ACC_ENABLE246_ADDR A:0xd560100
y.create.l HWIO_SPMI_PIC_ACC_ENABLE247_ADDR A:0xd570100
y.create.l HWIO_SPMI_PIC_ACC_ENABLE248_ADDR A:0xd580100
y.create.l HWIO_SPMI_PIC_ACC_ENABLE249_ADDR A:0xd590100
y.create.l HWIO_SPMI_PIC_ACC_ENABLE250_ADDR A:0xd5a0100
y.create.l HWIO_SPMI_PIC_ACC_ENABLE251_ADDR A:0xd5b0100
y.create.l HWIO_SPMI_PIC_ACC_ENABLE252_ADDR A:0xd5c0100
y.create.l HWIO_SPMI_PIC_ACC_ENABLE253_ADDR A:0xd5d0100
y.create.l HWIO_SPMI_PIC_ACC_ENABLE254_ADDR A:0xd5e0100
y.create.l HWIO_SPMI_PIC_ACC_ENABLE255_ADDR A:0xd5f0100
y.create.l HWIO_SPMI_PIC_IRQ_STATUS0_ADDR A:0xc600104
y.create.l HWIO_SPMI_PIC_IRQ_STATUS1_ADDR A:0xc610104
y.create.l HWIO_SPMI_PIC_IRQ_STATUS2_ADDR A:0xc620104
y.create.l HWIO_SPMI_PIC_IRQ_STATUS3_ADDR A:0xc630104
y.create.l HWIO_SPMI_PIC_IRQ_STATUS4_ADDR A:0xc640104
y.create.l HWIO_SPMI_PIC_IRQ_STATUS5_ADDR A:0xc650104
y.create.l HWIO_SPMI_PIC_IRQ_STATUS6_ADDR A:0xc660104
y.create.l HWIO_SPMI_PIC_IRQ_STATUS7_ADDR A:0xc670104
y.create.l HWIO_SPMI_PIC_IRQ_STATUS8_ADDR A:0xc680104
y.create.l HWIO_SPMI_PIC_IRQ_STATUS9_ADDR A:0xc690104
y.create.l HWIO_SPMI_PIC_IRQ_STATUS10_ADDR A:0xc6a0104
y.create.l HWIO_SPMI_PIC_IRQ_STATUS11_ADDR A:0xc6b0104
y.create.l HWIO_SPMI_PIC_IRQ_STATUS12_ADDR A:0xc6c0104
y.create.l HWIO_SPMI_PIC_IRQ_STATUS13_ADDR A:0xc6d0104
y.create.l HWIO_SPMI_PIC_IRQ_STATUS14_ADDR A:0xc6e0104
y.create.l HWIO_SPMI_PIC_IRQ_STATUS15_ADDR A:0xc6f0104
y.create.l HWIO_SPMI_PIC_IRQ_STATUS16_ADDR A:0xc700104
y.create.l HWIO_SPMI_PIC_IRQ_STATUS17_ADDR A:0xc710104
y.create.l HWIO_SPMI_PIC_IRQ_STATUS18_ADDR A:0xc720104
y.create.l HWIO_SPMI_PIC_IRQ_STATUS19_ADDR A:0xc730104
y.create.l HWIO_SPMI_PIC_IRQ_STATUS20_ADDR A:0xc740104
y.create.l HWIO_SPMI_PIC_IRQ_STATUS21_ADDR A:0xc750104
y.create.l HWIO_SPMI_PIC_IRQ_STATUS22_ADDR A:0xc760104
y.create.l HWIO_SPMI_PIC_IRQ_STATUS23_ADDR A:0xc770104
y.create.l HWIO_SPMI_PIC_IRQ_STATUS24_ADDR A:0xc780104
y.create.l HWIO_SPMI_PIC_IRQ_STATUS25_ADDR A:0xc790104
y.create.l HWIO_SPMI_PIC_IRQ_STATUS26_ADDR A:0xc7a0104
y.create.l HWIO_SPMI_PIC_IRQ_STATUS27_ADDR A:0xc7b0104
y.create.l HWIO_SPMI_PIC_IRQ_STATUS28_ADDR A:0xc7c0104
y.create.l HWIO_SPMI_PIC_IRQ_STATUS29_ADDR A:0xc7d0104
y.create.l HWIO_SPMI_PIC_IRQ_STATUS30_ADDR A:0xc7e0104
y.create.l HWIO_SPMI_PIC_IRQ_STATUS31_ADDR A:0xc7f0104
y.create.l HWIO_SPMI_PIC_IRQ_STATUS32_ADDR A:0xc800104
y.create.l HWIO_SPMI_PIC_IRQ_STATUS33_ADDR A:0xc810104
y.create.l HWIO_SPMI_PIC_IRQ_STATUS34_ADDR A:0xc820104
y.create.l HWIO_SPMI_PIC_IRQ_STATUS35_ADDR A:0xc830104
y.create.l HWIO_SPMI_PIC_IRQ_STATUS36_ADDR A:0xc840104
y.create.l HWIO_SPMI_PIC_IRQ_STATUS37_ADDR A:0xc850104
y.create.l HWIO_SPMI_PIC_IRQ_STATUS38_ADDR A:0xc860104
y.create.l HWIO_SPMI_PIC_IRQ_STATUS39_ADDR A:0xc870104
y.create.l HWIO_SPMI_PIC_IRQ_STATUS40_ADDR A:0xc880104
y.create.l HWIO_SPMI_PIC_IRQ_STATUS41_ADDR A:0xc890104
y.create.l HWIO_SPMI_PIC_IRQ_STATUS42_ADDR A:0xc8a0104
y.create.l HWIO_SPMI_PIC_IRQ_STATUS43_ADDR A:0xc8b0104
y.create.l HWIO_SPMI_PIC_IRQ_STATUS44_ADDR A:0xc8c0104
y.create.l HWIO_SPMI_PIC_IRQ_STATUS45_ADDR A:0xc8d0104
y.create.l HWIO_SPMI_PIC_IRQ_STATUS46_ADDR A:0xc8e0104
y.create.l HWIO_SPMI_PIC_IRQ_STATUS47_ADDR A:0xc8f0104
y.create.l HWIO_SPMI_PIC_IRQ_STATUS48_ADDR A:0xc900104
y.create.l HWIO_SPMI_PIC_IRQ_STATUS49_ADDR A:0xc910104
y.create.l HWIO_SPMI_PIC_IRQ_STATUS50_ADDR A:0xc920104
y.create.l HWIO_SPMI_PIC_IRQ_STATUS51_ADDR A:0xc930104
y.create.l HWIO_SPMI_PIC_IRQ_STATUS52_ADDR A:0xc940104
y.create.l HWIO_SPMI_PIC_IRQ_STATUS53_ADDR A:0xc950104
y.create.l HWIO_SPMI_PIC_IRQ_STATUS54_ADDR A:0xc960104
y.create.l HWIO_SPMI_PIC_IRQ_STATUS55_ADDR A:0xc970104
y.create.l HWIO_SPMI_PIC_IRQ_STATUS56_ADDR A:0xc980104
y.create.l HWIO_SPMI_PIC_IRQ_STATUS57_ADDR A:0xc990104
y.create.l HWIO_SPMI_PIC_IRQ_STATUS58_ADDR A:0xc9a0104
y.create.l HWIO_SPMI_PIC_IRQ_STATUS59_ADDR A:0xc9b0104
y.create.l HWIO_SPMI_PIC_IRQ_STATUS60_ADDR A:0xc9c0104
y.create.l HWIO_SPMI_PIC_IRQ_STATUS61_ADDR A:0xc9d0104
y.create.l HWIO_SPMI_PIC_IRQ_STATUS62_ADDR A:0xc9e0104
y.create.l HWIO_SPMI_PIC_IRQ_STATUS63_ADDR A:0xc9f0104
y.create.l HWIO_SPMI_PIC_IRQ_STATUS64_ADDR A:0xca00104
y.create.l HWIO_SPMI_PIC_IRQ_STATUS65_ADDR A:0xca10104
y.create.l HWIO_SPMI_PIC_IRQ_STATUS66_ADDR A:0xca20104
y.create.l HWIO_SPMI_PIC_IRQ_STATUS67_ADDR A:0xca30104
y.create.l HWIO_SPMI_PIC_IRQ_STATUS68_ADDR A:0xca40104
y.create.l HWIO_SPMI_PIC_IRQ_STATUS69_ADDR A:0xca50104
y.create.l HWIO_SPMI_PIC_IRQ_STATUS70_ADDR A:0xca60104
y.create.l HWIO_SPMI_PIC_IRQ_STATUS71_ADDR A:0xca70104
y.create.l HWIO_SPMI_PIC_IRQ_STATUS72_ADDR A:0xca80104
y.create.l HWIO_SPMI_PIC_IRQ_STATUS73_ADDR A:0xca90104
y.create.l HWIO_SPMI_PIC_IRQ_STATUS74_ADDR A:0xcaa0104
y.create.l HWIO_SPMI_PIC_IRQ_STATUS75_ADDR A:0xcab0104
y.create.l HWIO_SPMI_PIC_IRQ_STATUS76_ADDR A:0xcac0104
y.create.l HWIO_SPMI_PIC_IRQ_STATUS77_ADDR A:0xcad0104
y.create.l HWIO_SPMI_PIC_IRQ_STATUS78_ADDR A:0xcae0104
y.create.l HWIO_SPMI_PIC_IRQ_STATUS79_ADDR A:0xcaf0104
y.create.l HWIO_SPMI_PIC_IRQ_STATUS80_ADDR A:0xcb00104
y.create.l HWIO_SPMI_PIC_IRQ_STATUS81_ADDR A:0xcb10104
y.create.l HWIO_SPMI_PIC_IRQ_STATUS82_ADDR A:0xcb20104
y.create.l HWIO_SPMI_PIC_IRQ_STATUS83_ADDR A:0xcb30104
y.create.l HWIO_SPMI_PIC_IRQ_STATUS84_ADDR A:0xcb40104
y.create.l HWIO_SPMI_PIC_IRQ_STATUS85_ADDR A:0xcb50104
y.create.l HWIO_SPMI_PIC_IRQ_STATUS86_ADDR A:0xcb60104
y.create.l HWIO_SPMI_PIC_IRQ_STATUS87_ADDR A:0xcb70104
y.create.l HWIO_SPMI_PIC_IRQ_STATUS88_ADDR A:0xcb80104
y.create.l HWIO_SPMI_PIC_IRQ_STATUS89_ADDR A:0xcb90104
y.create.l HWIO_SPMI_PIC_IRQ_STATUS90_ADDR A:0xcba0104
y.create.l HWIO_SPMI_PIC_IRQ_STATUS91_ADDR A:0xcbb0104
y.create.l HWIO_SPMI_PIC_IRQ_STATUS92_ADDR A:0xcbc0104
y.create.l HWIO_SPMI_PIC_IRQ_STATUS93_ADDR A:0xcbd0104
y.create.l HWIO_SPMI_PIC_IRQ_STATUS94_ADDR A:0xcbe0104
y.create.l HWIO_SPMI_PIC_IRQ_STATUS95_ADDR A:0xcbf0104
y.create.l HWIO_SPMI_PIC_IRQ_STATUS96_ADDR A:0xcc00104
y.create.l HWIO_SPMI_PIC_IRQ_STATUS97_ADDR A:0xcc10104
y.create.l HWIO_SPMI_PIC_IRQ_STATUS98_ADDR A:0xcc20104
y.create.l HWIO_SPMI_PIC_IRQ_STATUS99_ADDR A:0xcc30104
y.create.l HWIO_SPMI_PIC_IRQ_STATUS100_ADDR A:0xcc40104
y.create.l HWIO_SPMI_PIC_IRQ_STATUS101_ADDR A:0xcc50104
y.create.l HWIO_SPMI_PIC_IRQ_STATUS102_ADDR A:0xcc60104
y.create.l HWIO_SPMI_PIC_IRQ_STATUS103_ADDR A:0xcc70104
y.create.l HWIO_SPMI_PIC_IRQ_STATUS104_ADDR A:0xcc80104
y.create.l HWIO_SPMI_PIC_IRQ_STATUS105_ADDR A:0xcc90104
y.create.l HWIO_SPMI_PIC_IRQ_STATUS106_ADDR A:0xcca0104
y.create.l HWIO_SPMI_PIC_IRQ_STATUS107_ADDR A:0xccb0104
y.create.l HWIO_SPMI_PIC_IRQ_STATUS108_ADDR A:0xccc0104
y.create.l HWIO_SPMI_PIC_IRQ_STATUS109_ADDR A:0xccd0104
y.create.l HWIO_SPMI_PIC_IRQ_STATUS110_ADDR A:0xcce0104
y.create.l HWIO_SPMI_PIC_IRQ_STATUS111_ADDR A:0xccf0104
y.create.l HWIO_SPMI_PIC_IRQ_STATUS112_ADDR A:0xcd00104
y.create.l HWIO_SPMI_PIC_IRQ_STATUS113_ADDR A:0xcd10104
y.create.l HWIO_SPMI_PIC_IRQ_STATUS114_ADDR A:0xcd20104
y.create.l HWIO_SPMI_PIC_IRQ_STATUS115_ADDR A:0xcd30104
y.create.l HWIO_SPMI_PIC_IRQ_STATUS116_ADDR A:0xcd40104
y.create.l HWIO_SPMI_PIC_IRQ_STATUS117_ADDR A:0xcd50104
y.create.l HWIO_SPMI_PIC_IRQ_STATUS118_ADDR A:0xcd60104
y.create.l HWIO_SPMI_PIC_IRQ_STATUS119_ADDR A:0xcd70104
y.create.l HWIO_SPMI_PIC_IRQ_STATUS120_ADDR A:0xcd80104
y.create.l HWIO_SPMI_PIC_IRQ_STATUS121_ADDR A:0xcd90104
y.create.l HWIO_SPMI_PIC_IRQ_STATUS122_ADDR A:0xcda0104
y.create.l HWIO_SPMI_PIC_IRQ_STATUS123_ADDR A:0xcdb0104
y.create.l HWIO_SPMI_PIC_IRQ_STATUS124_ADDR A:0xcdc0104
y.create.l HWIO_SPMI_PIC_IRQ_STATUS125_ADDR A:0xcdd0104
y.create.l HWIO_SPMI_PIC_IRQ_STATUS126_ADDR A:0xcde0104
y.create.l HWIO_SPMI_PIC_IRQ_STATUS127_ADDR A:0xcdf0104
y.create.l HWIO_SPMI_PIC_IRQ_STATUS128_ADDR A:0xce00104
y.create.l HWIO_SPMI_PIC_IRQ_STATUS129_ADDR A:0xce10104
y.create.l HWIO_SPMI_PIC_IRQ_STATUS130_ADDR A:0xce20104
y.create.l HWIO_SPMI_PIC_IRQ_STATUS131_ADDR A:0xce30104
y.create.l HWIO_SPMI_PIC_IRQ_STATUS132_ADDR A:0xce40104
y.create.l HWIO_SPMI_PIC_IRQ_STATUS133_ADDR A:0xce50104
y.create.l HWIO_SPMI_PIC_IRQ_STATUS134_ADDR A:0xce60104
y.create.l HWIO_SPMI_PIC_IRQ_STATUS135_ADDR A:0xce70104
y.create.l HWIO_SPMI_PIC_IRQ_STATUS136_ADDR A:0xce80104
y.create.l HWIO_SPMI_PIC_IRQ_STATUS137_ADDR A:0xce90104
y.create.l HWIO_SPMI_PIC_IRQ_STATUS138_ADDR A:0xcea0104
y.create.l HWIO_SPMI_PIC_IRQ_STATUS139_ADDR A:0xceb0104
y.create.l HWIO_SPMI_PIC_IRQ_STATUS140_ADDR A:0xcec0104
y.create.l HWIO_SPMI_PIC_IRQ_STATUS141_ADDR A:0xced0104
y.create.l HWIO_SPMI_PIC_IRQ_STATUS142_ADDR A:0xcee0104
y.create.l HWIO_SPMI_PIC_IRQ_STATUS143_ADDR A:0xcef0104
y.create.l HWIO_SPMI_PIC_IRQ_STATUS144_ADDR A:0xcf00104
y.create.l HWIO_SPMI_PIC_IRQ_STATUS145_ADDR A:0xcf10104
y.create.l HWIO_SPMI_PIC_IRQ_STATUS146_ADDR A:0xcf20104
y.create.l HWIO_SPMI_PIC_IRQ_STATUS147_ADDR A:0xcf30104
y.create.l HWIO_SPMI_PIC_IRQ_STATUS148_ADDR A:0xcf40104
y.create.l HWIO_SPMI_PIC_IRQ_STATUS149_ADDR A:0xcf50104
y.create.l HWIO_SPMI_PIC_IRQ_STATUS150_ADDR A:0xcf60104
y.create.l HWIO_SPMI_PIC_IRQ_STATUS151_ADDR A:0xcf70104
y.create.l HWIO_SPMI_PIC_IRQ_STATUS152_ADDR A:0xcf80104
y.create.l HWIO_SPMI_PIC_IRQ_STATUS153_ADDR A:0xcf90104
y.create.l HWIO_SPMI_PIC_IRQ_STATUS154_ADDR A:0xcfa0104
y.create.l HWIO_SPMI_PIC_IRQ_STATUS155_ADDR A:0xcfb0104
y.create.l HWIO_SPMI_PIC_IRQ_STATUS156_ADDR A:0xcfc0104
y.create.l HWIO_SPMI_PIC_IRQ_STATUS157_ADDR A:0xcfd0104
y.create.l HWIO_SPMI_PIC_IRQ_STATUS158_ADDR A:0xcfe0104
y.create.l HWIO_SPMI_PIC_IRQ_STATUS159_ADDR A:0xcff0104
y.create.l HWIO_SPMI_PIC_IRQ_STATUS160_ADDR A:0xd000104
y.create.l HWIO_SPMI_PIC_IRQ_STATUS161_ADDR A:0xd010104
y.create.l HWIO_SPMI_PIC_IRQ_STATUS162_ADDR A:0xd020104
y.create.l HWIO_SPMI_PIC_IRQ_STATUS163_ADDR A:0xd030104
y.create.l HWIO_SPMI_PIC_IRQ_STATUS164_ADDR A:0xd040104
y.create.l HWIO_SPMI_PIC_IRQ_STATUS165_ADDR A:0xd050104
y.create.l HWIO_SPMI_PIC_IRQ_STATUS166_ADDR A:0xd060104
y.create.l HWIO_SPMI_PIC_IRQ_STATUS167_ADDR A:0xd070104
y.create.l HWIO_SPMI_PIC_IRQ_STATUS168_ADDR A:0xd080104
y.create.l HWIO_SPMI_PIC_IRQ_STATUS169_ADDR A:0xd090104
y.create.l HWIO_SPMI_PIC_IRQ_STATUS170_ADDR A:0xd0a0104
y.create.l HWIO_SPMI_PIC_IRQ_STATUS171_ADDR A:0xd0b0104
y.create.l HWIO_SPMI_PIC_IRQ_STATUS172_ADDR A:0xd0c0104
y.create.l HWIO_SPMI_PIC_IRQ_STATUS173_ADDR A:0xd0d0104
y.create.l HWIO_SPMI_PIC_IRQ_STATUS174_ADDR A:0xd0e0104
y.create.l HWIO_SPMI_PIC_IRQ_STATUS175_ADDR A:0xd0f0104
y.create.l HWIO_SPMI_PIC_IRQ_STATUS176_ADDR A:0xd100104
y.create.l HWIO_SPMI_PIC_IRQ_STATUS177_ADDR A:0xd110104
y.create.l HWIO_SPMI_PIC_IRQ_STATUS178_ADDR A:0xd120104
y.create.l HWIO_SPMI_PIC_IRQ_STATUS179_ADDR A:0xd130104
y.create.l HWIO_SPMI_PIC_IRQ_STATUS180_ADDR A:0xd140104
y.create.l HWIO_SPMI_PIC_IRQ_STATUS181_ADDR A:0xd150104
y.create.l HWIO_SPMI_PIC_IRQ_STATUS182_ADDR A:0xd160104
y.create.l HWIO_SPMI_PIC_IRQ_STATUS183_ADDR A:0xd170104
y.create.l HWIO_SPMI_PIC_IRQ_STATUS184_ADDR A:0xd180104
y.create.l HWIO_SPMI_PIC_IRQ_STATUS185_ADDR A:0xd190104
y.create.l HWIO_SPMI_PIC_IRQ_STATUS186_ADDR A:0xd1a0104
y.create.l HWIO_SPMI_PIC_IRQ_STATUS187_ADDR A:0xd1b0104
y.create.l HWIO_SPMI_PIC_IRQ_STATUS188_ADDR A:0xd1c0104
y.create.l HWIO_SPMI_PIC_IRQ_STATUS189_ADDR A:0xd1d0104
y.create.l HWIO_SPMI_PIC_IRQ_STATUS190_ADDR A:0xd1e0104
y.create.l HWIO_SPMI_PIC_IRQ_STATUS191_ADDR A:0xd1f0104
y.create.l HWIO_SPMI_PIC_IRQ_STATUS192_ADDR A:0xd200104
y.create.l HWIO_SPMI_PIC_IRQ_STATUS193_ADDR A:0xd210104
y.create.l HWIO_SPMI_PIC_IRQ_STATUS194_ADDR A:0xd220104
y.create.l HWIO_SPMI_PIC_IRQ_STATUS195_ADDR A:0xd230104
y.create.l HWIO_SPMI_PIC_IRQ_STATUS196_ADDR A:0xd240104
y.create.l HWIO_SPMI_PIC_IRQ_STATUS197_ADDR A:0xd250104
y.create.l HWIO_SPMI_PIC_IRQ_STATUS198_ADDR A:0xd260104
y.create.l HWIO_SPMI_PIC_IRQ_STATUS199_ADDR A:0xd270104
y.create.l HWIO_SPMI_PIC_IRQ_STATUS200_ADDR A:0xd280104
y.create.l HWIO_SPMI_PIC_IRQ_STATUS201_ADDR A:0xd290104
y.create.l HWIO_SPMI_PIC_IRQ_STATUS202_ADDR A:0xd2a0104
y.create.l HWIO_SPMI_PIC_IRQ_STATUS203_ADDR A:0xd2b0104
y.create.l HWIO_SPMI_PIC_IRQ_STATUS204_ADDR A:0xd2c0104
y.create.l HWIO_SPMI_PIC_IRQ_STATUS205_ADDR A:0xd2d0104
y.create.l HWIO_SPMI_PIC_IRQ_STATUS206_ADDR A:0xd2e0104
y.create.l HWIO_SPMI_PIC_IRQ_STATUS207_ADDR A:0xd2f0104
y.create.l HWIO_SPMI_PIC_IRQ_STATUS208_ADDR A:0xd300104
y.create.l HWIO_SPMI_PIC_IRQ_STATUS209_ADDR A:0xd310104
y.create.l HWIO_SPMI_PIC_IRQ_STATUS210_ADDR A:0xd320104
y.create.l HWIO_SPMI_PIC_IRQ_STATUS211_ADDR A:0xd330104
y.create.l HWIO_SPMI_PIC_IRQ_STATUS212_ADDR A:0xd340104
y.create.l HWIO_SPMI_PIC_IRQ_STATUS213_ADDR A:0xd350104
y.create.l HWIO_SPMI_PIC_IRQ_STATUS214_ADDR A:0xd360104
y.create.l HWIO_SPMI_PIC_IRQ_STATUS215_ADDR A:0xd370104
y.create.l HWIO_SPMI_PIC_IRQ_STATUS216_ADDR A:0xd380104
y.create.l HWIO_SPMI_PIC_IRQ_STATUS217_ADDR A:0xd390104
y.create.l HWIO_SPMI_PIC_IRQ_STATUS218_ADDR A:0xd3a0104
y.create.l HWIO_SPMI_PIC_IRQ_STATUS219_ADDR A:0xd3b0104
y.create.l HWIO_SPMI_PIC_IRQ_STATUS220_ADDR A:0xd3c0104
y.create.l HWIO_SPMI_PIC_IRQ_STATUS221_ADDR A:0xd3d0104
y.create.l HWIO_SPMI_PIC_IRQ_STATUS222_ADDR A:0xd3e0104
y.create.l HWIO_SPMI_PIC_IRQ_STATUS223_ADDR A:0xd3f0104
y.create.l HWIO_SPMI_PIC_IRQ_STATUS224_ADDR A:0xd400104
y.create.l HWIO_SPMI_PIC_IRQ_STATUS225_ADDR A:0xd410104
y.create.l HWIO_SPMI_PIC_IRQ_STATUS226_ADDR A:0xd420104
y.create.l HWIO_SPMI_PIC_IRQ_STATUS227_ADDR A:0xd430104
y.create.l HWIO_SPMI_PIC_IRQ_STATUS228_ADDR A:0xd440104
y.create.l HWIO_SPMI_PIC_IRQ_STATUS229_ADDR A:0xd450104
y.create.l HWIO_SPMI_PIC_IRQ_STATUS230_ADDR A:0xd460104
y.create.l HWIO_SPMI_PIC_IRQ_STATUS231_ADDR A:0xd470104
y.create.l HWIO_SPMI_PIC_IRQ_STATUS232_ADDR A:0xd480104
y.create.l HWIO_SPMI_PIC_IRQ_STATUS233_ADDR A:0xd490104
y.create.l HWIO_SPMI_PIC_IRQ_STATUS234_ADDR A:0xd4a0104
y.create.l HWIO_SPMI_PIC_IRQ_STATUS235_ADDR A:0xd4b0104
y.create.l HWIO_SPMI_PIC_IRQ_STATUS236_ADDR A:0xd4c0104
y.create.l HWIO_SPMI_PIC_IRQ_STATUS237_ADDR A:0xd4d0104
y.create.l HWIO_SPMI_PIC_IRQ_STATUS238_ADDR A:0xd4e0104
y.create.l HWIO_SPMI_PIC_IRQ_STATUS239_ADDR A:0xd4f0104
y.create.l HWIO_SPMI_PIC_IRQ_STATUS240_ADDR A:0xd500104
y.create.l HWIO_SPMI_PIC_IRQ_STATUS241_ADDR A:0xd510104
y.create.l HWIO_SPMI_PIC_IRQ_STATUS242_ADDR A:0xd520104
y.create.l HWIO_SPMI_PIC_IRQ_STATUS243_ADDR A:0xd530104
y.create.l HWIO_SPMI_PIC_IRQ_STATUS244_ADDR A:0xd540104
y.create.l HWIO_SPMI_PIC_IRQ_STATUS245_ADDR A:0xd550104
y.create.l HWIO_SPMI_PIC_IRQ_STATUS246_ADDR A:0xd560104
y.create.l HWIO_SPMI_PIC_IRQ_STATUS247_ADDR A:0xd570104
y.create.l HWIO_SPMI_PIC_IRQ_STATUS248_ADDR A:0xd580104
y.create.l HWIO_SPMI_PIC_IRQ_STATUS249_ADDR A:0xd590104
y.create.l HWIO_SPMI_PIC_IRQ_STATUS250_ADDR A:0xd5a0104
y.create.l HWIO_SPMI_PIC_IRQ_STATUS251_ADDR A:0xd5b0104
y.create.l HWIO_SPMI_PIC_IRQ_STATUS252_ADDR A:0xd5c0104
y.create.l HWIO_SPMI_PIC_IRQ_STATUS253_ADDR A:0xd5d0104
y.create.l HWIO_SPMI_PIC_IRQ_STATUS254_ADDR A:0xd5e0104
y.create.l HWIO_SPMI_PIC_IRQ_STATUS255_ADDR A:0xd5f0104
y.create.l HWIO_SPMI_PIC_IRQ_CLEAR0_ADDR A:0xc600108
y.create.l HWIO_SPMI_PIC_IRQ_CLEAR1_ADDR A:0xc610108
y.create.l HWIO_SPMI_PIC_IRQ_CLEAR2_ADDR A:0xc620108
y.create.l HWIO_SPMI_PIC_IRQ_CLEAR3_ADDR A:0xc630108
y.create.l HWIO_SPMI_PIC_IRQ_CLEAR4_ADDR A:0xc640108
y.create.l HWIO_SPMI_PIC_IRQ_CLEAR5_ADDR A:0xc650108
y.create.l HWIO_SPMI_PIC_IRQ_CLEAR6_ADDR A:0xc660108
y.create.l HWIO_SPMI_PIC_IRQ_CLEAR7_ADDR A:0xc670108
y.create.l HWIO_SPMI_PIC_IRQ_CLEAR8_ADDR A:0xc680108
y.create.l HWIO_SPMI_PIC_IRQ_CLEAR9_ADDR A:0xc690108
y.create.l HWIO_SPMI_PIC_IRQ_CLEAR10_ADDR A:0xc6a0108
y.create.l HWIO_SPMI_PIC_IRQ_CLEAR11_ADDR A:0xc6b0108
y.create.l HWIO_SPMI_PIC_IRQ_CLEAR12_ADDR A:0xc6c0108
y.create.l HWIO_SPMI_PIC_IRQ_CLEAR13_ADDR A:0xc6d0108
y.create.l HWIO_SPMI_PIC_IRQ_CLEAR14_ADDR A:0xc6e0108
y.create.l HWIO_SPMI_PIC_IRQ_CLEAR15_ADDR A:0xc6f0108
y.create.l HWIO_SPMI_PIC_IRQ_CLEAR16_ADDR A:0xc700108
y.create.l HWIO_SPMI_PIC_IRQ_CLEAR17_ADDR A:0xc710108
y.create.l HWIO_SPMI_PIC_IRQ_CLEAR18_ADDR A:0xc720108
y.create.l HWIO_SPMI_PIC_IRQ_CLEAR19_ADDR A:0xc730108
y.create.l HWIO_SPMI_PIC_IRQ_CLEAR20_ADDR A:0xc740108
y.create.l HWIO_SPMI_PIC_IRQ_CLEAR21_ADDR A:0xc750108
y.create.l HWIO_SPMI_PIC_IRQ_CLEAR22_ADDR A:0xc760108
y.create.l HWIO_SPMI_PIC_IRQ_CLEAR23_ADDR A:0xc770108
y.create.l HWIO_SPMI_PIC_IRQ_CLEAR24_ADDR A:0xc780108
y.create.l HWIO_SPMI_PIC_IRQ_CLEAR25_ADDR A:0xc790108
y.create.l HWIO_SPMI_PIC_IRQ_CLEAR26_ADDR A:0xc7a0108
y.create.l HWIO_SPMI_PIC_IRQ_CLEAR27_ADDR A:0xc7b0108
y.create.l HWIO_SPMI_PIC_IRQ_CLEAR28_ADDR A:0xc7c0108
y.create.l HWIO_SPMI_PIC_IRQ_CLEAR29_ADDR A:0xc7d0108
y.create.l HWIO_SPMI_PIC_IRQ_CLEAR30_ADDR A:0xc7e0108
y.create.l HWIO_SPMI_PIC_IRQ_CLEAR31_ADDR A:0xc7f0108
y.create.l HWIO_SPMI_PIC_IRQ_CLEAR32_ADDR A:0xc800108
y.create.l HWIO_SPMI_PIC_IRQ_CLEAR33_ADDR A:0xc810108
y.create.l HWIO_SPMI_PIC_IRQ_CLEAR34_ADDR A:0xc820108
y.create.l HWIO_SPMI_PIC_IRQ_CLEAR35_ADDR A:0xc830108
y.create.l HWIO_SPMI_PIC_IRQ_CLEAR36_ADDR A:0xc840108
y.create.l HWIO_SPMI_PIC_IRQ_CLEAR37_ADDR A:0xc850108
y.create.l HWIO_SPMI_PIC_IRQ_CLEAR38_ADDR A:0xc860108
y.create.l HWIO_SPMI_PIC_IRQ_CLEAR39_ADDR A:0xc870108
y.create.l HWIO_SPMI_PIC_IRQ_CLEAR40_ADDR A:0xc880108
y.create.l HWIO_SPMI_PIC_IRQ_CLEAR41_ADDR A:0xc890108
y.create.l HWIO_SPMI_PIC_IRQ_CLEAR42_ADDR A:0xc8a0108
y.create.l HWIO_SPMI_PIC_IRQ_CLEAR43_ADDR A:0xc8b0108
y.create.l HWIO_SPMI_PIC_IRQ_CLEAR44_ADDR A:0xc8c0108
y.create.l HWIO_SPMI_PIC_IRQ_CLEAR45_ADDR A:0xc8d0108
y.create.l HWIO_SPMI_PIC_IRQ_CLEAR46_ADDR A:0xc8e0108
y.create.l HWIO_SPMI_PIC_IRQ_CLEAR47_ADDR A:0xc8f0108
y.create.l HWIO_SPMI_PIC_IRQ_CLEAR48_ADDR A:0xc900108
y.create.l HWIO_SPMI_PIC_IRQ_CLEAR49_ADDR A:0xc910108
y.create.l HWIO_SPMI_PIC_IRQ_CLEAR50_ADDR A:0xc920108
y.create.l HWIO_SPMI_PIC_IRQ_CLEAR51_ADDR A:0xc930108
y.create.l HWIO_SPMI_PIC_IRQ_CLEAR52_ADDR A:0xc940108
y.create.l HWIO_SPMI_PIC_IRQ_CLEAR53_ADDR A:0xc950108
y.create.l HWIO_SPMI_PIC_IRQ_CLEAR54_ADDR A:0xc960108
y.create.l HWIO_SPMI_PIC_IRQ_CLEAR55_ADDR A:0xc970108
y.create.l HWIO_SPMI_PIC_IRQ_CLEAR56_ADDR A:0xc980108
y.create.l HWIO_SPMI_PIC_IRQ_CLEAR57_ADDR A:0xc990108
y.create.l HWIO_SPMI_PIC_IRQ_CLEAR58_ADDR A:0xc9a0108
y.create.l HWIO_SPMI_PIC_IRQ_CLEAR59_ADDR A:0xc9b0108
y.create.l HWIO_SPMI_PIC_IRQ_CLEAR60_ADDR A:0xc9c0108
y.create.l HWIO_SPMI_PIC_IRQ_CLEAR61_ADDR A:0xc9d0108
y.create.l HWIO_SPMI_PIC_IRQ_CLEAR62_ADDR A:0xc9e0108
y.create.l HWIO_SPMI_PIC_IRQ_CLEAR63_ADDR A:0xc9f0108
y.create.l HWIO_SPMI_PIC_IRQ_CLEAR64_ADDR A:0xca00108
y.create.l HWIO_SPMI_PIC_IRQ_CLEAR65_ADDR A:0xca10108
y.create.l HWIO_SPMI_PIC_IRQ_CLEAR66_ADDR A:0xca20108
y.create.l HWIO_SPMI_PIC_IRQ_CLEAR67_ADDR A:0xca30108
y.create.l HWIO_SPMI_PIC_IRQ_CLEAR68_ADDR A:0xca40108
y.create.l HWIO_SPMI_PIC_IRQ_CLEAR69_ADDR A:0xca50108
y.create.l HWIO_SPMI_PIC_IRQ_CLEAR70_ADDR A:0xca60108
y.create.l HWIO_SPMI_PIC_IRQ_CLEAR71_ADDR A:0xca70108
y.create.l HWIO_SPMI_PIC_IRQ_CLEAR72_ADDR A:0xca80108
y.create.l HWIO_SPMI_PIC_IRQ_CLEAR73_ADDR A:0xca90108
y.create.l HWIO_SPMI_PIC_IRQ_CLEAR74_ADDR A:0xcaa0108
y.create.l HWIO_SPMI_PIC_IRQ_CLEAR75_ADDR A:0xcab0108
y.create.l HWIO_SPMI_PIC_IRQ_CLEAR76_ADDR A:0xcac0108
y.create.l HWIO_SPMI_PIC_IRQ_CLEAR77_ADDR A:0xcad0108
y.create.l HWIO_SPMI_PIC_IRQ_CLEAR78_ADDR A:0xcae0108
y.create.l HWIO_SPMI_PIC_IRQ_CLEAR79_ADDR A:0xcaf0108
y.create.l HWIO_SPMI_PIC_IRQ_CLEAR80_ADDR A:0xcb00108
y.create.l HWIO_SPMI_PIC_IRQ_CLEAR81_ADDR A:0xcb10108
y.create.l HWIO_SPMI_PIC_IRQ_CLEAR82_ADDR A:0xcb20108
y.create.l HWIO_SPMI_PIC_IRQ_CLEAR83_ADDR A:0xcb30108
y.create.l HWIO_SPMI_PIC_IRQ_CLEAR84_ADDR A:0xcb40108
y.create.l HWIO_SPMI_PIC_IRQ_CLEAR85_ADDR A:0xcb50108
y.create.l HWIO_SPMI_PIC_IRQ_CLEAR86_ADDR A:0xcb60108
y.create.l HWIO_SPMI_PIC_IRQ_CLEAR87_ADDR A:0xcb70108
y.create.l HWIO_SPMI_PIC_IRQ_CLEAR88_ADDR A:0xcb80108
y.create.l HWIO_SPMI_PIC_IRQ_CLEAR89_ADDR A:0xcb90108
y.create.l HWIO_SPMI_PIC_IRQ_CLEAR90_ADDR A:0xcba0108
y.create.l HWIO_SPMI_PIC_IRQ_CLEAR91_ADDR A:0xcbb0108
y.create.l HWIO_SPMI_PIC_IRQ_CLEAR92_ADDR A:0xcbc0108
y.create.l HWIO_SPMI_PIC_IRQ_CLEAR93_ADDR A:0xcbd0108
y.create.l HWIO_SPMI_PIC_IRQ_CLEAR94_ADDR A:0xcbe0108
y.create.l HWIO_SPMI_PIC_IRQ_CLEAR95_ADDR A:0xcbf0108
y.create.l HWIO_SPMI_PIC_IRQ_CLEAR96_ADDR A:0xcc00108
y.create.l HWIO_SPMI_PIC_IRQ_CLEAR97_ADDR A:0xcc10108
y.create.l HWIO_SPMI_PIC_IRQ_CLEAR98_ADDR A:0xcc20108
y.create.l HWIO_SPMI_PIC_IRQ_CLEAR99_ADDR A:0xcc30108
y.create.l HWIO_SPMI_PIC_IRQ_CLEAR100_ADDR A:0xcc40108
y.create.l HWIO_SPMI_PIC_IRQ_CLEAR101_ADDR A:0xcc50108
y.create.l HWIO_SPMI_PIC_IRQ_CLEAR102_ADDR A:0xcc60108
y.create.l HWIO_SPMI_PIC_IRQ_CLEAR103_ADDR A:0xcc70108
y.create.l HWIO_SPMI_PIC_IRQ_CLEAR104_ADDR A:0xcc80108
y.create.l HWIO_SPMI_PIC_IRQ_CLEAR105_ADDR A:0xcc90108
y.create.l HWIO_SPMI_PIC_IRQ_CLEAR106_ADDR A:0xcca0108
y.create.l HWIO_SPMI_PIC_IRQ_CLEAR107_ADDR A:0xccb0108
y.create.l HWIO_SPMI_PIC_IRQ_CLEAR108_ADDR A:0xccc0108
y.create.l HWIO_SPMI_PIC_IRQ_CLEAR109_ADDR A:0xccd0108
y.create.l HWIO_SPMI_PIC_IRQ_CLEAR110_ADDR A:0xcce0108
y.create.l HWIO_SPMI_PIC_IRQ_CLEAR111_ADDR A:0xccf0108
y.create.l HWIO_SPMI_PIC_IRQ_CLEAR112_ADDR A:0xcd00108
y.create.l HWIO_SPMI_PIC_IRQ_CLEAR113_ADDR A:0xcd10108
y.create.l HWIO_SPMI_PIC_IRQ_CLEAR114_ADDR A:0xcd20108
y.create.l HWIO_SPMI_PIC_IRQ_CLEAR115_ADDR A:0xcd30108
y.create.l HWIO_SPMI_PIC_IRQ_CLEAR116_ADDR A:0xcd40108
y.create.l HWIO_SPMI_PIC_IRQ_CLEAR117_ADDR A:0xcd50108
y.create.l HWIO_SPMI_PIC_IRQ_CLEAR118_ADDR A:0xcd60108
y.create.l HWIO_SPMI_PIC_IRQ_CLEAR119_ADDR A:0xcd70108
y.create.l HWIO_SPMI_PIC_IRQ_CLEAR120_ADDR A:0xcd80108
y.create.l HWIO_SPMI_PIC_IRQ_CLEAR121_ADDR A:0xcd90108
y.create.l HWIO_SPMI_PIC_IRQ_CLEAR122_ADDR A:0xcda0108
y.create.l HWIO_SPMI_PIC_IRQ_CLEAR123_ADDR A:0xcdb0108
y.create.l HWIO_SPMI_PIC_IRQ_CLEAR124_ADDR A:0xcdc0108
y.create.l HWIO_SPMI_PIC_IRQ_CLEAR125_ADDR A:0xcdd0108
y.create.l HWIO_SPMI_PIC_IRQ_CLEAR126_ADDR A:0xcde0108
y.create.l HWIO_SPMI_PIC_IRQ_CLEAR127_ADDR A:0xcdf0108
y.create.l HWIO_SPMI_PIC_IRQ_CLEAR128_ADDR A:0xce00108
y.create.l HWIO_SPMI_PIC_IRQ_CLEAR129_ADDR A:0xce10108
y.create.l HWIO_SPMI_PIC_IRQ_CLEAR130_ADDR A:0xce20108
y.create.l HWIO_SPMI_PIC_IRQ_CLEAR131_ADDR A:0xce30108
y.create.l HWIO_SPMI_PIC_IRQ_CLEAR132_ADDR A:0xce40108
y.create.l HWIO_SPMI_PIC_IRQ_CLEAR133_ADDR A:0xce50108
y.create.l HWIO_SPMI_PIC_IRQ_CLEAR134_ADDR A:0xce60108
y.create.l HWIO_SPMI_PIC_IRQ_CLEAR135_ADDR A:0xce70108
y.create.l HWIO_SPMI_PIC_IRQ_CLEAR136_ADDR A:0xce80108
y.create.l HWIO_SPMI_PIC_IRQ_CLEAR137_ADDR A:0xce90108
y.create.l HWIO_SPMI_PIC_IRQ_CLEAR138_ADDR A:0xcea0108
y.create.l HWIO_SPMI_PIC_IRQ_CLEAR139_ADDR A:0xceb0108
y.create.l HWIO_SPMI_PIC_IRQ_CLEAR140_ADDR A:0xcec0108
y.create.l HWIO_SPMI_PIC_IRQ_CLEAR141_ADDR A:0xced0108
y.create.l HWIO_SPMI_PIC_IRQ_CLEAR142_ADDR A:0xcee0108
y.create.l HWIO_SPMI_PIC_IRQ_CLEAR143_ADDR A:0xcef0108
y.create.l HWIO_SPMI_PIC_IRQ_CLEAR144_ADDR A:0xcf00108
y.create.l HWIO_SPMI_PIC_IRQ_CLEAR145_ADDR A:0xcf10108
y.create.l HWIO_SPMI_PIC_IRQ_CLEAR146_ADDR A:0xcf20108
y.create.l HWIO_SPMI_PIC_IRQ_CLEAR147_ADDR A:0xcf30108
y.create.l HWIO_SPMI_PIC_IRQ_CLEAR148_ADDR A:0xcf40108
y.create.l HWIO_SPMI_PIC_IRQ_CLEAR149_ADDR A:0xcf50108
y.create.l HWIO_SPMI_PIC_IRQ_CLEAR150_ADDR A:0xcf60108
y.create.l HWIO_SPMI_PIC_IRQ_CLEAR151_ADDR A:0xcf70108
y.create.l HWIO_SPMI_PIC_IRQ_CLEAR152_ADDR A:0xcf80108
y.create.l HWIO_SPMI_PIC_IRQ_CLEAR153_ADDR A:0xcf90108
y.create.l HWIO_SPMI_PIC_IRQ_CLEAR154_ADDR A:0xcfa0108
y.create.l HWIO_SPMI_PIC_IRQ_CLEAR155_ADDR A:0xcfb0108
y.create.l HWIO_SPMI_PIC_IRQ_CLEAR156_ADDR A:0xcfc0108
y.create.l HWIO_SPMI_PIC_IRQ_CLEAR157_ADDR A:0xcfd0108
y.create.l HWIO_SPMI_PIC_IRQ_CLEAR158_ADDR A:0xcfe0108
y.create.l HWIO_SPMI_PIC_IRQ_CLEAR159_ADDR A:0xcff0108
y.create.l HWIO_SPMI_PIC_IRQ_CLEAR160_ADDR A:0xd000108
y.create.l HWIO_SPMI_PIC_IRQ_CLEAR161_ADDR A:0xd010108
y.create.l HWIO_SPMI_PIC_IRQ_CLEAR162_ADDR A:0xd020108
y.create.l HWIO_SPMI_PIC_IRQ_CLEAR163_ADDR A:0xd030108
y.create.l HWIO_SPMI_PIC_IRQ_CLEAR164_ADDR A:0xd040108
y.create.l HWIO_SPMI_PIC_IRQ_CLEAR165_ADDR A:0xd050108
y.create.l HWIO_SPMI_PIC_IRQ_CLEAR166_ADDR A:0xd060108
y.create.l HWIO_SPMI_PIC_IRQ_CLEAR167_ADDR A:0xd070108
y.create.l HWIO_SPMI_PIC_IRQ_CLEAR168_ADDR A:0xd080108
y.create.l HWIO_SPMI_PIC_IRQ_CLEAR169_ADDR A:0xd090108
y.create.l HWIO_SPMI_PIC_IRQ_CLEAR170_ADDR A:0xd0a0108
y.create.l HWIO_SPMI_PIC_IRQ_CLEAR171_ADDR A:0xd0b0108
y.create.l HWIO_SPMI_PIC_IRQ_CLEAR172_ADDR A:0xd0c0108
y.create.l HWIO_SPMI_PIC_IRQ_CLEAR173_ADDR A:0xd0d0108
y.create.l HWIO_SPMI_PIC_IRQ_CLEAR174_ADDR A:0xd0e0108
y.create.l HWIO_SPMI_PIC_IRQ_CLEAR175_ADDR A:0xd0f0108
y.create.l HWIO_SPMI_PIC_IRQ_CLEAR176_ADDR A:0xd100108
y.create.l HWIO_SPMI_PIC_IRQ_CLEAR177_ADDR A:0xd110108
y.create.l HWIO_SPMI_PIC_IRQ_CLEAR178_ADDR A:0xd120108
y.create.l HWIO_SPMI_PIC_IRQ_CLEAR179_ADDR A:0xd130108
y.create.l HWIO_SPMI_PIC_IRQ_CLEAR180_ADDR A:0xd140108
y.create.l HWIO_SPMI_PIC_IRQ_CLEAR181_ADDR A:0xd150108
y.create.l HWIO_SPMI_PIC_IRQ_CLEAR182_ADDR A:0xd160108
y.create.l HWIO_SPMI_PIC_IRQ_CLEAR183_ADDR A:0xd170108
y.create.l HWIO_SPMI_PIC_IRQ_CLEAR184_ADDR A:0xd180108
y.create.l HWIO_SPMI_PIC_IRQ_CLEAR185_ADDR A:0xd190108
y.create.l HWIO_SPMI_PIC_IRQ_CLEAR186_ADDR A:0xd1a0108
y.create.l HWIO_SPMI_PIC_IRQ_CLEAR187_ADDR A:0xd1b0108
y.create.l HWIO_SPMI_PIC_IRQ_CLEAR188_ADDR A:0xd1c0108
y.create.l HWIO_SPMI_PIC_IRQ_CLEAR189_ADDR A:0xd1d0108
y.create.l HWIO_SPMI_PIC_IRQ_CLEAR190_ADDR A:0xd1e0108
y.create.l HWIO_SPMI_PIC_IRQ_CLEAR191_ADDR A:0xd1f0108
y.create.l HWIO_SPMI_PIC_IRQ_CLEAR192_ADDR A:0xd200108
y.create.l HWIO_SPMI_PIC_IRQ_CLEAR193_ADDR A:0xd210108
y.create.l HWIO_SPMI_PIC_IRQ_CLEAR194_ADDR A:0xd220108
y.create.l HWIO_SPMI_PIC_IRQ_CLEAR195_ADDR A:0xd230108
y.create.l HWIO_SPMI_PIC_IRQ_CLEAR196_ADDR A:0xd240108
y.create.l HWIO_SPMI_PIC_IRQ_CLEAR197_ADDR A:0xd250108
y.create.l HWIO_SPMI_PIC_IRQ_CLEAR198_ADDR A:0xd260108
y.create.l HWIO_SPMI_PIC_IRQ_CLEAR199_ADDR A:0xd270108
y.create.l HWIO_SPMI_PIC_IRQ_CLEAR200_ADDR A:0xd280108
y.create.l HWIO_SPMI_PIC_IRQ_CLEAR201_ADDR A:0xd290108
y.create.l HWIO_SPMI_PIC_IRQ_CLEAR202_ADDR A:0xd2a0108
y.create.l HWIO_SPMI_PIC_IRQ_CLEAR203_ADDR A:0xd2b0108
y.create.l HWIO_SPMI_PIC_IRQ_CLEAR204_ADDR A:0xd2c0108
y.create.l HWIO_SPMI_PIC_IRQ_CLEAR205_ADDR A:0xd2d0108
y.create.l HWIO_SPMI_PIC_IRQ_CLEAR206_ADDR A:0xd2e0108
y.create.l HWIO_SPMI_PIC_IRQ_CLEAR207_ADDR A:0xd2f0108
y.create.l HWIO_SPMI_PIC_IRQ_CLEAR208_ADDR A:0xd300108
y.create.l HWIO_SPMI_PIC_IRQ_CLEAR209_ADDR A:0xd310108
y.create.l HWIO_SPMI_PIC_IRQ_CLEAR210_ADDR A:0xd320108
y.create.l HWIO_SPMI_PIC_IRQ_CLEAR211_ADDR A:0xd330108
y.create.l HWIO_SPMI_PIC_IRQ_CLEAR212_ADDR A:0xd340108
y.create.l HWIO_SPMI_PIC_IRQ_CLEAR213_ADDR A:0xd350108
y.create.l HWIO_SPMI_PIC_IRQ_CLEAR214_ADDR A:0xd360108
y.create.l HWIO_SPMI_PIC_IRQ_CLEAR215_ADDR A:0xd370108
y.create.l HWIO_SPMI_PIC_IRQ_CLEAR216_ADDR A:0xd380108
y.create.l HWIO_SPMI_PIC_IRQ_CLEAR217_ADDR A:0xd390108
y.create.l HWIO_SPMI_PIC_IRQ_CLEAR218_ADDR A:0xd3a0108
y.create.l HWIO_SPMI_PIC_IRQ_CLEAR219_ADDR A:0xd3b0108
y.create.l HWIO_SPMI_PIC_IRQ_CLEAR220_ADDR A:0xd3c0108
y.create.l HWIO_SPMI_PIC_IRQ_CLEAR221_ADDR A:0xd3d0108
y.create.l HWIO_SPMI_PIC_IRQ_CLEAR222_ADDR A:0xd3e0108
y.create.l HWIO_SPMI_PIC_IRQ_CLEAR223_ADDR A:0xd3f0108
y.create.l HWIO_SPMI_PIC_IRQ_CLEAR224_ADDR A:0xd400108
y.create.l HWIO_SPMI_PIC_IRQ_CLEAR225_ADDR A:0xd410108
y.create.l HWIO_SPMI_PIC_IRQ_CLEAR226_ADDR A:0xd420108
y.create.l HWIO_SPMI_PIC_IRQ_CLEAR227_ADDR A:0xd430108
y.create.l HWIO_SPMI_PIC_IRQ_CLEAR228_ADDR A:0xd440108
y.create.l HWIO_SPMI_PIC_IRQ_CLEAR229_ADDR A:0xd450108
y.create.l HWIO_SPMI_PIC_IRQ_CLEAR230_ADDR A:0xd460108
y.create.l HWIO_SPMI_PIC_IRQ_CLEAR231_ADDR A:0xd470108
y.create.l HWIO_SPMI_PIC_IRQ_CLEAR232_ADDR A:0xd480108
y.create.l HWIO_SPMI_PIC_IRQ_CLEAR233_ADDR A:0xd490108
y.create.l HWIO_SPMI_PIC_IRQ_CLEAR234_ADDR A:0xd4a0108
y.create.l HWIO_SPMI_PIC_IRQ_CLEAR235_ADDR A:0xd4b0108
y.create.l HWIO_SPMI_PIC_IRQ_CLEAR236_ADDR A:0xd4c0108
y.create.l HWIO_SPMI_PIC_IRQ_CLEAR237_ADDR A:0xd4d0108
y.create.l HWIO_SPMI_PIC_IRQ_CLEAR238_ADDR A:0xd4e0108
y.create.l HWIO_SPMI_PIC_IRQ_CLEAR239_ADDR A:0xd4f0108
y.create.l HWIO_SPMI_PIC_IRQ_CLEAR240_ADDR A:0xd500108
y.create.l HWIO_SPMI_PIC_IRQ_CLEAR241_ADDR A:0xd510108
y.create.l HWIO_SPMI_PIC_IRQ_CLEAR242_ADDR A:0xd520108
y.create.l HWIO_SPMI_PIC_IRQ_CLEAR243_ADDR A:0xd530108
y.create.l HWIO_SPMI_PIC_IRQ_CLEAR244_ADDR A:0xd540108
y.create.l HWIO_SPMI_PIC_IRQ_CLEAR245_ADDR A:0xd550108
y.create.l HWIO_SPMI_PIC_IRQ_CLEAR246_ADDR A:0xd560108
y.create.l HWIO_SPMI_PIC_IRQ_CLEAR247_ADDR A:0xd570108
y.create.l HWIO_SPMI_PIC_IRQ_CLEAR248_ADDR A:0xd580108
y.create.l HWIO_SPMI_PIC_IRQ_CLEAR249_ADDR A:0xd590108
y.create.l HWIO_SPMI_PIC_IRQ_CLEAR250_ADDR A:0xd5a0108
y.create.l HWIO_SPMI_PIC_IRQ_CLEAR251_ADDR A:0xd5b0108
y.create.l HWIO_SPMI_PIC_IRQ_CLEAR252_ADDR A:0xd5c0108
y.create.l HWIO_SPMI_PIC_IRQ_CLEAR253_ADDR A:0xd5d0108
y.create.l HWIO_SPMI_PIC_IRQ_CLEAR254_ADDR A:0xd5e0108
y.create.l HWIO_SPMI_PIC_IRQ_CLEAR255_ADDR A:0xd5f0108
y.create.l HWIO_PMIC_ARB_OBS0_CHNL0_CMD_ADDR A:0xe600000
y.create.l HWIO_PMIC_ARB_OBS0_CHNL1_CMD_ADDR A:0xe600080
y.create.l HWIO_PMIC_ARB_OBS0_CHNL2_CMD_ADDR A:0xe600100
y.create.l HWIO_PMIC_ARB_OBS0_CHNL3_CMD_ADDR A:0xe600180
y.create.l HWIO_PMIC_ARB_OBS0_CHNL4_CMD_ADDR A:0xe600200
y.create.l HWIO_PMIC_ARB_OBS0_CHNL5_CMD_ADDR A:0xe600280
y.create.l HWIO_PMIC_ARB_OBS0_CHNL6_CMD_ADDR A:0xe600300
y.create.l HWIO_PMIC_ARB_OBS0_CHNL7_CMD_ADDR A:0xe600380
y.create.l HWIO_PMIC_ARB_OBS0_CHNL8_CMD_ADDR A:0xe600400
y.create.l HWIO_PMIC_ARB_OBS0_CHNL9_CMD_ADDR A:0xe600480
y.create.l HWIO_PMIC_ARB_OBS0_CHNL10_CMD_ADDR A:0xe600500
y.create.l HWIO_PMIC_ARB_OBS0_CHNL11_CMD_ADDR A:0xe600580
y.create.l HWIO_PMIC_ARB_OBS0_CHNL12_CMD_ADDR A:0xe600600
y.create.l HWIO_PMIC_ARB_OBS0_CHNL13_CMD_ADDR A:0xe600680
y.create.l HWIO_PMIC_ARB_OBS0_CHNL14_CMD_ADDR A:0xe600700
y.create.l HWIO_PMIC_ARB_OBS0_CHNL15_CMD_ADDR A:0xe600780
y.create.l HWIO_PMIC_ARB_OBS0_CHNL16_CMD_ADDR A:0xe600800
y.create.l HWIO_PMIC_ARB_OBS0_CHNL17_CMD_ADDR A:0xe600880
y.create.l HWIO_PMIC_ARB_OBS0_CHNL18_CMD_ADDR A:0xe600900
y.create.l HWIO_PMIC_ARB_OBS0_CHNL19_CMD_ADDR A:0xe600980
y.create.l HWIO_PMIC_ARB_OBS0_CHNL20_CMD_ADDR A:0xe600a00
y.create.l HWIO_PMIC_ARB_OBS0_CHNL21_CMD_ADDR A:0xe600a80
y.create.l HWIO_PMIC_ARB_OBS0_CHNL22_CMD_ADDR A:0xe600b00
y.create.l HWIO_PMIC_ARB_OBS0_CHNL23_CMD_ADDR A:0xe600b80
y.create.l HWIO_PMIC_ARB_OBS0_CHNL24_CMD_ADDR A:0xe600c00
y.create.l HWIO_PMIC_ARB_OBS0_CHNL25_CMD_ADDR A:0xe600c80
y.create.l HWIO_PMIC_ARB_OBS0_CHNL26_CMD_ADDR A:0xe600d00
y.create.l HWIO_PMIC_ARB_OBS0_CHNL27_CMD_ADDR A:0xe600d80
y.create.l HWIO_PMIC_ARB_OBS0_CHNL28_CMD_ADDR A:0xe600e00
y.create.l HWIO_PMIC_ARB_OBS0_CHNL29_CMD_ADDR A:0xe600e80
y.create.l HWIO_PMIC_ARB_OBS0_CHNL30_CMD_ADDR A:0xe600f00
y.create.l HWIO_PMIC_ARB_OBS0_CHNL31_CMD_ADDR A:0xe600f80
y.create.l HWIO_PMIC_ARB_OBS0_CHNL32_CMD_ADDR A:0xe601000
y.create.l HWIO_PMIC_ARB_OBS0_CHNL33_CMD_ADDR A:0xe601080
y.create.l HWIO_PMIC_ARB_OBS0_CHNL34_CMD_ADDR A:0xe601100
y.create.l HWIO_PMIC_ARB_OBS0_CHNL35_CMD_ADDR A:0xe601180
y.create.l HWIO_PMIC_ARB_OBS0_CHNL36_CMD_ADDR A:0xe601200
y.create.l HWIO_PMIC_ARB_OBS0_CHNL37_CMD_ADDR A:0xe601280
y.create.l HWIO_PMIC_ARB_OBS0_CHNL38_CMD_ADDR A:0xe601300
y.create.l HWIO_PMIC_ARB_OBS0_CHNL39_CMD_ADDR A:0xe601380
y.create.l HWIO_PMIC_ARB_OBS0_CHNL40_CMD_ADDR A:0xe601400
y.create.l HWIO_PMIC_ARB_OBS0_CHNL41_CMD_ADDR A:0xe601480
y.create.l HWIO_PMIC_ARB_OBS0_CHNL42_CMD_ADDR A:0xe601500
y.create.l HWIO_PMIC_ARB_OBS0_CHNL43_CMD_ADDR A:0xe601580
y.create.l HWIO_PMIC_ARB_OBS0_CHNL44_CMD_ADDR A:0xe601600
y.create.l HWIO_PMIC_ARB_OBS0_CHNL45_CMD_ADDR A:0xe601680
y.create.l HWIO_PMIC_ARB_OBS0_CHNL46_CMD_ADDR A:0xe601700
y.create.l HWIO_PMIC_ARB_OBS0_CHNL47_CMD_ADDR A:0xe601780
y.create.l HWIO_PMIC_ARB_OBS0_CHNL48_CMD_ADDR A:0xe601800
y.create.l HWIO_PMIC_ARB_OBS0_CHNL49_CMD_ADDR A:0xe601880
y.create.l HWIO_PMIC_ARB_OBS0_CHNL50_CMD_ADDR A:0xe601900
y.create.l HWIO_PMIC_ARB_OBS0_CHNL51_CMD_ADDR A:0xe601980
y.create.l HWIO_PMIC_ARB_OBS0_CHNL52_CMD_ADDR A:0xe601a00
y.create.l HWIO_PMIC_ARB_OBS0_CHNL53_CMD_ADDR A:0xe601a80
y.create.l HWIO_PMIC_ARB_OBS0_CHNL54_CMD_ADDR A:0xe601b00
y.create.l HWIO_PMIC_ARB_OBS0_CHNL55_CMD_ADDR A:0xe601b80
y.create.l HWIO_PMIC_ARB_OBS0_CHNL56_CMD_ADDR A:0xe601c00
y.create.l HWIO_PMIC_ARB_OBS0_CHNL57_CMD_ADDR A:0xe601c80
y.create.l HWIO_PMIC_ARB_OBS0_CHNL58_CMD_ADDR A:0xe601d00
y.create.l HWIO_PMIC_ARB_OBS0_CHNL59_CMD_ADDR A:0xe601d80
y.create.l HWIO_PMIC_ARB_OBS0_CHNL60_CMD_ADDR A:0xe601e00
y.create.l HWIO_PMIC_ARB_OBS0_CHNL61_CMD_ADDR A:0xe601e80
y.create.l HWIO_PMIC_ARB_OBS0_CHNL62_CMD_ADDR A:0xe601f00
y.create.l HWIO_PMIC_ARB_OBS0_CHNL63_CMD_ADDR A:0xe601f80
y.create.l HWIO_PMIC_ARB_OBS0_CHNL64_CMD_ADDR A:0xe602000
y.create.l HWIO_PMIC_ARB_OBS0_CHNL65_CMD_ADDR A:0xe602080
y.create.l HWIO_PMIC_ARB_OBS0_CHNL66_CMD_ADDR A:0xe602100
y.create.l HWIO_PMIC_ARB_OBS0_CHNL67_CMD_ADDR A:0xe602180
y.create.l HWIO_PMIC_ARB_OBS0_CHNL68_CMD_ADDR A:0xe602200
y.create.l HWIO_PMIC_ARB_OBS0_CHNL69_CMD_ADDR A:0xe602280
y.create.l HWIO_PMIC_ARB_OBS0_CHNL70_CMD_ADDR A:0xe602300
y.create.l HWIO_PMIC_ARB_OBS0_CHNL71_CMD_ADDR A:0xe602380
y.create.l HWIO_PMIC_ARB_OBS0_CHNL72_CMD_ADDR A:0xe602400
y.create.l HWIO_PMIC_ARB_OBS0_CHNL73_CMD_ADDR A:0xe602480
y.create.l HWIO_PMIC_ARB_OBS0_CHNL74_CMD_ADDR A:0xe602500
y.create.l HWIO_PMIC_ARB_OBS0_CHNL75_CMD_ADDR A:0xe602580
y.create.l HWIO_PMIC_ARB_OBS0_CHNL76_CMD_ADDR A:0xe602600
y.create.l HWIO_PMIC_ARB_OBS0_CHNL77_CMD_ADDR A:0xe602680
y.create.l HWIO_PMIC_ARB_OBS0_CHNL78_CMD_ADDR A:0xe602700
y.create.l HWIO_PMIC_ARB_OBS0_CHNL79_CMD_ADDR A:0xe602780
y.create.l HWIO_PMIC_ARB_OBS0_CHNL80_CMD_ADDR A:0xe602800
y.create.l HWIO_PMIC_ARB_OBS0_CHNL81_CMD_ADDR A:0xe602880
y.create.l HWIO_PMIC_ARB_OBS0_CHNL82_CMD_ADDR A:0xe602900
y.create.l HWIO_PMIC_ARB_OBS0_CHNL83_CMD_ADDR A:0xe602980
y.create.l HWIO_PMIC_ARB_OBS0_CHNL84_CMD_ADDR A:0xe602a00
y.create.l HWIO_PMIC_ARB_OBS0_CHNL85_CMD_ADDR A:0xe602a80
y.create.l HWIO_PMIC_ARB_OBS0_CHNL86_CMD_ADDR A:0xe602b00
y.create.l HWIO_PMIC_ARB_OBS0_CHNL87_CMD_ADDR A:0xe602b80
y.create.l HWIO_PMIC_ARB_OBS0_CHNL88_CMD_ADDR A:0xe602c00
y.create.l HWIO_PMIC_ARB_OBS0_CHNL89_CMD_ADDR A:0xe602c80
y.create.l HWIO_PMIC_ARB_OBS0_CHNL90_CMD_ADDR A:0xe602d00
y.create.l HWIO_PMIC_ARB_OBS0_CHNL91_CMD_ADDR A:0xe602d80
y.create.l HWIO_PMIC_ARB_OBS0_CHNL92_CMD_ADDR A:0xe602e00
y.create.l HWIO_PMIC_ARB_OBS0_CHNL93_CMD_ADDR A:0xe602e80
y.create.l HWIO_PMIC_ARB_OBS0_CHNL94_CMD_ADDR A:0xe602f00
y.create.l HWIO_PMIC_ARB_OBS0_CHNL95_CMD_ADDR A:0xe602f80
y.create.l HWIO_PMIC_ARB_OBS0_CHNL96_CMD_ADDR A:0xe603000
y.create.l HWIO_PMIC_ARB_OBS0_CHNL97_CMD_ADDR A:0xe603080
y.create.l HWIO_PMIC_ARB_OBS0_CHNL98_CMD_ADDR A:0xe603100
y.create.l HWIO_PMIC_ARB_OBS0_CHNL99_CMD_ADDR A:0xe603180
y.create.l HWIO_PMIC_ARB_OBS0_CHNL100_CMD_ADDR A:0xe603200
y.create.l HWIO_PMIC_ARB_OBS0_CHNL101_CMD_ADDR A:0xe603280
y.create.l HWIO_PMIC_ARB_OBS0_CHNL102_CMD_ADDR A:0xe603300
y.create.l HWIO_PMIC_ARB_OBS0_CHNL103_CMD_ADDR A:0xe603380
y.create.l HWIO_PMIC_ARB_OBS0_CHNL104_CMD_ADDR A:0xe603400
y.create.l HWIO_PMIC_ARB_OBS0_CHNL105_CMD_ADDR A:0xe603480
y.create.l HWIO_PMIC_ARB_OBS0_CHNL106_CMD_ADDR A:0xe603500
y.create.l HWIO_PMIC_ARB_OBS0_CHNL107_CMD_ADDR A:0xe603580
y.create.l HWIO_PMIC_ARB_OBS0_CHNL108_CMD_ADDR A:0xe603600
y.create.l HWIO_PMIC_ARB_OBS0_CHNL109_CMD_ADDR A:0xe603680
y.create.l HWIO_PMIC_ARB_OBS0_CHNL110_CMD_ADDR A:0xe603700
y.create.l HWIO_PMIC_ARB_OBS0_CHNL111_CMD_ADDR A:0xe603780
y.create.l HWIO_PMIC_ARB_OBS0_CHNL112_CMD_ADDR A:0xe603800
y.create.l HWIO_PMIC_ARB_OBS0_CHNL113_CMD_ADDR A:0xe603880
y.create.l HWIO_PMIC_ARB_OBS0_CHNL114_CMD_ADDR A:0xe603900
y.create.l HWIO_PMIC_ARB_OBS0_CHNL115_CMD_ADDR A:0xe603980
y.create.l HWIO_PMIC_ARB_OBS0_CHNL116_CMD_ADDR A:0xe603a00
y.create.l HWIO_PMIC_ARB_OBS0_CHNL117_CMD_ADDR A:0xe603a80
y.create.l HWIO_PMIC_ARB_OBS0_CHNL118_CMD_ADDR A:0xe603b00
y.create.l HWIO_PMIC_ARB_OBS0_CHNL119_CMD_ADDR A:0xe603b80
y.create.l HWIO_PMIC_ARB_OBS0_CHNL120_CMD_ADDR A:0xe603c00
y.create.l HWIO_PMIC_ARB_OBS0_CHNL121_CMD_ADDR A:0xe603c80
y.create.l HWIO_PMIC_ARB_OBS0_CHNL122_CMD_ADDR A:0xe603d00
y.create.l HWIO_PMIC_ARB_OBS0_CHNL123_CMD_ADDR A:0xe603d80
y.create.l HWIO_PMIC_ARB_OBS0_CHNL124_CMD_ADDR A:0xe603e00
y.create.l HWIO_PMIC_ARB_OBS0_CHNL125_CMD_ADDR A:0xe603e80
y.create.l HWIO_PMIC_ARB_OBS0_CHNL126_CMD_ADDR A:0xe603f00
y.create.l HWIO_PMIC_ARB_OBS0_CHNL127_CMD_ADDR A:0xe603f80
y.create.l HWIO_PMIC_ARB_OBS0_CHNL128_CMD_ADDR A:0xe604000
y.create.l HWIO_PMIC_ARB_OBS0_CHNL129_CMD_ADDR A:0xe604080
y.create.l HWIO_PMIC_ARB_OBS0_CHNL130_CMD_ADDR A:0xe604100
y.create.l HWIO_PMIC_ARB_OBS0_CHNL131_CMD_ADDR A:0xe604180
y.create.l HWIO_PMIC_ARB_OBS0_CHNL132_CMD_ADDR A:0xe604200
y.create.l HWIO_PMIC_ARB_OBS0_CHNL133_CMD_ADDR A:0xe604280
y.create.l HWIO_PMIC_ARB_OBS0_CHNL134_CMD_ADDR A:0xe604300
y.create.l HWIO_PMIC_ARB_OBS0_CHNL135_CMD_ADDR A:0xe604380
y.create.l HWIO_PMIC_ARB_OBS0_CHNL136_CMD_ADDR A:0xe604400
y.create.l HWIO_PMIC_ARB_OBS0_CHNL137_CMD_ADDR A:0xe604480
y.create.l HWIO_PMIC_ARB_OBS0_CHNL138_CMD_ADDR A:0xe604500
y.create.l HWIO_PMIC_ARB_OBS0_CHNL139_CMD_ADDR A:0xe604580
y.create.l HWIO_PMIC_ARB_OBS0_CHNL140_CMD_ADDR A:0xe604600
y.create.l HWIO_PMIC_ARB_OBS0_CHNL141_CMD_ADDR A:0xe604680
y.create.l HWIO_PMIC_ARB_OBS0_CHNL142_CMD_ADDR A:0xe604700
y.create.l HWIO_PMIC_ARB_OBS0_CHNL143_CMD_ADDR A:0xe604780
y.create.l HWIO_PMIC_ARB_OBS0_CHNL144_CMD_ADDR A:0xe604800
y.create.l HWIO_PMIC_ARB_OBS0_CHNL145_CMD_ADDR A:0xe604880
y.create.l HWIO_PMIC_ARB_OBS0_CHNL146_CMD_ADDR A:0xe604900
y.create.l HWIO_PMIC_ARB_OBS0_CHNL147_CMD_ADDR A:0xe604980
y.create.l HWIO_PMIC_ARB_OBS0_CHNL148_CMD_ADDR A:0xe604a00
y.create.l HWIO_PMIC_ARB_OBS0_CHNL149_CMD_ADDR A:0xe604a80
y.create.l HWIO_PMIC_ARB_OBS0_CHNL150_CMD_ADDR A:0xe604b00
y.create.l HWIO_PMIC_ARB_OBS0_CHNL151_CMD_ADDR A:0xe604b80
y.create.l HWIO_PMIC_ARB_OBS0_CHNL152_CMD_ADDR A:0xe604c00
y.create.l HWIO_PMIC_ARB_OBS0_CHNL153_CMD_ADDR A:0xe604c80
y.create.l HWIO_PMIC_ARB_OBS0_CHNL154_CMD_ADDR A:0xe604d00
y.create.l HWIO_PMIC_ARB_OBS0_CHNL155_CMD_ADDR A:0xe604d80
y.create.l HWIO_PMIC_ARB_OBS0_CHNL156_CMD_ADDR A:0xe604e00
y.create.l HWIO_PMIC_ARB_OBS0_CHNL157_CMD_ADDR A:0xe604e80
y.create.l HWIO_PMIC_ARB_OBS0_CHNL158_CMD_ADDR A:0xe604f00
y.create.l HWIO_PMIC_ARB_OBS0_CHNL159_CMD_ADDR A:0xe604f80
y.create.l HWIO_PMIC_ARB_OBS0_CHNL160_CMD_ADDR A:0xe605000
y.create.l HWIO_PMIC_ARB_OBS0_CHNL161_CMD_ADDR A:0xe605080
y.create.l HWIO_PMIC_ARB_OBS0_CHNL162_CMD_ADDR A:0xe605100
y.create.l HWIO_PMIC_ARB_OBS0_CHNL163_CMD_ADDR A:0xe605180
y.create.l HWIO_PMIC_ARB_OBS0_CHNL164_CMD_ADDR A:0xe605200
y.create.l HWIO_PMIC_ARB_OBS0_CHNL165_CMD_ADDR A:0xe605280
y.create.l HWIO_PMIC_ARB_OBS0_CHNL166_CMD_ADDR A:0xe605300
y.create.l HWIO_PMIC_ARB_OBS0_CHNL167_CMD_ADDR A:0xe605380
y.create.l HWIO_PMIC_ARB_OBS0_CHNL168_CMD_ADDR A:0xe605400
y.create.l HWIO_PMIC_ARB_OBS0_CHNL169_CMD_ADDR A:0xe605480
y.create.l HWIO_PMIC_ARB_OBS0_CHNL170_CMD_ADDR A:0xe605500
y.create.l HWIO_PMIC_ARB_OBS0_CHNL171_CMD_ADDR A:0xe605580
y.create.l HWIO_PMIC_ARB_OBS0_CHNL172_CMD_ADDR A:0xe605600
y.create.l HWIO_PMIC_ARB_OBS0_CHNL173_CMD_ADDR A:0xe605680
y.create.l HWIO_PMIC_ARB_OBS0_CHNL174_CMD_ADDR A:0xe605700
y.create.l HWIO_PMIC_ARB_OBS0_CHNL175_CMD_ADDR A:0xe605780
y.create.l HWIO_PMIC_ARB_OBS0_CHNL176_CMD_ADDR A:0xe605800
y.create.l HWIO_PMIC_ARB_OBS0_CHNL177_CMD_ADDR A:0xe605880
y.create.l HWIO_PMIC_ARB_OBS0_CHNL178_CMD_ADDR A:0xe605900
y.create.l HWIO_PMIC_ARB_OBS0_CHNL179_CMD_ADDR A:0xe605980
y.create.l HWIO_PMIC_ARB_OBS0_CHNL180_CMD_ADDR A:0xe605a00
y.create.l HWIO_PMIC_ARB_OBS0_CHNL181_CMD_ADDR A:0xe605a80
y.create.l HWIO_PMIC_ARB_OBS0_CHNL182_CMD_ADDR A:0xe605b00
y.create.l HWIO_PMIC_ARB_OBS0_CHNL183_CMD_ADDR A:0xe605b80
y.create.l HWIO_PMIC_ARB_OBS0_CHNL184_CMD_ADDR A:0xe605c00
y.create.l HWIO_PMIC_ARB_OBS0_CHNL185_CMD_ADDR A:0xe605c80
y.create.l HWIO_PMIC_ARB_OBS0_CHNL186_CMD_ADDR A:0xe605d00
y.create.l HWIO_PMIC_ARB_OBS0_CHNL187_CMD_ADDR A:0xe605d80
y.create.l HWIO_PMIC_ARB_OBS0_CHNL188_CMD_ADDR A:0xe605e00
y.create.l HWIO_PMIC_ARB_OBS0_CHNL189_CMD_ADDR A:0xe605e80
y.create.l HWIO_PMIC_ARB_OBS0_CHNL190_CMD_ADDR A:0xe605f00
y.create.l HWIO_PMIC_ARB_OBS0_CHNL191_CMD_ADDR A:0xe605f80
y.create.l HWIO_PMIC_ARB_OBS0_CHNL192_CMD_ADDR A:0xe606000
y.create.l HWIO_PMIC_ARB_OBS0_CHNL193_CMD_ADDR A:0xe606080
y.create.l HWIO_PMIC_ARB_OBS0_CHNL194_CMD_ADDR A:0xe606100
y.create.l HWIO_PMIC_ARB_OBS0_CHNL195_CMD_ADDR A:0xe606180
y.create.l HWIO_PMIC_ARB_OBS0_CHNL196_CMD_ADDR A:0xe606200
y.create.l HWIO_PMIC_ARB_OBS0_CHNL197_CMD_ADDR A:0xe606280
y.create.l HWIO_PMIC_ARB_OBS0_CHNL198_CMD_ADDR A:0xe606300
y.create.l HWIO_PMIC_ARB_OBS0_CHNL199_CMD_ADDR A:0xe606380
y.create.l HWIO_PMIC_ARB_OBS0_CHNL200_CMD_ADDR A:0xe606400
y.create.l HWIO_PMIC_ARB_OBS0_CHNL201_CMD_ADDR A:0xe606480
y.create.l HWIO_PMIC_ARB_OBS0_CHNL202_CMD_ADDR A:0xe606500
y.create.l HWIO_PMIC_ARB_OBS0_CHNL203_CMD_ADDR A:0xe606580
y.create.l HWIO_PMIC_ARB_OBS0_CHNL204_CMD_ADDR A:0xe606600
y.create.l HWIO_PMIC_ARB_OBS0_CHNL205_CMD_ADDR A:0xe606680
y.create.l HWIO_PMIC_ARB_OBS0_CHNL206_CMD_ADDR A:0xe606700
y.create.l HWIO_PMIC_ARB_OBS0_CHNL207_CMD_ADDR A:0xe606780
y.create.l HWIO_PMIC_ARB_OBS0_CHNL208_CMD_ADDR A:0xe606800
y.create.l HWIO_PMIC_ARB_OBS0_CHNL209_CMD_ADDR A:0xe606880
y.create.l HWIO_PMIC_ARB_OBS0_CHNL210_CMD_ADDR A:0xe606900
y.create.l HWIO_PMIC_ARB_OBS0_CHNL211_CMD_ADDR A:0xe606980
y.create.l HWIO_PMIC_ARB_OBS0_CHNL212_CMD_ADDR A:0xe606a00
y.create.l HWIO_PMIC_ARB_OBS0_CHNL213_CMD_ADDR A:0xe606a80
y.create.l HWIO_PMIC_ARB_OBS0_CHNL214_CMD_ADDR A:0xe606b00
y.create.l HWIO_PMIC_ARB_OBS0_CHNL215_CMD_ADDR A:0xe606b80
y.create.l HWIO_PMIC_ARB_OBS0_CHNL216_CMD_ADDR A:0xe606c00
y.create.l HWIO_PMIC_ARB_OBS0_CHNL217_CMD_ADDR A:0xe606c80
y.create.l HWIO_PMIC_ARB_OBS0_CHNL218_CMD_ADDR A:0xe606d00
y.create.l HWIO_PMIC_ARB_OBS0_CHNL219_CMD_ADDR A:0xe606d80
y.create.l HWIO_PMIC_ARB_OBS0_CHNL220_CMD_ADDR A:0xe606e00
y.create.l HWIO_PMIC_ARB_OBS0_CHNL221_CMD_ADDR A:0xe606e80
y.create.l HWIO_PMIC_ARB_OBS0_CHNL222_CMD_ADDR A:0xe606f00
y.create.l HWIO_PMIC_ARB_OBS0_CHNL223_CMD_ADDR A:0xe606f80
y.create.l HWIO_PMIC_ARB_OBS0_CHNL224_CMD_ADDR A:0xe607000
y.create.l HWIO_PMIC_ARB_OBS0_CHNL225_CMD_ADDR A:0xe607080
y.create.l HWIO_PMIC_ARB_OBS0_CHNL226_CMD_ADDR A:0xe607100
y.create.l HWIO_PMIC_ARB_OBS0_CHNL227_CMD_ADDR A:0xe607180
y.create.l HWIO_PMIC_ARB_OBS0_CHNL228_CMD_ADDR A:0xe607200
y.create.l HWIO_PMIC_ARB_OBS0_CHNL229_CMD_ADDR A:0xe607280
y.create.l HWIO_PMIC_ARB_OBS0_CHNL230_CMD_ADDR A:0xe607300
y.create.l HWIO_PMIC_ARB_OBS0_CHNL231_CMD_ADDR A:0xe607380
y.create.l HWIO_PMIC_ARB_OBS0_CHNL232_CMD_ADDR A:0xe607400
y.create.l HWIO_PMIC_ARB_OBS0_CHNL233_CMD_ADDR A:0xe607480
y.create.l HWIO_PMIC_ARB_OBS0_CHNL234_CMD_ADDR A:0xe607500
y.create.l HWIO_PMIC_ARB_OBS0_CHNL235_CMD_ADDR A:0xe607580
y.create.l HWIO_PMIC_ARB_OBS0_CHNL236_CMD_ADDR A:0xe607600
y.create.l HWIO_PMIC_ARB_OBS0_CHNL237_CMD_ADDR A:0xe607680
y.create.l HWIO_PMIC_ARB_OBS0_CHNL238_CMD_ADDR A:0xe607700
y.create.l HWIO_PMIC_ARB_OBS0_CHNL239_CMD_ADDR A:0xe607780
y.create.l HWIO_PMIC_ARB_OBS0_CHNL240_CMD_ADDR A:0xe607800
y.create.l HWIO_PMIC_ARB_OBS0_CHNL241_CMD_ADDR A:0xe607880
y.create.l HWIO_PMIC_ARB_OBS0_CHNL242_CMD_ADDR A:0xe607900
y.create.l HWIO_PMIC_ARB_OBS0_CHNL243_CMD_ADDR A:0xe607980
y.create.l HWIO_PMIC_ARB_OBS0_CHNL244_CMD_ADDR A:0xe607a00
y.create.l HWIO_PMIC_ARB_OBS0_CHNL245_CMD_ADDR A:0xe607a80
y.create.l HWIO_PMIC_ARB_OBS0_CHNL246_CMD_ADDR A:0xe607b00
y.create.l HWIO_PMIC_ARB_OBS0_CHNL247_CMD_ADDR A:0xe607b80
y.create.l HWIO_PMIC_ARB_OBS0_CHNL248_CMD_ADDR A:0xe607c00
y.create.l HWIO_PMIC_ARB_OBS0_CHNL249_CMD_ADDR A:0xe607c80
y.create.l HWIO_PMIC_ARB_OBS0_CHNL250_CMD_ADDR A:0xe607d00
y.create.l HWIO_PMIC_ARB_OBS0_CHNL251_CMD_ADDR A:0xe607d80
y.create.l HWIO_PMIC_ARB_OBS0_CHNL252_CMD_ADDR A:0xe607e00
y.create.l HWIO_PMIC_ARB_OBS0_CHNL253_CMD_ADDR A:0xe607e80
y.create.l HWIO_PMIC_ARB_OBS0_CHNL254_CMD_ADDR A:0xe607f00
y.create.l HWIO_PMIC_ARB_OBS0_CHNL255_CMD_ADDR A:0xe607f80
y.create.l HWIO_PMIC_ARB_OBS1_CHNL0_CMD_ADDR A:0xe610000
y.create.l HWIO_PMIC_ARB_OBS1_CHNL1_CMD_ADDR A:0xe610080
y.create.l HWIO_PMIC_ARB_OBS1_CHNL2_CMD_ADDR A:0xe610100
y.create.l HWIO_PMIC_ARB_OBS1_CHNL3_CMD_ADDR A:0xe610180
y.create.l HWIO_PMIC_ARB_OBS1_CHNL4_CMD_ADDR A:0xe610200
y.create.l HWIO_PMIC_ARB_OBS1_CHNL5_CMD_ADDR A:0xe610280
y.create.l HWIO_PMIC_ARB_OBS1_CHNL6_CMD_ADDR A:0xe610300
y.create.l HWIO_PMIC_ARB_OBS1_CHNL7_CMD_ADDR A:0xe610380
y.create.l HWIO_PMIC_ARB_OBS1_CHNL8_CMD_ADDR A:0xe610400
y.create.l HWIO_PMIC_ARB_OBS1_CHNL9_CMD_ADDR A:0xe610480
y.create.l HWIO_PMIC_ARB_OBS1_CHNL10_CMD_ADDR A:0xe610500
y.create.l HWIO_PMIC_ARB_OBS1_CHNL11_CMD_ADDR A:0xe610580
y.create.l HWIO_PMIC_ARB_OBS1_CHNL12_CMD_ADDR A:0xe610600
y.create.l HWIO_PMIC_ARB_OBS1_CHNL13_CMD_ADDR A:0xe610680
y.create.l HWIO_PMIC_ARB_OBS1_CHNL14_CMD_ADDR A:0xe610700
y.create.l HWIO_PMIC_ARB_OBS1_CHNL15_CMD_ADDR A:0xe610780
y.create.l HWIO_PMIC_ARB_OBS1_CHNL16_CMD_ADDR A:0xe610800
y.create.l HWIO_PMIC_ARB_OBS1_CHNL17_CMD_ADDR A:0xe610880
y.create.l HWIO_PMIC_ARB_OBS1_CHNL18_CMD_ADDR A:0xe610900
y.create.l HWIO_PMIC_ARB_OBS1_CHNL19_CMD_ADDR A:0xe610980
y.create.l HWIO_PMIC_ARB_OBS1_CHNL20_CMD_ADDR A:0xe610a00
y.create.l HWIO_PMIC_ARB_OBS1_CHNL21_CMD_ADDR A:0xe610a80
y.create.l HWIO_PMIC_ARB_OBS1_CHNL22_CMD_ADDR A:0xe610b00
y.create.l HWIO_PMIC_ARB_OBS1_CHNL23_CMD_ADDR A:0xe610b80
y.create.l HWIO_PMIC_ARB_OBS1_CHNL24_CMD_ADDR A:0xe610c00
y.create.l HWIO_PMIC_ARB_OBS1_CHNL25_CMD_ADDR A:0xe610c80
y.create.l HWIO_PMIC_ARB_OBS1_CHNL26_CMD_ADDR A:0xe610d00
y.create.l HWIO_PMIC_ARB_OBS1_CHNL27_CMD_ADDR A:0xe610d80
y.create.l HWIO_PMIC_ARB_OBS1_CHNL28_CMD_ADDR A:0xe610e00
y.create.l HWIO_PMIC_ARB_OBS1_CHNL29_CMD_ADDR A:0xe610e80
y.create.l HWIO_PMIC_ARB_OBS1_CHNL30_CMD_ADDR A:0xe610f00
y.create.l HWIO_PMIC_ARB_OBS1_CHNL31_CMD_ADDR A:0xe610f80
y.create.l HWIO_PMIC_ARB_OBS1_CHNL32_CMD_ADDR A:0xe611000
y.create.l HWIO_PMIC_ARB_OBS1_CHNL33_CMD_ADDR A:0xe611080
y.create.l HWIO_PMIC_ARB_OBS1_CHNL34_CMD_ADDR A:0xe611100
y.create.l HWIO_PMIC_ARB_OBS1_CHNL35_CMD_ADDR A:0xe611180
y.create.l HWIO_PMIC_ARB_OBS1_CHNL36_CMD_ADDR A:0xe611200
y.create.l HWIO_PMIC_ARB_OBS1_CHNL37_CMD_ADDR A:0xe611280
y.create.l HWIO_PMIC_ARB_OBS1_CHNL38_CMD_ADDR A:0xe611300
y.create.l HWIO_PMIC_ARB_OBS1_CHNL39_CMD_ADDR A:0xe611380
y.create.l HWIO_PMIC_ARB_OBS1_CHNL40_CMD_ADDR A:0xe611400
y.create.l HWIO_PMIC_ARB_OBS1_CHNL41_CMD_ADDR A:0xe611480
y.create.l HWIO_PMIC_ARB_OBS1_CHNL42_CMD_ADDR A:0xe611500
y.create.l HWIO_PMIC_ARB_OBS1_CHNL43_CMD_ADDR A:0xe611580
y.create.l HWIO_PMIC_ARB_OBS1_CHNL44_CMD_ADDR A:0xe611600
y.create.l HWIO_PMIC_ARB_OBS1_CHNL45_CMD_ADDR A:0xe611680
y.create.l HWIO_PMIC_ARB_OBS1_CHNL46_CMD_ADDR A:0xe611700
y.create.l HWIO_PMIC_ARB_OBS1_CHNL47_CMD_ADDR A:0xe611780
y.create.l HWIO_PMIC_ARB_OBS1_CHNL48_CMD_ADDR A:0xe611800
y.create.l HWIO_PMIC_ARB_OBS1_CHNL49_CMD_ADDR A:0xe611880
y.create.l HWIO_PMIC_ARB_OBS1_CHNL50_CMD_ADDR A:0xe611900
y.create.l HWIO_PMIC_ARB_OBS1_CHNL51_CMD_ADDR A:0xe611980
y.create.l HWIO_PMIC_ARB_OBS1_CHNL52_CMD_ADDR A:0xe611a00
y.create.l HWIO_PMIC_ARB_OBS1_CHNL53_CMD_ADDR A:0xe611a80
y.create.l HWIO_PMIC_ARB_OBS1_CHNL54_CMD_ADDR A:0xe611b00
y.create.l HWIO_PMIC_ARB_OBS1_CHNL55_CMD_ADDR A:0xe611b80
y.create.l HWIO_PMIC_ARB_OBS1_CHNL56_CMD_ADDR A:0xe611c00
y.create.l HWIO_PMIC_ARB_OBS1_CHNL57_CMD_ADDR A:0xe611c80
y.create.l HWIO_PMIC_ARB_OBS1_CHNL58_CMD_ADDR A:0xe611d00
y.create.l HWIO_PMIC_ARB_OBS1_CHNL59_CMD_ADDR A:0xe611d80
y.create.l HWIO_PMIC_ARB_OBS1_CHNL60_CMD_ADDR A:0xe611e00
y.create.l HWIO_PMIC_ARB_OBS1_CHNL61_CMD_ADDR A:0xe611e80
y.create.l HWIO_PMIC_ARB_OBS1_CHNL62_CMD_ADDR A:0xe611f00
y.create.l HWIO_PMIC_ARB_OBS1_CHNL63_CMD_ADDR A:0xe611f80
y.create.l HWIO_PMIC_ARB_OBS1_CHNL64_CMD_ADDR A:0xe612000
y.create.l HWIO_PMIC_ARB_OBS1_CHNL65_CMD_ADDR A:0xe612080
y.create.l HWIO_PMIC_ARB_OBS1_CHNL66_CMD_ADDR A:0xe612100
y.create.l HWIO_PMIC_ARB_OBS1_CHNL67_CMD_ADDR A:0xe612180
y.create.l HWIO_PMIC_ARB_OBS1_CHNL68_CMD_ADDR A:0xe612200
y.create.l HWIO_PMIC_ARB_OBS1_CHNL69_CMD_ADDR A:0xe612280
y.create.l HWIO_PMIC_ARB_OBS1_CHNL70_CMD_ADDR A:0xe612300
y.create.l HWIO_PMIC_ARB_OBS1_CHNL71_CMD_ADDR A:0xe612380
y.create.l HWIO_PMIC_ARB_OBS1_CHNL72_CMD_ADDR A:0xe612400
y.create.l HWIO_PMIC_ARB_OBS1_CHNL73_CMD_ADDR A:0xe612480
y.create.l HWIO_PMIC_ARB_OBS1_CHNL74_CMD_ADDR A:0xe612500
y.create.l HWIO_PMIC_ARB_OBS1_CHNL75_CMD_ADDR A:0xe612580
y.create.l HWIO_PMIC_ARB_OBS1_CHNL76_CMD_ADDR A:0xe612600
y.create.l HWIO_PMIC_ARB_OBS1_CHNL77_CMD_ADDR A:0xe612680
y.create.l HWIO_PMIC_ARB_OBS1_CHNL78_CMD_ADDR A:0xe612700
y.create.l HWIO_PMIC_ARB_OBS1_CHNL79_CMD_ADDR A:0xe612780
y.create.l HWIO_PMIC_ARB_OBS1_CHNL80_CMD_ADDR A:0xe612800
y.create.l HWIO_PMIC_ARB_OBS1_CHNL81_CMD_ADDR A:0xe612880
y.create.l HWIO_PMIC_ARB_OBS1_CHNL82_CMD_ADDR A:0xe612900
y.create.l HWIO_PMIC_ARB_OBS1_CHNL83_CMD_ADDR A:0xe612980
y.create.l HWIO_PMIC_ARB_OBS1_CHNL84_CMD_ADDR A:0xe612a00
y.create.l HWIO_PMIC_ARB_OBS1_CHNL85_CMD_ADDR A:0xe612a80
y.create.l HWIO_PMIC_ARB_OBS1_CHNL86_CMD_ADDR A:0xe612b00
y.create.l HWIO_PMIC_ARB_OBS1_CHNL87_CMD_ADDR A:0xe612b80
y.create.l HWIO_PMIC_ARB_OBS1_CHNL88_CMD_ADDR A:0xe612c00
y.create.l HWIO_PMIC_ARB_OBS1_CHNL89_CMD_ADDR A:0xe612c80
y.create.l HWIO_PMIC_ARB_OBS1_CHNL90_CMD_ADDR A:0xe612d00
y.create.l HWIO_PMIC_ARB_OBS1_CHNL91_CMD_ADDR A:0xe612d80
y.create.l HWIO_PMIC_ARB_OBS1_CHNL92_CMD_ADDR A:0xe612e00
y.create.l HWIO_PMIC_ARB_OBS1_CHNL93_CMD_ADDR A:0xe612e80
y.create.l HWIO_PMIC_ARB_OBS1_CHNL94_CMD_ADDR A:0xe612f00
y.create.l HWIO_PMIC_ARB_OBS1_CHNL95_CMD_ADDR A:0xe612f80
y.create.l HWIO_PMIC_ARB_OBS1_CHNL96_CMD_ADDR A:0xe613000
y.create.l HWIO_PMIC_ARB_OBS1_CHNL97_CMD_ADDR A:0xe613080
y.create.l HWIO_PMIC_ARB_OBS1_CHNL98_CMD_ADDR A:0xe613100
y.create.l HWIO_PMIC_ARB_OBS1_CHNL99_CMD_ADDR A:0xe613180
y.create.l HWIO_PMIC_ARB_OBS1_CHNL100_CMD_ADDR A:0xe613200
y.create.l HWIO_PMIC_ARB_OBS1_CHNL101_CMD_ADDR A:0xe613280
y.create.l HWIO_PMIC_ARB_OBS1_CHNL102_CMD_ADDR A:0xe613300
y.create.l HWIO_PMIC_ARB_OBS1_CHNL103_CMD_ADDR A:0xe613380
y.create.l HWIO_PMIC_ARB_OBS1_CHNL104_CMD_ADDR A:0xe613400
y.create.l HWIO_PMIC_ARB_OBS1_CHNL105_CMD_ADDR A:0xe613480
y.create.l HWIO_PMIC_ARB_OBS1_CHNL106_CMD_ADDR A:0xe613500
y.create.l HWIO_PMIC_ARB_OBS1_CHNL107_CMD_ADDR A:0xe613580
y.create.l HWIO_PMIC_ARB_OBS1_CHNL108_CMD_ADDR A:0xe613600
y.create.l HWIO_PMIC_ARB_OBS1_CHNL109_CMD_ADDR A:0xe613680
y.create.l HWIO_PMIC_ARB_OBS1_CHNL110_CMD_ADDR A:0xe613700
y.create.l HWIO_PMIC_ARB_OBS1_CHNL111_CMD_ADDR A:0xe613780
y.create.l HWIO_PMIC_ARB_OBS1_CHNL112_CMD_ADDR A:0xe613800
y.create.l HWIO_PMIC_ARB_OBS1_CHNL113_CMD_ADDR A:0xe613880
y.create.l HWIO_PMIC_ARB_OBS1_CHNL114_CMD_ADDR A:0xe613900
y.create.l HWIO_PMIC_ARB_OBS1_CHNL115_CMD_ADDR A:0xe613980
y.create.l HWIO_PMIC_ARB_OBS1_CHNL116_CMD_ADDR A:0xe613a00
y.create.l HWIO_PMIC_ARB_OBS1_CHNL117_CMD_ADDR A:0xe613a80
y.create.l HWIO_PMIC_ARB_OBS1_CHNL118_CMD_ADDR A:0xe613b00
y.create.l HWIO_PMIC_ARB_OBS1_CHNL119_CMD_ADDR A:0xe613b80
y.create.l HWIO_PMIC_ARB_OBS1_CHNL120_CMD_ADDR A:0xe613c00
y.create.l HWIO_PMIC_ARB_OBS1_CHNL121_CMD_ADDR A:0xe613c80
y.create.l HWIO_PMIC_ARB_OBS1_CHNL122_CMD_ADDR A:0xe613d00
y.create.l HWIO_PMIC_ARB_OBS1_CHNL123_CMD_ADDR A:0xe613d80
y.create.l HWIO_PMIC_ARB_OBS1_CHNL124_CMD_ADDR A:0xe613e00
y.create.l HWIO_PMIC_ARB_OBS1_CHNL125_CMD_ADDR A:0xe613e80
y.create.l HWIO_PMIC_ARB_OBS1_CHNL126_CMD_ADDR A:0xe613f00
y.create.l HWIO_PMIC_ARB_OBS1_CHNL127_CMD_ADDR A:0xe613f80
y.create.l HWIO_PMIC_ARB_OBS1_CHNL128_CMD_ADDR A:0xe614000
y.create.l HWIO_PMIC_ARB_OBS1_CHNL129_CMD_ADDR A:0xe614080
y.create.l HWIO_PMIC_ARB_OBS1_CHNL130_CMD_ADDR A:0xe614100
y.create.l HWIO_PMIC_ARB_OBS1_CHNL131_CMD_ADDR A:0xe614180
y.create.l HWIO_PMIC_ARB_OBS1_CHNL132_CMD_ADDR A:0xe614200
y.create.l HWIO_PMIC_ARB_OBS1_CHNL133_CMD_ADDR A:0xe614280
y.create.l HWIO_PMIC_ARB_OBS1_CHNL134_CMD_ADDR A:0xe614300
y.create.l HWIO_PMIC_ARB_OBS1_CHNL135_CMD_ADDR A:0xe614380
y.create.l HWIO_PMIC_ARB_OBS1_CHNL136_CMD_ADDR A:0xe614400
y.create.l HWIO_PMIC_ARB_OBS1_CHNL137_CMD_ADDR A:0xe614480
y.create.l HWIO_PMIC_ARB_OBS1_CHNL138_CMD_ADDR A:0xe614500
y.create.l HWIO_PMIC_ARB_OBS1_CHNL139_CMD_ADDR A:0xe614580
y.create.l HWIO_PMIC_ARB_OBS1_CHNL140_CMD_ADDR A:0xe614600
y.create.l HWIO_PMIC_ARB_OBS1_CHNL141_CMD_ADDR A:0xe614680
y.create.l HWIO_PMIC_ARB_OBS1_CHNL142_CMD_ADDR A:0xe614700
y.create.l HWIO_PMIC_ARB_OBS1_CHNL143_CMD_ADDR A:0xe614780
y.create.l HWIO_PMIC_ARB_OBS1_CHNL144_CMD_ADDR A:0xe614800
y.create.l HWIO_PMIC_ARB_OBS1_CHNL145_CMD_ADDR A:0xe614880
y.create.l HWIO_PMIC_ARB_OBS1_CHNL146_CMD_ADDR A:0xe614900
y.create.l HWIO_PMIC_ARB_OBS1_CHNL147_CMD_ADDR A:0xe614980
y.create.l HWIO_PMIC_ARB_OBS1_CHNL148_CMD_ADDR A:0xe614a00
y.create.l HWIO_PMIC_ARB_OBS1_CHNL149_CMD_ADDR A:0xe614a80
y.create.l HWIO_PMIC_ARB_OBS1_CHNL150_CMD_ADDR A:0xe614b00
y.create.l HWIO_PMIC_ARB_OBS1_CHNL151_CMD_ADDR A:0xe614b80
y.create.l HWIO_PMIC_ARB_OBS1_CHNL152_CMD_ADDR A:0xe614c00
y.create.l HWIO_PMIC_ARB_OBS1_CHNL153_CMD_ADDR A:0xe614c80
y.create.l HWIO_PMIC_ARB_OBS1_CHNL154_CMD_ADDR A:0xe614d00
y.create.l HWIO_PMIC_ARB_OBS1_CHNL155_CMD_ADDR A:0xe614d80
y.create.l HWIO_PMIC_ARB_OBS1_CHNL156_CMD_ADDR A:0xe614e00
y.create.l HWIO_PMIC_ARB_OBS1_CHNL157_CMD_ADDR A:0xe614e80
y.create.l HWIO_PMIC_ARB_OBS1_CHNL158_CMD_ADDR A:0xe614f00
y.create.l HWIO_PMIC_ARB_OBS1_CHNL159_CMD_ADDR A:0xe614f80
y.create.l HWIO_PMIC_ARB_OBS1_CHNL160_CMD_ADDR A:0xe615000
y.create.l HWIO_PMIC_ARB_OBS1_CHNL161_CMD_ADDR A:0xe615080
y.create.l HWIO_PMIC_ARB_OBS1_CHNL162_CMD_ADDR A:0xe615100
y.create.l HWIO_PMIC_ARB_OBS1_CHNL163_CMD_ADDR A:0xe615180
y.create.l HWIO_PMIC_ARB_OBS1_CHNL164_CMD_ADDR A:0xe615200
y.create.l HWIO_PMIC_ARB_OBS1_CHNL165_CMD_ADDR A:0xe615280
y.create.l HWIO_PMIC_ARB_OBS1_CHNL166_CMD_ADDR A:0xe615300
y.create.l HWIO_PMIC_ARB_OBS1_CHNL167_CMD_ADDR A:0xe615380
y.create.l HWIO_PMIC_ARB_OBS1_CHNL168_CMD_ADDR A:0xe615400
y.create.l HWIO_PMIC_ARB_OBS1_CHNL169_CMD_ADDR A:0xe615480
y.create.l HWIO_PMIC_ARB_OBS1_CHNL170_CMD_ADDR A:0xe615500
y.create.l HWIO_PMIC_ARB_OBS1_CHNL171_CMD_ADDR A:0xe615580
y.create.l HWIO_PMIC_ARB_OBS1_CHNL172_CMD_ADDR A:0xe615600
y.create.l HWIO_PMIC_ARB_OBS1_CHNL173_CMD_ADDR A:0xe615680
y.create.l HWIO_PMIC_ARB_OBS1_CHNL174_CMD_ADDR A:0xe615700
y.create.l HWIO_PMIC_ARB_OBS1_CHNL175_CMD_ADDR A:0xe615780
y.create.l HWIO_PMIC_ARB_OBS1_CHNL176_CMD_ADDR A:0xe615800
y.create.l HWIO_PMIC_ARB_OBS1_CHNL177_CMD_ADDR A:0xe615880
y.create.l HWIO_PMIC_ARB_OBS1_CHNL178_CMD_ADDR A:0xe615900
y.create.l HWIO_PMIC_ARB_OBS1_CHNL179_CMD_ADDR A:0xe615980
y.create.l HWIO_PMIC_ARB_OBS1_CHNL180_CMD_ADDR A:0xe615a00
y.create.l HWIO_PMIC_ARB_OBS1_CHNL181_CMD_ADDR A:0xe615a80
y.create.l HWIO_PMIC_ARB_OBS1_CHNL182_CMD_ADDR A:0xe615b00
y.create.l HWIO_PMIC_ARB_OBS1_CHNL183_CMD_ADDR A:0xe615b80
y.create.l HWIO_PMIC_ARB_OBS1_CHNL184_CMD_ADDR A:0xe615c00
y.create.l HWIO_PMIC_ARB_OBS1_CHNL185_CMD_ADDR A:0xe615c80
y.create.l HWIO_PMIC_ARB_OBS1_CHNL186_CMD_ADDR A:0xe615d00
y.create.l HWIO_PMIC_ARB_OBS1_CHNL187_CMD_ADDR A:0xe615d80
y.create.l HWIO_PMIC_ARB_OBS1_CHNL188_CMD_ADDR A:0xe615e00
y.create.l HWIO_PMIC_ARB_OBS1_CHNL189_CMD_ADDR A:0xe615e80
y.create.l HWIO_PMIC_ARB_OBS1_CHNL190_CMD_ADDR A:0xe615f00
y.create.l HWIO_PMIC_ARB_OBS1_CHNL191_CMD_ADDR A:0xe615f80
y.create.l HWIO_PMIC_ARB_OBS1_CHNL192_CMD_ADDR A:0xe616000
y.create.l HWIO_PMIC_ARB_OBS1_CHNL193_CMD_ADDR A:0xe616080
y.create.l HWIO_PMIC_ARB_OBS1_CHNL194_CMD_ADDR A:0xe616100
y.create.l HWIO_PMIC_ARB_OBS1_CHNL195_CMD_ADDR A:0xe616180
y.create.l HWIO_PMIC_ARB_OBS1_CHNL196_CMD_ADDR A:0xe616200
y.create.l HWIO_PMIC_ARB_OBS1_CHNL197_CMD_ADDR A:0xe616280
y.create.l HWIO_PMIC_ARB_OBS1_CHNL198_CMD_ADDR A:0xe616300
y.create.l HWIO_PMIC_ARB_OBS1_CHNL199_CMD_ADDR A:0xe616380
y.create.l HWIO_PMIC_ARB_OBS1_CHNL200_CMD_ADDR A:0xe616400
y.create.l HWIO_PMIC_ARB_OBS1_CHNL201_CMD_ADDR A:0xe616480
y.create.l HWIO_PMIC_ARB_OBS1_CHNL202_CMD_ADDR A:0xe616500
y.create.l HWIO_PMIC_ARB_OBS1_CHNL203_CMD_ADDR A:0xe616580
y.create.l HWIO_PMIC_ARB_OBS1_CHNL204_CMD_ADDR A:0xe616600
y.create.l HWIO_PMIC_ARB_OBS1_CHNL205_CMD_ADDR A:0xe616680
y.create.l HWIO_PMIC_ARB_OBS1_CHNL206_CMD_ADDR A:0xe616700
y.create.l HWIO_PMIC_ARB_OBS1_CHNL207_CMD_ADDR A:0xe616780
y.create.l HWIO_PMIC_ARB_OBS1_CHNL208_CMD_ADDR A:0xe616800
y.create.l HWIO_PMIC_ARB_OBS1_CHNL209_CMD_ADDR A:0xe616880
y.create.l HWIO_PMIC_ARB_OBS1_CHNL210_CMD_ADDR A:0xe616900
y.create.l HWIO_PMIC_ARB_OBS1_CHNL211_CMD_ADDR A:0xe616980
y.create.l HWIO_PMIC_ARB_OBS1_CHNL212_CMD_ADDR A:0xe616a00
y.create.l HWIO_PMIC_ARB_OBS1_CHNL213_CMD_ADDR A:0xe616a80
y.create.l HWIO_PMIC_ARB_OBS1_CHNL214_CMD_ADDR A:0xe616b00
y.create.l HWIO_PMIC_ARB_OBS1_CHNL215_CMD_ADDR A:0xe616b80
y.create.l HWIO_PMIC_ARB_OBS1_CHNL216_CMD_ADDR A:0xe616c00
y.create.l HWIO_PMIC_ARB_OBS1_CHNL217_CMD_ADDR A:0xe616c80
y.create.l HWIO_PMIC_ARB_OBS1_CHNL218_CMD_ADDR A:0xe616d00
y.create.l HWIO_PMIC_ARB_OBS1_CHNL219_CMD_ADDR A:0xe616d80
y.create.l HWIO_PMIC_ARB_OBS1_CHNL220_CMD_ADDR A:0xe616e00
y.create.l HWIO_PMIC_ARB_OBS1_CHNL221_CMD_ADDR A:0xe616e80
y.create.l HWIO_PMIC_ARB_OBS1_CHNL222_CMD_ADDR A:0xe616f00
y.create.l HWIO_PMIC_ARB_OBS1_CHNL223_CMD_ADDR A:0xe616f80
y.create.l HWIO_PMIC_ARB_OBS1_CHNL224_CMD_ADDR A:0xe617000
y.create.l HWIO_PMIC_ARB_OBS1_CHNL225_CMD_ADDR A:0xe617080
y.create.l HWIO_PMIC_ARB_OBS1_CHNL226_CMD_ADDR A:0xe617100
y.create.l HWIO_PMIC_ARB_OBS1_CHNL227_CMD_ADDR A:0xe617180
y.create.l HWIO_PMIC_ARB_OBS1_CHNL228_CMD_ADDR A:0xe617200
y.create.l HWIO_PMIC_ARB_OBS1_CHNL229_CMD_ADDR A:0xe617280
y.create.l HWIO_PMIC_ARB_OBS1_CHNL230_CMD_ADDR A:0xe617300
y.create.l HWIO_PMIC_ARB_OBS1_CHNL231_CMD_ADDR A:0xe617380
y.create.l HWIO_PMIC_ARB_OBS1_CHNL232_CMD_ADDR A:0xe617400
y.create.l HWIO_PMIC_ARB_OBS1_CHNL233_CMD_ADDR A:0xe617480
y.create.l HWIO_PMIC_ARB_OBS1_CHNL234_CMD_ADDR A:0xe617500
y.create.l HWIO_PMIC_ARB_OBS1_CHNL235_CMD_ADDR A:0xe617580
y.create.l HWIO_PMIC_ARB_OBS1_CHNL236_CMD_ADDR A:0xe617600
y.create.l HWIO_PMIC_ARB_OBS1_CHNL237_CMD_ADDR A:0xe617680
y.create.l HWIO_PMIC_ARB_OBS1_CHNL238_CMD_ADDR A:0xe617700
y.create.l HWIO_PMIC_ARB_OBS1_CHNL239_CMD_ADDR A:0xe617780
y.create.l HWIO_PMIC_ARB_OBS1_CHNL240_CMD_ADDR A:0xe617800
y.create.l HWIO_PMIC_ARB_OBS1_CHNL241_CMD_ADDR A:0xe617880
y.create.l HWIO_PMIC_ARB_OBS1_CHNL242_CMD_ADDR A:0xe617900
y.create.l HWIO_PMIC_ARB_OBS1_CHNL243_CMD_ADDR A:0xe617980
y.create.l HWIO_PMIC_ARB_OBS1_CHNL244_CMD_ADDR A:0xe617a00
y.create.l HWIO_PMIC_ARB_OBS1_CHNL245_CMD_ADDR A:0xe617a80
y.create.l HWIO_PMIC_ARB_OBS1_CHNL246_CMD_ADDR A:0xe617b00
y.create.l HWIO_PMIC_ARB_OBS1_CHNL247_CMD_ADDR A:0xe617b80
y.create.l HWIO_PMIC_ARB_OBS1_CHNL248_CMD_ADDR A:0xe617c00
y.create.l HWIO_PMIC_ARB_OBS1_CHNL249_CMD_ADDR A:0xe617c80
y.create.l HWIO_PMIC_ARB_OBS1_CHNL250_CMD_ADDR A:0xe617d00
y.create.l HWIO_PMIC_ARB_OBS1_CHNL251_CMD_ADDR A:0xe617d80
y.create.l HWIO_PMIC_ARB_OBS1_CHNL252_CMD_ADDR A:0xe617e00
y.create.l HWIO_PMIC_ARB_OBS1_CHNL253_CMD_ADDR A:0xe617e80
y.create.l HWIO_PMIC_ARB_OBS1_CHNL254_CMD_ADDR A:0xe617f00
y.create.l HWIO_PMIC_ARB_OBS1_CHNL255_CMD_ADDR A:0xe617f80
y.create.l HWIO_PMIC_ARB_OBS2_CHNL0_CMD_ADDR A:0xe620000
y.create.l HWIO_PMIC_ARB_OBS2_CHNL1_CMD_ADDR A:0xe620080
y.create.l HWIO_PMIC_ARB_OBS2_CHNL2_CMD_ADDR A:0xe620100
y.create.l HWIO_PMIC_ARB_OBS2_CHNL3_CMD_ADDR A:0xe620180
y.create.l HWIO_PMIC_ARB_OBS2_CHNL4_CMD_ADDR A:0xe620200
y.create.l HWIO_PMIC_ARB_OBS2_CHNL5_CMD_ADDR A:0xe620280
y.create.l HWIO_PMIC_ARB_OBS2_CHNL6_CMD_ADDR A:0xe620300
y.create.l HWIO_PMIC_ARB_OBS2_CHNL7_CMD_ADDR A:0xe620380
y.create.l HWIO_PMIC_ARB_OBS2_CHNL8_CMD_ADDR A:0xe620400
y.create.l HWIO_PMIC_ARB_OBS2_CHNL9_CMD_ADDR A:0xe620480
y.create.l HWIO_PMIC_ARB_OBS2_CHNL10_CMD_ADDR A:0xe620500
y.create.l HWIO_PMIC_ARB_OBS2_CHNL11_CMD_ADDR A:0xe620580
y.create.l HWIO_PMIC_ARB_OBS2_CHNL12_CMD_ADDR A:0xe620600
y.create.l HWIO_PMIC_ARB_OBS2_CHNL13_CMD_ADDR A:0xe620680
y.create.l HWIO_PMIC_ARB_OBS2_CHNL14_CMD_ADDR A:0xe620700
y.create.l HWIO_PMIC_ARB_OBS2_CHNL15_CMD_ADDR A:0xe620780
y.create.l HWIO_PMIC_ARB_OBS2_CHNL16_CMD_ADDR A:0xe620800
y.create.l HWIO_PMIC_ARB_OBS2_CHNL17_CMD_ADDR A:0xe620880
y.create.l HWIO_PMIC_ARB_OBS2_CHNL18_CMD_ADDR A:0xe620900
y.create.l HWIO_PMIC_ARB_OBS2_CHNL19_CMD_ADDR A:0xe620980
y.create.l HWIO_PMIC_ARB_OBS2_CHNL20_CMD_ADDR A:0xe620a00
y.create.l HWIO_PMIC_ARB_OBS2_CHNL21_CMD_ADDR A:0xe620a80
y.create.l HWIO_PMIC_ARB_OBS2_CHNL22_CMD_ADDR A:0xe620b00
y.create.l HWIO_PMIC_ARB_OBS2_CHNL23_CMD_ADDR A:0xe620b80
y.create.l HWIO_PMIC_ARB_OBS2_CHNL24_CMD_ADDR A:0xe620c00
y.create.l HWIO_PMIC_ARB_OBS2_CHNL25_CMD_ADDR A:0xe620c80
y.create.l HWIO_PMIC_ARB_OBS2_CHNL26_CMD_ADDR A:0xe620d00
y.create.l HWIO_PMIC_ARB_OBS2_CHNL27_CMD_ADDR A:0xe620d80
y.create.l HWIO_PMIC_ARB_OBS2_CHNL28_CMD_ADDR A:0xe620e00
y.create.l HWIO_PMIC_ARB_OBS2_CHNL29_CMD_ADDR A:0xe620e80
y.create.l HWIO_PMIC_ARB_OBS2_CHNL30_CMD_ADDR A:0xe620f00
y.create.l HWIO_PMIC_ARB_OBS2_CHNL31_CMD_ADDR A:0xe620f80
y.create.l HWIO_PMIC_ARB_OBS2_CHNL32_CMD_ADDR A:0xe621000
y.create.l HWIO_PMIC_ARB_OBS2_CHNL33_CMD_ADDR A:0xe621080
y.create.l HWIO_PMIC_ARB_OBS2_CHNL34_CMD_ADDR A:0xe621100
y.create.l HWIO_PMIC_ARB_OBS2_CHNL35_CMD_ADDR A:0xe621180
y.create.l HWIO_PMIC_ARB_OBS2_CHNL36_CMD_ADDR A:0xe621200
y.create.l HWIO_PMIC_ARB_OBS2_CHNL37_CMD_ADDR A:0xe621280
y.create.l HWIO_PMIC_ARB_OBS2_CHNL38_CMD_ADDR A:0xe621300
y.create.l HWIO_PMIC_ARB_OBS2_CHNL39_CMD_ADDR A:0xe621380
y.create.l HWIO_PMIC_ARB_OBS2_CHNL40_CMD_ADDR A:0xe621400
y.create.l HWIO_PMIC_ARB_OBS2_CHNL41_CMD_ADDR A:0xe621480
y.create.l HWIO_PMIC_ARB_OBS2_CHNL42_CMD_ADDR A:0xe621500
y.create.l HWIO_PMIC_ARB_OBS2_CHNL43_CMD_ADDR A:0xe621580
y.create.l HWIO_PMIC_ARB_OBS2_CHNL44_CMD_ADDR A:0xe621600
y.create.l HWIO_PMIC_ARB_OBS2_CHNL45_CMD_ADDR A:0xe621680
y.create.l HWIO_PMIC_ARB_OBS2_CHNL46_CMD_ADDR A:0xe621700
y.create.l HWIO_PMIC_ARB_OBS2_CHNL47_CMD_ADDR A:0xe621780
y.create.l HWIO_PMIC_ARB_OBS2_CHNL48_CMD_ADDR A:0xe621800
y.create.l HWIO_PMIC_ARB_OBS2_CHNL49_CMD_ADDR A:0xe621880
y.create.l HWIO_PMIC_ARB_OBS2_CHNL50_CMD_ADDR A:0xe621900
y.create.l HWIO_PMIC_ARB_OBS2_CHNL51_CMD_ADDR A:0xe621980
y.create.l HWIO_PMIC_ARB_OBS2_CHNL52_CMD_ADDR A:0xe621a00
y.create.l HWIO_PMIC_ARB_OBS2_CHNL53_CMD_ADDR A:0xe621a80
y.create.l HWIO_PMIC_ARB_OBS2_CHNL54_CMD_ADDR A:0xe621b00
y.create.l HWIO_PMIC_ARB_OBS2_CHNL55_CMD_ADDR A:0xe621b80
y.create.l HWIO_PMIC_ARB_OBS2_CHNL56_CMD_ADDR A:0xe621c00
y.create.l HWIO_PMIC_ARB_OBS2_CHNL57_CMD_ADDR A:0xe621c80
y.create.l HWIO_PMIC_ARB_OBS2_CHNL58_CMD_ADDR A:0xe621d00
y.create.l HWIO_PMIC_ARB_OBS2_CHNL59_CMD_ADDR A:0xe621d80
y.create.l HWIO_PMIC_ARB_OBS2_CHNL60_CMD_ADDR A:0xe621e00
y.create.l HWIO_PMIC_ARB_OBS2_CHNL61_CMD_ADDR A:0xe621e80
y.create.l HWIO_PMIC_ARB_OBS2_CHNL62_CMD_ADDR A:0xe621f00
y.create.l HWIO_PMIC_ARB_OBS2_CHNL63_CMD_ADDR A:0xe621f80
y.create.l HWIO_PMIC_ARB_OBS2_CHNL64_CMD_ADDR A:0xe622000
y.create.l HWIO_PMIC_ARB_OBS2_CHNL65_CMD_ADDR A:0xe622080
y.create.l HWIO_PMIC_ARB_OBS2_CHNL66_CMD_ADDR A:0xe622100
y.create.l HWIO_PMIC_ARB_OBS2_CHNL67_CMD_ADDR A:0xe622180
y.create.l HWIO_PMIC_ARB_OBS2_CHNL68_CMD_ADDR A:0xe622200
y.create.l HWIO_PMIC_ARB_OBS2_CHNL69_CMD_ADDR A:0xe622280
y.create.l HWIO_PMIC_ARB_OBS2_CHNL70_CMD_ADDR A:0xe622300
y.create.l HWIO_PMIC_ARB_OBS2_CHNL71_CMD_ADDR A:0xe622380
y.create.l HWIO_PMIC_ARB_OBS2_CHNL72_CMD_ADDR A:0xe622400
y.create.l HWIO_PMIC_ARB_OBS2_CHNL73_CMD_ADDR A:0xe622480
y.create.l HWIO_PMIC_ARB_OBS2_CHNL74_CMD_ADDR A:0xe622500
y.create.l HWIO_PMIC_ARB_OBS2_CHNL75_CMD_ADDR A:0xe622580
y.create.l HWIO_PMIC_ARB_OBS2_CHNL76_CMD_ADDR A:0xe622600
y.create.l HWIO_PMIC_ARB_OBS2_CHNL77_CMD_ADDR A:0xe622680
y.create.l HWIO_PMIC_ARB_OBS2_CHNL78_CMD_ADDR A:0xe622700
y.create.l HWIO_PMIC_ARB_OBS2_CHNL79_CMD_ADDR A:0xe622780
y.create.l HWIO_PMIC_ARB_OBS2_CHNL80_CMD_ADDR A:0xe622800
y.create.l HWIO_PMIC_ARB_OBS2_CHNL81_CMD_ADDR A:0xe622880
y.create.l HWIO_PMIC_ARB_OBS2_CHNL82_CMD_ADDR A:0xe622900
y.create.l HWIO_PMIC_ARB_OBS2_CHNL83_CMD_ADDR A:0xe622980
y.create.l HWIO_PMIC_ARB_OBS2_CHNL84_CMD_ADDR A:0xe622a00
y.create.l HWIO_PMIC_ARB_OBS2_CHNL85_CMD_ADDR A:0xe622a80
y.create.l HWIO_PMIC_ARB_OBS2_CHNL86_CMD_ADDR A:0xe622b00
y.create.l HWIO_PMIC_ARB_OBS2_CHNL87_CMD_ADDR A:0xe622b80
y.create.l HWIO_PMIC_ARB_OBS2_CHNL88_CMD_ADDR A:0xe622c00
y.create.l HWIO_PMIC_ARB_OBS2_CHNL89_CMD_ADDR A:0xe622c80
y.create.l HWIO_PMIC_ARB_OBS2_CHNL90_CMD_ADDR A:0xe622d00
y.create.l HWIO_PMIC_ARB_OBS2_CHNL91_CMD_ADDR A:0xe622d80
y.create.l HWIO_PMIC_ARB_OBS2_CHNL92_CMD_ADDR A:0xe622e00
y.create.l HWIO_PMIC_ARB_OBS2_CHNL93_CMD_ADDR A:0xe622e80
y.create.l HWIO_PMIC_ARB_OBS2_CHNL94_CMD_ADDR A:0xe622f00
y.create.l HWIO_PMIC_ARB_OBS2_CHNL95_CMD_ADDR A:0xe622f80
y.create.l HWIO_PMIC_ARB_OBS2_CHNL96_CMD_ADDR A:0xe623000
y.create.l HWIO_PMIC_ARB_OBS2_CHNL97_CMD_ADDR A:0xe623080
y.create.l HWIO_PMIC_ARB_OBS2_CHNL98_CMD_ADDR A:0xe623100
y.create.l HWIO_PMIC_ARB_OBS2_CHNL99_CMD_ADDR A:0xe623180
y.create.l HWIO_PMIC_ARB_OBS2_CHNL100_CMD_ADDR A:0xe623200
y.create.l HWIO_PMIC_ARB_OBS2_CHNL101_CMD_ADDR A:0xe623280
y.create.l HWIO_PMIC_ARB_OBS2_CHNL102_CMD_ADDR A:0xe623300
y.create.l HWIO_PMIC_ARB_OBS2_CHNL103_CMD_ADDR A:0xe623380
y.create.l HWIO_PMIC_ARB_OBS2_CHNL104_CMD_ADDR A:0xe623400
y.create.l HWIO_PMIC_ARB_OBS2_CHNL105_CMD_ADDR A:0xe623480
y.create.l HWIO_PMIC_ARB_OBS2_CHNL106_CMD_ADDR A:0xe623500
y.create.l HWIO_PMIC_ARB_OBS2_CHNL107_CMD_ADDR A:0xe623580
y.create.l HWIO_PMIC_ARB_OBS2_CHNL108_CMD_ADDR A:0xe623600
y.create.l HWIO_PMIC_ARB_OBS2_CHNL109_CMD_ADDR A:0xe623680
y.create.l HWIO_PMIC_ARB_OBS2_CHNL110_CMD_ADDR A:0xe623700
y.create.l HWIO_PMIC_ARB_OBS2_CHNL111_CMD_ADDR A:0xe623780
y.create.l HWIO_PMIC_ARB_OBS2_CHNL112_CMD_ADDR A:0xe623800
y.create.l HWIO_PMIC_ARB_OBS2_CHNL113_CMD_ADDR A:0xe623880
y.create.l HWIO_PMIC_ARB_OBS2_CHNL114_CMD_ADDR A:0xe623900
y.create.l HWIO_PMIC_ARB_OBS2_CHNL115_CMD_ADDR A:0xe623980
y.create.l HWIO_PMIC_ARB_OBS2_CHNL116_CMD_ADDR A:0xe623a00
y.create.l HWIO_PMIC_ARB_OBS2_CHNL117_CMD_ADDR A:0xe623a80
y.create.l HWIO_PMIC_ARB_OBS2_CHNL118_CMD_ADDR A:0xe623b00
y.create.l HWIO_PMIC_ARB_OBS2_CHNL119_CMD_ADDR A:0xe623b80
y.create.l HWIO_PMIC_ARB_OBS2_CHNL120_CMD_ADDR A:0xe623c00
y.create.l HWIO_PMIC_ARB_OBS2_CHNL121_CMD_ADDR A:0xe623c80
y.create.l HWIO_PMIC_ARB_OBS2_CHNL122_CMD_ADDR A:0xe623d00
y.create.l HWIO_PMIC_ARB_OBS2_CHNL123_CMD_ADDR A:0xe623d80
y.create.l HWIO_PMIC_ARB_OBS2_CHNL124_CMD_ADDR A:0xe623e00
y.create.l HWIO_PMIC_ARB_OBS2_CHNL125_CMD_ADDR A:0xe623e80
y.create.l HWIO_PMIC_ARB_OBS2_CHNL126_CMD_ADDR A:0xe623f00
y.create.l HWIO_PMIC_ARB_OBS2_CHNL127_CMD_ADDR A:0xe623f80
y.create.l HWIO_PMIC_ARB_OBS2_CHNL128_CMD_ADDR A:0xe624000
y.create.l HWIO_PMIC_ARB_OBS2_CHNL129_CMD_ADDR A:0xe624080
y.create.l HWIO_PMIC_ARB_OBS2_CHNL130_CMD_ADDR A:0xe624100
y.create.l HWIO_PMIC_ARB_OBS2_CHNL131_CMD_ADDR A:0xe624180
y.create.l HWIO_PMIC_ARB_OBS2_CHNL132_CMD_ADDR A:0xe624200
y.create.l HWIO_PMIC_ARB_OBS2_CHNL133_CMD_ADDR A:0xe624280
y.create.l HWIO_PMIC_ARB_OBS2_CHNL134_CMD_ADDR A:0xe624300
y.create.l HWIO_PMIC_ARB_OBS2_CHNL135_CMD_ADDR A:0xe624380
y.create.l HWIO_PMIC_ARB_OBS2_CHNL136_CMD_ADDR A:0xe624400
y.create.l HWIO_PMIC_ARB_OBS2_CHNL137_CMD_ADDR A:0xe624480
y.create.l HWIO_PMIC_ARB_OBS2_CHNL138_CMD_ADDR A:0xe624500
y.create.l HWIO_PMIC_ARB_OBS2_CHNL139_CMD_ADDR A:0xe624580
y.create.l HWIO_PMIC_ARB_OBS2_CHNL140_CMD_ADDR A:0xe624600
y.create.l HWIO_PMIC_ARB_OBS2_CHNL141_CMD_ADDR A:0xe624680
y.create.l HWIO_PMIC_ARB_OBS2_CHNL142_CMD_ADDR A:0xe624700
y.create.l HWIO_PMIC_ARB_OBS2_CHNL143_CMD_ADDR A:0xe624780
y.create.l HWIO_PMIC_ARB_OBS2_CHNL144_CMD_ADDR A:0xe624800
y.create.l HWIO_PMIC_ARB_OBS2_CHNL145_CMD_ADDR A:0xe624880
y.create.l HWIO_PMIC_ARB_OBS2_CHNL146_CMD_ADDR A:0xe624900
y.create.l HWIO_PMIC_ARB_OBS2_CHNL147_CMD_ADDR A:0xe624980
y.create.l HWIO_PMIC_ARB_OBS2_CHNL148_CMD_ADDR A:0xe624a00
y.create.l HWIO_PMIC_ARB_OBS2_CHNL149_CMD_ADDR A:0xe624a80
y.create.l HWIO_PMIC_ARB_OBS2_CHNL150_CMD_ADDR A:0xe624b00
y.create.l HWIO_PMIC_ARB_OBS2_CHNL151_CMD_ADDR A:0xe624b80
y.create.l HWIO_PMIC_ARB_OBS2_CHNL152_CMD_ADDR A:0xe624c00
y.create.l HWIO_PMIC_ARB_OBS2_CHNL153_CMD_ADDR A:0xe624c80
y.create.l HWIO_PMIC_ARB_OBS2_CHNL154_CMD_ADDR A:0xe624d00
y.create.l HWIO_PMIC_ARB_OBS2_CHNL155_CMD_ADDR A:0xe624d80
y.create.l HWIO_PMIC_ARB_OBS2_CHNL156_CMD_ADDR A:0xe624e00
y.create.l HWIO_PMIC_ARB_OBS2_CHNL157_CMD_ADDR A:0xe624e80
y.create.l HWIO_PMIC_ARB_OBS2_CHNL158_CMD_ADDR A:0xe624f00
y.create.l HWIO_PMIC_ARB_OBS2_CHNL159_CMD_ADDR A:0xe624f80
y.create.l HWIO_PMIC_ARB_OBS2_CHNL160_CMD_ADDR A:0xe625000
y.create.l HWIO_PMIC_ARB_OBS2_CHNL161_CMD_ADDR A:0xe625080
y.create.l HWIO_PMIC_ARB_OBS2_CHNL162_CMD_ADDR A:0xe625100
y.create.l HWIO_PMIC_ARB_OBS2_CHNL163_CMD_ADDR A:0xe625180
y.create.l HWIO_PMIC_ARB_OBS2_CHNL164_CMD_ADDR A:0xe625200
y.create.l HWIO_PMIC_ARB_OBS2_CHNL165_CMD_ADDR A:0xe625280
y.create.l HWIO_PMIC_ARB_OBS2_CHNL166_CMD_ADDR A:0xe625300
y.create.l HWIO_PMIC_ARB_OBS2_CHNL167_CMD_ADDR A:0xe625380
y.create.l HWIO_PMIC_ARB_OBS2_CHNL168_CMD_ADDR A:0xe625400
y.create.l HWIO_PMIC_ARB_OBS2_CHNL169_CMD_ADDR A:0xe625480
y.create.l HWIO_PMIC_ARB_OBS2_CHNL170_CMD_ADDR A:0xe625500
y.create.l HWIO_PMIC_ARB_OBS2_CHNL171_CMD_ADDR A:0xe625580
y.create.l HWIO_PMIC_ARB_OBS2_CHNL172_CMD_ADDR A:0xe625600
y.create.l HWIO_PMIC_ARB_OBS2_CHNL173_CMD_ADDR A:0xe625680
y.create.l HWIO_PMIC_ARB_OBS2_CHNL174_CMD_ADDR A:0xe625700
y.create.l HWIO_PMIC_ARB_OBS2_CHNL175_CMD_ADDR A:0xe625780
y.create.l HWIO_PMIC_ARB_OBS2_CHNL176_CMD_ADDR A:0xe625800
y.create.l HWIO_PMIC_ARB_OBS2_CHNL177_CMD_ADDR A:0xe625880
y.create.l HWIO_PMIC_ARB_OBS2_CHNL178_CMD_ADDR A:0xe625900
y.create.l HWIO_PMIC_ARB_OBS2_CHNL179_CMD_ADDR A:0xe625980
y.create.l HWIO_PMIC_ARB_OBS2_CHNL180_CMD_ADDR A:0xe625a00
y.create.l HWIO_PMIC_ARB_OBS2_CHNL181_CMD_ADDR A:0xe625a80
y.create.l HWIO_PMIC_ARB_OBS2_CHNL182_CMD_ADDR A:0xe625b00
y.create.l HWIO_PMIC_ARB_OBS2_CHNL183_CMD_ADDR A:0xe625b80
y.create.l HWIO_PMIC_ARB_OBS2_CHNL184_CMD_ADDR A:0xe625c00
y.create.l HWIO_PMIC_ARB_OBS2_CHNL185_CMD_ADDR A:0xe625c80
y.create.l HWIO_PMIC_ARB_OBS2_CHNL186_CMD_ADDR A:0xe625d00
y.create.l HWIO_PMIC_ARB_OBS2_CHNL187_CMD_ADDR A:0xe625d80
y.create.l HWIO_PMIC_ARB_OBS2_CHNL188_CMD_ADDR A:0xe625e00
y.create.l HWIO_PMIC_ARB_OBS2_CHNL189_CMD_ADDR A:0xe625e80
y.create.l HWIO_PMIC_ARB_OBS2_CHNL190_CMD_ADDR A:0xe625f00
y.create.l HWIO_PMIC_ARB_OBS2_CHNL191_CMD_ADDR A:0xe625f80
y.create.l HWIO_PMIC_ARB_OBS2_CHNL192_CMD_ADDR A:0xe626000
y.create.l HWIO_PMIC_ARB_OBS2_CHNL193_CMD_ADDR A:0xe626080
y.create.l HWIO_PMIC_ARB_OBS2_CHNL194_CMD_ADDR A:0xe626100
y.create.l HWIO_PMIC_ARB_OBS2_CHNL195_CMD_ADDR A:0xe626180
y.create.l HWIO_PMIC_ARB_OBS2_CHNL196_CMD_ADDR A:0xe626200
y.create.l HWIO_PMIC_ARB_OBS2_CHNL197_CMD_ADDR A:0xe626280
y.create.l HWIO_PMIC_ARB_OBS2_CHNL198_CMD_ADDR A:0xe626300
y.create.l HWIO_PMIC_ARB_OBS2_CHNL199_CMD_ADDR A:0xe626380
y.create.l HWIO_PMIC_ARB_OBS2_CHNL200_CMD_ADDR A:0xe626400
y.create.l HWIO_PMIC_ARB_OBS2_CHNL201_CMD_ADDR A:0xe626480
y.create.l HWIO_PMIC_ARB_OBS2_CHNL202_CMD_ADDR A:0xe626500
y.create.l HWIO_PMIC_ARB_OBS2_CHNL203_CMD_ADDR A:0xe626580
y.create.l HWIO_PMIC_ARB_OBS2_CHNL204_CMD_ADDR A:0xe626600
y.create.l HWIO_PMIC_ARB_OBS2_CHNL205_CMD_ADDR A:0xe626680
y.create.l HWIO_PMIC_ARB_OBS2_CHNL206_CMD_ADDR A:0xe626700
y.create.l HWIO_PMIC_ARB_OBS2_CHNL207_CMD_ADDR A:0xe626780
y.create.l HWIO_PMIC_ARB_OBS2_CHNL208_CMD_ADDR A:0xe626800
y.create.l HWIO_PMIC_ARB_OBS2_CHNL209_CMD_ADDR A:0xe626880
y.create.l HWIO_PMIC_ARB_OBS2_CHNL210_CMD_ADDR A:0xe626900
y.create.l HWIO_PMIC_ARB_OBS2_CHNL211_CMD_ADDR A:0xe626980
y.create.l HWIO_PMIC_ARB_OBS2_CHNL212_CMD_ADDR A:0xe626a00
y.create.l HWIO_PMIC_ARB_OBS2_CHNL213_CMD_ADDR A:0xe626a80
y.create.l HWIO_PMIC_ARB_OBS2_CHNL214_CMD_ADDR A:0xe626b00
y.create.l HWIO_PMIC_ARB_OBS2_CHNL215_CMD_ADDR A:0xe626b80
y.create.l HWIO_PMIC_ARB_OBS2_CHNL216_CMD_ADDR A:0xe626c00
y.create.l HWIO_PMIC_ARB_OBS2_CHNL217_CMD_ADDR A:0xe626c80
y.create.l HWIO_PMIC_ARB_OBS2_CHNL218_CMD_ADDR A:0xe626d00
y.create.l HWIO_PMIC_ARB_OBS2_CHNL219_CMD_ADDR A:0xe626d80
y.create.l HWIO_PMIC_ARB_OBS2_CHNL220_CMD_ADDR A:0xe626e00
y.create.l HWIO_PMIC_ARB_OBS2_CHNL221_CMD_ADDR A:0xe626e80
y.create.l HWIO_PMIC_ARB_OBS2_CHNL222_CMD_ADDR A:0xe626f00
y.create.l HWIO_PMIC_ARB_OBS2_CHNL223_CMD_ADDR A:0xe626f80
y.create.l HWIO_PMIC_ARB_OBS2_CHNL224_CMD_ADDR A:0xe627000
y.create.l HWIO_PMIC_ARB_OBS2_CHNL225_CMD_ADDR A:0xe627080
y.create.l HWIO_PMIC_ARB_OBS2_CHNL226_CMD_ADDR A:0xe627100
y.create.l HWIO_PMIC_ARB_OBS2_CHNL227_CMD_ADDR A:0xe627180
y.create.l HWIO_PMIC_ARB_OBS2_CHNL228_CMD_ADDR A:0xe627200
y.create.l HWIO_PMIC_ARB_OBS2_CHNL229_CMD_ADDR A:0xe627280
y.create.l HWIO_PMIC_ARB_OBS2_CHNL230_CMD_ADDR A:0xe627300
y.create.l HWIO_PMIC_ARB_OBS2_CHNL231_CMD_ADDR A:0xe627380
y.create.l HWIO_PMIC_ARB_OBS2_CHNL232_CMD_ADDR A:0xe627400
y.create.l HWIO_PMIC_ARB_OBS2_CHNL233_CMD_ADDR A:0xe627480
y.create.l HWIO_PMIC_ARB_OBS2_CHNL234_CMD_ADDR A:0xe627500
y.create.l HWIO_PMIC_ARB_OBS2_CHNL235_CMD_ADDR A:0xe627580
y.create.l HWIO_PMIC_ARB_OBS2_CHNL236_CMD_ADDR A:0xe627600
y.create.l HWIO_PMIC_ARB_OBS2_CHNL237_CMD_ADDR A:0xe627680
y.create.l HWIO_PMIC_ARB_OBS2_CHNL238_CMD_ADDR A:0xe627700
y.create.l HWIO_PMIC_ARB_OBS2_CHNL239_CMD_ADDR A:0xe627780
y.create.l HWIO_PMIC_ARB_OBS2_CHNL240_CMD_ADDR A:0xe627800
y.create.l HWIO_PMIC_ARB_OBS2_CHNL241_CMD_ADDR A:0xe627880
y.create.l HWIO_PMIC_ARB_OBS2_CHNL242_CMD_ADDR A:0xe627900
y.create.l HWIO_PMIC_ARB_OBS2_CHNL243_CMD_ADDR A:0xe627980
y.create.l HWIO_PMIC_ARB_OBS2_CHNL244_CMD_ADDR A:0xe627a00
y.create.l HWIO_PMIC_ARB_OBS2_CHNL245_CMD_ADDR A:0xe627a80
y.create.l HWIO_PMIC_ARB_OBS2_CHNL246_CMD_ADDR A:0xe627b00
y.create.l HWIO_PMIC_ARB_OBS2_CHNL247_CMD_ADDR A:0xe627b80
y.create.l HWIO_PMIC_ARB_OBS2_CHNL248_CMD_ADDR A:0xe627c00
y.create.l HWIO_PMIC_ARB_OBS2_CHNL249_CMD_ADDR A:0xe627c80
y.create.l HWIO_PMIC_ARB_OBS2_CHNL250_CMD_ADDR A:0xe627d00
y.create.l HWIO_PMIC_ARB_OBS2_CHNL251_CMD_ADDR A:0xe627d80
y.create.l HWIO_PMIC_ARB_OBS2_CHNL252_CMD_ADDR A:0xe627e00
y.create.l HWIO_PMIC_ARB_OBS2_CHNL253_CMD_ADDR A:0xe627e80
y.create.l HWIO_PMIC_ARB_OBS2_CHNL254_CMD_ADDR A:0xe627f00
y.create.l HWIO_PMIC_ARB_OBS2_CHNL255_CMD_ADDR A:0xe627f80
y.create.l HWIO_PMIC_ARB_OBS3_CHNL0_CMD_ADDR A:0xe630000
y.create.l HWIO_PMIC_ARB_OBS3_CHNL1_CMD_ADDR A:0xe630080
y.create.l HWIO_PMIC_ARB_OBS3_CHNL2_CMD_ADDR A:0xe630100
y.create.l HWIO_PMIC_ARB_OBS3_CHNL3_CMD_ADDR A:0xe630180
y.create.l HWIO_PMIC_ARB_OBS3_CHNL4_CMD_ADDR A:0xe630200
y.create.l HWIO_PMIC_ARB_OBS3_CHNL5_CMD_ADDR A:0xe630280
y.create.l HWIO_PMIC_ARB_OBS3_CHNL6_CMD_ADDR A:0xe630300
y.create.l HWIO_PMIC_ARB_OBS3_CHNL7_CMD_ADDR A:0xe630380
y.create.l HWIO_PMIC_ARB_OBS3_CHNL8_CMD_ADDR A:0xe630400
y.create.l HWIO_PMIC_ARB_OBS3_CHNL9_CMD_ADDR A:0xe630480
y.create.l HWIO_PMIC_ARB_OBS3_CHNL10_CMD_ADDR A:0xe630500
y.create.l HWIO_PMIC_ARB_OBS3_CHNL11_CMD_ADDR A:0xe630580
y.create.l HWIO_PMIC_ARB_OBS3_CHNL12_CMD_ADDR A:0xe630600
y.create.l HWIO_PMIC_ARB_OBS3_CHNL13_CMD_ADDR A:0xe630680
y.create.l HWIO_PMIC_ARB_OBS3_CHNL14_CMD_ADDR A:0xe630700
y.create.l HWIO_PMIC_ARB_OBS3_CHNL15_CMD_ADDR A:0xe630780
y.create.l HWIO_PMIC_ARB_OBS3_CHNL16_CMD_ADDR A:0xe630800
y.create.l HWIO_PMIC_ARB_OBS3_CHNL17_CMD_ADDR A:0xe630880
y.create.l HWIO_PMIC_ARB_OBS3_CHNL18_CMD_ADDR A:0xe630900
y.create.l HWIO_PMIC_ARB_OBS3_CHNL19_CMD_ADDR A:0xe630980
y.create.l HWIO_PMIC_ARB_OBS3_CHNL20_CMD_ADDR A:0xe630a00
y.create.l HWIO_PMIC_ARB_OBS3_CHNL21_CMD_ADDR A:0xe630a80
y.create.l HWIO_PMIC_ARB_OBS3_CHNL22_CMD_ADDR A:0xe630b00
y.create.l HWIO_PMIC_ARB_OBS3_CHNL23_CMD_ADDR A:0xe630b80
y.create.l HWIO_PMIC_ARB_OBS3_CHNL24_CMD_ADDR A:0xe630c00
y.create.l HWIO_PMIC_ARB_OBS3_CHNL25_CMD_ADDR A:0xe630c80
y.create.l HWIO_PMIC_ARB_OBS3_CHNL26_CMD_ADDR A:0xe630d00
y.create.l HWIO_PMIC_ARB_OBS3_CHNL27_CMD_ADDR A:0xe630d80
y.create.l HWIO_PMIC_ARB_OBS3_CHNL28_CMD_ADDR A:0xe630e00
y.create.l HWIO_PMIC_ARB_OBS3_CHNL29_CMD_ADDR A:0xe630e80
y.create.l HWIO_PMIC_ARB_OBS3_CHNL30_CMD_ADDR A:0xe630f00
y.create.l HWIO_PMIC_ARB_OBS3_CHNL31_CMD_ADDR A:0xe630f80
y.create.l HWIO_PMIC_ARB_OBS3_CHNL32_CMD_ADDR A:0xe631000
y.create.l HWIO_PMIC_ARB_OBS3_CHNL33_CMD_ADDR A:0xe631080
y.create.l HWIO_PMIC_ARB_OBS3_CHNL34_CMD_ADDR A:0xe631100
y.create.l HWIO_PMIC_ARB_OBS3_CHNL35_CMD_ADDR A:0xe631180
y.create.l HWIO_PMIC_ARB_OBS3_CHNL36_CMD_ADDR A:0xe631200
y.create.l HWIO_PMIC_ARB_OBS3_CHNL37_CMD_ADDR A:0xe631280
y.create.l HWIO_PMIC_ARB_OBS3_CHNL38_CMD_ADDR A:0xe631300
y.create.l HWIO_PMIC_ARB_OBS3_CHNL39_CMD_ADDR A:0xe631380
y.create.l HWIO_PMIC_ARB_OBS3_CHNL40_CMD_ADDR A:0xe631400
y.create.l HWIO_PMIC_ARB_OBS3_CHNL41_CMD_ADDR A:0xe631480
y.create.l HWIO_PMIC_ARB_OBS3_CHNL42_CMD_ADDR A:0xe631500
y.create.l HWIO_PMIC_ARB_OBS3_CHNL43_CMD_ADDR A:0xe631580
y.create.l HWIO_PMIC_ARB_OBS3_CHNL44_CMD_ADDR A:0xe631600
y.create.l HWIO_PMIC_ARB_OBS3_CHNL45_CMD_ADDR A:0xe631680
y.create.l HWIO_PMIC_ARB_OBS3_CHNL46_CMD_ADDR A:0xe631700
y.create.l HWIO_PMIC_ARB_OBS3_CHNL47_CMD_ADDR A:0xe631780
y.create.l HWIO_PMIC_ARB_OBS3_CHNL48_CMD_ADDR A:0xe631800
y.create.l HWIO_PMIC_ARB_OBS3_CHNL49_CMD_ADDR A:0xe631880
y.create.l HWIO_PMIC_ARB_OBS3_CHNL50_CMD_ADDR A:0xe631900
y.create.l HWIO_PMIC_ARB_OBS3_CHNL51_CMD_ADDR A:0xe631980
y.create.l HWIO_PMIC_ARB_OBS3_CHNL52_CMD_ADDR A:0xe631a00
y.create.l HWIO_PMIC_ARB_OBS3_CHNL53_CMD_ADDR A:0xe631a80
y.create.l HWIO_PMIC_ARB_OBS3_CHNL54_CMD_ADDR A:0xe631b00
y.create.l HWIO_PMIC_ARB_OBS3_CHNL55_CMD_ADDR A:0xe631b80
y.create.l HWIO_PMIC_ARB_OBS3_CHNL56_CMD_ADDR A:0xe631c00
y.create.l HWIO_PMIC_ARB_OBS3_CHNL57_CMD_ADDR A:0xe631c80
y.create.l HWIO_PMIC_ARB_OBS3_CHNL58_CMD_ADDR A:0xe631d00
y.create.l HWIO_PMIC_ARB_OBS3_CHNL59_CMD_ADDR A:0xe631d80
y.create.l HWIO_PMIC_ARB_OBS3_CHNL60_CMD_ADDR A:0xe631e00
y.create.l HWIO_PMIC_ARB_OBS3_CHNL61_CMD_ADDR A:0xe631e80
y.create.l HWIO_PMIC_ARB_OBS3_CHNL62_CMD_ADDR A:0xe631f00
y.create.l HWIO_PMIC_ARB_OBS3_CHNL63_CMD_ADDR A:0xe631f80
y.create.l HWIO_PMIC_ARB_OBS3_CHNL64_CMD_ADDR A:0xe632000
y.create.l HWIO_PMIC_ARB_OBS3_CHNL65_CMD_ADDR A:0xe632080
y.create.l HWIO_PMIC_ARB_OBS3_CHNL66_CMD_ADDR A:0xe632100
y.create.l HWIO_PMIC_ARB_OBS3_CHNL67_CMD_ADDR A:0xe632180
y.create.l HWIO_PMIC_ARB_OBS3_CHNL68_CMD_ADDR A:0xe632200
y.create.l HWIO_PMIC_ARB_OBS3_CHNL69_CMD_ADDR A:0xe632280
y.create.l HWIO_PMIC_ARB_OBS3_CHNL70_CMD_ADDR A:0xe632300
y.create.l HWIO_PMIC_ARB_OBS3_CHNL71_CMD_ADDR A:0xe632380
y.create.l HWIO_PMIC_ARB_OBS3_CHNL72_CMD_ADDR A:0xe632400
y.create.l HWIO_PMIC_ARB_OBS3_CHNL73_CMD_ADDR A:0xe632480
y.create.l HWIO_PMIC_ARB_OBS3_CHNL74_CMD_ADDR A:0xe632500
y.create.l HWIO_PMIC_ARB_OBS3_CHNL75_CMD_ADDR A:0xe632580
y.create.l HWIO_PMIC_ARB_OBS3_CHNL76_CMD_ADDR A:0xe632600
y.create.l HWIO_PMIC_ARB_OBS3_CHNL77_CMD_ADDR A:0xe632680
y.create.l HWIO_PMIC_ARB_OBS3_CHNL78_CMD_ADDR A:0xe632700
y.create.l HWIO_PMIC_ARB_OBS3_CHNL79_CMD_ADDR A:0xe632780
y.create.l HWIO_PMIC_ARB_OBS3_CHNL80_CMD_ADDR A:0xe632800
y.create.l HWIO_PMIC_ARB_OBS3_CHNL81_CMD_ADDR A:0xe632880
y.create.l HWIO_PMIC_ARB_OBS3_CHNL82_CMD_ADDR A:0xe632900
y.create.l HWIO_PMIC_ARB_OBS3_CHNL83_CMD_ADDR A:0xe632980
y.create.l HWIO_PMIC_ARB_OBS3_CHNL84_CMD_ADDR A:0xe632a00
y.create.l HWIO_PMIC_ARB_OBS3_CHNL85_CMD_ADDR A:0xe632a80
y.create.l HWIO_PMIC_ARB_OBS3_CHNL86_CMD_ADDR A:0xe632b00
y.create.l HWIO_PMIC_ARB_OBS3_CHNL87_CMD_ADDR A:0xe632b80
y.create.l HWIO_PMIC_ARB_OBS3_CHNL88_CMD_ADDR A:0xe632c00
y.create.l HWIO_PMIC_ARB_OBS3_CHNL89_CMD_ADDR A:0xe632c80
y.create.l HWIO_PMIC_ARB_OBS3_CHNL90_CMD_ADDR A:0xe632d00
y.create.l HWIO_PMIC_ARB_OBS3_CHNL91_CMD_ADDR A:0xe632d80
y.create.l HWIO_PMIC_ARB_OBS3_CHNL92_CMD_ADDR A:0xe632e00
y.create.l HWIO_PMIC_ARB_OBS3_CHNL93_CMD_ADDR A:0xe632e80
y.create.l HWIO_PMIC_ARB_OBS3_CHNL94_CMD_ADDR A:0xe632f00
y.create.l HWIO_PMIC_ARB_OBS3_CHNL95_CMD_ADDR A:0xe632f80
y.create.l HWIO_PMIC_ARB_OBS3_CHNL96_CMD_ADDR A:0xe633000
y.create.l HWIO_PMIC_ARB_OBS3_CHNL97_CMD_ADDR A:0xe633080
y.create.l HWIO_PMIC_ARB_OBS3_CHNL98_CMD_ADDR A:0xe633100
y.create.l HWIO_PMIC_ARB_OBS3_CHNL99_CMD_ADDR A:0xe633180
y.create.l HWIO_PMIC_ARB_OBS3_CHNL100_CMD_ADDR A:0xe633200
y.create.l HWIO_PMIC_ARB_OBS3_CHNL101_CMD_ADDR A:0xe633280
y.create.l HWIO_PMIC_ARB_OBS3_CHNL102_CMD_ADDR A:0xe633300
y.create.l HWIO_PMIC_ARB_OBS3_CHNL103_CMD_ADDR A:0xe633380
y.create.l HWIO_PMIC_ARB_OBS3_CHNL104_CMD_ADDR A:0xe633400
y.create.l HWIO_PMIC_ARB_OBS3_CHNL105_CMD_ADDR A:0xe633480
y.create.l HWIO_PMIC_ARB_OBS3_CHNL106_CMD_ADDR A:0xe633500
y.create.l HWIO_PMIC_ARB_OBS3_CHNL107_CMD_ADDR A:0xe633580
y.create.l HWIO_PMIC_ARB_OBS3_CHNL108_CMD_ADDR A:0xe633600
y.create.l HWIO_PMIC_ARB_OBS3_CHNL109_CMD_ADDR A:0xe633680
y.create.l HWIO_PMIC_ARB_OBS3_CHNL110_CMD_ADDR A:0xe633700
y.create.l HWIO_PMIC_ARB_OBS3_CHNL111_CMD_ADDR A:0xe633780
y.create.l HWIO_PMIC_ARB_OBS3_CHNL112_CMD_ADDR A:0xe633800
y.create.l HWIO_PMIC_ARB_OBS3_CHNL113_CMD_ADDR A:0xe633880
y.create.l HWIO_PMIC_ARB_OBS3_CHNL114_CMD_ADDR A:0xe633900
y.create.l HWIO_PMIC_ARB_OBS3_CHNL115_CMD_ADDR A:0xe633980
y.create.l HWIO_PMIC_ARB_OBS3_CHNL116_CMD_ADDR A:0xe633a00
y.create.l HWIO_PMIC_ARB_OBS3_CHNL117_CMD_ADDR A:0xe633a80
y.create.l HWIO_PMIC_ARB_OBS3_CHNL118_CMD_ADDR A:0xe633b00
y.create.l HWIO_PMIC_ARB_OBS3_CHNL119_CMD_ADDR A:0xe633b80
y.create.l HWIO_PMIC_ARB_OBS3_CHNL120_CMD_ADDR A:0xe633c00
y.create.l HWIO_PMIC_ARB_OBS3_CHNL121_CMD_ADDR A:0xe633c80
y.create.l HWIO_PMIC_ARB_OBS3_CHNL122_CMD_ADDR A:0xe633d00
y.create.l HWIO_PMIC_ARB_OBS3_CHNL123_CMD_ADDR A:0xe633d80
y.create.l HWIO_PMIC_ARB_OBS3_CHNL124_CMD_ADDR A:0xe633e00
y.create.l HWIO_PMIC_ARB_OBS3_CHNL125_CMD_ADDR A:0xe633e80
y.create.l HWIO_PMIC_ARB_OBS3_CHNL126_CMD_ADDR A:0xe633f00
y.create.l HWIO_PMIC_ARB_OBS3_CHNL127_CMD_ADDR A:0xe633f80
y.create.l HWIO_PMIC_ARB_OBS3_CHNL128_CMD_ADDR A:0xe634000
y.create.l HWIO_PMIC_ARB_OBS3_CHNL129_CMD_ADDR A:0xe634080
y.create.l HWIO_PMIC_ARB_OBS3_CHNL130_CMD_ADDR A:0xe634100
y.create.l HWIO_PMIC_ARB_OBS3_CHNL131_CMD_ADDR A:0xe634180
y.create.l HWIO_PMIC_ARB_OBS3_CHNL132_CMD_ADDR A:0xe634200
y.create.l HWIO_PMIC_ARB_OBS3_CHNL133_CMD_ADDR A:0xe634280
y.create.l HWIO_PMIC_ARB_OBS3_CHNL134_CMD_ADDR A:0xe634300
y.create.l HWIO_PMIC_ARB_OBS3_CHNL135_CMD_ADDR A:0xe634380
y.create.l HWIO_PMIC_ARB_OBS3_CHNL136_CMD_ADDR A:0xe634400
y.create.l HWIO_PMIC_ARB_OBS3_CHNL137_CMD_ADDR A:0xe634480
y.create.l HWIO_PMIC_ARB_OBS3_CHNL138_CMD_ADDR A:0xe634500
y.create.l HWIO_PMIC_ARB_OBS3_CHNL139_CMD_ADDR A:0xe634580
y.create.l HWIO_PMIC_ARB_OBS3_CHNL140_CMD_ADDR A:0xe634600
y.create.l HWIO_PMIC_ARB_OBS3_CHNL141_CMD_ADDR A:0xe634680
y.create.l HWIO_PMIC_ARB_OBS3_CHNL142_CMD_ADDR A:0xe634700
y.create.l HWIO_PMIC_ARB_OBS3_CHNL143_CMD_ADDR A:0xe634780
y.create.l HWIO_PMIC_ARB_OBS3_CHNL144_CMD_ADDR A:0xe634800
y.create.l HWIO_PMIC_ARB_OBS3_CHNL145_CMD_ADDR A:0xe634880
y.create.l HWIO_PMIC_ARB_OBS3_CHNL146_CMD_ADDR A:0xe634900
y.create.l HWIO_PMIC_ARB_OBS3_CHNL147_CMD_ADDR A:0xe634980
y.create.l HWIO_PMIC_ARB_OBS3_CHNL148_CMD_ADDR A:0xe634a00
y.create.l HWIO_PMIC_ARB_OBS3_CHNL149_CMD_ADDR A:0xe634a80
y.create.l HWIO_PMIC_ARB_OBS3_CHNL150_CMD_ADDR A:0xe634b00
y.create.l HWIO_PMIC_ARB_OBS3_CHNL151_CMD_ADDR A:0xe634b80
y.create.l HWIO_PMIC_ARB_OBS3_CHNL152_CMD_ADDR A:0xe634c00
y.create.l HWIO_PMIC_ARB_OBS3_CHNL153_CMD_ADDR A:0xe634c80
y.create.l HWIO_PMIC_ARB_OBS3_CHNL154_CMD_ADDR A:0xe634d00
y.create.l HWIO_PMIC_ARB_OBS3_CHNL155_CMD_ADDR A:0xe634d80
y.create.l HWIO_PMIC_ARB_OBS3_CHNL156_CMD_ADDR A:0xe634e00
y.create.l HWIO_PMIC_ARB_OBS3_CHNL157_CMD_ADDR A:0xe634e80
y.create.l HWIO_PMIC_ARB_OBS3_CHNL158_CMD_ADDR A:0xe634f00
y.create.l HWIO_PMIC_ARB_OBS3_CHNL159_CMD_ADDR A:0xe634f80
y.create.l HWIO_PMIC_ARB_OBS3_CHNL160_CMD_ADDR A:0xe635000
y.create.l HWIO_PMIC_ARB_OBS3_CHNL161_CMD_ADDR A:0xe635080
y.create.l HWIO_PMIC_ARB_OBS3_CHNL162_CMD_ADDR A:0xe635100
y.create.l HWIO_PMIC_ARB_OBS3_CHNL163_CMD_ADDR A:0xe635180
y.create.l HWIO_PMIC_ARB_OBS3_CHNL164_CMD_ADDR A:0xe635200
y.create.l HWIO_PMIC_ARB_OBS3_CHNL165_CMD_ADDR A:0xe635280
y.create.l HWIO_PMIC_ARB_OBS3_CHNL166_CMD_ADDR A:0xe635300
y.create.l HWIO_PMIC_ARB_OBS3_CHNL167_CMD_ADDR A:0xe635380
y.create.l HWIO_PMIC_ARB_OBS3_CHNL168_CMD_ADDR A:0xe635400
y.create.l HWIO_PMIC_ARB_OBS3_CHNL169_CMD_ADDR A:0xe635480
y.create.l HWIO_PMIC_ARB_OBS3_CHNL170_CMD_ADDR A:0xe635500
y.create.l HWIO_PMIC_ARB_OBS3_CHNL171_CMD_ADDR A:0xe635580
y.create.l HWIO_PMIC_ARB_OBS3_CHNL172_CMD_ADDR A:0xe635600
y.create.l HWIO_PMIC_ARB_OBS3_CHNL173_CMD_ADDR A:0xe635680
y.create.l HWIO_PMIC_ARB_OBS3_CHNL174_CMD_ADDR A:0xe635700
y.create.l HWIO_PMIC_ARB_OBS3_CHNL175_CMD_ADDR A:0xe635780
y.create.l HWIO_PMIC_ARB_OBS3_CHNL176_CMD_ADDR A:0xe635800
y.create.l HWIO_PMIC_ARB_OBS3_CHNL177_CMD_ADDR A:0xe635880
y.create.l HWIO_PMIC_ARB_OBS3_CHNL178_CMD_ADDR A:0xe635900
y.create.l HWIO_PMIC_ARB_OBS3_CHNL179_CMD_ADDR A:0xe635980
y.create.l HWIO_PMIC_ARB_OBS3_CHNL180_CMD_ADDR A:0xe635a00
y.create.l HWIO_PMIC_ARB_OBS3_CHNL181_CMD_ADDR A:0xe635a80
y.create.l HWIO_PMIC_ARB_OBS3_CHNL182_CMD_ADDR A:0xe635b00
y.create.l HWIO_PMIC_ARB_OBS3_CHNL183_CMD_ADDR A:0xe635b80
y.create.l HWIO_PMIC_ARB_OBS3_CHNL184_CMD_ADDR A:0xe635c00
y.create.l HWIO_PMIC_ARB_OBS3_CHNL185_CMD_ADDR A:0xe635c80
y.create.l HWIO_PMIC_ARB_OBS3_CHNL186_CMD_ADDR A:0xe635d00
y.create.l HWIO_PMIC_ARB_OBS3_CHNL187_CMD_ADDR A:0xe635d80
y.create.l HWIO_PMIC_ARB_OBS3_CHNL188_CMD_ADDR A:0xe635e00
y.create.l HWIO_PMIC_ARB_OBS3_CHNL189_CMD_ADDR A:0xe635e80
y.create.l HWIO_PMIC_ARB_OBS3_CHNL190_CMD_ADDR A:0xe635f00
y.create.l HWIO_PMIC_ARB_OBS3_CHNL191_CMD_ADDR A:0xe635f80
y.create.l HWIO_PMIC_ARB_OBS3_CHNL192_CMD_ADDR A:0xe636000
y.create.l HWIO_PMIC_ARB_OBS3_CHNL193_CMD_ADDR A:0xe636080
y.create.l HWIO_PMIC_ARB_OBS3_CHNL194_CMD_ADDR A:0xe636100
y.create.l HWIO_PMIC_ARB_OBS3_CHNL195_CMD_ADDR A:0xe636180
y.create.l HWIO_PMIC_ARB_OBS3_CHNL196_CMD_ADDR A:0xe636200
y.create.l HWIO_PMIC_ARB_OBS3_CHNL197_CMD_ADDR A:0xe636280
y.create.l HWIO_PMIC_ARB_OBS3_CHNL198_CMD_ADDR A:0xe636300
y.create.l HWIO_PMIC_ARB_OBS3_CHNL199_CMD_ADDR A:0xe636380
y.create.l HWIO_PMIC_ARB_OBS3_CHNL200_CMD_ADDR A:0xe636400
y.create.l HWIO_PMIC_ARB_OBS3_CHNL201_CMD_ADDR A:0xe636480
y.create.l HWIO_PMIC_ARB_OBS3_CHNL202_CMD_ADDR A:0xe636500
y.create.l HWIO_PMIC_ARB_OBS3_CHNL203_CMD_ADDR A:0xe636580
y.create.l HWIO_PMIC_ARB_OBS3_CHNL204_CMD_ADDR A:0xe636600
y.create.l HWIO_PMIC_ARB_OBS3_CHNL205_CMD_ADDR A:0xe636680
y.create.l HWIO_PMIC_ARB_OBS3_CHNL206_CMD_ADDR A:0xe636700
y.create.l HWIO_PMIC_ARB_OBS3_CHNL207_CMD_ADDR A:0xe636780
y.create.l HWIO_PMIC_ARB_OBS3_CHNL208_CMD_ADDR A:0xe636800
y.create.l HWIO_PMIC_ARB_OBS3_CHNL209_CMD_ADDR A:0xe636880
y.create.l HWIO_PMIC_ARB_OBS3_CHNL210_CMD_ADDR A:0xe636900
y.create.l HWIO_PMIC_ARB_OBS3_CHNL211_CMD_ADDR A:0xe636980
y.create.l HWIO_PMIC_ARB_OBS3_CHNL212_CMD_ADDR A:0xe636a00
y.create.l HWIO_PMIC_ARB_OBS3_CHNL213_CMD_ADDR A:0xe636a80
y.create.l HWIO_PMIC_ARB_OBS3_CHNL214_CMD_ADDR A:0xe636b00
y.create.l HWIO_PMIC_ARB_OBS3_CHNL215_CMD_ADDR A:0xe636b80
y.create.l HWIO_PMIC_ARB_OBS3_CHNL216_CMD_ADDR A:0xe636c00
y.create.l HWIO_PMIC_ARB_OBS3_CHNL217_CMD_ADDR A:0xe636c80
y.create.l HWIO_PMIC_ARB_OBS3_CHNL218_CMD_ADDR A:0xe636d00
y.create.l HWIO_PMIC_ARB_OBS3_CHNL219_CMD_ADDR A:0xe636d80
y.create.l HWIO_PMIC_ARB_OBS3_CHNL220_CMD_ADDR A:0xe636e00
y.create.l HWIO_PMIC_ARB_OBS3_CHNL221_CMD_ADDR A:0xe636e80
y.create.l HWIO_PMIC_ARB_OBS3_CHNL222_CMD_ADDR A:0xe636f00
y.create.l HWIO_PMIC_ARB_OBS3_CHNL223_CMD_ADDR A:0xe636f80
y.create.l HWIO_PMIC_ARB_OBS3_CHNL224_CMD_ADDR A:0xe637000
y.create.l HWIO_PMIC_ARB_OBS3_CHNL225_CMD_ADDR A:0xe637080
y.create.l HWIO_PMIC_ARB_OBS3_CHNL226_CMD_ADDR A:0xe637100
y.create.l HWIO_PMIC_ARB_OBS3_CHNL227_CMD_ADDR A:0xe637180
y.create.l HWIO_PMIC_ARB_OBS3_CHNL228_CMD_ADDR A:0xe637200
y.create.l HWIO_PMIC_ARB_OBS3_CHNL229_CMD_ADDR A:0xe637280
y.create.l HWIO_PMIC_ARB_OBS3_CHNL230_CMD_ADDR A:0xe637300
y.create.l HWIO_PMIC_ARB_OBS3_CHNL231_CMD_ADDR A:0xe637380
y.create.l HWIO_PMIC_ARB_OBS3_CHNL232_CMD_ADDR A:0xe637400
y.create.l HWIO_PMIC_ARB_OBS3_CHNL233_CMD_ADDR A:0xe637480
y.create.l HWIO_PMIC_ARB_OBS3_CHNL234_CMD_ADDR A:0xe637500
y.create.l HWIO_PMIC_ARB_OBS3_CHNL235_CMD_ADDR A:0xe637580
y.create.l HWIO_PMIC_ARB_OBS3_CHNL236_CMD_ADDR A:0xe637600
y.create.l HWIO_PMIC_ARB_OBS3_CHNL237_CMD_ADDR A:0xe637680
y.create.l HWIO_PMIC_ARB_OBS3_CHNL238_CMD_ADDR A:0xe637700
y.create.l HWIO_PMIC_ARB_OBS3_CHNL239_CMD_ADDR A:0xe637780
y.create.l HWIO_PMIC_ARB_OBS3_CHNL240_CMD_ADDR A:0xe637800
y.create.l HWIO_PMIC_ARB_OBS3_CHNL241_CMD_ADDR A:0xe637880
y.create.l HWIO_PMIC_ARB_OBS3_CHNL242_CMD_ADDR A:0xe637900
y.create.l HWIO_PMIC_ARB_OBS3_CHNL243_CMD_ADDR A:0xe637980
y.create.l HWIO_PMIC_ARB_OBS3_CHNL244_CMD_ADDR A:0xe637a00
y.create.l HWIO_PMIC_ARB_OBS3_CHNL245_CMD_ADDR A:0xe637a80
y.create.l HWIO_PMIC_ARB_OBS3_CHNL246_CMD_ADDR A:0xe637b00
y.create.l HWIO_PMIC_ARB_OBS3_CHNL247_CMD_ADDR A:0xe637b80
y.create.l HWIO_PMIC_ARB_OBS3_CHNL248_CMD_ADDR A:0xe637c00
y.create.l HWIO_PMIC_ARB_OBS3_CHNL249_CMD_ADDR A:0xe637c80
y.create.l HWIO_PMIC_ARB_OBS3_CHNL250_CMD_ADDR A:0xe637d00
y.create.l HWIO_PMIC_ARB_OBS3_CHNL251_CMD_ADDR A:0xe637d80
y.create.l HWIO_PMIC_ARB_OBS3_CHNL252_CMD_ADDR A:0xe637e00
y.create.l HWIO_PMIC_ARB_OBS3_CHNL253_CMD_ADDR A:0xe637e80
y.create.l HWIO_PMIC_ARB_OBS3_CHNL254_CMD_ADDR A:0xe637f00
y.create.l HWIO_PMIC_ARB_OBS3_CHNL255_CMD_ADDR A:0xe637f80
y.create.l HWIO_PMIC_ARB_OBS4_CHNL0_CMD_ADDR A:0xe640000
y.create.l HWIO_PMIC_ARB_OBS4_CHNL1_CMD_ADDR A:0xe640080
y.create.l HWIO_PMIC_ARB_OBS4_CHNL2_CMD_ADDR A:0xe640100
y.create.l HWIO_PMIC_ARB_OBS4_CHNL3_CMD_ADDR A:0xe640180
y.create.l HWIO_PMIC_ARB_OBS4_CHNL4_CMD_ADDR A:0xe640200
y.create.l HWIO_PMIC_ARB_OBS4_CHNL5_CMD_ADDR A:0xe640280
y.create.l HWIO_PMIC_ARB_OBS4_CHNL6_CMD_ADDR A:0xe640300
y.create.l HWIO_PMIC_ARB_OBS4_CHNL7_CMD_ADDR A:0xe640380
y.create.l HWIO_PMIC_ARB_OBS4_CHNL8_CMD_ADDR A:0xe640400
y.create.l HWIO_PMIC_ARB_OBS4_CHNL9_CMD_ADDR A:0xe640480
y.create.l HWIO_PMIC_ARB_OBS4_CHNL10_CMD_ADDR A:0xe640500
y.create.l HWIO_PMIC_ARB_OBS4_CHNL11_CMD_ADDR A:0xe640580
y.create.l HWIO_PMIC_ARB_OBS4_CHNL12_CMD_ADDR A:0xe640600
y.create.l HWIO_PMIC_ARB_OBS4_CHNL13_CMD_ADDR A:0xe640680
y.create.l HWIO_PMIC_ARB_OBS4_CHNL14_CMD_ADDR A:0xe640700
y.create.l HWIO_PMIC_ARB_OBS4_CHNL15_CMD_ADDR A:0xe640780
y.create.l HWIO_PMIC_ARB_OBS4_CHNL16_CMD_ADDR A:0xe640800
y.create.l HWIO_PMIC_ARB_OBS4_CHNL17_CMD_ADDR A:0xe640880
y.create.l HWIO_PMIC_ARB_OBS4_CHNL18_CMD_ADDR A:0xe640900
y.create.l HWIO_PMIC_ARB_OBS4_CHNL19_CMD_ADDR A:0xe640980
y.create.l HWIO_PMIC_ARB_OBS4_CHNL20_CMD_ADDR A:0xe640a00
y.create.l HWIO_PMIC_ARB_OBS4_CHNL21_CMD_ADDR A:0xe640a80
y.create.l HWIO_PMIC_ARB_OBS4_CHNL22_CMD_ADDR A:0xe640b00
y.create.l HWIO_PMIC_ARB_OBS4_CHNL23_CMD_ADDR A:0xe640b80
y.create.l HWIO_PMIC_ARB_OBS4_CHNL24_CMD_ADDR A:0xe640c00
y.create.l HWIO_PMIC_ARB_OBS4_CHNL25_CMD_ADDR A:0xe640c80
y.create.l HWIO_PMIC_ARB_OBS4_CHNL26_CMD_ADDR A:0xe640d00
y.create.l HWIO_PMIC_ARB_OBS4_CHNL27_CMD_ADDR A:0xe640d80
y.create.l HWIO_PMIC_ARB_OBS4_CHNL28_CMD_ADDR A:0xe640e00
y.create.l HWIO_PMIC_ARB_OBS4_CHNL29_CMD_ADDR A:0xe640e80
y.create.l HWIO_PMIC_ARB_OBS4_CHNL30_CMD_ADDR A:0xe640f00
y.create.l HWIO_PMIC_ARB_OBS4_CHNL31_CMD_ADDR A:0xe640f80
y.create.l HWIO_PMIC_ARB_OBS4_CHNL32_CMD_ADDR A:0xe641000
y.create.l HWIO_PMIC_ARB_OBS4_CHNL33_CMD_ADDR A:0xe641080
y.create.l HWIO_PMIC_ARB_OBS4_CHNL34_CMD_ADDR A:0xe641100
y.create.l HWIO_PMIC_ARB_OBS4_CHNL35_CMD_ADDR A:0xe641180
y.create.l HWIO_PMIC_ARB_OBS4_CHNL36_CMD_ADDR A:0xe641200
y.create.l HWIO_PMIC_ARB_OBS4_CHNL37_CMD_ADDR A:0xe641280
y.create.l HWIO_PMIC_ARB_OBS4_CHNL38_CMD_ADDR A:0xe641300
y.create.l HWIO_PMIC_ARB_OBS4_CHNL39_CMD_ADDR A:0xe641380
y.create.l HWIO_PMIC_ARB_OBS4_CHNL40_CMD_ADDR A:0xe641400
y.create.l HWIO_PMIC_ARB_OBS4_CHNL41_CMD_ADDR A:0xe641480
y.create.l HWIO_PMIC_ARB_OBS4_CHNL42_CMD_ADDR A:0xe641500
y.create.l HWIO_PMIC_ARB_OBS4_CHNL43_CMD_ADDR A:0xe641580
y.create.l HWIO_PMIC_ARB_OBS4_CHNL44_CMD_ADDR A:0xe641600
y.create.l HWIO_PMIC_ARB_OBS4_CHNL45_CMD_ADDR A:0xe641680
y.create.l HWIO_PMIC_ARB_OBS4_CHNL46_CMD_ADDR A:0xe641700
y.create.l HWIO_PMIC_ARB_OBS4_CHNL47_CMD_ADDR A:0xe641780
y.create.l HWIO_PMIC_ARB_OBS4_CHNL48_CMD_ADDR A:0xe641800
y.create.l HWIO_PMIC_ARB_OBS4_CHNL49_CMD_ADDR A:0xe641880
y.create.l HWIO_PMIC_ARB_OBS4_CHNL50_CMD_ADDR A:0xe641900
y.create.l HWIO_PMIC_ARB_OBS4_CHNL51_CMD_ADDR A:0xe641980
y.create.l HWIO_PMIC_ARB_OBS4_CHNL52_CMD_ADDR A:0xe641a00
y.create.l HWIO_PMIC_ARB_OBS4_CHNL53_CMD_ADDR A:0xe641a80
y.create.l HWIO_PMIC_ARB_OBS4_CHNL54_CMD_ADDR A:0xe641b00
y.create.l HWIO_PMIC_ARB_OBS4_CHNL55_CMD_ADDR A:0xe641b80
y.create.l HWIO_PMIC_ARB_OBS4_CHNL56_CMD_ADDR A:0xe641c00
y.create.l HWIO_PMIC_ARB_OBS4_CHNL57_CMD_ADDR A:0xe641c80
y.create.l HWIO_PMIC_ARB_OBS4_CHNL58_CMD_ADDR A:0xe641d00
y.create.l HWIO_PMIC_ARB_OBS4_CHNL59_CMD_ADDR A:0xe641d80
y.create.l HWIO_PMIC_ARB_OBS4_CHNL60_CMD_ADDR A:0xe641e00
y.create.l HWIO_PMIC_ARB_OBS4_CHNL61_CMD_ADDR A:0xe641e80
y.create.l HWIO_PMIC_ARB_OBS4_CHNL62_CMD_ADDR A:0xe641f00
y.create.l HWIO_PMIC_ARB_OBS4_CHNL63_CMD_ADDR A:0xe641f80
y.create.l HWIO_PMIC_ARB_OBS4_CHNL64_CMD_ADDR A:0xe642000
y.create.l HWIO_PMIC_ARB_OBS4_CHNL65_CMD_ADDR A:0xe642080
y.create.l HWIO_PMIC_ARB_OBS4_CHNL66_CMD_ADDR A:0xe642100
y.create.l HWIO_PMIC_ARB_OBS4_CHNL67_CMD_ADDR A:0xe642180
y.create.l HWIO_PMIC_ARB_OBS4_CHNL68_CMD_ADDR A:0xe642200
y.create.l HWIO_PMIC_ARB_OBS4_CHNL69_CMD_ADDR A:0xe642280
y.create.l HWIO_PMIC_ARB_OBS4_CHNL70_CMD_ADDR A:0xe642300
y.create.l HWIO_PMIC_ARB_OBS4_CHNL71_CMD_ADDR A:0xe642380
y.create.l HWIO_PMIC_ARB_OBS4_CHNL72_CMD_ADDR A:0xe642400
y.create.l HWIO_PMIC_ARB_OBS4_CHNL73_CMD_ADDR A:0xe642480
y.create.l HWIO_PMIC_ARB_OBS4_CHNL74_CMD_ADDR A:0xe642500
y.create.l HWIO_PMIC_ARB_OBS4_CHNL75_CMD_ADDR A:0xe642580
y.create.l HWIO_PMIC_ARB_OBS4_CHNL76_CMD_ADDR A:0xe642600
y.create.l HWIO_PMIC_ARB_OBS4_CHNL77_CMD_ADDR A:0xe642680
y.create.l HWIO_PMIC_ARB_OBS4_CHNL78_CMD_ADDR A:0xe642700
y.create.l HWIO_PMIC_ARB_OBS4_CHNL79_CMD_ADDR A:0xe642780
y.create.l HWIO_PMIC_ARB_OBS4_CHNL80_CMD_ADDR A:0xe642800
y.create.l HWIO_PMIC_ARB_OBS4_CHNL81_CMD_ADDR A:0xe642880
y.create.l HWIO_PMIC_ARB_OBS4_CHNL82_CMD_ADDR A:0xe642900
y.create.l HWIO_PMIC_ARB_OBS4_CHNL83_CMD_ADDR A:0xe642980
y.create.l HWIO_PMIC_ARB_OBS4_CHNL84_CMD_ADDR A:0xe642a00
y.create.l HWIO_PMIC_ARB_OBS4_CHNL85_CMD_ADDR A:0xe642a80
y.create.l HWIO_PMIC_ARB_OBS4_CHNL86_CMD_ADDR A:0xe642b00
y.create.l HWIO_PMIC_ARB_OBS4_CHNL87_CMD_ADDR A:0xe642b80
y.create.l HWIO_PMIC_ARB_OBS4_CHNL88_CMD_ADDR A:0xe642c00
y.create.l HWIO_PMIC_ARB_OBS4_CHNL89_CMD_ADDR A:0xe642c80
y.create.l HWIO_PMIC_ARB_OBS4_CHNL90_CMD_ADDR A:0xe642d00
y.create.l HWIO_PMIC_ARB_OBS4_CHNL91_CMD_ADDR A:0xe642d80
y.create.l HWIO_PMIC_ARB_OBS4_CHNL92_CMD_ADDR A:0xe642e00
y.create.l HWIO_PMIC_ARB_OBS4_CHNL93_CMD_ADDR A:0xe642e80
y.create.l HWIO_PMIC_ARB_OBS4_CHNL94_CMD_ADDR A:0xe642f00
y.create.l HWIO_PMIC_ARB_OBS4_CHNL95_CMD_ADDR A:0xe642f80
y.create.l HWIO_PMIC_ARB_OBS4_CHNL96_CMD_ADDR A:0xe643000
y.create.l HWIO_PMIC_ARB_OBS4_CHNL97_CMD_ADDR A:0xe643080
y.create.l HWIO_PMIC_ARB_OBS4_CHNL98_CMD_ADDR A:0xe643100
y.create.l HWIO_PMIC_ARB_OBS4_CHNL99_CMD_ADDR A:0xe643180
y.create.l HWIO_PMIC_ARB_OBS4_CHNL100_CMD_ADDR A:0xe643200
y.create.l HWIO_PMIC_ARB_OBS4_CHNL101_CMD_ADDR A:0xe643280
y.create.l HWIO_PMIC_ARB_OBS4_CHNL102_CMD_ADDR A:0xe643300
y.create.l HWIO_PMIC_ARB_OBS4_CHNL103_CMD_ADDR A:0xe643380
y.create.l HWIO_PMIC_ARB_OBS4_CHNL104_CMD_ADDR A:0xe643400
y.create.l HWIO_PMIC_ARB_OBS4_CHNL105_CMD_ADDR A:0xe643480
y.create.l HWIO_PMIC_ARB_OBS4_CHNL106_CMD_ADDR A:0xe643500
y.create.l HWIO_PMIC_ARB_OBS4_CHNL107_CMD_ADDR A:0xe643580
y.create.l HWIO_PMIC_ARB_OBS4_CHNL108_CMD_ADDR A:0xe643600
y.create.l HWIO_PMIC_ARB_OBS4_CHNL109_CMD_ADDR A:0xe643680
y.create.l HWIO_PMIC_ARB_OBS4_CHNL110_CMD_ADDR A:0xe643700
y.create.l HWIO_PMIC_ARB_OBS4_CHNL111_CMD_ADDR A:0xe643780
y.create.l HWIO_PMIC_ARB_OBS4_CHNL112_CMD_ADDR A:0xe643800
y.create.l HWIO_PMIC_ARB_OBS4_CHNL113_CMD_ADDR A:0xe643880
y.create.l HWIO_PMIC_ARB_OBS4_CHNL114_CMD_ADDR A:0xe643900
y.create.l HWIO_PMIC_ARB_OBS4_CHNL115_CMD_ADDR A:0xe643980
y.create.l HWIO_PMIC_ARB_OBS4_CHNL116_CMD_ADDR A:0xe643a00
y.create.l HWIO_PMIC_ARB_OBS4_CHNL117_CMD_ADDR A:0xe643a80
y.create.l HWIO_PMIC_ARB_OBS4_CHNL118_CMD_ADDR A:0xe643b00
y.create.l HWIO_PMIC_ARB_OBS4_CHNL119_CMD_ADDR A:0xe643b80
y.create.l HWIO_PMIC_ARB_OBS4_CHNL120_CMD_ADDR A:0xe643c00
y.create.l HWIO_PMIC_ARB_OBS4_CHNL121_CMD_ADDR A:0xe643c80
y.create.l HWIO_PMIC_ARB_OBS4_CHNL122_CMD_ADDR A:0xe643d00
y.create.l HWIO_PMIC_ARB_OBS4_CHNL123_CMD_ADDR A:0xe643d80
y.create.l HWIO_PMIC_ARB_OBS4_CHNL124_CMD_ADDR A:0xe643e00
y.create.l HWIO_PMIC_ARB_OBS4_CHNL125_CMD_ADDR A:0xe643e80
y.create.l HWIO_PMIC_ARB_OBS4_CHNL126_CMD_ADDR A:0xe643f00
y.create.l HWIO_PMIC_ARB_OBS4_CHNL127_CMD_ADDR A:0xe643f80
y.create.l HWIO_PMIC_ARB_OBS4_CHNL128_CMD_ADDR A:0xe644000
y.create.l HWIO_PMIC_ARB_OBS4_CHNL129_CMD_ADDR A:0xe644080
y.create.l HWIO_PMIC_ARB_OBS4_CHNL130_CMD_ADDR A:0xe644100
y.create.l HWIO_PMIC_ARB_OBS4_CHNL131_CMD_ADDR A:0xe644180
y.create.l HWIO_PMIC_ARB_OBS4_CHNL132_CMD_ADDR A:0xe644200
y.create.l HWIO_PMIC_ARB_OBS4_CHNL133_CMD_ADDR A:0xe644280
y.create.l HWIO_PMIC_ARB_OBS4_CHNL134_CMD_ADDR A:0xe644300
y.create.l HWIO_PMIC_ARB_OBS4_CHNL135_CMD_ADDR A:0xe644380
y.create.l HWIO_PMIC_ARB_OBS4_CHNL136_CMD_ADDR A:0xe644400
y.create.l HWIO_PMIC_ARB_OBS4_CHNL137_CMD_ADDR A:0xe644480
y.create.l HWIO_PMIC_ARB_OBS4_CHNL138_CMD_ADDR A:0xe644500
y.create.l HWIO_PMIC_ARB_OBS4_CHNL139_CMD_ADDR A:0xe644580
y.create.l HWIO_PMIC_ARB_OBS4_CHNL140_CMD_ADDR A:0xe644600
y.create.l HWIO_PMIC_ARB_OBS4_CHNL141_CMD_ADDR A:0xe644680
y.create.l HWIO_PMIC_ARB_OBS4_CHNL142_CMD_ADDR A:0xe644700
y.create.l HWIO_PMIC_ARB_OBS4_CHNL143_CMD_ADDR A:0xe644780
y.create.l HWIO_PMIC_ARB_OBS4_CHNL144_CMD_ADDR A:0xe644800
y.create.l HWIO_PMIC_ARB_OBS4_CHNL145_CMD_ADDR A:0xe644880
y.create.l HWIO_PMIC_ARB_OBS4_CHNL146_CMD_ADDR A:0xe644900
y.create.l HWIO_PMIC_ARB_OBS4_CHNL147_CMD_ADDR A:0xe644980
y.create.l HWIO_PMIC_ARB_OBS4_CHNL148_CMD_ADDR A:0xe644a00
y.create.l HWIO_PMIC_ARB_OBS4_CHNL149_CMD_ADDR A:0xe644a80
y.create.l HWIO_PMIC_ARB_OBS4_CHNL150_CMD_ADDR A:0xe644b00
y.create.l HWIO_PMIC_ARB_OBS4_CHNL151_CMD_ADDR A:0xe644b80
y.create.l HWIO_PMIC_ARB_OBS4_CHNL152_CMD_ADDR A:0xe644c00
y.create.l HWIO_PMIC_ARB_OBS4_CHNL153_CMD_ADDR A:0xe644c80
y.create.l HWIO_PMIC_ARB_OBS4_CHNL154_CMD_ADDR A:0xe644d00
y.create.l HWIO_PMIC_ARB_OBS4_CHNL155_CMD_ADDR A:0xe644d80
y.create.l HWIO_PMIC_ARB_OBS4_CHNL156_CMD_ADDR A:0xe644e00
y.create.l HWIO_PMIC_ARB_OBS4_CHNL157_CMD_ADDR A:0xe644e80
y.create.l HWIO_PMIC_ARB_OBS4_CHNL158_CMD_ADDR A:0xe644f00
y.create.l HWIO_PMIC_ARB_OBS4_CHNL159_CMD_ADDR A:0xe644f80
y.create.l HWIO_PMIC_ARB_OBS4_CHNL160_CMD_ADDR A:0xe645000
y.create.l HWIO_PMIC_ARB_OBS4_CHNL161_CMD_ADDR A:0xe645080
y.create.l HWIO_PMIC_ARB_OBS4_CHNL162_CMD_ADDR A:0xe645100
y.create.l HWIO_PMIC_ARB_OBS4_CHNL163_CMD_ADDR A:0xe645180
y.create.l HWIO_PMIC_ARB_OBS4_CHNL164_CMD_ADDR A:0xe645200
y.create.l HWIO_PMIC_ARB_OBS4_CHNL165_CMD_ADDR A:0xe645280
y.create.l HWIO_PMIC_ARB_OBS4_CHNL166_CMD_ADDR A:0xe645300
y.create.l HWIO_PMIC_ARB_OBS4_CHNL167_CMD_ADDR A:0xe645380
y.create.l HWIO_PMIC_ARB_OBS4_CHNL168_CMD_ADDR A:0xe645400
y.create.l HWIO_PMIC_ARB_OBS4_CHNL169_CMD_ADDR A:0xe645480
y.create.l HWIO_PMIC_ARB_OBS4_CHNL170_CMD_ADDR A:0xe645500
y.create.l HWIO_PMIC_ARB_OBS4_CHNL171_CMD_ADDR A:0xe645580
y.create.l HWIO_PMIC_ARB_OBS4_CHNL172_CMD_ADDR A:0xe645600
y.create.l HWIO_PMIC_ARB_OBS4_CHNL173_CMD_ADDR A:0xe645680
y.create.l HWIO_PMIC_ARB_OBS4_CHNL174_CMD_ADDR A:0xe645700
y.create.l HWIO_PMIC_ARB_OBS4_CHNL175_CMD_ADDR A:0xe645780
y.create.l HWIO_PMIC_ARB_OBS4_CHNL176_CMD_ADDR A:0xe645800
y.create.l HWIO_PMIC_ARB_OBS4_CHNL177_CMD_ADDR A:0xe645880
y.create.l HWIO_PMIC_ARB_OBS4_CHNL178_CMD_ADDR A:0xe645900
y.create.l HWIO_PMIC_ARB_OBS4_CHNL179_CMD_ADDR A:0xe645980
y.create.l HWIO_PMIC_ARB_OBS4_CHNL180_CMD_ADDR A:0xe645a00
y.create.l HWIO_PMIC_ARB_OBS4_CHNL181_CMD_ADDR A:0xe645a80
y.create.l HWIO_PMIC_ARB_OBS4_CHNL182_CMD_ADDR A:0xe645b00
y.create.l HWIO_PMIC_ARB_OBS4_CHNL183_CMD_ADDR A:0xe645b80
y.create.l HWIO_PMIC_ARB_OBS4_CHNL184_CMD_ADDR A:0xe645c00
y.create.l HWIO_PMIC_ARB_OBS4_CHNL185_CMD_ADDR A:0xe645c80
y.create.l HWIO_PMIC_ARB_OBS4_CHNL186_CMD_ADDR A:0xe645d00
y.create.l HWIO_PMIC_ARB_OBS4_CHNL187_CMD_ADDR A:0xe645d80
y.create.l HWIO_PMIC_ARB_OBS4_CHNL188_CMD_ADDR A:0xe645e00
y.create.l HWIO_PMIC_ARB_OBS4_CHNL189_CMD_ADDR A:0xe645e80
y.create.l HWIO_PMIC_ARB_OBS4_CHNL190_CMD_ADDR A:0xe645f00
y.create.l HWIO_PMIC_ARB_OBS4_CHNL191_CMD_ADDR A:0xe645f80
y.create.l HWIO_PMIC_ARB_OBS4_CHNL192_CMD_ADDR A:0xe646000
y.create.l HWIO_PMIC_ARB_OBS4_CHNL193_CMD_ADDR A:0xe646080
y.create.l HWIO_PMIC_ARB_OBS4_CHNL194_CMD_ADDR A:0xe646100
y.create.l HWIO_PMIC_ARB_OBS4_CHNL195_CMD_ADDR A:0xe646180
y.create.l HWIO_PMIC_ARB_OBS4_CHNL196_CMD_ADDR A:0xe646200
y.create.l HWIO_PMIC_ARB_OBS4_CHNL197_CMD_ADDR A:0xe646280
y.create.l HWIO_PMIC_ARB_OBS4_CHNL198_CMD_ADDR A:0xe646300
y.create.l HWIO_PMIC_ARB_OBS4_CHNL199_CMD_ADDR A:0xe646380
y.create.l HWIO_PMIC_ARB_OBS4_CHNL200_CMD_ADDR A:0xe646400
y.create.l HWIO_PMIC_ARB_OBS4_CHNL201_CMD_ADDR A:0xe646480
y.create.l HWIO_PMIC_ARB_OBS4_CHNL202_CMD_ADDR A:0xe646500
y.create.l HWIO_PMIC_ARB_OBS4_CHNL203_CMD_ADDR A:0xe646580
y.create.l HWIO_PMIC_ARB_OBS4_CHNL204_CMD_ADDR A:0xe646600
y.create.l HWIO_PMIC_ARB_OBS4_CHNL205_CMD_ADDR A:0xe646680
y.create.l HWIO_PMIC_ARB_OBS4_CHNL206_CMD_ADDR A:0xe646700
y.create.l HWIO_PMIC_ARB_OBS4_CHNL207_CMD_ADDR A:0xe646780
y.create.l HWIO_PMIC_ARB_OBS4_CHNL208_CMD_ADDR A:0xe646800
y.create.l HWIO_PMIC_ARB_OBS4_CHNL209_CMD_ADDR A:0xe646880
y.create.l HWIO_PMIC_ARB_OBS4_CHNL210_CMD_ADDR A:0xe646900
y.create.l HWIO_PMIC_ARB_OBS4_CHNL211_CMD_ADDR A:0xe646980
y.create.l HWIO_PMIC_ARB_OBS4_CHNL212_CMD_ADDR A:0xe646a00
y.create.l HWIO_PMIC_ARB_OBS4_CHNL213_CMD_ADDR A:0xe646a80
y.create.l HWIO_PMIC_ARB_OBS4_CHNL214_CMD_ADDR A:0xe646b00
y.create.l HWIO_PMIC_ARB_OBS4_CHNL215_CMD_ADDR A:0xe646b80
y.create.l HWIO_PMIC_ARB_OBS4_CHNL216_CMD_ADDR A:0xe646c00
y.create.l HWIO_PMIC_ARB_OBS4_CHNL217_CMD_ADDR A:0xe646c80
y.create.l HWIO_PMIC_ARB_OBS4_CHNL218_CMD_ADDR A:0xe646d00
y.create.l HWIO_PMIC_ARB_OBS4_CHNL219_CMD_ADDR A:0xe646d80
y.create.l HWIO_PMIC_ARB_OBS4_CHNL220_CMD_ADDR A:0xe646e00
y.create.l HWIO_PMIC_ARB_OBS4_CHNL221_CMD_ADDR A:0xe646e80
y.create.l HWIO_PMIC_ARB_OBS4_CHNL222_CMD_ADDR A:0xe646f00
y.create.l HWIO_PMIC_ARB_OBS4_CHNL223_CMD_ADDR A:0xe646f80
y.create.l HWIO_PMIC_ARB_OBS4_CHNL224_CMD_ADDR A:0xe647000
y.create.l HWIO_PMIC_ARB_OBS4_CHNL225_CMD_ADDR A:0xe647080
y.create.l HWIO_PMIC_ARB_OBS4_CHNL226_CMD_ADDR A:0xe647100
y.create.l HWIO_PMIC_ARB_OBS4_CHNL227_CMD_ADDR A:0xe647180
y.create.l HWIO_PMIC_ARB_OBS4_CHNL228_CMD_ADDR A:0xe647200
y.create.l HWIO_PMIC_ARB_OBS4_CHNL229_CMD_ADDR A:0xe647280
y.create.l HWIO_PMIC_ARB_OBS4_CHNL230_CMD_ADDR A:0xe647300
y.create.l HWIO_PMIC_ARB_OBS4_CHNL231_CMD_ADDR A:0xe647380
y.create.l HWIO_PMIC_ARB_OBS4_CHNL232_CMD_ADDR A:0xe647400
y.create.l HWIO_PMIC_ARB_OBS4_CHNL233_CMD_ADDR A:0xe647480
y.create.l HWIO_PMIC_ARB_OBS4_CHNL234_CMD_ADDR A:0xe647500
y.create.l HWIO_PMIC_ARB_OBS4_CHNL235_CMD_ADDR A:0xe647580
y.create.l HWIO_PMIC_ARB_OBS4_CHNL236_CMD_ADDR A:0xe647600
y.create.l HWIO_PMIC_ARB_OBS4_CHNL237_CMD_ADDR A:0xe647680
y.create.l HWIO_PMIC_ARB_OBS4_CHNL238_CMD_ADDR A:0xe647700
y.create.l HWIO_PMIC_ARB_OBS4_CHNL239_CMD_ADDR A:0xe647780
y.create.l HWIO_PMIC_ARB_OBS4_CHNL240_CMD_ADDR A:0xe647800
y.create.l HWIO_PMIC_ARB_OBS4_CHNL241_CMD_ADDR A:0xe647880
y.create.l HWIO_PMIC_ARB_OBS4_CHNL242_CMD_ADDR A:0xe647900
y.create.l HWIO_PMIC_ARB_OBS4_CHNL243_CMD_ADDR A:0xe647980
y.create.l HWIO_PMIC_ARB_OBS4_CHNL244_CMD_ADDR A:0xe647a00
y.create.l HWIO_PMIC_ARB_OBS4_CHNL245_CMD_ADDR A:0xe647a80
y.create.l HWIO_PMIC_ARB_OBS4_CHNL246_CMD_ADDR A:0xe647b00
y.create.l HWIO_PMIC_ARB_OBS4_CHNL247_CMD_ADDR A:0xe647b80
y.create.l HWIO_PMIC_ARB_OBS4_CHNL248_CMD_ADDR A:0xe647c00
y.create.l HWIO_PMIC_ARB_OBS4_CHNL249_CMD_ADDR A:0xe647c80
y.create.l HWIO_PMIC_ARB_OBS4_CHNL250_CMD_ADDR A:0xe647d00
y.create.l HWIO_PMIC_ARB_OBS4_CHNL251_CMD_ADDR A:0xe647d80
y.create.l HWIO_PMIC_ARB_OBS4_CHNL252_CMD_ADDR A:0xe647e00
y.create.l HWIO_PMIC_ARB_OBS4_CHNL253_CMD_ADDR A:0xe647e80
y.create.l HWIO_PMIC_ARB_OBS4_CHNL254_CMD_ADDR A:0xe647f00
y.create.l HWIO_PMIC_ARB_OBS4_CHNL255_CMD_ADDR A:0xe647f80
y.create.l HWIO_PMIC_ARB_OBS0_CHNL0_CONFIG_ADDR A:0xe600004
y.create.l HWIO_PMIC_ARB_OBS0_CHNL1_CONFIG_ADDR A:0xe600084
y.create.l HWIO_PMIC_ARB_OBS0_CHNL2_CONFIG_ADDR A:0xe600104
y.create.l HWIO_PMIC_ARB_OBS0_CHNL3_CONFIG_ADDR A:0xe600184
y.create.l HWIO_PMIC_ARB_OBS0_CHNL4_CONFIG_ADDR A:0xe600204
y.create.l HWIO_PMIC_ARB_OBS0_CHNL5_CONFIG_ADDR A:0xe600284
y.create.l HWIO_PMIC_ARB_OBS0_CHNL6_CONFIG_ADDR A:0xe600304
y.create.l HWIO_PMIC_ARB_OBS0_CHNL7_CONFIG_ADDR A:0xe600384
y.create.l HWIO_PMIC_ARB_OBS0_CHNL8_CONFIG_ADDR A:0xe600404
y.create.l HWIO_PMIC_ARB_OBS0_CHNL9_CONFIG_ADDR A:0xe600484
y.create.l HWIO_PMIC_ARB_OBS0_CHNL10_CONFIG_ADDR A:0xe600504
y.create.l HWIO_PMIC_ARB_OBS0_CHNL11_CONFIG_ADDR A:0xe600584
y.create.l HWIO_PMIC_ARB_OBS0_CHNL12_CONFIG_ADDR A:0xe600604
y.create.l HWIO_PMIC_ARB_OBS0_CHNL13_CONFIG_ADDR A:0xe600684
y.create.l HWIO_PMIC_ARB_OBS0_CHNL14_CONFIG_ADDR A:0xe600704
y.create.l HWIO_PMIC_ARB_OBS0_CHNL15_CONFIG_ADDR A:0xe600784
y.create.l HWIO_PMIC_ARB_OBS0_CHNL16_CONFIG_ADDR A:0xe600804
y.create.l HWIO_PMIC_ARB_OBS0_CHNL17_CONFIG_ADDR A:0xe600884
y.create.l HWIO_PMIC_ARB_OBS0_CHNL18_CONFIG_ADDR A:0xe600904
y.create.l HWIO_PMIC_ARB_OBS0_CHNL19_CONFIG_ADDR A:0xe600984
y.create.l HWIO_PMIC_ARB_OBS0_CHNL20_CONFIG_ADDR A:0xe600a04
y.create.l HWIO_PMIC_ARB_OBS0_CHNL21_CONFIG_ADDR A:0xe600a84
y.create.l HWIO_PMIC_ARB_OBS0_CHNL22_CONFIG_ADDR A:0xe600b04
y.create.l HWIO_PMIC_ARB_OBS0_CHNL23_CONFIG_ADDR A:0xe600b84
y.create.l HWIO_PMIC_ARB_OBS0_CHNL24_CONFIG_ADDR A:0xe600c04
y.create.l HWIO_PMIC_ARB_OBS0_CHNL25_CONFIG_ADDR A:0xe600c84
y.create.l HWIO_PMIC_ARB_OBS0_CHNL26_CONFIG_ADDR A:0xe600d04
y.create.l HWIO_PMIC_ARB_OBS0_CHNL27_CONFIG_ADDR A:0xe600d84
y.create.l HWIO_PMIC_ARB_OBS0_CHNL28_CONFIG_ADDR A:0xe600e04
y.create.l HWIO_PMIC_ARB_OBS0_CHNL29_CONFIG_ADDR A:0xe600e84
y.create.l HWIO_PMIC_ARB_OBS0_CHNL30_CONFIG_ADDR A:0xe600f04
y.create.l HWIO_PMIC_ARB_OBS0_CHNL31_CONFIG_ADDR A:0xe600f84
y.create.l HWIO_PMIC_ARB_OBS0_CHNL32_CONFIG_ADDR A:0xe601004
y.create.l HWIO_PMIC_ARB_OBS0_CHNL33_CONFIG_ADDR A:0xe601084
y.create.l HWIO_PMIC_ARB_OBS0_CHNL34_CONFIG_ADDR A:0xe601104
y.create.l HWIO_PMIC_ARB_OBS0_CHNL35_CONFIG_ADDR A:0xe601184
y.create.l HWIO_PMIC_ARB_OBS0_CHNL36_CONFIG_ADDR A:0xe601204
y.create.l HWIO_PMIC_ARB_OBS0_CHNL37_CONFIG_ADDR A:0xe601284
y.create.l HWIO_PMIC_ARB_OBS0_CHNL38_CONFIG_ADDR A:0xe601304
y.create.l HWIO_PMIC_ARB_OBS0_CHNL39_CONFIG_ADDR A:0xe601384
y.create.l HWIO_PMIC_ARB_OBS0_CHNL40_CONFIG_ADDR A:0xe601404
y.create.l HWIO_PMIC_ARB_OBS0_CHNL41_CONFIG_ADDR A:0xe601484
y.create.l HWIO_PMIC_ARB_OBS0_CHNL42_CONFIG_ADDR A:0xe601504
y.create.l HWIO_PMIC_ARB_OBS0_CHNL43_CONFIG_ADDR A:0xe601584
y.create.l HWIO_PMIC_ARB_OBS0_CHNL44_CONFIG_ADDR A:0xe601604
y.create.l HWIO_PMIC_ARB_OBS0_CHNL45_CONFIG_ADDR A:0xe601684
y.create.l HWIO_PMIC_ARB_OBS0_CHNL46_CONFIG_ADDR A:0xe601704
y.create.l HWIO_PMIC_ARB_OBS0_CHNL47_CONFIG_ADDR A:0xe601784
y.create.l HWIO_PMIC_ARB_OBS0_CHNL48_CONFIG_ADDR A:0xe601804
y.create.l HWIO_PMIC_ARB_OBS0_CHNL49_CONFIG_ADDR A:0xe601884
y.create.l HWIO_PMIC_ARB_OBS0_CHNL50_CONFIG_ADDR A:0xe601904
y.create.l HWIO_PMIC_ARB_OBS0_CHNL51_CONFIG_ADDR A:0xe601984
y.create.l HWIO_PMIC_ARB_OBS0_CHNL52_CONFIG_ADDR A:0xe601a04
y.create.l HWIO_PMIC_ARB_OBS0_CHNL53_CONFIG_ADDR A:0xe601a84
y.create.l HWIO_PMIC_ARB_OBS0_CHNL54_CONFIG_ADDR A:0xe601b04
y.create.l HWIO_PMIC_ARB_OBS0_CHNL55_CONFIG_ADDR A:0xe601b84
y.create.l HWIO_PMIC_ARB_OBS0_CHNL56_CONFIG_ADDR A:0xe601c04
y.create.l HWIO_PMIC_ARB_OBS0_CHNL57_CONFIG_ADDR A:0xe601c84
y.create.l HWIO_PMIC_ARB_OBS0_CHNL58_CONFIG_ADDR A:0xe601d04
y.create.l HWIO_PMIC_ARB_OBS0_CHNL59_CONFIG_ADDR A:0xe601d84
y.create.l HWIO_PMIC_ARB_OBS0_CHNL60_CONFIG_ADDR A:0xe601e04
y.create.l HWIO_PMIC_ARB_OBS0_CHNL61_CONFIG_ADDR A:0xe601e84
y.create.l HWIO_PMIC_ARB_OBS0_CHNL62_CONFIG_ADDR A:0xe601f04
y.create.l HWIO_PMIC_ARB_OBS0_CHNL63_CONFIG_ADDR A:0xe601f84
y.create.l HWIO_PMIC_ARB_OBS0_CHNL64_CONFIG_ADDR A:0xe602004
y.create.l HWIO_PMIC_ARB_OBS0_CHNL65_CONFIG_ADDR A:0xe602084
y.create.l HWIO_PMIC_ARB_OBS0_CHNL66_CONFIG_ADDR A:0xe602104
y.create.l HWIO_PMIC_ARB_OBS0_CHNL67_CONFIG_ADDR A:0xe602184
y.create.l HWIO_PMIC_ARB_OBS0_CHNL68_CONFIG_ADDR A:0xe602204
y.create.l HWIO_PMIC_ARB_OBS0_CHNL69_CONFIG_ADDR A:0xe602284
y.create.l HWIO_PMIC_ARB_OBS0_CHNL70_CONFIG_ADDR A:0xe602304
y.create.l HWIO_PMIC_ARB_OBS0_CHNL71_CONFIG_ADDR A:0xe602384
y.create.l HWIO_PMIC_ARB_OBS0_CHNL72_CONFIG_ADDR A:0xe602404
y.create.l HWIO_PMIC_ARB_OBS0_CHNL73_CONFIG_ADDR A:0xe602484
y.create.l HWIO_PMIC_ARB_OBS0_CHNL74_CONFIG_ADDR A:0xe602504
y.create.l HWIO_PMIC_ARB_OBS0_CHNL75_CONFIG_ADDR A:0xe602584
y.create.l HWIO_PMIC_ARB_OBS0_CHNL76_CONFIG_ADDR A:0xe602604
y.create.l HWIO_PMIC_ARB_OBS0_CHNL77_CONFIG_ADDR A:0xe602684
y.create.l HWIO_PMIC_ARB_OBS0_CHNL78_CONFIG_ADDR A:0xe602704
y.create.l HWIO_PMIC_ARB_OBS0_CHNL79_CONFIG_ADDR A:0xe602784
y.create.l HWIO_PMIC_ARB_OBS0_CHNL80_CONFIG_ADDR A:0xe602804
y.create.l HWIO_PMIC_ARB_OBS0_CHNL81_CONFIG_ADDR A:0xe602884
y.create.l HWIO_PMIC_ARB_OBS0_CHNL82_CONFIG_ADDR A:0xe602904
y.create.l HWIO_PMIC_ARB_OBS0_CHNL83_CONFIG_ADDR A:0xe602984
y.create.l HWIO_PMIC_ARB_OBS0_CHNL84_CONFIG_ADDR A:0xe602a04
y.create.l HWIO_PMIC_ARB_OBS0_CHNL85_CONFIG_ADDR A:0xe602a84
y.create.l HWIO_PMIC_ARB_OBS0_CHNL86_CONFIG_ADDR A:0xe602b04
y.create.l HWIO_PMIC_ARB_OBS0_CHNL87_CONFIG_ADDR A:0xe602b84
y.create.l HWIO_PMIC_ARB_OBS0_CHNL88_CONFIG_ADDR A:0xe602c04
y.create.l HWIO_PMIC_ARB_OBS0_CHNL89_CONFIG_ADDR A:0xe602c84
y.create.l HWIO_PMIC_ARB_OBS0_CHNL90_CONFIG_ADDR A:0xe602d04
y.create.l HWIO_PMIC_ARB_OBS0_CHNL91_CONFIG_ADDR A:0xe602d84
y.create.l HWIO_PMIC_ARB_OBS0_CHNL92_CONFIG_ADDR A:0xe602e04
y.create.l HWIO_PMIC_ARB_OBS0_CHNL93_CONFIG_ADDR A:0xe602e84
y.create.l HWIO_PMIC_ARB_OBS0_CHNL94_CONFIG_ADDR A:0xe602f04
y.create.l HWIO_PMIC_ARB_OBS0_CHNL95_CONFIG_ADDR A:0xe602f84
y.create.l HWIO_PMIC_ARB_OBS0_CHNL96_CONFIG_ADDR A:0xe603004
y.create.l HWIO_PMIC_ARB_OBS0_CHNL97_CONFIG_ADDR A:0xe603084
y.create.l HWIO_PMIC_ARB_OBS0_CHNL98_CONFIG_ADDR A:0xe603104
y.create.l HWIO_PMIC_ARB_OBS0_CHNL99_CONFIG_ADDR A:0xe603184
y.create.l HWIO_PMIC_ARB_OBS0_CHNL100_CONFIG_ADDR A:0xe603204
y.create.l HWIO_PMIC_ARB_OBS0_CHNL101_CONFIG_ADDR A:0xe603284
y.create.l HWIO_PMIC_ARB_OBS0_CHNL102_CONFIG_ADDR A:0xe603304
y.create.l HWIO_PMIC_ARB_OBS0_CHNL103_CONFIG_ADDR A:0xe603384
y.create.l HWIO_PMIC_ARB_OBS0_CHNL104_CONFIG_ADDR A:0xe603404
y.create.l HWIO_PMIC_ARB_OBS0_CHNL105_CONFIG_ADDR A:0xe603484
y.create.l HWIO_PMIC_ARB_OBS0_CHNL106_CONFIG_ADDR A:0xe603504
y.create.l HWIO_PMIC_ARB_OBS0_CHNL107_CONFIG_ADDR A:0xe603584
y.create.l HWIO_PMIC_ARB_OBS0_CHNL108_CONFIG_ADDR A:0xe603604
y.create.l HWIO_PMIC_ARB_OBS0_CHNL109_CONFIG_ADDR A:0xe603684
y.create.l HWIO_PMIC_ARB_OBS0_CHNL110_CONFIG_ADDR A:0xe603704
y.create.l HWIO_PMIC_ARB_OBS0_CHNL111_CONFIG_ADDR A:0xe603784
y.create.l HWIO_PMIC_ARB_OBS0_CHNL112_CONFIG_ADDR A:0xe603804
y.create.l HWIO_PMIC_ARB_OBS0_CHNL113_CONFIG_ADDR A:0xe603884
y.create.l HWIO_PMIC_ARB_OBS0_CHNL114_CONFIG_ADDR A:0xe603904
y.create.l HWIO_PMIC_ARB_OBS0_CHNL115_CONFIG_ADDR A:0xe603984
y.create.l HWIO_PMIC_ARB_OBS0_CHNL116_CONFIG_ADDR A:0xe603a04
y.create.l HWIO_PMIC_ARB_OBS0_CHNL117_CONFIG_ADDR A:0xe603a84
y.create.l HWIO_PMIC_ARB_OBS0_CHNL118_CONFIG_ADDR A:0xe603b04
y.create.l HWIO_PMIC_ARB_OBS0_CHNL119_CONFIG_ADDR A:0xe603b84
y.create.l HWIO_PMIC_ARB_OBS0_CHNL120_CONFIG_ADDR A:0xe603c04
y.create.l HWIO_PMIC_ARB_OBS0_CHNL121_CONFIG_ADDR A:0xe603c84
y.create.l HWIO_PMIC_ARB_OBS0_CHNL122_CONFIG_ADDR A:0xe603d04
y.create.l HWIO_PMIC_ARB_OBS0_CHNL123_CONFIG_ADDR A:0xe603d84
y.create.l HWIO_PMIC_ARB_OBS0_CHNL124_CONFIG_ADDR A:0xe603e04
y.create.l HWIO_PMIC_ARB_OBS0_CHNL125_CONFIG_ADDR A:0xe603e84
y.create.l HWIO_PMIC_ARB_OBS0_CHNL126_CONFIG_ADDR A:0xe603f04
y.create.l HWIO_PMIC_ARB_OBS0_CHNL127_CONFIG_ADDR A:0xe603f84
y.create.l HWIO_PMIC_ARB_OBS0_CHNL128_CONFIG_ADDR A:0xe604004
y.create.l HWIO_PMIC_ARB_OBS0_CHNL129_CONFIG_ADDR A:0xe604084
y.create.l HWIO_PMIC_ARB_OBS0_CHNL130_CONFIG_ADDR A:0xe604104
y.create.l HWIO_PMIC_ARB_OBS0_CHNL131_CONFIG_ADDR A:0xe604184
y.create.l HWIO_PMIC_ARB_OBS0_CHNL132_CONFIG_ADDR A:0xe604204
y.create.l HWIO_PMIC_ARB_OBS0_CHNL133_CONFIG_ADDR A:0xe604284
y.create.l HWIO_PMIC_ARB_OBS0_CHNL134_CONFIG_ADDR A:0xe604304
y.create.l HWIO_PMIC_ARB_OBS0_CHNL135_CONFIG_ADDR A:0xe604384
y.create.l HWIO_PMIC_ARB_OBS0_CHNL136_CONFIG_ADDR A:0xe604404
y.create.l HWIO_PMIC_ARB_OBS0_CHNL137_CONFIG_ADDR A:0xe604484
y.create.l HWIO_PMIC_ARB_OBS0_CHNL138_CONFIG_ADDR A:0xe604504
y.create.l HWIO_PMIC_ARB_OBS0_CHNL139_CONFIG_ADDR A:0xe604584
y.create.l HWIO_PMIC_ARB_OBS0_CHNL140_CONFIG_ADDR A:0xe604604
y.create.l HWIO_PMIC_ARB_OBS0_CHNL141_CONFIG_ADDR A:0xe604684
y.create.l HWIO_PMIC_ARB_OBS0_CHNL142_CONFIG_ADDR A:0xe604704
y.create.l HWIO_PMIC_ARB_OBS0_CHNL143_CONFIG_ADDR A:0xe604784
y.create.l HWIO_PMIC_ARB_OBS0_CHNL144_CONFIG_ADDR A:0xe604804
y.create.l HWIO_PMIC_ARB_OBS0_CHNL145_CONFIG_ADDR A:0xe604884
y.create.l HWIO_PMIC_ARB_OBS0_CHNL146_CONFIG_ADDR A:0xe604904
y.create.l HWIO_PMIC_ARB_OBS0_CHNL147_CONFIG_ADDR A:0xe604984
y.create.l HWIO_PMIC_ARB_OBS0_CHNL148_CONFIG_ADDR A:0xe604a04
y.create.l HWIO_PMIC_ARB_OBS0_CHNL149_CONFIG_ADDR A:0xe604a84
y.create.l HWIO_PMIC_ARB_OBS0_CHNL150_CONFIG_ADDR A:0xe604b04
y.create.l HWIO_PMIC_ARB_OBS0_CHNL151_CONFIG_ADDR A:0xe604b84
y.create.l HWIO_PMIC_ARB_OBS0_CHNL152_CONFIG_ADDR A:0xe604c04
y.create.l HWIO_PMIC_ARB_OBS0_CHNL153_CONFIG_ADDR A:0xe604c84
y.create.l HWIO_PMIC_ARB_OBS0_CHNL154_CONFIG_ADDR A:0xe604d04
y.create.l HWIO_PMIC_ARB_OBS0_CHNL155_CONFIG_ADDR A:0xe604d84
y.create.l HWIO_PMIC_ARB_OBS0_CHNL156_CONFIG_ADDR A:0xe604e04
y.create.l HWIO_PMIC_ARB_OBS0_CHNL157_CONFIG_ADDR A:0xe604e84
y.create.l HWIO_PMIC_ARB_OBS0_CHNL158_CONFIG_ADDR A:0xe604f04
y.create.l HWIO_PMIC_ARB_OBS0_CHNL159_CONFIG_ADDR A:0xe604f84
y.create.l HWIO_PMIC_ARB_OBS0_CHNL160_CONFIG_ADDR A:0xe605004
y.create.l HWIO_PMIC_ARB_OBS0_CHNL161_CONFIG_ADDR A:0xe605084
y.create.l HWIO_PMIC_ARB_OBS0_CHNL162_CONFIG_ADDR A:0xe605104
y.create.l HWIO_PMIC_ARB_OBS0_CHNL163_CONFIG_ADDR A:0xe605184
y.create.l HWIO_PMIC_ARB_OBS0_CHNL164_CONFIG_ADDR A:0xe605204
y.create.l HWIO_PMIC_ARB_OBS0_CHNL165_CONFIG_ADDR A:0xe605284
y.create.l HWIO_PMIC_ARB_OBS0_CHNL166_CONFIG_ADDR A:0xe605304
y.create.l HWIO_PMIC_ARB_OBS0_CHNL167_CONFIG_ADDR A:0xe605384
y.create.l HWIO_PMIC_ARB_OBS0_CHNL168_CONFIG_ADDR A:0xe605404
y.create.l HWIO_PMIC_ARB_OBS0_CHNL169_CONFIG_ADDR A:0xe605484
y.create.l HWIO_PMIC_ARB_OBS0_CHNL170_CONFIG_ADDR A:0xe605504
y.create.l HWIO_PMIC_ARB_OBS0_CHNL171_CONFIG_ADDR A:0xe605584
y.create.l HWIO_PMIC_ARB_OBS0_CHNL172_CONFIG_ADDR A:0xe605604
y.create.l HWIO_PMIC_ARB_OBS0_CHNL173_CONFIG_ADDR A:0xe605684
y.create.l HWIO_PMIC_ARB_OBS0_CHNL174_CONFIG_ADDR A:0xe605704
y.create.l HWIO_PMIC_ARB_OBS0_CHNL175_CONFIG_ADDR A:0xe605784
y.create.l HWIO_PMIC_ARB_OBS0_CHNL176_CONFIG_ADDR A:0xe605804
y.create.l HWIO_PMIC_ARB_OBS0_CHNL177_CONFIG_ADDR A:0xe605884
y.create.l HWIO_PMIC_ARB_OBS0_CHNL178_CONFIG_ADDR A:0xe605904
y.create.l HWIO_PMIC_ARB_OBS0_CHNL179_CONFIG_ADDR A:0xe605984
y.create.l HWIO_PMIC_ARB_OBS0_CHNL180_CONFIG_ADDR A:0xe605a04
y.create.l HWIO_PMIC_ARB_OBS0_CHNL181_CONFIG_ADDR A:0xe605a84
y.create.l HWIO_PMIC_ARB_OBS0_CHNL182_CONFIG_ADDR A:0xe605b04
y.create.l HWIO_PMIC_ARB_OBS0_CHNL183_CONFIG_ADDR A:0xe605b84
y.create.l HWIO_PMIC_ARB_OBS0_CHNL184_CONFIG_ADDR A:0xe605c04
y.create.l HWIO_PMIC_ARB_OBS0_CHNL185_CONFIG_ADDR A:0xe605c84
y.create.l HWIO_PMIC_ARB_OBS0_CHNL186_CONFIG_ADDR A:0xe605d04
y.create.l HWIO_PMIC_ARB_OBS0_CHNL187_CONFIG_ADDR A:0xe605d84
y.create.l HWIO_PMIC_ARB_OBS0_CHNL188_CONFIG_ADDR A:0xe605e04
y.create.l HWIO_PMIC_ARB_OBS0_CHNL189_CONFIG_ADDR A:0xe605e84
y.create.l HWIO_PMIC_ARB_OBS0_CHNL190_CONFIG_ADDR A:0xe605f04
y.create.l HWIO_PMIC_ARB_OBS0_CHNL191_CONFIG_ADDR A:0xe605f84
y.create.l HWIO_PMIC_ARB_OBS0_CHNL192_CONFIG_ADDR A:0xe606004
y.create.l HWIO_PMIC_ARB_OBS0_CHNL193_CONFIG_ADDR A:0xe606084
y.create.l HWIO_PMIC_ARB_OBS0_CHNL194_CONFIG_ADDR A:0xe606104
y.create.l HWIO_PMIC_ARB_OBS0_CHNL195_CONFIG_ADDR A:0xe606184
y.create.l HWIO_PMIC_ARB_OBS0_CHNL196_CONFIG_ADDR A:0xe606204
y.create.l HWIO_PMIC_ARB_OBS0_CHNL197_CONFIG_ADDR A:0xe606284
y.create.l HWIO_PMIC_ARB_OBS0_CHNL198_CONFIG_ADDR A:0xe606304
y.create.l HWIO_PMIC_ARB_OBS0_CHNL199_CONFIG_ADDR A:0xe606384
y.create.l HWIO_PMIC_ARB_OBS0_CHNL200_CONFIG_ADDR A:0xe606404
y.create.l HWIO_PMIC_ARB_OBS0_CHNL201_CONFIG_ADDR A:0xe606484
y.create.l HWIO_PMIC_ARB_OBS0_CHNL202_CONFIG_ADDR A:0xe606504
y.create.l HWIO_PMIC_ARB_OBS0_CHNL203_CONFIG_ADDR A:0xe606584
y.create.l HWIO_PMIC_ARB_OBS0_CHNL204_CONFIG_ADDR A:0xe606604
y.create.l HWIO_PMIC_ARB_OBS0_CHNL205_CONFIG_ADDR A:0xe606684
y.create.l HWIO_PMIC_ARB_OBS0_CHNL206_CONFIG_ADDR A:0xe606704
y.create.l HWIO_PMIC_ARB_OBS0_CHNL207_CONFIG_ADDR A:0xe606784
y.create.l HWIO_PMIC_ARB_OBS0_CHNL208_CONFIG_ADDR A:0xe606804
y.create.l HWIO_PMIC_ARB_OBS0_CHNL209_CONFIG_ADDR A:0xe606884
y.create.l HWIO_PMIC_ARB_OBS0_CHNL210_CONFIG_ADDR A:0xe606904
y.create.l HWIO_PMIC_ARB_OBS0_CHNL211_CONFIG_ADDR A:0xe606984
y.create.l HWIO_PMIC_ARB_OBS0_CHNL212_CONFIG_ADDR A:0xe606a04
y.create.l HWIO_PMIC_ARB_OBS0_CHNL213_CONFIG_ADDR A:0xe606a84
y.create.l HWIO_PMIC_ARB_OBS0_CHNL214_CONFIG_ADDR A:0xe606b04
y.create.l HWIO_PMIC_ARB_OBS0_CHNL215_CONFIG_ADDR A:0xe606b84
y.create.l HWIO_PMIC_ARB_OBS0_CHNL216_CONFIG_ADDR A:0xe606c04
y.create.l HWIO_PMIC_ARB_OBS0_CHNL217_CONFIG_ADDR A:0xe606c84
y.create.l HWIO_PMIC_ARB_OBS0_CHNL218_CONFIG_ADDR A:0xe606d04
y.create.l HWIO_PMIC_ARB_OBS0_CHNL219_CONFIG_ADDR A:0xe606d84
y.create.l HWIO_PMIC_ARB_OBS0_CHNL220_CONFIG_ADDR A:0xe606e04
y.create.l HWIO_PMIC_ARB_OBS0_CHNL221_CONFIG_ADDR A:0xe606e84
y.create.l HWIO_PMIC_ARB_OBS0_CHNL222_CONFIG_ADDR A:0xe606f04
y.create.l HWIO_PMIC_ARB_OBS0_CHNL223_CONFIG_ADDR A:0xe606f84
y.create.l HWIO_PMIC_ARB_OBS0_CHNL224_CONFIG_ADDR A:0xe607004
y.create.l HWIO_PMIC_ARB_OBS0_CHNL225_CONFIG_ADDR A:0xe607084
y.create.l HWIO_PMIC_ARB_OBS0_CHNL226_CONFIG_ADDR A:0xe607104
y.create.l HWIO_PMIC_ARB_OBS0_CHNL227_CONFIG_ADDR A:0xe607184
y.create.l HWIO_PMIC_ARB_OBS0_CHNL228_CONFIG_ADDR A:0xe607204
y.create.l HWIO_PMIC_ARB_OBS0_CHNL229_CONFIG_ADDR A:0xe607284
y.create.l HWIO_PMIC_ARB_OBS0_CHNL230_CONFIG_ADDR A:0xe607304
y.create.l HWIO_PMIC_ARB_OBS0_CHNL231_CONFIG_ADDR A:0xe607384
y.create.l HWIO_PMIC_ARB_OBS0_CHNL232_CONFIG_ADDR A:0xe607404
y.create.l HWIO_PMIC_ARB_OBS0_CHNL233_CONFIG_ADDR A:0xe607484
y.create.l HWIO_PMIC_ARB_OBS0_CHNL234_CONFIG_ADDR A:0xe607504
y.create.l HWIO_PMIC_ARB_OBS0_CHNL235_CONFIG_ADDR A:0xe607584
y.create.l HWIO_PMIC_ARB_OBS0_CHNL236_CONFIG_ADDR A:0xe607604
y.create.l HWIO_PMIC_ARB_OBS0_CHNL237_CONFIG_ADDR A:0xe607684
y.create.l HWIO_PMIC_ARB_OBS0_CHNL238_CONFIG_ADDR A:0xe607704
y.create.l HWIO_PMIC_ARB_OBS0_CHNL239_CONFIG_ADDR A:0xe607784
y.create.l HWIO_PMIC_ARB_OBS0_CHNL240_CONFIG_ADDR A:0xe607804
y.create.l HWIO_PMIC_ARB_OBS0_CHNL241_CONFIG_ADDR A:0xe607884
y.create.l HWIO_PMIC_ARB_OBS0_CHNL242_CONFIG_ADDR A:0xe607904
y.create.l HWIO_PMIC_ARB_OBS0_CHNL243_CONFIG_ADDR A:0xe607984
y.create.l HWIO_PMIC_ARB_OBS0_CHNL244_CONFIG_ADDR A:0xe607a04
y.create.l HWIO_PMIC_ARB_OBS0_CHNL245_CONFIG_ADDR A:0xe607a84
y.create.l HWIO_PMIC_ARB_OBS0_CHNL246_CONFIG_ADDR A:0xe607b04
y.create.l HWIO_PMIC_ARB_OBS0_CHNL247_CONFIG_ADDR A:0xe607b84
y.create.l HWIO_PMIC_ARB_OBS0_CHNL248_CONFIG_ADDR A:0xe607c04
y.create.l HWIO_PMIC_ARB_OBS0_CHNL249_CONFIG_ADDR A:0xe607c84
y.create.l HWIO_PMIC_ARB_OBS0_CHNL250_CONFIG_ADDR A:0xe607d04
y.create.l HWIO_PMIC_ARB_OBS0_CHNL251_CONFIG_ADDR A:0xe607d84
y.create.l HWIO_PMIC_ARB_OBS0_CHNL252_CONFIG_ADDR A:0xe607e04
y.create.l HWIO_PMIC_ARB_OBS0_CHNL253_CONFIG_ADDR A:0xe607e84
y.create.l HWIO_PMIC_ARB_OBS0_CHNL254_CONFIG_ADDR A:0xe607f04
y.create.l HWIO_PMIC_ARB_OBS0_CHNL255_CONFIG_ADDR A:0xe607f84
y.create.l HWIO_PMIC_ARB_OBS1_CHNL0_CONFIG_ADDR A:0xe610004
y.create.l HWIO_PMIC_ARB_OBS1_CHNL1_CONFIG_ADDR A:0xe610084
y.create.l HWIO_PMIC_ARB_OBS1_CHNL2_CONFIG_ADDR A:0xe610104
y.create.l HWIO_PMIC_ARB_OBS1_CHNL3_CONFIG_ADDR A:0xe610184
y.create.l HWIO_PMIC_ARB_OBS1_CHNL4_CONFIG_ADDR A:0xe610204
y.create.l HWIO_PMIC_ARB_OBS1_CHNL5_CONFIG_ADDR A:0xe610284
y.create.l HWIO_PMIC_ARB_OBS1_CHNL6_CONFIG_ADDR A:0xe610304
y.create.l HWIO_PMIC_ARB_OBS1_CHNL7_CONFIG_ADDR A:0xe610384
y.create.l HWIO_PMIC_ARB_OBS1_CHNL8_CONFIG_ADDR A:0xe610404
y.create.l HWIO_PMIC_ARB_OBS1_CHNL9_CONFIG_ADDR A:0xe610484
y.create.l HWIO_PMIC_ARB_OBS1_CHNL10_CONFIG_ADDR A:0xe610504
y.create.l HWIO_PMIC_ARB_OBS1_CHNL11_CONFIG_ADDR A:0xe610584
y.create.l HWIO_PMIC_ARB_OBS1_CHNL12_CONFIG_ADDR A:0xe610604
y.create.l HWIO_PMIC_ARB_OBS1_CHNL13_CONFIG_ADDR A:0xe610684
y.create.l HWIO_PMIC_ARB_OBS1_CHNL14_CONFIG_ADDR A:0xe610704
y.create.l HWIO_PMIC_ARB_OBS1_CHNL15_CONFIG_ADDR A:0xe610784
y.create.l HWIO_PMIC_ARB_OBS1_CHNL16_CONFIG_ADDR A:0xe610804
y.create.l HWIO_PMIC_ARB_OBS1_CHNL17_CONFIG_ADDR A:0xe610884
y.create.l HWIO_PMIC_ARB_OBS1_CHNL18_CONFIG_ADDR A:0xe610904
y.create.l HWIO_PMIC_ARB_OBS1_CHNL19_CONFIG_ADDR A:0xe610984
y.create.l HWIO_PMIC_ARB_OBS1_CHNL20_CONFIG_ADDR A:0xe610a04
y.create.l HWIO_PMIC_ARB_OBS1_CHNL21_CONFIG_ADDR A:0xe610a84
y.create.l HWIO_PMIC_ARB_OBS1_CHNL22_CONFIG_ADDR A:0xe610b04
y.create.l HWIO_PMIC_ARB_OBS1_CHNL23_CONFIG_ADDR A:0xe610b84
y.create.l HWIO_PMIC_ARB_OBS1_CHNL24_CONFIG_ADDR A:0xe610c04
y.create.l HWIO_PMIC_ARB_OBS1_CHNL25_CONFIG_ADDR A:0xe610c84
y.create.l HWIO_PMIC_ARB_OBS1_CHNL26_CONFIG_ADDR A:0xe610d04
y.create.l HWIO_PMIC_ARB_OBS1_CHNL27_CONFIG_ADDR A:0xe610d84
y.create.l HWIO_PMIC_ARB_OBS1_CHNL28_CONFIG_ADDR A:0xe610e04
y.create.l HWIO_PMIC_ARB_OBS1_CHNL29_CONFIG_ADDR A:0xe610e84
y.create.l HWIO_PMIC_ARB_OBS1_CHNL30_CONFIG_ADDR A:0xe610f04
y.create.l HWIO_PMIC_ARB_OBS1_CHNL31_CONFIG_ADDR A:0xe610f84
y.create.l HWIO_PMIC_ARB_OBS1_CHNL32_CONFIG_ADDR A:0xe611004
y.create.l HWIO_PMIC_ARB_OBS1_CHNL33_CONFIG_ADDR A:0xe611084
y.create.l HWIO_PMIC_ARB_OBS1_CHNL34_CONFIG_ADDR A:0xe611104
y.create.l HWIO_PMIC_ARB_OBS1_CHNL35_CONFIG_ADDR A:0xe611184
y.create.l HWIO_PMIC_ARB_OBS1_CHNL36_CONFIG_ADDR A:0xe611204
y.create.l HWIO_PMIC_ARB_OBS1_CHNL37_CONFIG_ADDR A:0xe611284
y.create.l HWIO_PMIC_ARB_OBS1_CHNL38_CONFIG_ADDR A:0xe611304
y.create.l HWIO_PMIC_ARB_OBS1_CHNL39_CONFIG_ADDR A:0xe611384
y.create.l HWIO_PMIC_ARB_OBS1_CHNL40_CONFIG_ADDR A:0xe611404
y.create.l HWIO_PMIC_ARB_OBS1_CHNL41_CONFIG_ADDR A:0xe611484
y.create.l HWIO_PMIC_ARB_OBS1_CHNL42_CONFIG_ADDR A:0xe611504
y.create.l HWIO_PMIC_ARB_OBS1_CHNL43_CONFIG_ADDR A:0xe611584
y.create.l HWIO_PMIC_ARB_OBS1_CHNL44_CONFIG_ADDR A:0xe611604
y.create.l HWIO_PMIC_ARB_OBS1_CHNL45_CONFIG_ADDR A:0xe611684
y.create.l HWIO_PMIC_ARB_OBS1_CHNL46_CONFIG_ADDR A:0xe611704
y.create.l HWIO_PMIC_ARB_OBS1_CHNL47_CONFIG_ADDR A:0xe611784
y.create.l HWIO_PMIC_ARB_OBS1_CHNL48_CONFIG_ADDR A:0xe611804
y.create.l HWIO_PMIC_ARB_OBS1_CHNL49_CONFIG_ADDR A:0xe611884
y.create.l HWIO_PMIC_ARB_OBS1_CHNL50_CONFIG_ADDR A:0xe611904
y.create.l HWIO_PMIC_ARB_OBS1_CHNL51_CONFIG_ADDR A:0xe611984
y.create.l HWIO_PMIC_ARB_OBS1_CHNL52_CONFIG_ADDR A:0xe611a04
y.create.l HWIO_PMIC_ARB_OBS1_CHNL53_CONFIG_ADDR A:0xe611a84
y.create.l HWIO_PMIC_ARB_OBS1_CHNL54_CONFIG_ADDR A:0xe611b04
y.create.l HWIO_PMIC_ARB_OBS1_CHNL55_CONFIG_ADDR A:0xe611b84
y.create.l HWIO_PMIC_ARB_OBS1_CHNL56_CONFIG_ADDR A:0xe611c04
y.create.l HWIO_PMIC_ARB_OBS1_CHNL57_CONFIG_ADDR A:0xe611c84
y.create.l HWIO_PMIC_ARB_OBS1_CHNL58_CONFIG_ADDR A:0xe611d04
y.create.l HWIO_PMIC_ARB_OBS1_CHNL59_CONFIG_ADDR A:0xe611d84
y.create.l HWIO_PMIC_ARB_OBS1_CHNL60_CONFIG_ADDR A:0xe611e04
y.create.l HWIO_PMIC_ARB_OBS1_CHNL61_CONFIG_ADDR A:0xe611e84
y.create.l HWIO_PMIC_ARB_OBS1_CHNL62_CONFIG_ADDR A:0xe611f04
y.create.l HWIO_PMIC_ARB_OBS1_CHNL63_CONFIG_ADDR A:0xe611f84
y.create.l HWIO_PMIC_ARB_OBS1_CHNL64_CONFIG_ADDR A:0xe612004
y.create.l HWIO_PMIC_ARB_OBS1_CHNL65_CONFIG_ADDR A:0xe612084
y.create.l HWIO_PMIC_ARB_OBS1_CHNL66_CONFIG_ADDR A:0xe612104
y.create.l HWIO_PMIC_ARB_OBS1_CHNL67_CONFIG_ADDR A:0xe612184
y.create.l HWIO_PMIC_ARB_OBS1_CHNL68_CONFIG_ADDR A:0xe612204
y.create.l HWIO_PMIC_ARB_OBS1_CHNL69_CONFIG_ADDR A:0xe612284
y.create.l HWIO_PMIC_ARB_OBS1_CHNL70_CONFIG_ADDR A:0xe612304
y.create.l HWIO_PMIC_ARB_OBS1_CHNL71_CONFIG_ADDR A:0xe612384
y.create.l HWIO_PMIC_ARB_OBS1_CHNL72_CONFIG_ADDR A:0xe612404
y.create.l HWIO_PMIC_ARB_OBS1_CHNL73_CONFIG_ADDR A:0xe612484
y.create.l HWIO_PMIC_ARB_OBS1_CHNL74_CONFIG_ADDR A:0xe612504
y.create.l HWIO_PMIC_ARB_OBS1_CHNL75_CONFIG_ADDR A:0xe612584
y.create.l HWIO_PMIC_ARB_OBS1_CHNL76_CONFIG_ADDR A:0xe612604
y.create.l HWIO_PMIC_ARB_OBS1_CHNL77_CONFIG_ADDR A:0xe612684
y.create.l HWIO_PMIC_ARB_OBS1_CHNL78_CONFIG_ADDR A:0xe612704
y.create.l HWIO_PMIC_ARB_OBS1_CHNL79_CONFIG_ADDR A:0xe612784
y.create.l HWIO_PMIC_ARB_OBS1_CHNL80_CONFIG_ADDR A:0xe612804
y.create.l HWIO_PMIC_ARB_OBS1_CHNL81_CONFIG_ADDR A:0xe612884
y.create.l HWIO_PMIC_ARB_OBS1_CHNL82_CONFIG_ADDR A:0xe612904
y.create.l HWIO_PMIC_ARB_OBS1_CHNL83_CONFIG_ADDR A:0xe612984
y.create.l HWIO_PMIC_ARB_OBS1_CHNL84_CONFIG_ADDR A:0xe612a04
y.create.l HWIO_PMIC_ARB_OBS1_CHNL85_CONFIG_ADDR A:0xe612a84
y.create.l HWIO_PMIC_ARB_OBS1_CHNL86_CONFIG_ADDR A:0xe612b04
y.create.l HWIO_PMIC_ARB_OBS1_CHNL87_CONFIG_ADDR A:0xe612b84
y.create.l HWIO_PMIC_ARB_OBS1_CHNL88_CONFIG_ADDR A:0xe612c04
y.create.l HWIO_PMIC_ARB_OBS1_CHNL89_CONFIG_ADDR A:0xe612c84
y.create.l HWIO_PMIC_ARB_OBS1_CHNL90_CONFIG_ADDR A:0xe612d04
y.create.l HWIO_PMIC_ARB_OBS1_CHNL91_CONFIG_ADDR A:0xe612d84
y.create.l HWIO_PMIC_ARB_OBS1_CHNL92_CONFIG_ADDR A:0xe612e04
y.create.l HWIO_PMIC_ARB_OBS1_CHNL93_CONFIG_ADDR A:0xe612e84
y.create.l HWIO_PMIC_ARB_OBS1_CHNL94_CONFIG_ADDR A:0xe612f04
y.create.l HWIO_PMIC_ARB_OBS1_CHNL95_CONFIG_ADDR A:0xe612f84
y.create.l HWIO_PMIC_ARB_OBS1_CHNL96_CONFIG_ADDR A:0xe613004
y.create.l HWIO_PMIC_ARB_OBS1_CHNL97_CONFIG_ADDR A:0xe613084
y.create.l HWIO_PMIC_ARB_OBS1_CHNL98_CONFIG_ADDR A:0xe613104
y.create.l HWIO_PMIC_ARB_OBS1_CHNL99_CONFIG_ADDR A:0xe613184
y.create.l HWIO_PMIC_ARB_OBS1_CHNL100_CONFIG_ADDR A:0xe613204
y.create.l HWIO_PMIC_ARB_OBS1_CHNL101_CONFIG_ADDR A:0xe613284
y.create.l HWIO_PMIC_ARB_OBS1_CHNL102_CONFIG_ADDR A:0xe613304
y.create.l HWIO_PMIC_ARB_OBS1_CHNL103_CONFIG_ADDR A:0xe613384
y.create.l HWIO_PMIC_ARB_OBS1_CHNL104_CONFIG_ADDR A:0xe613404
y.create.l HWIO_PMIC_ARB_OBS1_CHNL105_CONFIG_ADDR A:0xe613484
y.create.l HWIO_PMIC_ARB_OBS1_CHNL106_CONFIG_ADDR A:0xe613504
y.create.l HWIO_PMIC_ARB_OBS1_CHNL107_CONFIG_ADDR A:0xe613584
y.create.l HWIO_PMIC_ARB_OBS1_CHNL108_CONFIG_ADDR A:0xe613604
y.create.l HWIO_PMIC_ARB_OBS1_CHNL109_CONFIG_ADDR A:0xe613684
y.create.l HWIO_PMIC_ARB_OBS1_CHNL110_CONFIG_ADDR A:0xe613704
y.create.l HWIO_PMIC_ARB_OBS1_CHNL111_CONFIG_ADDR A:0xe613784
y.create.l HWIO_PMIC_ARB_OBS1_CHNL112_CONFIG_ADDR A:0xe613804
y.create.l HWIO_PMIC_ARB_OBS1_CHNL113_CONFIG_ADDR A:0xe613884
y.create.l HWIO_PMIC_ARB_OBS1_CHNL114_CONFIG_ADDR A:0xe613904
y.create.l HWIO_PMIC_ARB_OBS1_CHNL115_CONFIG_ADDR A:0xe613984
y.create.l HWIO_PMIC_ARB_OBS1_CHNL116_CONFIG_ADDR A:0xe613a04
y.create.l HWIO_PMIC_ARB_OBS1_CHNL117_CONFIG_ADDR A:0xe613a84
y.create.l HWIO_PMIC_ARB_OBS1_CHNL118_CONFIG_ADDR A:0xe613b04
y.create.l HWIO_PMIC_ARB_OBS1_CHNL119_CONFIG_ADDR A:0xe613b84
y.create.l HWIO_PMIC_ARB_OBS1_CHNL120_CONFIG_ADDR A:0xe613c04
y.create.l HWIO_PMIC_ARB_OBS1_CHNL121_CONFIG_ADDR A:0xe613c84
y.create.l HWIO_PMIC_ARB_OBS1_CHNL122_CONFIG_ADDR A:0xe613d04
y.create.l HWIO_PMIC_ARB_OBS1_CHNL123_CONFIG_ADDR A:0xe613d84
y.create.l HWIO_PMIC_ARB_OBS1_CHNL124_CONFIG_ADDR A:0xe613e04
y.create.l HWIO_PMIC_ARB_OBS1_CHNL125_CONFIG_ADDR A:0xe613e84
y.create.l HWIO_PMIC_ARB_OBS1_CHNL126_CONFIG_ADDR A:0xe613f04
y.create.l HWIO_PMIC_ARB_OBS1_CHNL127_CONFIG_ADDR A:0xe613f84
y.create.l HWIO_PMIC_ARB_OBS1_CHNL128_CONFIG_ADDR A:0xe614004
y.create.l HWIO_PMIC_ARB_OBS1_CHNL129_CONFIG_ADDR A:0xe614084
y.create.l HWIO_PMIC_ARB_OBS1_CHNL130_CONFIG_ADDR A:0xe614104
y.create.l HWIO_PMIC_ARB_OBS1_CHNL131_CONFIG_ADDR A:0xe614184
y.create.l HWIO_PMIC_ARB_OBS1_CHNL132_CONFIG_ADDR A:0xe614204
y.create.l HWIO_PMIC_ARB_OBS1_CHNL133_CONFIG_ADDR A:0xe614284
y.create.l HWIO_PMIC_ARB_OBS1_CHNL134_CONFIG_ADDR A:0xe614304
y.create.l HWIO_PMIC_ARB_OBS1_CHNL135_CONFIG_ADDR A:0xe614384
y.create.l HWIO_PMIC_ARB_OBS1_CHNL136_CONFIG_ADDR A:0xe614404
y.create.l HWIO_PMIC_ARB_OBS1_CHNL137_CONFIG_ADDR A:0xe614484
y.create.l HWIO_PMIC_ARB_OBS1_CHNL138_CONFIG_ADDR A:0xe614504
y.create.l HWIO_PMIC_ARB_OBS1_CHNL139_CONFIG_ADDR A:0xe614584
y.create.l HWIO_PMIC_ARB_OBS1_CHNL140_CONFIG_ADDR A:0xe614604
y.create.l HWIO_PMIC_ARB_OBS1_CHNL141_CONFIG_ADDR A:0xe614684
y.create.l HWIO_PMIC_ARB_OBS1_CHNL142_CONFIG_ADDR A:0xe614704
y.create.l HWIO_PMIC_ARB_OBS1_CHNL143_CONFIG_ADDR A:0xe614784
y.create.l HWIO_PMIC_ARB_OBS1_CHNL144_CONFIG_ADDR A:0xe614804
y.create.l HWIO_PMIC_ARB_OBS1_CHNL145_CONFIG_ADDR A:0xe614884
y.create.l HWIO_PMIC_ARB_OBS1_CHNL146_CONFIG_ADDR A:0xe614904
y.create.l HWIO_PMIC_ARB_OBS1_CHNL147_CONFIG_ADDR A:0xe614984
y.create.l HWIO_PMIC_ARB_OBS1_CHNL148_CONFIG_ADDR A:0xe614a04
y.create.l HWIO_PMIC_ARB_OBS1_CHNL149_CONFIG_ADDR A:0xe614a84
y.create.l HWIO_PMIC_ARB_OBS1_CHNL150_CONFIG_ADDR A:0xe614b04
y.create.l HWIO_PMIC_ARB_OBS1_CHNL151_CONFIG_ADDR A:0xe614b84
y.create.l HWIO_PMIC_ARB_OBS1_CHNL152_CONFIG_ADDR A:0xe614c04
y.create.l HWIO_PMIC_ARB_OBS1_CHNL153_CONFIG_ADDR A:0xe614c84
y.create.l HWIO_PMIC_ARB_OBS1_CHNL154_CONFIG_ADDR A:0xe614d04
y.create.l HWIO_PMIC_ARB_OBS1_CHNL155_CONFIG_ADDR A:0xe614d84
y.create.l HWIO_PMIC_ARB_OBS1_CHNL156_CONFIG_ADDR A:0xe614e04
y.create.l HWIO_PMIC_ARB_OBS1_CHNL157_CONFIG_ADDR A:0xe614e84
y.create.l HWIO_PMIC_ARB_OBS1_CHNL158_CONFIG_ADDR A:0xe614f04
y.create.l HWIO_PMIC_ARB_OBS1_CHNL159_CONFIG_ADDR A:0xe614f84
y.create.l HWIO_PMIC_ARB_OBS1_CHNL160_CONFIG_ADDR A:0xe615004
y.create.l HWIO_PMIC_ARB_OBS1_CHNL161_CONFIG_ADDR A:0xe615084
y.create.l HWIO_PMIC_ARB_OBS1_CHNL162_CONFIG_ADDR A:0xe615104
y.create.l HWIO_PMIC_ARB_OBS1_CHNL163_CONFIG_ADDR A:0xe615184
y.create.l HWIO_PMIC_ARB_OBS1_CHNL164_CONFIG_ADDR A:0xe615204
y.create.l HWIO_PMIC_ARB_OBS1_CHNL165_CONFIG_ADDR A:0xe615284
y.create.l HWIO_PMIC_ARB_OBS1_CHNL166_CONFIG_ADDR A:0xe615304
y.create.l HWIO_PMIC_ARB_OBS1_CHNL167_CONFIG_ADDR A:0xe615384
y.create.l HWIO_PMIC_ARB_OBS1_CHNL168_CONFIG_ADDR A:0xe615404
y.create.l HWIO_PMIC_ARB_OBS1_CHNL169_CONFIG_ADDR A:0xe615484
y.create.l HWIO_PMIC_ARB_OBS1_CHNL170_CONFIG_ADDR A:0xe615504
y.create.l HWIO_PMIC_ARB_OBS1_CHNL171_CONFIG_ADDR A:0xe615584
y.create.l HWIO_PMIC_ARB_OBS1_CHNL172_CONFIG_ADDR A:0xe615604
y.create.l HWIO_PMIC_ARB_OBS1_CHNL173_CONFIG_ADDR A:0xe615684
y.create.l HWIO_PMIC_ARB_OBS1_CHNL174_CONFIG_ADDR A:0xe615704
y.create.l HWIO_PMIC_ARB_OBS1_CHNL175_CONFIG_ADDR A:0xe615784
y.create.l HWIO_PMIC_ARB_OBS1_CHNL176_CONFIG_ADDR A:0xe615804
y.create.l HWIO_PMIC_ARB_OBS1_CHNL177_CONFIG_ADDR A:0xe615884
y.create.l HWIO_PMIC_ARB_OBS1_CHNL178_CONFIG_ADDR A:0xe615904
y.create.l HWIO_PMIC_ARB_OBS1_CHNL179_CONFIG_ADDR A:0xe615984
y.create.l HWIO_PMIC_ARB_OBS1_CHNL180_CONFIG_ADDR A:0xe615a04
y.create.l HWIO_PMIC_ARB_OBS1_CHNL181_CONFIG_ADDR A:0xe615a84
y.create.l HWIO_PMIC_ARB_OBS1_CHNL182_CONFIG_ADDR A:0xe615b04
y.create.l HWIO_PMIC_ARB_OBS1_CHNL183_CONFIG_ADDR A:0xe615b84
y.create.l HWIO_PMIC_ARB_OBS1_CHNL184_CONFIG_ADDR A:0xe615c04
y.create.l HWIO_PMIC_ARB_OBS1_CHNL185_CONFIG_ADDR A:0xe615c84
y.create.l HWIO_PMIC_ARB_OBS1_CHNL186_CONFIG_ADDR A:0xe615d04
y.create.l HWIO_PMIC_ARB_OBS1_CHNL187_CONFIG_ADDR A:0xe615d84
y.create.l HWIO_PMIC_ARB_OBS1_CHNL188_CONFIG_ADDR A:0xe615e04
y.create.l HWIO_PMIC_ARB_OBS1_CHNL189_CONFIG_ADDR A:0xe615e84
y.create.l HWIO_PMIC_ARB_OBS1_CHNL190_CONFIG_ADDR A:0xe615f04
y.create.l HWIO_PMIC_ARB_OBS1_CHNL191_CONFIG_ADDR A:0xe615f84
y.create.l HWIO_PMIC_ARB_OBS1_CHNL192_CONFIG_ADDR A:0xe616004
y.create.l HWIO_PMIC_ARB_OBS1_CHNL193_CONFIG_ADDR A:0xe616084
y.create.l HWIO_PMIC_ARB_OBS1_CHNL194_CONFIG_ADDR A:0xe616104
y.create.l HWIO_PMIC_ARB_OBS1_CHNL195_CONFIG_ADDR A:0xe616184
y.create.l HWIO_PMIC_ARB_OBS1_CHNL196_CONFIG_ADDR A:0xe616204
y.create.l HWIO_PMIC_ARB_OBS1_CHNL197_CONFIG_ADDR A:0xe616284
y.create.l HWIO_PMIC_ARB_OBS1_CHNL198_CONFIG_ADDR A:0xe616304
y.create.l HWIO_PMIC_ARB_OBS1_CHNL199_CONFIG_ADDR A:0xe616384
y.create.l HWIO_PMIC_ARB_OBS1_CHNL200_CONFIG_ADDR A:0xe616404
y.create.l HWIO_PMIC_ARB_OBS1_CHNL201_CONFIG_ADDR A:0xe616484
y.create.l HWIO_PMIC_ARB_OBS1_CHNL202_CONFIG_ADDR A:0xe616504
y.create.l HWIO_PMIC_ARB_OBS1_CHNL203_CONFIG_ADDR A:0xe616584
y.create.l HWIO_PMIC_ARB_OBS1_CHNL204_CONFIG_ADDR A:0xe616604
y.create.l HWIO_PMIC_ARB_OBS1_CHNL205_CONFIG_ADDR A:0xe616684
y.create.l HWIO_PMIC_ARB_OBS1_CHNL206_CONFIG_ADDR A:0xe616704
y.create.l HWIO_PMIC_ARB_OBS1_CHNL207_CONFIG_ADDR A:0xe616784
y.create.l HWIO_PMIC_ARB_OBS1_CHNL208_CONFIG_ADDR A:0xe616804
y.create.l HWIO_PMIC_ARB_OBS1_CHNL209_CONFIG_ADDR A:0xe616884
y.create.l HWIO_PMIC_ARB_OBS1_CHNL210_CONFIG_ADDR A:0xe616904
y.create.l HWIO_PMIC_ARB_OBS1_CHNL211_CONFIG_ADDR A:0xe616984
y.create.l HWIO_PMIC_ARB_OBS1_CHNL212_CONFIG_ADDR A:0xe616a04
y.create.l HWIO_PMIC_ARB_OBS1_CHNL213_CONFIG_ADDR A:0xe616a84
y.create.l HWIO_PMIC_ARB_OBS1_CHNL214_CONFIG_ADDR A:0xe616b04
y.create.l HWIO_PMIC_ARB_OBS1_CHNL215_CONFIG_ADDR A:0xe616b84
y.create.l HWIO_PMIC_ARB_OBS1_CHNL216_CONFIG_ADDR A:0xe616c04
y.create.l HWIO_PMIC_ARB_OBS1_CHNL217_CONFIG_ADDR A:0xe616c84
y.create.l HWIO_PMIC_ARB_OBS1_CHNL218_CONFIG_ADDR A:0xe616d04
y.create.l HWIO_PMIC_ARB_OBS1_CHNL219_CONFIG_ADDR A:0xe616d84
y.create.l HWIO_PMIC_ARB_OBS1_CHNL220_CONFIG_ADDR A:0xe616e04
y.create.l HWIO_PMIC_ARB_OBS1_CHNL221_CONFIG_ADDR A:0xe616e84
y.create.l HWIO_PMIC_ARB_OBS1_CHNL222_CONFIG_ADDR A:0xe616f04
y.create.l HWIO_PMIC_ARB_OBS1_CHNL223_CONFIG_ADDR A:0xe616f84
y.create.l HWIO_PMIC_ARB_OBS1_CHNL224_CONFIG_ADDR A:0xe617004
y.create.l HWIO_PMIC_ARB_OBS1_CHNL225_CONFIG_ADDR A:0xe617084
y.create.l HWIO_PMIC_ARB_OBS1_CHNL226_CONFIG_ADDR A:0xe617104
y.create.l HWIO_PMIC_ARB_OBS1_CHNL227_CONFIG_ADDR A:0xe617184
y.create.l HWIO_PMIC_ARB_OBS1_CHNL228_CONFIG_ADDR A:0xe617204
y.create.l HWIO_PMIC_ARB_OBS1_CHNL229_CONFIG_ADDR A:0xe617284
y.create.l HWIO_PMIC_ARB_OBS1_CHNL230_CONFIG_ADDR A:0xe617304
y.create.l HWIO_PMIC_ARB_OBS1_CHNL231_CONFIG_ADDR A:0xe617384
y.create.l HWIO_PMIC_ARB_OBS1_CHNL232_CONFIG_ADDR A:0xe617404
y.create.l HWIO_PMIC_ARB_OBS1_CHNL233_CONFIG_ADDR A:0xe617484
y.create.l HWIO_PMIC_ARB_OBS1_CHNL234_CONFIG_ADDR A:0xe617504
y.create.l HWIO_PMIC_ARB_OBS1_CHNL235_CONFIG_ADDR A:0xe617584
y.create.l HWIO_PMIC_ARB_OBS1_CHNL236_CONFIG_ADDR A:0xe617604
y.create.l HWIO_PMIC_ARB_OBS1_CHNL237_CONFIG_ADDR A:0xe617684
y.create.l HWIO_PMIC_ARB_OBS1_CHNL238_CONFIG_ADDR A:0xe617704
y.create.l HWIO_PMIC_ARB_OBS1_CHNL239_CONFIG_ADDR A:0xe617784
y.create.l HWIO_PMIC_ARB_OBS1_CHNL240_CONFIG_ADDR A:0xe617804
y.create.l HWIO_PMIC_ARB_OBS1_CHNL241_CONFIG_ADDR A:0xe617884
y.create.l HWIO_PMIC_ARB_OBS1_CHNL242_CONFIG_ADDR A:0xe617904
y.create.l HWIO_PMIC_ARB_OBS1_CHNL243_CONFIG_ADDR A:0xe617984
y.create.l HWIO_PMIC_ARB_OBS1_CHNL244_CONFIG_ADDR A:0xe617a04
y.create.l HWIO_PMIC_ARB_OBS1_CHNL245_CONFIG_ADDR A:0xe617a84
y.create.l HWIO_PMIC_ARB_OBS1_CHNL246_CONFIG_ADDR A:0xe617b04
y.create.l HWIO_PMIC_ARB_OBS1_CHNL247_CONFIG_ADDR A:0xe617b84
y.create.l HWIO_PMIC_ARB_OBS1_CHNL248_CONFIG_ADDR A:0xe617c04
y.create.l HWIO_PMIC_ARB_OBS1_CHNL249_CONFIG_ADDR A:0xe617c84
y.create.l HWIO_PMIC_ARB_OBS1_CHNL250_CONFIG_ADDR A:0xe617d04
y.create.l HWIO_PMIC_ARB_OBS1_CHNL251_CONFIG_ADDR A:0xe617d84
y.create.l HWIO_PMIC_ARB_OBS1_CHNL252_CONFIG_ADDR A:0xe617e04
y.create.l HWIO_PMIC_ARB_OBS1_CHNL253_CONFIG_ADDR A:0xe617e84
y.create.l HWIO_PMIC_ARB_OBS1_CHNL254_CONFIG_ADDR A:0xe617f04
y.create.l HWIO_PMIC_ARB_OBS1_CHNL255_CONFIG_ADDR A:0xe617f84
y.create.l HWIO_PMIC_ARB_OBS2_CHNL0_CONFIG_ADDR A:0xe620004
y.create.l HWIO_PMIC_ARB_OBS2_CHNL1_CONFIG_ADDR A:0xe620084
y.create.l HWIO_PMIC_ARB_OBS2_CHNL2_CONFIG_ADDR A:0xe620104
y.create.l HWIO_PMIC_ARB_OBS2_CHNL3_CONFIG_ADDR A:0xe620184
y.create.l HWIO_PMIC_ARB_OBS2_CHNL4_CONFIG_ADDR A:0xe620204
y.create.l HWIO_PMIC_ARB_OBS2_CHNL5_CONFIG_ADDR A:0xe620284
y.create.l HWIO_PMIC_ARB_OBS2_CHNL6_CONFIG_ADDR A:0xe620304
y.create.l HWIO_PMIC_ARB_OBS2_CHNL7_CONFIG_ADDR A:0xe620384
y.create.l HWIO_PMIC_ARB_OBS2_CHNL8_CONFIG_ADDR A:0xe620404
y.create.l HWIO_PMIC_ARB_OBS2_CHNL9_CONFIG_ADDR A:0xe620484
y.create.l HWIO_PMIC_ARB_OBS2_CHNL10_CONFIG_ADDR A:0xe620504
y.create.l HWIO_PMIC_ARB_OBS2_CHNL11_CONFIG_ADDR A:0xe620584
y.create.l HWIO_PMIC_ARB_OBS2_CHNL12_CONFIG_ADDR A:0xe620604
y.create.l HWIO_PMIC_ARB_OBS2_CHNL13_CONFIG_ADDR A:0xe620684
y.create.l HWIO_PMIC_ARB_OBS2_CHNL14_CONFIG_ADDR A:0xe620704
y.create.l HWIO_PMIC_ARB_OBS2_CHNL15_CONFIG_ADDR A:0xe620784
y.create.l HWIO_PMIC_ARB_OBS2_CHNL16_CONFIG_ADDR A:0xe620804
y.create.l HWIO_PMIC_ARB_OBS2_CHNL17_CONFIG_ADDR A:0xe620884
y.create.l HWIO_PMIC_ARB_OBS2_CHNL18_CONFIG_ADDR A:0xe620904
y.create.l HWIO_PMIC_ARB_OBS2_CHNL19_CONFIG_ADDR A:0xe620984
y.create.l HWIO_PMIC_ARB_OBS2_CHNL20_CONFIG_ADDR A:0xe620a04
y.create.l HWIO_PMIC_ARB_OBS2_CHNL21_CONFIG_ADDR A:0xe620a84
y.create.l HWIO_PMIC_ARB_OBS2_CHNL22_CONFIG_ADDR A:0xe620b04
y.create.l HWIO_PMIC_ARB_OBS2_CHNL23_CONFIG_ADDR A:0xe620b84
y.create.l HWIO_PMIC_ARB_OBS2_CHNL24_CONFIG_ADDR A:0xe620c04
y.create.l HWIO_PMIC_ARB_OBS2_CHNL25_CONFIG_ADDR A:0xe620c84
y.create.l HWIO_PMIC_ARB_OBS2_CHNL26_CONFIG_ADDR A:0xe620d04
y.create.l HWIO_PMIC_ARB_OBS2_CHNL27_CONFIG_ADDR A:0xe620d84
y.create.l HWIO_PMIC_ARB_OBS2_CHNL28_CONFIG_ADDR A:0xe620e04
y.create.l HWIO_PMIC_ARB_OBS2_CHNL29_CONFIG_ADDR A:0xe620e84
y.create.l HWIO_PMIC_ARB_OBS2_CHNL30_CONFIG_ADDR A:0xe620f04
y.create.l HWIO_PMIC_ARB_OBS2_CHNL31_CONFIG_ADDR A:0xe620f84
y.create.l HWIO_PMIC_ARB_OBS2_CHNL32_CONFIG_ADDR A:0xe621004
y.create.l HWIO_PMIC_ARB_OBS2_CHNL33_CONFIG_ADDR A:0xe621084
y.create.l HWIO_PMIC_ARB_OBS2_CHNL34_CONFIG_ADDR A:0xe621104
y.create.l HWIO_PMIC_ARB_OBS2_CHNL35_CONFIG_ADDR A:0xe621184
y.create.l HWIO_PMIC_ARB_OBS2_CHNL36_CONFIG_ADDR A:0xe621204
y.create.l HWIO_PMIC_ARB_OBS2_CHNL37_CONFIG_ADDR A:0xe621284
y.create.l HWIO_PMIC_ARB_OBS2_CHNL38_CONFIG_ADDR A:0xe621304
y.create.l HWIO_PMIC_ARB_OBS2_CHNL39_CONFIG_ADDR A:0xe621384
y.create.l HWIO_PMIC_ARB_OBS2_CHNL40_CONFIG_ADDR A:0xe621404
y.create.l HWIO_PMIC_ARB_OBS2_CHNL41_CONFIG_ADDR A:0xe621484
y.create.l HWIO_PMIC_ARB_OBS2_CHNL42_CONFIG_ADDR A:0xe621504
y.create.l HWIO_PMIC_ARB_OBS2_CHNL43_CONFIG_ADDR A:0xe621584
y.create.l HWIO_PMIC_ARB_OBS2_CHNL44_CONFIG_ADDR A:0xe621604
y.create.l HWIO_PMIC_ARB_OBS2_CHNL45_CONFIG_ADDR A:0xe621684
y.create.l HWIO_PMIC_ARB_OBS2_CHNL46_CONFIG_ADDR A:0xe621704
y.create.l HWIO_PMIC_ARB_OBS2_CHNL47_CONFIG_ADDR A:0xe621784
y.create.l HWIO_PMIC_ARB_OBS2_CHNL48_CONFIG_ADDR A:0xe621804
y.create.l HWIO_PMIC_ARB_OBS2_CHNL49_CONFIG_ADDR A:0xe621884
y.create.l HWIO_PMIC_ARB_OBS2_CHNL50_CONFIG_ADDR A:0xe621904
y.create.l HWIO_PMIC_ARB_OBS2_CHNL51_CONFIG_ADDR A:0xe621984
y.create.l HWIO_PMIC_ARB_OBS2_CHNL52_CONFIG_ADDR A:0xe621a04
y.create.l HWIO_PMIC_ARB_OBS2_CHNL53_CONFIG_ADDR A:0xe621a84
y.create.l HWIO_PMIC_ARB_OBS2_CHNL54_CONFIG_ADDR A:0xe621b04
y.create.l HWIO_PMIC_ARB_OBS2_CHNL55_CONFIG_ADDR A:0xe621b84
y.create.l HWIO_PMIC_ARB_OBS2_CHNL56_CONFIG_ADDR A:0xe621c04
y.create.l HWIO_PMIC_ARB_OBS2_CHNL57_CONFIG_ADDR A:0xe621c84
y.create.l HWIO_PMIC_ARB_OBS2_CHNL58_CONFIG_ADDR A:0xe621d04
y.create.l HWIO_PMIC_ARB_OBS2_CHNL59_CONFIG_ADDR A:0xe621d84
y.create.l HWIO_PMIC_ARB_OBS2_CHNL60_CONFIG_ADDR A:0xe621e04
y.create.l HWIO_PMIC_ARB_OBS2_CHNL61_CONFIG_ADDR A:0xe621e84
y.create.l HWIO_PMIC_ARB_OBS2_CHNL62_CONFIG_ADDR A:0xe621f04
y.create.l HWIO_PMIC_ARB_OBS2_CHNL63_CONFIG_ADDR A:0xe621f84
y.create.l HWIO_PMIC_ARB_OBS2_CHNL64_CONFIG_ADDR A:0xe622004
y.create.l HWIO_PMIC_ARB_OBS2_CHNL65_CONFIG_ADDR A:0xe622084
y.create.l HWIO_PMIC_ARB_OBS2_CHNL66_CONFIG_ADDR A:0xe622104
y.create.l HWIO_PMIC_ARB_OBS2_CHNL67_CONFIG_ADDR A:0xe622184
y.create.l HWIO_PMIC_ARB_OBS2_CHNL68_CONFIG_ADDR A:0xe622204
y.create.l HWIO_PMIC_ARB_OBS2_CHNL69_CONFIG_ADDR A:0xe622284
y.create.l HWIO_PMIC_ARB_OBS2_CHNL70_CONFIG_ADDR A:0xe622304
y.create.l HWIO_PMIC_ARB_OBS2_CHNL71_CONFIG_ADDR A:0xe622384
y.create.l HWIO_PMIC_ARB_OBS2_CHNL72_CONFIG_ADDR A:0xe622404
y.create.l HWIO_PMIC_ARB_OBS2_CHNL73_CONFIG_ADDR A:0xe622484
y.create.l HWIO_PMIC_ARB_OBS2_CHNL74_CONFIG_ADDR A:0xe622504
y.create.l HWIO_PMIC_ARB_OBS2_CHNL75_CONFIG_ADDR A:0xe622584
y.create.l HWIO_PMIC_ARB_OBS2_CHNL76_CONFIG_ADDR A:0xe622604
y.create.l HWIO_PMIC_ARB_OBS2_CHNL77_CONFIG_ADDR A:0xe622684
y.create.l HWIO_PMIC_ARB_OBS2_CHNL78_CONFIG_ADDR A:0xe622704
y.create.l HWIO_PMIC_ARB_OBS2_CHNL79_CONFIG_ADDR A:0xe622784
y.create.l HWIO_PMIC_ARB_OBS2_CHNL80_CONFIG_ADDR A:0xe622804
y.create.l HWIO_PMIC_ARB_OBS2_CHNL81_CONFIG_ADDR A:0xe622884
y.create.l HWIO_PMIC_ARB_OBS2_CHNL82_CONFIG_ADDR A:0xe622904
y.create.l HWIO_PMIC_ARB_OBS2_CHNL83_CONFIG_ADDR A:0xe622984
y.create.l HWIO_PMIC_ARB_OBS2_CHNL84_CONFIG_ADDR A:0xe622a04
y.create.l HWIO_PMIC_ARB_OBS2_CHNL85_CONFIG_ADDR A:0xe622a84
y.create.l HWIO_PMIC_ARB_OBS2_CHNL86_CONFIG_ADDR A:0xe622b04
y.create.l HWIO_PMIC_ARB_OBS2_CHNL87_CONFIG_ADDR A:0xe622b84
y.create.l HWIO_PMIC_ARB_OBS2_CHNL88_CONFIG_ADDR A:0xe622c04
y.create.l HWIO_PMIC_ARB_OBS2_CHNL89_CONFIG_ADDR A:0xe622c84
y.create.l HWIO_PMIC_ARB_OBS2_CHNL90_CONFIG_ADDR A:0xe622d04
y.create.l HWIO_PMIC_ARB_OBS2_CHNL91_CONFIG_ADDR A:0xe622d84
y.create.l HWIO_PMIC_ARB_OBS2_CHNL92_CONFIG_ADDR A:0xe622e04
y.create.l HWIO_PMIC_ARB_OBS2_CHNL93_CONFIG_ADDR A:0xe622e84
y.create.l HWIO_PMIC_ARB_OBS2_CHNL94_CONFIG_ADDR A:0xe622f04
y.create.l HWIO_PMIC_ARB_OBS2_CHNL95_CONFIG_ADDR A:0xe622f84
y.create.l HWIO_PMIC_ARB_OBS2_CHNL96_CONFIG_ADDR A:0xe623004
y.create.l HWIO_PMIC_ARB_OBS2_CHNL97_CONFIG_ADDR A:0xe623084
y.create.l HWIO_PMIC_ARB_OBS2_CHNL98_CONFIG_ADDR A:0xe623104
y.create.l HWIO_PMIC_ARB_OBS2_CHNL99_CONFIG_ADDR A:0xe623184
y.create.l HWIO_PMIC_ARB_OBS2_CHNL100_CONFIG_ADDR A:0xe623204
y.create.l HWIO_PMIC_ARB_OBS2_CHNL101_CONFIG_ADDR A:0xe623284
y.create.l HWIO_PMIC_ARB_OBS2_CHNL102_CONFIG_ADDR A:0xe623304
y.create.l HWIO_PMIC_ARB_OBS2_CHNL103_CONFIG_ADDR A:0xe623384
y.create.l HWIO_PMIC_ARB_OBS2_CHNL104_CONFIG_ADDR A:0xe623404
y.create.l HWIO_PMIC_ARB_OBS2_CHNL105_CONFIG_ADDR A:0xe623484
y.create.l HWIO_PMIC_ARB_OBS2_CHNL106_CONFIG_ADDR A:0xe623504
y.create.l HWIO_PMIC_ARB_OBS2_CHNL107_CONFIG_ADDR A:0xe623584
y.create.l HWIO_PMIC_ARB_OBS2_CHNL108_CONFIG_ADDR A:0xe623604
y.create.l HWIO_PMIC_ARB_OBS2_CHNL109_CONFIG_ADDR A:0xe623684
y.create.l HWIO_PMIC_ARB_OBS2_CHNL110_CONFIG_ADDR A:0xe623704
y.create.l HWIO_PMIC_ARB_OBS2_CHNL111_CONFIG_ADDR A:0xe623784
y.create.l HWIO_PMIC_ARB_OBS2_CHNL112_CONFIG_ADDR A:0xe623804
y.create.l HWIO_PMIC_ARB_OBS2_CHNL113_CONFIG_ADDR A:0xe623884
y.create.l HWIO_PMIC_ARB_OBS2_CHNL114_CONFIG_ADDR A:0xe623904
y.create.l HWIO_PMIC_ARB_OBS2_CHNL115_CONFIG_ADDR A:0xe623984
y.create.l HWIO_PMIC_ARB_OBS2_CHNL116_CONFIG_ADDR A:0xe623a04
y.create.l HWIO_PMIC_ARB_OBS2_CHNL117_CONFIG_ADDR A:0xe623a84
y.create.l HWIO_PMIC_ARB_OBS2_CHNL118_CONFIG_ADDR A:0xe623b04
y.create.l HWIO_PMIC_ARB_OBS2_CHNL119_CONFIG_ADDR A:0xe623b84
y.create.l HWIO_PMIC_ARB_OBS2_CHNL120_CONFIG_ADDR A:0xe623c04
y.create.l HWIO_PMIC_ARB_OBS2_CHNL121_CONFIG_ADDR A:0xe623c84
y.create.l HWIO_PMIC_ARB_OBS2_CHNL122_CONFIG_ADDR A:0xe623d04
y.create.l HWIO_PMIC_ARB_OBS2_CHNL123_CONFIG_ADDR A:0xe623d84
y.create.l HWIO_PMIC_ARB_OBS2_CHNL124_CONFIG_ADDR A:0xe623e04
y.create.l HWIO_PMIC_ARB_OBS2_CHNL125_CONFIG_ADDR A:0xe623e84
y.create.l HWIO_PMIC_ARB_OBS2_CHNL126_CONFIG_ADDR A:0xe623f04
y.create.l HWIO_PMIC_ARB_OBS2_CHNL127_CONFIG_ADDR A:0xe623f84
y.create.l HWIO_PMIC_ARB_OBS2_CHNL128_CONFIG_ADDR A:0xe624004
y.create.l HWIO_PMIC_ARB_OBS2_CHNL129_CONFIG_ADDR A:0xe624084
y.create.l HWIO_PMIC_ARB_OBS2_CHNL130_CONFIG_ADDR A:0xe624104
y.create.l HWIO_PMIC_ARB_OBS2_CHNL131_CONFIG_ADDR A:0xe624184
y.create.l HWIO_PMIC_ARB_OBS2_CHNL132_CONFIG_ADDR A:0xe624204
y.create.l HWIO_PMIC_ARB_OBS2_CHNL133_CONFIG_ADDR A:0xe624284
y.create.l HWIO_PMIC_ARB_OBS2_CHNL134_CONFIG_ADDR A:0xe624304
y.create.l HWIO_PMIC_ARB_OBS2_CHNL135_CONFIG_ADDR A:0xe624384
y.create.l HWIO_PMIC_ARB_OBS2_CHNL136_CONFIG_ADDR A:0xe624404
y.create.l HWIO_PMIC_ARB_OBS2_CHNL137_CONFIG_ADDR A:0xe624484
y.create.l HWIO_PMIC_ARB_OBS2_CHNL138_CONFIG_ADDR A:0xe624504
y.create.l HWIO_PMIC_ARB_OBS2_CHNL139_CONFIG_ADDR A:0xe624584
y.create.l HWIO_PMIC_ARB_OBS2_CHNL140_CONFIG_ADDR A:0xe624604
y.create.l HWIO_PMIC_ARB_OBS2_CHNL141_CONFIG_ADDR A:0xe624684
y.create.l HWIO_PMIC_ARB_OBS2_CHNL142_CONFIG_ADDR A:0xe624704
y.create.l HWIO_PMIC_ARB_OBS2_CHNL143_CONFIG_ADDR A:0xe624784
y.create.l HWIO_PMIC_ARB_OBS2_CHNL144_CONFIG_ADDR A:0xe624804
y.create.l HWIO_PMIC_ARB_OBS2_CHNL145_CONFIG_ADDR A:0xe624884
y.create.l HWIO_PMIC_ARB_OBS2_CHNL146_CONFIG_ADDR A:0xe624904
y.create.l HWIO_PMIC_ARB_OBS2_CHNL147_CONFIG_ADDR A:0xe624984
y.create.l HWIO_PMIC_ARB_OBS2_CHNL148_CONFIG_ADDR A:0xe624a04
y.create.l HWIO_PMIC_ARB_OBS2_CHNL149_CONFIG_ADDR A:0xe624a84
y.create.l HWIO_PMIC_ARB_OBS2_CHNL150_CONFIG_ADDR A:0xe624b04
y.create.l HWIO_PMIC_ARB_OBS2_CHNL151_CONFIG_ADDR A:0xe624b84
y.create.l HWIO_PMIC_ARB_OBS2_CHNL152_CONFIG_ADDR A:0xe624c04
y.create.l HWIO_PMIC_ARB_OBS2_CHNL153_CONFIG_ADDR A:0xe624c84
y.create.l HWIO_PMIC_ARB_OBS2_CHNL154_CONFIG_ADDR A:0xe624d04
y.create.l HWIO_PMIC_ARB_OBS2_CHNL155_CONFIG_ADDR A:0xe624d84
y.create.l HWIO_PMIC_ARB_OBS2_CHNL156_CONFIG_ADDR A:0xe624e04
y.create.l HWIO_PMIC_ARB_OBS2_CHNL157_CONFIG_ADDR A:0xe624e84
y.create.l HWIO_PMIC_ARB_OBS2_CHNL158_CONFIG_ADDR A:0xe624f04
y.create.l HWIO_PMIC_ARB_OBS2_CHNL159_CONFIG_ADDR A:0xe624f84
y.create.l HWIO_PMIC_ARB_OBS2_CHNL160_CONFIG_ADDR A:0xe625004
y.create.l HWIO_PMIC_ARB_OBS2_CHNL161_CONFIG_ADDR A:0xe625084
y.create.l HWIO_PMIC_ARB_OBS2_CHNL162_CONFIG_ADDR A:0xe625104
y.create.l HWIO_PMIC_ARB_OBS2_CHNL163_CONFIG_ADDR A:0xe625184
y.create.l HWIO_PMIC_ARB_OBS2_CHNL164_CONFIG_ADDR A:0xe625204
y.create.l HWIO_PMIC_ARB_OBS2_CHNL165_CONFIG_ADDR A:0xe625284
y.create.l HWIO_PMIC_ARB_OBS2_CHNL166_CONFIG_ADDR A:0xe625304
y.create.l HWIO_PMIC_ARB_OBS2_CHNL167_CONFIG_ADDR A:0xe625384
y.create.l HWIO_PMIC_ARB_OBS2_CHNL168_CONFIG_ADDR A:0xe625404
y.create.l HWIO_PMIC_ARB_OBS2_CHNL169_CONFIG_ADDR A:0xe625484
y.create.l HWIO_PMIC_ARB_OBS2_CHNL170_CONFIG_ADDR A:0xe625504
y.create.l HWIO_PMIC_ARB_OBS2_CHNL171_CONFIG_ADDR A:0xe625584
y.create.l HWIO_PMIC_ARB_OBS2_CHNL172_CONFIG_ADDR A:0xe625604
y.create.l HWIO_PMIC_ARB_OBS2_CHNL173_CONFIG_ADDR A:0xe625684
y.create.l HWIO_PMIC_ARB_OBS2_CHNL174_CONFIG_ADDR A:0xe625704
y.create.l HWIO_PMIC_ARB_OBS2_CHNL175_CONFIG_ADDR A:0xe625784
y.create.l HWIO_PMIC_ARB_OBS2_CHNL176_CONFIG_ADDR A:0xe625804
y.create.l HWIO_PMIC_ARB_OBS2_CHNL177_CONFIG_ADDR A:0xe625884
y.create.l HWIO_PMIC_ARB_OBS2_CHNL178_CONFIG_ADDR A:0xe625904
y.create.l HWIO_PMIC_ARB_OBS2_CHNL179_CONFIG_ADDR A:0xe625984
y.create.l HWIO_PMIC_ARB_OBS2_CHNL180_CONFIG_ADDR A:0xe625a04
y.create.l HWIO_PMIC_ARB_OBS2_CHNL181_CONFIG_ADDR A:0xe625a84
y.create.l HWIO_PMIC_ARB_OBS2_CHNL182_CONFIG_ADDR A:0xe625b04
y.create.l HWIO_PMIC_ARB_OBS2_CHNL183_CONFIG_ADDR A:0xe625b84
y.create.l HWIO_PMIC_ARB_OBS2_CHNL184_CONFIG_ADDR A:0xe625c04
y.create.l HWIO_PMIC_ARB_OBS2_CHNL185_CONFIG_ADDR A:0xe625c84
y.create.l HWIO_PMIC_ARB_OBS2_CHNL186_CONFIG_ADDR A:0xe625d04
y.create.l HWIO_PMIC_ARB_OBS2_CHNL187_CONFIG_ADDR A:0xe625d84
y.create.l HWIO_PMIC_ARB_OBS2_CHNL188_CONFIG_ADDR A:0xe625e04
y.create.l HWIO_PMIC_ARB_OBS2_CHNL189_CONFIG_ADDR A:0xe625e84
y.create.l HWIO_PMIC_ARB_OBS2_CHNL190_CONFIG_ADDR A:0xe625f04
y.create.l HWIO_PMIC_ARB_OBS2_CHNL191_CONFIG_ADDR A:0xe625f84
y.create.l HWIO_PMIC_ARB_OBS2_CHNL192_CONFIG_ADDR A:0xe626004
y.create.l HWIO_PMIC_ARB_OBS2_CHNL193_CONFIG_ADDR A:0xe626084
y.create.l HWIO_PMIC_ARB_OBS2_CHNL194_CONFIG_ADDR A:0xe626104
y.create.l HWIO_PMIC_ARB_OBS2_CHNL195_CONFIG_ADDR A:0xe626184
y.create.l HWIO_PMIC_ARB_OBS2_CHNL196_CONFIG_ADDR A:0xe626204
y.create.l HWIO_PMIC_ARB_OBS2_CHNL197_CONFIG_ADDR A:0xe626284
y.create.l HWIO_PMIC_ARB_OBS2_CHNL198_CONFIG_ADDR A:0xe626304
y.create.l HWIO_PMIC_ARB_OBS2_CHNL199_CONFIG_ADDR A:0xe626384
y.create.l HWIO_PMIC_ARB_OBS2_CHNL200_CONFIG_ADDR A:0xe626404
y.create.l HWIO_PMIC_ARB_OBS2_CHNL201_CONFIG_ADDR A:0xe626484
y.create.l HWIO_PMIC_ARB_OBS2_CHNL202_CONFIG_ADDR A:0xe626504
y.create.l HWIO_PMIC_ARB_OBS2_CHNL203_CONFIG_ADDR A:0xe626584
y.create.l HWIO_PMIC_ARB_OBS2_CHNL204_CONFIG_ADDR A:0xe626604
y.create.l HWIO_PMIC_ARB_OBS2_CHNL205_CONFIG_ADDR A:0xe626684
y.create.l HWIO_PMIC_ARB_OBS2_CHNL206_CONFIG_ADDR A:0xe626704
y.create.l HWIO_PMIC_ARB_OBS2_CHNL207_CONFIG_ADDR A:0xe626784
y.create.l HWIO_PMIC_ARB_OBS2_CHNL208_CONFIG_ADDR A:0xe626804
y.create.l HWIO_PMIC_ARB_OBS2_CHNL209_CONFIG_ADDR A:0xe626884
y.create.l HWIO_PMIC_ARB_OBS2_CHNL210_CONFIG_ADDR A:0xe626904
y.create.l HWIO_PMIC_ARB_OBS2_CHNL211_CONFIG_ADDR A:0xe626984
y.create.l HWIO_PMIC_ARB_OBS2_CHNL212_CONFIG_ADDR A:0xe626a04
y.create.l HWIO_PMIC_ARB_OBS2_CHNL213_CONFIG_ADDR A:0xe626a84
y.create.l HWIO_PMIC_ARB_OBS2_CHNL214_CONFIG_ADDR A:0xe626b04
y.create.l HWIO_PMIC_ARB_OBS2_CHNL215_CONFIG_ADDR A:0xe626b84
y.create.l HWIO_PMIC_ARB_OBS2_CHNL216_CONFIG_ADDR A:0xe626c04
y.create.l HWIO_PMIC_ARB_OBS2_CHNL217_CONFIG_ADDR A:0xe626c84
y.create.l HWIO_PMIC_ARB_OBS2_CHNL218_CONFIG_ADDR A:0xe626d04
y.create.l HWIO_PMIC_ARB_OBS2_CHNL219_CONFIG_ADDR A:0xe626d84
y.create.l HWIO_PMIC_ARB_OBS2_CHNL220_CONFIG_ADDR A:0xe626e04
y.create.l HWIO_PMIC_ARB_OBS2_CHNL221_CONFIG_ADDR A:0xe626e84
y.create.l HWIO_PMIC_ARB_OBS2_CHNL222_CONFIG_ADDR A:0xe626f04
y.create.l HWIO_PMIC_ARB_OBS2_CHNL223_CONFIG_ADDR A:0xe626f84
y.create.l HWIO_PMIC_ARB_OBS2_CHNL224_CONFIG_ADDR A:0xe627004
y.create.l HWIO_PMIC_ARB_OBS2_CHNL225_CONFIG_ADDR A:0xe627084
y.create.l HWIO_PMIC_ARB_OBS2_CHNL226_CONFIG_ADDR A:0xe627104
y.create.l HWIO_PMIC_ARB_OBS2_CHNL227_CONFIG_ADDR A:0xe627184
y.create.l HWIO_PMIC_ARB_OBS2_CHNL228_CONFIG_ADDR A:0xe627204
y.create.l HWIO_PMIC_ARB_OBS2_CHNL229_CONFIG_ADDR A:0xe627284
y.create.l HWIO_PMIC_ARB_OBS2_CHNL230_CONFIG_ADDR A:0xe627304
y.create.l HWIO_PMIC_ARB_OBS2_CHNL231_CONFIG_ADDR A:0xe627384
y.create.l HWIO_PMIC_ARB_OBS2_CHNL232_CONFIG_ADDR A:0xe627404
y.create.l HWIO_PMIC_ARB_OBS2_CHNL233_CONFIG_ADDR A:0xe627484
y.create.l HWIO_PMIC_ARB_OBS2_CHNL234_CONFIG_ADDR A:0xe627504
y.create.l HWIO_PMIC_ARB_OBS2_CHNL235_CONFIG_ADDR A:0xe627584
y.create.l HWIO_PMIC_ARB_OBS2_CHNL236_CONFIG_ADDR A:0xe627604
y.create.l HWIO_PMIC_ARB_OBS2_CHNL237_CONFIG_ADDR A:0xe627684
y.create.l HWIO_PMIC_ARB_OBS2_CHNL238_CONFIG_ADDR A:0xe627704
y.create.l HWIO_PMIC_ARB_OBS2_CHNL239_CONFIG_ADDR A:0xe627784
y.create.l HWIO_PMIC_ARB_OBS2_CHNL240_CONFIG_ADDR A:0xe627804
y.create.l HWIO_PMIC_ARB_OBS2_CHNL241_CONFIG_ADDR A:0xe627884
y.create.l HWIO_PMIC_ARB_OBS2_CHNL242_CONFIG_ADDR A:0xe627904
y.create.l HWIO_PMIC_ARB_OBS2_CHNL243_CONFIG_ADDR A:0xe627984
y.create.l HWIO_PMIC_ARB_OBS2_CHNL244_CONFIG_ADDR A:0xe627a04
y.create.l HWIO_PMIC_ARB_OBS2_CHNL245_CONFIG_ADDR A:0xe627a84
y.create.l HWIO_PMIC_ARB_OBS2_CHNL246_CONFIG_ADDR A:0xe627b04
y.create.l HWIO_PMIC_ARB_OBS2_CHNL247_CONFIG_ADDR A:0xe627b84
y.create.l HWIO_PMIC_ARB_OBS2_CHNL248_CONFIG_ADDR A:0xe627c04
y.create.l HWIO_PMIC_ARB_OBS2_CHNL249_CONFIG_ADDR A:0xe627c84
y.create.l HWIO_PMIC_ARB_OBS2_CHNL250_CONFIG_ADDR A:0xe627d04
y.create.l HWIO_PMIC_ARB_OBS2_CHNL251_CONFIG_ADDR A:0xe627d84
y.create.l HWIO_PMIC_ARB_OBS2_CHNL252_CONFIG_ADDR A:0xe627e04
y.create.l HWIO_PMIC_ARB_OBS2_CHNL253_CONFIG_ADDR A:0xe627e84
y.create.l HWIO_PMIC_ARB_OBS2_CHNL254_CONFIG_ADDR A:0xe627f04
y.create.l HWIO_PMIC_ARB_OBS2_CHNL255_CONFIG_ADDR A:0xe627f84
y.create.l HWIO_PMIC_ARB_OBS3_CHNL0_CONFIG_ADDR A:0xe630004
y.create.l HWIO_PMIC_ARB_OBS3_CHNL1_CONFIG_ADDR A:0xe630084
y.create.l HWIO_PMIC_ARB_OBS3_CHNL2_CONFIG_ADDR A:0xe630104
y.create.l HWIO_PMIC_ARB_OBS3_CHNL3_CONFIG_ADDR A:0xe630184
y.create.l HWIO_PMIC_ARB_OBS3_CHNL4_CONFIG_ADDR A:0xe630204
y.create.l HWIO_PMIC_ARB_OBS3_CHNL5_CONFIG_ADDR A:0xe630284
y.create.l HWIO_PMIC_ARB_OBS3_CHNL6_CONFIG_ADDR A:0xe630304
y.create.l HWIO_PMIC_ARB_OBS3_CHNL7_CONFIG_ADDR A:0xe630384
y.create.l HWIO_PMIC_ARB_OBS3_CHNL8_CONFIG_ADDR A:0xe630404
y.create.l HWIO_PMIC_ARB_OBS3_CHNL9_CONFIG_ADDR A:0xe630484
y.create.l HWIO_PMIC_ARB_OBS3_CHNL10_CONFIG_ADDR A:0xe630504
y.create.l HWIO_PMIC_ARB_OBS3_CHNL11_CONFIG_ADDR A:0xe630584
y.create.l HWIO_PMIC_ARB_OBS3_CHNL12_CONFIG_ADDR A:0xe630604
y.create.l HWIO_PMIC_ARB_OBS3_CHNL13_CONFIG_ADDR A:0xe630684
y.create.l HWIO_PMIC_ARB_OBS3_CHNL14_CONFIG_ADDR A:0xe630704
y.create.l HWIO_PMIC_ARB_OBS3_CHNL15_CONFIG_ADDR A:0xe630784
y.create.l HWIO_PMIC_ARB_OBS3_CHNL16_CONFIG_ADDR A:0xe630804
y.create.l HWIO_PMIC_ARB_OBS3_CHNL17_CONFIG_ADDR A:0xe630884
y.create.l HWIO_PMIC_ARB_OBS3_CHNL18_CONFIG_ADDR A:0xe630904
y.create.l HWIO_PMIC_ARB_OBS3_CHNL19_CONFIG_ADDR A:0xe630984
y.create.l HWIO_PMIC_ARB_OBS3_CHNL20_CONFIG_ADDR A:0xe630a04
y.create.l HWIO_PMIC_ARB_OBS3_CHNL21_CONFIG_ADDR A:0xe630a84
y.create.l HWIO_PMIC_ARB_OBS3_CHNL22_CONFIG_ADDR A:0xe630b04
y.create.l HWIO_PMIC_ARB_OBS3_CHNL23_CONFIG_ADDR A:0xe630b84
y.create.l HWIO_PMIC_ARB_OBS3_CHNL24_CONFIG_ADDR A:0xe630c04
y.create.l HWIO_PMIC_ARB_OBS3_CHNL25_CONFIG_ADDR A:0xe630c84
y.create.l HWIO_PMIC_ARB_OBS3_CHNL26_CONFIG_ADDR A:0xe630d04
y.create.l HWIO_PMIC_ARB_OBS3_CHNL27_CONFIG_ADDR A:0xe630d84
y.create.l HWIO_PMIC_ARB_OBS3_CHNL28_CONFIG_ADDR A:0xe630e04
y.create.l HWIO_PMIC_ARB_OBS3_CHNL29_CONFIG_ADDR A:0xe630e84
y.create.l HWIO_PMIC_ARB_OBS3_CHNL30_CONFIG_ADDR A:0xe630f04
y.create.l HWIO_PMIC_ARB_OBS3_CHNL31_CONFIG_ADDR A:0xe630f84
y.create.l HWIO_PMIC_ARB_OBS3_CHNL32_CONFIG_ADDR A:0xe631004
y.create.l HWIO_PMIC_ARB_OBS3_CHNL33_CONFIG_ADDR A:0xe631084
y.create.l HWIO_PMIC_ARB_OBS3_CHNL34_CONFIG_ADDR A:0xe631104
y.create.l HWIO_PMIC_ARB_OBS3_CHNL35_CONFIG_ADDR A:0xe631184
y.create.l HWIO_PMIC_ARB_OBS3_CHNL36_CONFIG_ADDR A:0xe631204
y.create.l HWIO_PMIC_ARB_OBS3_CHNL37_CONFIG_ADDR A:0xe631284
y.create.l HWIO_PMIC_ARB_OBS3_CHNL38_CONFIG_ADDR A:0xe631304
y.create.l HWIO_PMIC_ARB_OBS3_CHNL39_CONFIG_ADDR A:0xe631384
y.create.l HWIO_PMIC_ARB_OBS3_CHNL40_CONFIG_ADDR A:0xe631404
y.create.l HWIO_PMIC_ARB_OBS3_CHNL41_CONFIG_ADDR A:0xe631484
y.create.l HWIO_PMIC_ARB_OBS3_CHNL42_CONFIG_ADDR A:0xe631504
y.create.l HWIO_PMIC_ARB_OBS3_CHNL43_CONFIG_ADDR A:0xe631584
y.create.l HWIO_PMIC_ARB_OBS3_CHNL44_CONFIG_ADDR A:0xe631604
y.create.l HWIO_PMIC_ARB_OBS3_CHNL45_CONFIG_ADDR A:0xe631684
y.create.l HWIO_PMIC_ARB_OBS3_CHNL46_CONFIG_ADDR A:0xe631704
y.create.l HWIO_PMIC_ARB_OBS3_CHNL47_CONFIG_ADDR A:0xe631784
y.create.l HWIO_PMIC_ARB_OBS3_CHNL48_CONFIG_ADDR A:0xe631804
y.create.l HWIO_PMIC_ARB_OBS3_CHNL49_CONFIG_ADDR A:0xe631884
y.create.l HWIO_PMIC_ARB_OBS3_CHNL50_CONFIG_ADDR A:0xe631904
y.create.l HWIO_PMIC_ARB_OBS3_CHNL51_CONFIG_ADDR A:0xe631984
y.create.l HWIO_PMIC_ARB_OBS3_CHNL52_CONFIG_ADDR A:0xe631a04
y.create.l HWIO_PMIC_ARB_OBS3_CHNL53_CONFIG_ADDR A:0xe631a84
y.create.l HWIO_PMIC_ARB_OBS3_CHNL54_CONFIG_ADDR A:0xe631b04
y.create.l HWIO_PMIC_ARB_OBS3_CHNL55_CONFIG_ADDR A:0xe631b84
y.create.l HWIO_PMIC_ARB_OBS3_CHNL56_CONFIG_ADDR A:0xe631c04
y.create.l HWIO_PMIC_ARB_OBS3_CHNL57_CONFIG_ADDR A:0xe631c84
y.create.l HWIO_PMIC_ARB_OBS3_CHNL58_CONFIG_ADDR A:0xe631d04
y.create.l HWIO_PMIC_ARB_OBS3_CHNL59_CONFIG_ADDR A:0xe631d84
y.create.l HWIO_PMIC_ARB_OBS3_CHNL60_CONFIG_ADDR A:0xe631e04
y.create.l HWIO_PMIC_ARB_OBS3_CHNL61_CONFIG_ADDR A:0xe631e84
y.create.l HWIO_PMIC_ARB_OBS3_CHNL62_CONFIG_ADDR A:0xe631f04
y.create.l HWIO_PMIC_ARB_OBS3_CHNL63_CONFIG_ADDR A:0xe631f84
y.create.l HWIO_PMIC_ARB_OBS3_CHNL64_CONFIG_ADDR A:0xe632004
y.create.l HWIO_PMIC_ARB_OBS3_CHNL65_CONFIG_ADDR A:0xe632084
y.create.l HWIO_PMIC_ARB_OBS3_CHNL66_CONFIG_ADDR A:0xe632104
y.create.l HWIO_PMIC_ARB_OBS3_CHNL67_CONFIG_ADDR A:0xe632184
y.create.l HWIO_PMIC_ARB_OBS3_CHNL68_CONFIG_ADDR A:0xe632204
y.create.l HWIO_PMIC_ARB_OBS3_CHNL69_CONFIG_ADDR A:0xe632284
y.create.l HWIO_PMIC_ARB_OBS3_CHNL70_CONFIG_ADDR A:0xe632304
y.create.l HWIO_PMIC_ARB_OBS3_CHNL71_CONFIG_ADDR A:0xe632384
y.create.l HWIO_PMIC_ARB_OBS3_CHNL72_CONFIG_ADDR A:0xe632404
y.create.l HWIO_PMIC_ARB_OBS3_CHNL73_CONFIG_ADDR A:0xe632484
y.create.l HWIO_PMIC_ARB_OBS3_CHNL74_CONFIG_ADDR A:0xe632504
y.create.l HWIO_PMIC_ARB_OBS3_CHNL75_CONFIG_ADDR A:0xe632584
y.create.l HWIO_PMIC_ARB_OBS3_CHNL76_CONFIG_ADDR A:0xe632604
y.create.l HWIO_PMIC_ARB_OBS3_CHNL77_CONFIG_ADDR A:0xe632684
y.create.l HWIO_PMIC_ARB_OBS3_CHNL78_CONFIG_ADDR A:0xe632704
y.create.l HWIO_PMIC_ARB_OBS3_CHNL79_CONFIG_ADDR A:0xe632784
y.create.l HWIO_PMIC_ARB_OBS3_CHNL80_CONFIG_ADDR A:0xe632804
y.create.l HWIO_PMIC_ARB_OBS3_CHNL81_CONFIG_ADDR A:0xe632884
y.create.l HWIO_PMIC_ARB_OBS3_CHNL82_CONFIG_ADDR A:0xe632904
y.create.l HWIO_PMIC_ARB_OBS3_CHNL83_CONFIG_ADDR A:0xe632984
y.create.l HWIO_PMIC_ARB_OBS3_CHNL84_CONFIG_ADDR A:0xe632a04
y.create.l HWIO_PMIC_ARB_OBS3_CHNL85_CONFIG_ADDR A:0xe632a84
y.create.l HWIO_PMIC_ARB_OBS3_CHNL86_CONFIG_ADDR A:0xe632b04
y.create.l HWIO_PMIC_ARB_OBS3_CHNL87_CONFIG_ADDR A:0xe632b84
y.create.l HWIO_PMIC_ARB_OBS3_CHNL88_CONFIG_ADDR A:0xe632c04
y.create.l HWIO_PMIC_ARB_OBS3_CHNL89_CONFIG_ADDR A:0xe632c84
y.create.l HWIO_PMIC_ARB_OBS3_CHNL90_CONFIG_ADDR A:0xe632d04
y.create.l HWIO_PMIC_ARB_OBS3_CHNL91_CONFIG_ADDR A:0xe632d84
y.create.l HWIO_PMIC_ARB_OBS3_CHNL92_CONFIG_ADDR A:0xe632e04
y.create.l HWIO_PMIC_ARB_OBS3_CHNL93_CONFIG_ADDR A:0xe632e84
y.create.l HWIO_PMIC_ARB_OBS3_CHNL94_CONFIG_ADDR A:0xe632f04
y.create.l HWIO_PMIC_ARB_OBS3_CHNL95_CONFIG_ADDR A:0xe632f84
y.create.l HWIO_PMIC_ARB_OBS3_CHNL96_CONFIG_ADDR A:0xe633004
y.create.l HWIO_PMIC_ARB_OBS3_CHNL97_CONFIG_ADDR A:0xe633084
y.create.l HWIO_PMIC_ARB_OBS3_CHNL98_CONFIG_ADDR A:0xe633104
y.create.l HWIO_PMIC_ARB_OBS3_CHNL99_CONFIG_ADDR A:0xe633184
y.create.l HWIO_PMIC_ARB_OBS3_CHNL100_CONFIG_ADDR A:0xe633204
y.create.l HWIO_PMIC_ARB_OBS3_CHNL101_CONFIG_ADDR A:0xe633284
y.create.l HWIO_PMIC_ARB_OBS3_CHNL102_CONFIG_ADDR A:0xe633304
y.create.l HWIO_PMIC_ARB_OBS3_CHNL103_CONFIG_ADDR A:0xe633384
y.create.l HWIO_PMIC_ARB_OBS3_CHNL104_CONFIG_ADDR A:0xe633404
y.create.l HWIO_PMIC_ARB_OBS3_CHNL105_CONFIG_ADDR A:0xe633484
y.create.l HWIO_PMIC_ARB_OBS3_CHNL106_CONFIG_ADDR A:0xe633504
y.create.l HWIO_PMIC_ARB_OBS3_CHNL107_CONFIG_ADDR A:0xe633584
y.create.l HWIO_PMIC_ARB_OBS3_CHNL108_CONFIG_ADDR A:0xe633604
y.create.l HWIO_PMIC_ARB_OBS3_CHNL109_CONFIG_ADDR A:0xe633684
y.create.l HWIO_PMIC_ARB_OBS3_CHNL110_CONFIG_ADDR A:0xe633704
y.create.l HWIO_PMIC_ARB_OBS3_CHNL111_CONFIG_ADDR A:0xe633784
y.create.l HWIO_PMIC_ARB_OBS3_CHNL112_CONFIG_ADDR A:0xe633804
y.create.l HWIO_PMIC_ARB_OBS3_CHNL113_CONFIG_ADDR A:0xe633884
y.create.l HWIO_PMIC_ARB_OBS3_CHNL114_CONFIG_ADDR A:0xe633904
y.create.l HWIO_PMIC_ARB_OBS3_CHNL115_CONFIG_ADDR A:0xe633984
y.create.l HWIO_PMIC_ARB_OBS3_CHNL116_CONFIG_ADDR A:0xe633a04
y.create.l HWIO_PMIC_ARB_OBS3_CHNL117_CONFIG_ADDR A:0xe633a84
y.create.l HWIO_PMIC_ARB_OBS3_CHNL118_CONFIG_ADDR A:0xe633b04
y.create.l HWIO_PMIC_ARB_OBS3_CHNL119_CONFIG_ADDR A:0xe633b84
y.create.l HWIO_PMIC_ARB_OBS3_CHNL120_CONFIG_ADDR A:0xe633c04
y.create.l HWIO_PMIC_ARB_OBS3_CHNL121_CONFIG_ADDR A:0xe633c84
y.create.l HWIO_PMIC_ARB_OBS3_CHNL122_CONFIG_ADDR A:0xe633d04
y.create.l HWIO_PMIC_ARB_OBS3_CHNL123_CONFIG_ADDR A:0xe633d84
y.create.l HWIO_PMIC_ARB_OBS3_CHNL124_CONFIG_ADDR A:0xe633e04
y.create.l HWIO_PMIC_ARB_OBS3_CHNL125_CONFIG_ADDR A:0xe633e84
y.create.l HWIO_PMIC_ARB_OBS3_CHNL126_CONFIG_ADDR A:0xe633f04
y.create.l HWIO_PMIC_ARB_OBS3_CHNL127_CONFIG_ADDR A:0xe633f84
y.create.l HWIO_PMIC_ARB_OBS3_CHNL128_CONFIG_ADDR A:0xe634004
y.create.l HWIO_PMIC_ARB_OBS3_CHNL129_CONFIG_ADDR A:0xe634084
y.create.l HWIO_PMIC_ARB_OBS3_CHNL130_CONFIG_ADDR A:0xe634104
y.create.l HWIO_PMIC_ARB_OBS3_CHNL131_CONFIG_ADDR A:0xe634184
y.create.l HWIO_PMIC_ARB_OBS3_CHNL132_CONFIG_ADDR A:0xe634204
y.create.l HWIO_PMIC_ARB_OBS3_CHNL133_CONFIG_ADDR A:0xe634284
y.create.l HWIO_PMIC_ARB_OBS3_CHNL134_CONFIG_ADDR A:0xe634304
y.create.l HWIO_PMIC_ARB_OBS3_CHNL135_CONFIG_ADDR A:0xe634384
y.create.l HWIO_PMIC_ARB_OBS3_CHNL136_CONFIG_ADDR A:0xe634404
y.create.l HWIO_PMIC_ARB_OBS3_CHNL137_CONFIG_ADDR A:0xe634484
y.create.l HWIO_PMIC_ARB_OBS3_CHNL138_CONFIG_ADDR A:0xe634504
y.create.l HWIO_PMIC_ARB_OBS3_CHNL139_CONFIG_ADDR A:0xe634584
y.create.l HWIO_PMIC_ARB_OBS3_CHNL140_CONFIG_ADDR A:0xe634604
y.create.l HWIO_PMIC_ARB_OBS3_CHNL141_CONFIG_ADDR A:0xe634684
y.create.l HWIO_PMIC_ARB_OBS3_CHNL142_CONFIG_ADDR A:0xe634704
y.create.l HWIO_PMIC_ARB_OBS3_CHNL143_CONFIG_ADDR A:0xe634784
y.create.l HWIO_PMIC_ARB_OBS3_CHNL144_CONFIG_ADDR A:0xe634804
y.create.l HWIO_PMIC_ARB_OBS3_CHNL145_CONFIG_ADDR A:0xe634884
y.create.l HWIO_PMIC_ARB_OBS3_CHNL146_CONFIG_ADDR A:0xe634904
y.create.l HWIO_PMIC_ARB_OBS3_CHNL147_CONFIG_ADDR A:0xe634984
y.create.l HWIO_PMIC_ARB_OBS3_CHNL148_CONFIG_ADDR A:0xe634a04
y.create.l HWIO_PMIC_ARB_OBS3_CHNL149_CONFIG_ADDR A:0xe634a84
y.create.l HWIO_PMIC_ARB_OBS3_CHNL150_CONFIG_ADDR A:0xe634b04
y.create.l HWIO_PMIC_ARB_OBS3_CHNL151_CONFIG_ADDR A:0xe634b84
y.create.l HWIO_PMIC_ARB_OBS3_CHNL152_CONFIG_ADDR A:0xe634c04
y.create.l HWIO_PMIC_ARB_OBS3_CHNL153_CONFIG_ADDR A:0xe634c84
y.create.l HWIO_PMIC_ARB_OBS3_CHNL154_CONFIG_ADDR A:0xe634d04
y.create.l HWIO_PMIC_ARB_OBS3_CHNL155_CONFIG_ADDR A:0xe634d84
y.create.l HWIO_PMIC_ARB_OBS3_CHNL156_CONFIG_ADDR A:0xe634e04
y.create.l HWIO_PMIC_ARB_OBS3_CHNL157_CONFIG_ADDR A:0xe634e84
y.create.l HWIO_PMIC_ARB_OBS3_CHNL158_CONFIG_ADDR A:0xe634f04
y.create.l HWIO_PMIC_ARB_OBS3_CHNL159_CONFIG_ADDR A:0xe634f84
y.create.l HWIO_PMIC_ARB_OBS3_CHNL160_CONFIG_ADDR A:0xe635004
y.create.l HWIO_PMIC_ARB_OBS3_CHNL161_CONFIG_ADDR A:0xe635084
y.create.l HWIO_PMIC_ARB_OBS3_CHNL162_CONFIG_ADDR A:0xe635104
y.create.l HWIO_PMIC_ARB_OBS3_CHNL163_CONFIG_ADDR A:0xe635184
y.create.l HWIO_PMIC_ARB_OBS3_CHNL164_CONFIG_ADDR A:0xe635204
y.create.l HWIO_PMIC_ARB_OBS3_CHNL165_CONFIG_ADDR A:0xe635284
y.create.l HWIO_PMIC_ARB_OBS3_CHNL166_CONFIG_ADDR A:0xe635304
y.create.l HWIO_PMIC_ARB_OBS3_CHNL167_CONFIG_ADDR A:0xe635384
y.create.l HWIO_PMIC_ARB_OBS3_CHNL168_CONFIG_ADDR A:0xe635404
y.create.l HWIO_PMIC_ARB_OBS3_CHNL169_CONFIG_ADDR A:0xe635484
y.create.l HWIO_PMIC_ARB_OBS3_CHNL170_CONFIG_ADDR A:0xe635504
y.create.l HWIO_PMIC_ARB_OBS3_CHNL171_CONFIG_ADDR A:0xe635584
y.create.l HWIO_PMIC_ARB_OBS3_CHNL172_CONFIG_ADDR A:0xe635604
y.create.l HWIO_PMIC_ARB_OBS3_CHNL173_CONFIG_ADDR A:0xe635684
y.create.l HWIO_PMIC_ARB_OBS3_CHNL174_CONFIG_ADDR A:0xe635704
y.create.l HWIO_PMIC_ARB_OBS3_CHNL175_CONFIG_ADDR A:0xe635784
y.create.l HWIO_PMIC_ARB_OBS3_CHNL176_CONFIG_ADDR A:0xe635804
y.create.l HWIO_PMIC_ARB_OBS3_CHNL177_CONFIG_ADDR A:0xe635884
y.create.l HWIO_PMIC_ARB_OBS3_CHNL178_CONFIG_ADDR A:0xe635904
y.create.l HWIO_PMIC_ARB_OBS3_CHNL179_CONFIG_ADDR A:0xe635984
y.create.l HWIO_PMIC_ARB_OBS3_CHNL180_CONFIG_ADDR A:0xe635a04
y.create.l HWIO_PMIC_ARB_OBS3_CHNL181_CONFIG_ADDR A:0xe635a84
y.create.l HWIO_PMIC_ARB_OBS3_CHNL182_CONFIG_ADDR A:0xe635b04
y.create.l HWIO_PMIC_ARB_OBS3_CHNL183_CONFIG_ADDR A:0xe635b84
y.create.l HWIO_PMIC_ARB_OBS3_CHNL184_CONFIG_ADDR A:0xe635c04
y.create.l HWIO_PMIC_ARB_OBS3_CHNL185_CONFIG_ADDR A:0xe635c84
y.create.l HWIO_PMIC_ARB_OBS3_CHNL186_CONFIG_ADDR A:0xe635d04
y.create.l HWIO_PMIC_ARB_OBS3_CHNL187_CONFIG_ADDR A:0xe635d84
y.create.l HWIO_PMIC_ARB_OBS3_CHNL188_CONFIG_ADDR A:0xe635e04
y.create.l HWIO_PMIC_ARB_OBS3_CHNL189_CONFIG_ADDR A:0xe635e84
y.create.l HWIO_PMIC_ARB_OBS3_CHNL190_CONFIG_ADDR A:0xe635f04
y.create.l HWIO_PMIC_ARB_OBS3_CHNL191_CONFIG_ADDR A:0xe635f84
y.create.l HWIO_PMIC_ARB_OBS3_CHNL192_CONFIG_ADDR A:0xe636004
y.create.l HWIO_PMIC_ARB_OBS3_CHNL193_CONFIG_ADDR A:0xe636084
y.create.l HWIO_PMIC_ARB_OBS3_CHNL194_CONFIG_ADDR A:0xe636104
y.create.l HWIO_PMIC_ARB_OBS3_CHNL195_CONFIG_ADDR A:0xe636184
y.create.l HWIO_PMIC_ARB_OBS3_CHNL196_CONFIG_ADDR A:0xe636204
y.create.l HWIO_PMIC_ARB_OBS3_CHNL197_CONFIG_ADDR A:0xe636284
y.create.l HWIO_PMIC_ARB_OBS3_CHNL198_CONFIG_ADDR A:0xe636304
y.create.l HWIO_PMIC_ARB_OBS3_CHNL199_CONFIG_ADDR A:0xe636384
y.create.l HWIO_PMIC_ARB_OBS3_CHNL200_CONFIG_ADDR A:0xe636404
y.create.l HWIO_PMIC_ARB_OBS3_CHNL201_CONFIG_ADDR A:0xe636484
y.create.l HWIO_PMIC_ARB_OBS3_CHNL202_CONFIG_ADDR A:0xe636504
y.create.l HWIO_PMIC_ARB_OBS3_CHNL203_CONFIG_ADDR A:0xe636584
y.create.l HWIO_PMIC_ARB_OBS3_CHNL204_CONFIG_ADDR A:0xe636604
y.create.l HWIO_PMIC_ARB_OBS3_CHNL205_CONFIG_ADDR A:0xe636684
y.create.l HWIO_PMIC_ARB_OBS3_CHNL206_CONFIG_ADDR A:0xe636704
y.create.l HWIO_PMIC_ARB_OBS3_CHNL207_CONFIG_ADDR A:0xe636784
y.create.l HWIO_PMIC_ARB_OBS3_CHNL208_CONFIG_ADDR A:0xe636804
y.create.l HWIO_PMIC_ARB_OBS3_CHNL209_CONFIG_ADDR A:0xe636884
y.create.l HWIO_PMIC_ARB_OBS3_CHNL210_CONFIG_ADDR A:0xe636904
y.create.l HWIO_PMIC_ARB_OBS3_CHNL211_CONFIG_ADDR A:0xe636984
y.create.l HWIO_PMIC_ARB_OBS3_CHNL212_CONFIG_ADDR A:0xe636a04
y.create.l HWIO_PMIC_ARB_OBS3_CHNL213_CONFIG_ADDR A:0xe636a84
y.create.l HWIO_PMIC_ARB_OBS3_CHNL214_CONFIG_ADDR A:0xe636b04
y.create.l HWIO_PMIC_ARB_OBS3_CHNL215_CONFIG_ADDR A:0xe636b84
y.create.l HWIO_PMIC_ARB_OBS3_CHNL216_CONFIG_ADDR A:0xe636c04
y.create.l HWIO_PMIC_ARB_OBS3_CHNL217_CONFIG_ADDR A:0xe636c84
y.create.l HWIO_PMIC_ARB_OBS3_CHNL218_CONFIG_ADDR A:0xe636d04
y.create.l HWIO_PMIC_ARB_OBS3_CHNL219_CONFIG_ADDR A:0xe636d84
y.create.l HWIO_PMIC_ARB_OBS3_CHNL220_CONFIG_ADDR A:0xe636e04
y.create.l HWIO_PMIC_ARB_OBS3_CHNL221_CONFIG_ADDR A:0xe636e84
y.create.l HWIO_PMIC_ARB_OBS3_CHNL222_CONFIG_ADDR A:0xe636f04
y.create.l HWIO_PMIC_ARB_OBS3_CHNL223_CONFIG_ADDR A:0xe636f84
y.create.l HWIO_PMIC_ARB_OBS3_CHNL224_CONFIG_ADDR A:0xe637004
y.create.l HWIO_PMIC_ARB_OBS3_CHNL225_CONFIG_ADDR A:0xe637084
y.create.l HWIO_PMIC_ARB_OBS3_CHNL226_CONFIG_ADDR A:0xe637104
y.create.l HWIO_PMIC_ARB_OBS3_CHNL227_CONFIG_ADDR A:0xe637184
y.create.l HWIO_PMIC_ARB_OBS3_CHNL228_CONFIG_ADDR A:0xe637204
y.create.l HWIO_PMIC_ARB_OBS3_CHNL229_CONFIG_ADDR A:0xe637284
y.create.l HWIO_PMIC_ARB_OBS3_CHNL230_CONFIG_ADDR A:0xe637304
y.create.l HWIO_PMIC_ARB_OBS3_CHNL231_CONFIG_ADDR A:0xe637384
y.create.l HWIO_PMIC_ARB_OBS3_CHNL232_CONFIG_ADDR A:0xe637404
y.create.l HWIO_PMIC_ARB_OBS3_CHNL233_CONFIG_ADDR A:0xe637484
y.create.l HWIO_PMIC_ARB_OBS3_CHNL234_CONFIG_ADDR A:0xe637504
y.create.l HWIO_PMIC_ARB_OBS3_CHNL235_CONFIG_ADDR A:0xe637584
y.create.l HWIO_PMIC_ARB_OBS3_CHNL236_CONFIG_ADDR A:0xe637604
y.create.l HWIO_PMIC_ARB_OBS3_CHNL237_CONFIG_ADDR A:0xe637684
y.create.l HWIO_PMIC_ARB_OBS3_CHNL238_CONFIG_ADDR A:0xe637704
y.create.l HWIO_PMIC_ARB_OBS3_CHNL239_CONFIG_ADDR A:0xe637784
y.create.l HWIO_PMIC_ARB_OBS3_CHNL240_CONFIG_ADDR A:0xe637804
y.create.l HWIO_PMIC_ARB_OBS3_CHNL241_CONFIG_ADDR A:0xe637884
y.create.l HWIO_PMIC_ARB_OBS3_CHNL242_CONFIG_ADDR A:0xe637904
y.create.l HWIO_PMIC_ARB_OBS3_CHNL243_CONFIG_ADDR A:0xe637984
y.create.l HWIO_PMIC_ARB_OBS3_CHNL244_CONFIG_ADDR A:0xe637a04
y.create.l HWIO_PMIC_ARB_OBS3_CHNL245_CONFIG_ADDR A:0xe637a84
y.create.l HWIO_PMIC_ARB_OBS3_CHNL246_CONFIG_ADDR A:0xe637b04
y.create.l HWIO_PMIC_ARB_OBS3_CHNL247_CONFIG_ADDR A:0xe637b84
y.create.l HWIO_PMIC_ARB_OBS3_CHNL248_CONFIG_ADDR A:0xe637c04
y.create.l HWIO_PMIC_ARB_OBS3_CHNL249_CONFIG_ADDR A:0xe637c84
y.create.l HWIO_PMIC_ARB_OBS3_CHNL250_CONFIG_ADDR A:0xe637d04
y.create.l HWIO_PMIC_ARB_OBS3_CHNL251_CONFIG_ADDR A:0xe637d84
y.create.l HWIO_PMIC_ARB_OBS3_CHNL252_CONFIG_ADDR A:0xe637e04
y.create.l HWIO_PMIC_ARB_OBS3_CHNL253_CONFIG_ADDR A:0xe637e84
y.create.l HWIO_PMIC_ARB_OBS3_CHNL254_CONFIG_ADDR A:0xe637f04
y.create.l HWIO_PMIC_ARB_OBS3_CHNL255_CONFIG_ADDR A:0xe637f84
y.create.l HWIO_PMIC_ARB_OBS4_CHNL0_CONFIG_ADDR A:0xe640004
y.create.l HWIO_PMIC_ARB_OBS4_CHNL1_CONFIG_ADDR A:0xe640084
y.create.l HWIO_PMIC_ARB_OBS4_CHNL2_CONFIG_ADDR A:0xe640104
y.create.l HWIO_PMIC_ARB_OBS4_CHNL3_CONFIG_ADDR A:0xe640184
y.create.l HWIO_PMIC_ARB_OBS4_CHNL4_CONFIG_ADDR A:0xe640204
y.create.l HWIO_PMIC_ARB_OBS4_CHNL5_CONFIG_ADDR A:0xe640284
y.create.l HWIO_PMIC_ARB_OBS4_CHNL6_CONFIG_ADDR A:0xe640304
y.create.l HWIO_PMIC_ARB_OBS4_CHNL7_CONFIG_ADDR A:0xe640384
y.create.l HWIO_PMIC_ARB_OBS4_CHNL8_CONFIG_ADDR A:0xe640404
y.create.l HWIO_PMIC_ARB_OBS4_CHNL9_CONFIG_ADDR A:0xe640484
y.create.l HWIO_PMIC_ARB_OBS4_CHNL10_CONFIG_ADDR A:0xe640504
y.create.l HWIO_PMIC_ARB_OBS4_CHNL11_CONFIG_ADDR A:0xe640584
y.create.l HWIO_PMIC_ARB_OBS4_CHNL12_CONFIG_ADDR A:0xe640604
y.create.l HWIO_PMIC_ARB_OBS4_CHNL13_CONFIG_ADDR A:0xe640684
y.create.l HWIO_PMIC_ARB_OBS4_CHNL14_CONFIG_ADDR A:0xe640704
y.create.l HWIO_PMIC_ARB_OBS4_CHNL15_CONFIG_ADDR A:0xe640784
y.create.l HWIO_PMIC_ARB_OBS4_CHNL16_CONFIG_ADDR A:0xe640804
y.create.l HWIO_PMIC_ARB_OBS4_CHNL17_CONFIG_ADDR A:0xe640884
y.create.l HWIO_PMIC_ARB_OBS4_CHNL18_CONFIG_ADDR A:0xe640904
y.create.l HWIO_PMIC_ARB_OBS4_CHNL19_CONFIG_ADDR A:0xe640984
y.create.l HWIO_PMIC_ARB_OBS4_CHNL20_CONFIG_ADDR A:0xe640a04
y.create.l HWIO_PMIC_ARB_OBS4_CHNL21_CONFIG_ADDR A:0xe640a84
y.create.l HWIO_PMIC_ARB_OBS4_CHNL22_CONFIG_ADDR A:0xe640b04
y.create.l HWIO_PMIC_ARB_OBS4_CHNL23_CONFIG_ADDR A:0xe640b84
y.create.l HWIO_PMIC_ARB_OBS4_CHNL24_CONFIG_ADDR A:0xe640c04
y.create.l HWIO_PMIC_ARB_OBS4_CHNL25_CONFIG_ADDR A:0xe640c84
y.create.l HWIO_PMIC_ARB_OBS4_CHNL26_CONFIG_ADDR A:0xe640d04
y.create.l HWIO_PMIC_ARB_OBS4_CHNL27_CONFIG_ADDR A:0xe640d84
y.create.l HWIO_PMIC_ARB_OBS4_CHNL28_CONFIG_ADDR A:0xe640e04
y.create.l HWIO_PMIC_ARB_OBS4_CHNL29_CONFIG_ADDR A:0xe640e84
y.create.l HWIO_PMIC_ARB_OBS4_CHNL30_CONFIG_ADDR A:0xe640f04
y.create.l HWIO_PMIC_ARB_OBS4_CHNL31_CONFIG_ADDR A:0xe640f84
y.create.l HWIO_PMIC_ARB_OBS4_CHNL32_CONFIG_ADDR A:0xe641004
y.create.l HWIO_PMIC_ARB_OBS4_CHNL33_CONFIG_ADDR A:0xe641084
y.create.l HWIO_PMIC_ARB_OBS4_CHNL34_CONFIG_ADDR A:0xe641104
y.create.l HWIO_PMIC_ARB_OBS4_CHNL35_CONFIG_ADDR A:0xe641184
y.create.l HWIO_PMIC_ARB_OBS4_CHNL36_CONFIG_ADDR A:0xe641204
y.create.l HWIO_PMIC_ARB_OBS4_CHNL37_CONFIG_ADDR A:0xe641284
y.create.l HWIO_PMIC_ARB_OBS4_CHNL38_CONFIG_ADDR A:0xe641304
y.create.l HWIO_PMIC_ARB_OBS4_CHNL39_CONFIG_ADDR A:0xe641384
y.create.l HWIO_PMIC_ARB_OBS4_CHNL40_CONFIG_ADDR A:0xe641404
y.create.l HWIO_PMIC_ARB_OBS4_CHNL41_CONFIG_ADDR A:0xe641484
y.create.l HWIO_PMIC_ARB_OBS4_CHNL42_CONFIG_ADDR A:0xe641504
y.create.l HWIO_PMIC_ARB_OBS4_CHNL43_CONFIG_ADDR A:0xe641584
y.create.l HWIO_PMIC_ARB_OBS4_CHNL44_CONFIG_ADDR A:0xe641604
y.create.l HWIO_PMIC_ARB_OBS4_CHNL45_CONFIG_ADDR A:0xe641684
y.create.l HWIO_PMIC_ARB_OBS4_CHNL46_CONFIG_ADDR A:0xe641704
y.create.l HWIO_PMIC_ARB_OBS4_CHNL47_CONFIG_ADDR A:0xe641784
y.create.l HWIO_PMIC_ARB_OBS4_CHNL48_CONFIG_ADDR A:0xe641804
y.create.l HWIO_PMIC_ARB_OBS4_CHNL49_CONFIG_ADDR A:0xe641884
y.create.l HWIO_PMIC_ARB_OBS4_CHNL50_CONFIG_ADDR A:0xe641904
y.create.l HWIO_PMIC_ARB_OBS4_CHNL51_CONFIG_ADDR A:0xe641984
y.create.l HWIO_PMIC_ARB_OBS4_CHNL52_CONFIG_ADDR A:0xe641a04
y.create.l HWIO_PMIC_ARB_OBS4_CHNL53_CONFIG_ADDR A:0xe641a84
y.create.l HWIO_PMIC_ARB_OBS4_CHNL54_CONFIG_ADDR A:0xe641b04
y.create.l HWIO_PMIC_ARB_OBS4_CHNL55_CONFIG_ADDR A:0xe641b84
y.create.l HWIO_PMIC_ARB_OBS4_CHNL56_CONFIG_ADDR A:0xe641c04
y.create.l HWIO_PMIC_ARB_OBS4_CHNL57_CONFIG_ADDR A:0xe641c84
y.create.l HWIO_PMIC_ARB_OBS4_CHNL58_CONFIG_ADDR A:0xe641d04
y.create.l HWIO_PMIC_ARB_OBS4_CHNL59_CONFIG_ADDR A:0xe641d84
y.create.l HWIO_PMIC_ARB_OBS4_CHNL60_CONFIG_ADDR A:0xe641e04
y.create.l HWIO_PMIC_ARB_OBS4_CHNL61_CONFIG_ADDR A:0xe641e84
y.create.l HWIO_PMIC_ARB_OBS4_CHNL62_CONFIG_ADDR A:0xe641f04
y.create.l HWIO_PMIC_ARB_OBS4_CHNL63_CONFIG_ADDR A:0xe641f84
y.create.l HWIO_PMIC_ARB_OBS4_CHNL64_CONFIG_ADDR A:0xe642004
y.create.l HWIO_PMIC_ARB_OBS4_CHNL65_CONFIG_ADDR A:0xe642084
y.create.l HWIO_PMIC_ARB_OBS4_CHNL66_CONFIG_ADDR A:0xe642104
y.create.l HWIO_PMIC_ARB_OBS4_CHNL67_CONFIG_ADDR A:0xe642184
y.create.l HWIO_PMIC_ARB_OBS4_CHNL68_CONFIG_ADDR A:0xe642204
y.create.l HWIO_PMIC_ARB_OBS4_CHNL69_CONFIG_ADDR A:0xe642284
y.create.l HWIO_PMIC_ARB_OBS4_CHNL70_CONFIG_ADDR A:0xe642304
y.create.l HWIO_PMIC_ARB_OBS4_CHNL71_CONFIG_ADDR A:0xe642384
y.create.l HWIO_PMIC_ARB_OBS4_CHNL72_CONFIG_ADDR A:0xe642404
y.create.l HWIO_PMIC_ARB_OBS4_CHNL73_CONFIG_ADDR A:0xe642484
y.create.l HWIO_PMIC_ARB_OBS4_CHNL74_CONFIG_ADDR A:0xe642504
y.create.l HWIO_PMIC_ARB_OBS4_CHNL75_CONFIG_ADDR A:0xe642584
y.create.l HWIO_PMIC_ARB_OBS4_CHNL76_CONFIG_ADDR A:0xe642604
y.create.l HWIO_PMIC_ARB_OBS4_CHNL77_CONFIG_ADDR A:0xe642684
y.create.l HWIO_PMIC_ARB_OBS4_CHNL78_CONFIG_ADDR A:0xe642704
y.create.l HWIO_PMIC_ARB_OBS4_CHNL79_CONFIG_ADDR A:0xe642784
y.create.l HWIO_PMIC_ARB_OBS4_CHNL80_CONFIG_ADDR A:0xe642804
y.create.l HWIO_PMIC_ARB_OBS4_CHNL81_CONFIG_ADDR A:0xe642884
y.create.l HWIO_PMIC_ARB_OBS4_CHNL82_CONFIG_ADDR A:0xe642904
y.create.l HWIO_PMIC_ARB_OBS4_CHNL83_CONFIG_ADDR A:0xe642984
y.create.l HWIO_PMIC_ARB_OBS4_CHNL84_CONFIG_ADDR A:0xe642a04
y.create.l HWIO_PMIC_ARB_OBS4_CHNL85_CONFIG_ADDR A:0xe642a84
y.create.l HWIO_PMIC_ARB_OBS4_CHNL86_CONFIG_ADDR A:0xe642b04
y.create.l HWIO_PMIC_ARB_OBS4_CHNL87_CONFIG_ADDR A:0xe642b84
y.create.l HWIO_PMIC_ARB_OBS4_CHNL88_CONFIG_ADDR A:0xe642c04
y.create.l HWIO_PMIC_ARB_OBS4_CHNL89_CONFIG_ADDR A:0xe642c84
y.create.l HWIO_PMIC_ARB_OBS4_CHNL90_CONFIG_ADDR A:0xe642d04
y.create.l HWIO_PMIC_ARB_OBS4_CHNL91_CONFIG_ADDR A:0xe642d84
y.create.l HWIO_PMIC_ARB_OBS4_CHNL92_CONFIG_ADDR A:0xe642e04
y.create.l HWIO_PMIC_ARB_OBS4_CHNL93_CONFIG_ADDR A:0xe642e84
y.create.l HWIO_PMIC_ARB_OBS4_CHNL94_CONFIG_ADDR A:0xe642f04
y.create.l HWIO_PMIC_ARB_OBS4_CHNL95_CONFIG_ADDR A:0xe642f84
y.create.l HWIO_PMIC_ARB_OBS4_CHNL96_CONFIG_ADDR A:0xe643004
y.create.l HWIO_PMIC_ARB_OBS4_CHNL97_CONFIG_ADDR A:0xe643084
y.create.l HWIO_PMIC_ARB_OBS4_CHNL98_CONFIG_ADDR A:0xe643104
y.create.l HWIO_PMIC_ARB_OBS4_CHNL99_CONFIG_ADDR A:0xe643184
y.create.l HWIO_PMIC_ARB_OBS4_CHNL100_CONFIG_ADDR A:0xe643204
y.create.l HWIO_PMIC_ARB_OBS4_CHNL101_CONFIG_ADDR A:0xe643284
y.create.l HWIO_PMIC_ARB_OBS4_CHNL102_CONFIG_ADDR A:0xe643304
y.create.l HWIO_PMIC_ARB_OBS4_CHNL103_CONFIG_ADDR A:0xe643384
y.create.l HWIO_PMIC_ARB_OBS4_CHNL104_CONFIG_ADDR A:0xe643404
y.create.l HWIO_PMIC_ARB_OBS4_CHNL105_CONFIG_ADDR A:0xe643484
y.create.l HWIO_PMIC_ARB_OBS4_CHNL106_CONFIG_ADDR A:0xe643504
y.create.l HWIO_PMIC_ARB_OBS4_CHNL107_CONFIG_ADDR A:0xe643584
y.create.l HWIO_PMIC_ARB_OBS4_CHNL108_CONFIG_ADDR A:0xe643604
y.create.l HWIO_PMIC_ARB_OBS4_CHNL109_CONFIG_ADDR A:0xe643684
y.create.l HWIO_PMIC_ARB_OBS4_CHNL110_CONFIG_ADDR A:0xe643704
y.create.l HWIO_PMIC_ARB_OBS4_CHNL111_CONFIG_ADDR A:0xe643784
y.create.l HWIO_PMIC_ARB_OBS4_CHNL112_CONFIG_ADDR A:0xe643804
y.create.l HWIO_PMIC_ARB_OBS4_CHNL113_CONFIG_ADDR A:0xe643884
y.create.l HWIO_PMIC_ARB_OBS4_CHNL114_CONFIG_ADDR A:0xe643904
y.create.l HWIO_PMIC_ARB_OBS4_CHNL115_CONFIG_ADDR A:0xe643984
y.create.l HWIO_PMIC_ARB_OBS4_CHNL116_CONFIG_ADDR A:0xe643a04
y.create.l HWIO_PMIC_ARB_OBS4_CHNL117_CONFIG_ADDR A:0xe643a84
y.create.l HWIO_PMIC_ARB_OBS4_CHNL118_CONFIG_ADDR A:0xe643b04
y.create.l HWIO_PMIC_ARB_OBS4_CHNL119_CONFIG_ADDR A:0xe643b84
y.create.l HWIO_PMIC_ARB_OBS4_CHNL120_CONFIG_ADDR A:0xe643c04
y.create.l HWIO_PMIC_ARB_OBS4_CHNL121_CONFIG_ADDR A:0xe643c84
y.create.l HWIO_PMIC_ARB_OBS4_CHNL122_CONFIG_ADDR A:0xe643d04
y.create.l HWIO_PMIC_ARB_OBS4_CHNL123_CONFIG_ADDR A:0xe643d84
y.create.l HWIO_PMIC_ARB_OBS4_CHNL124_CONFIG_ADDR A:0xe643e04
y.create.l HWIO_PMIC_ARB_OBS4_CHNL125_CONFIG_ADDR A:0xe643e84
y.create.l HWIO_PMIC_ARB_OBS4_CHNL126_CONFIG_ADDR A:0xe643f04
y.create.l HWIO_PMIC_ARB_OBS4_CHNL127_CONFIG_ADDR A:0xe643f84
y.create.l HWIO_PMIC_ARB_OBS4_CHNL128_CONFIG_ADDR A:0xe644004
y.create.l HWIO_PMIC_ARB_OBS4_CHNL129_CONFIG_ADDR A:0xe644084
y.create.l HWIO_PMIC_ARB_OBS4_CHNL130_CONFIG_ADDR A:0xe644104
y.create.l HWIO_PMIC_ARB_OBS4_CHNL131_CONFIG_ADDR A:0xe644184
y.create.l HWIO_PMIC_ARB_OBS4_CHNL132_CONFIG_ADDR A:0xe644204
y.create.l HWIO_PMIC_ARB_OBS4_CHNL133_CONFIG_ADDR A:0xe644284
y.create.l HWIO_PMIC_ARB_OBS4_CHNL134_CONFIG_ADDR A:0xe644304
y.create.l HWIO_PMIC_ARB_OBS4_CHNL135_CONFIG_ADDR A:0xe644384
y.create.l HWIO_PMIC_ARB_OBS4_CHNL136_CONFIG_ADDR A:0xe644404
y.create.l HWIO_PMIC_ARB_OBS4_CHNL137_CONFIG_ADDR A:0xe644484
y.create.l HWIO_PMIC_ARB_OBS4_CHNL138_CONFIG_ADDR A:0xe644504
y.create.l HWIO_PMIC_ARB_OBS4_CHNL139_CONFIG_ADDR A:0xe644584
y.create.l HWIO_PMIC_ARB_OBS4_CHNL140_CONFIG_ADDR A:0xe644604
y.create.l HWIO_PMIC_ARB_OBS4_CHNL141_CONFIG_ADDR A:0xe644684
y.create.l HWIO_PMIC_ARB_OBS4_CHNL142_CONFIG_ADDR A:0xe644704
y.create.l HWIO_PMIC_ARB_OBS4_CHNL143_CONFIG_ADDR A:0xe644784
y.create.l HWIO_PMIC_ARB_OBS4_CHNL144_CONFIG_ADDR A:0xe644804
y.create.l HWIO_PMIC_ARB_OBS4_CHNL145_CONFIG_ADDR A:0xe644884
y.create.l HWIO_PMIC_ARB_OBS4_CHNL146_CONFIG_ADDR A:0xe644904
y.create.l HWIO_PMIC_ARB_OBS4_CHNL147_CONFIG_ADDR A:0xe644984
y.create.l HWIO_PMIC_ARB_OBS4_CHNL148_CONFIG_ADDR A:0xe644a04
y.create.l HWIO_PMIC_ARB_OBS4_CHNL149_CONFIG_ADDR A:0xe644a84
y.create.l HWIO_PMIC_ARB_OBS4_CHNL150_CONFIG_ADDR A:0xe644b04
y.create.l HWIO_PMIC_ARB_OBS4_CHNL151_CONFIG_ADDR A:0xe644b84
y.create.l HWIO_PMIC_ARB_OBS4_CHNL152_CONFIG_ADDR A:0xe644c04
y.create.l HWIO_PMIC_ARB_OBS4_CHNL153_CONFIG_ADDR A:0xe644c84
y.create.l HWIO_PMIC_ARB_OBS4_CHNL154_CONFIG_ADDR A:0xe644d04
y.create.l HWIO_PMIC_ARB_OBS4_CHNL155_CONFIG_ADDR A:0xe644d84
y.create.l HWIO_PMIC_ARB_OBS4_CHNL156_CONFIG_ADDR A:0xe644e04
y.create.l HWIO_PMIC_ARB_OBS4_CHNL157_CONFIG_ADDR A:0xe644e84
y.create.l HWIO_PMIC_ARB_OBS4_CHNL158_CONFIG_ADDR A:0xe644f04
y.create.l HWIO_PMIC_ARB_OBS4_CHNL159_CONFIG_ADDR A:0xe644f84
y.create.l HWIO_PMIC_ARB_OBS4_CHNL160_CONFIG_ADDR A:0xe645004
y.create.l HWIO_PMIC_ARB_OBS4_CHNL161_CONFIG_ADDR A:0xe645084
y.create.l HWIO_PMIC_ARB_OBS4_CHNL162_CONFIG_ADDR A:0xe645104
y.create.l HWIO_PMIC_ARB_OBS4_CHNL163_CONFIG_ADDR A:0xe645184
y.create.l HWIO_PMIC_ARB_OBS4_CHNL164_CONFIG_ADDR A:0xe645204
y.create.l HWIO_PMIC_ARB_OBS4_CHNL165_CONFIG_ADDR A:0xe645284
y.create.l HWIO_PMIC_ARB_OBS4_CHNL166_CONFIG_ADDR A:0xe645304
y.create.l HWIO_PMIC_ARB_OBS4_CHNL167_CONFIG_ADDR A:0xe645384
y.create.l HWIO_PMIC_ARB_OBS4_CHNL168_CONFIG_ADDR A:0xe645404
y.create.l HWIO_PMIC_ARB_OBS4_CHNL169_CONFIG_ADDR A:0xe645484
y.create.l HWIO_PMIC_ARB_OBS4_CHNL170_CONFIG_ADDR A:0xe645504
y.create.l HWIO_PMIC_ARB_OBS4_CHNL171_CONFIG_ADDR A:0xe645584
y.create.l HWIO_PMIC_ARB_OBS4_CHNL172_CONFIG_ADDR A:0xe645604
y.create.l HWIO_PMIC_ARB_OBS4_CHNL173_CONFIG_ADDR A:0xe645684
y.create.l HWIO_PMIC_ARB_OBS4_CHNL174_CONFIG_ADDR A:0xe645704
y.create.l HWIO_PMIC_ARB_OBS4_CHNL175_CONFIG_ADDR A:0xe645784
y.create.l HWIO_PMIC_ARB_OBS4_CHNL176_CONFIG_ADDR A:0xe645804
y.create.l HWIO_PMIC_ARB_OBS4_CHNL177_CONFIG_ADDR A:0xe645884
y.create.l HWIO_PMIC_ARB_OBS4_CHNL178_CONFIG_ADDR A:0xe645904
y.create.l HWIO_PMIC_ARB_OBS4_CHNL179_CONFIG_ADDR A:0xe645984
y.create.l HWIO_PMIC_ARB_OBS4_CHNL180_CONFIG_ADDR A:0xe645a04
y.create.l HWIO_PMIC_ARB_OBS4_CHNL181_CONFIG_ADDR A:0xe645a84
y.create.l HWIO_PMIC_ARB_OBS4_CHNL182_CONFIG_ADDR A:0xe645b04
y.create.l HWIO_PMIC_ARB_OBS4_CHNL183_CONFIG_ADDR A:0xe645b84
y.create.l HWIO_PMIC_ARB_OBS4_CHNL184_CONFIG_ADDR A:0xe645c04
y.create.l HWIO_PMIC_ARB_OBS4_CHNL185_CONFIG_ADDR A:0xe645c84
y.create.l HWIO_PMIC_ARB_OBS4_CHNL186_CONFIG_ADDR A:0xe645d04
y.create.l HWIO_PMIC_ARB_OBS4_CHNL187_CONFIG_ADDR A:0xe645d84
y.create.l HWIO_PMIC_ARB_OBS4_CHNL188_CONFIG_ADDR A:0xe645e04
y.create.l HWIO_PMIC_ARB_OBS4_CHNL189_CONFIG_ADDR A:0xe645e84
y.create.l HWIO_PMIC_ARB_OBS4_CHNL190_CONFIG_ADDR A:0xe645f04
y.create.l HWIO_PMIC_ARB_OBS4_CHNL191_CONFIG_ADDR A:0xe645f84
y.create.l HWIO_PMIC_ARB_OBS4_CHNL192_CONFIG_ADDR A:0xe646004
y.create.l HWIO_PMIC_ARB_OBS4_CHNL193_CONFIG_ADDR A:0xe646084
y.create.l HWIO_PMIC_ARB_OBS4_CHNL194_CONFIG_ADDR A:0xe646104
y.create.l HWIO_PMIC_ARB_OBS4_CHNL195_CONFIG_ADDR A:0xe646184
y.create.l HWIO_PMIC_ARB_OBS4_CHNL196_CONFIG_ADDR A:0xe646204
y.create.l HWIO_PMIC_ARB_OBS4_CHNL197_CONFIG_ADDR A:0xe646284
y.create.l HWIO_PMIC_ARB_OBS4_CHNL198_CONFIG_ADDR A:0xe646304
y.create.l HWIO_PMIC_ARB_OBS4_CHNL199_CONFIG_ADDR A:0xe646384
y.create.l HWIO_PMIC_ARB_OBS4_CHNL200_CONFIG_ADDR A:0xe646404
y.create.l HWIO_PMIC_ARB_OBS4_CHNL201_CONFIG_ADDR A:0xe646484
y.create.l HWIO_PMIC_ARB_OBS4_CHNL202_CONFIG_ADDR A:0xe646504
y.create.l HWIO_PMIC_ARB_OBS4_CHNL203_CONFIG_ADDR A:0xe646584
y.create.l HWIO_PMIC_ARB_OBS4_CHNL204_CONFIG_ADDR A:0xe646604
y.create.l HWIO_PMIC_ARB_OBS4_CHNL205_CONFIG_ADDR A:0xe646684
y.create.l HWIO_PMIC_ARB_OBS4_CHNL206_CONFIG_ADDR A:0xe646704
y.create.l HWIO_PMIC_ARB_OBS4_CHNL207_CONFIG_ADDR A:0xe646784
y.create.l HWIO_PMIC_ARB_OBS4_CHNL208_CONFIG_ADDR A:0xe646804
y.create.l HWIO_PMIC_ARB_OBS4_CHNL209_CONFIG_ADDR A:0xe646884
y.create.l HWIO_PMIC_ARB_OBS4_CHNL210_CONFIG_ADDR A:0xe646904
y.create.l HWIO_PMIC_ARB_OBS4_CHNL211_CONFIG_ADDR A:0xe646984
y.create.l HWIO_PMIC_ARB_OBS4_CHNL212_CONFIG_ADDR A:0xe646a04
y.create.l HWIO_PMIC_ARB_OBS4_CHNL213_CONFIG_ADDR A:0xe646a84
y.create.l HWIO_PMIC_ARB_OBS4_CHNL214_CONFIG_ADDR A:0xe646b04
y.create.l HWIO_PMIC_ARB_OBS4_CHNL215_CONFIG_ADDR A:0xe646b84
y.create.l HWIO_PMIC_ARB_OBS4_CHNL216_CONFIG_ADDR A:0xe646c04
y.create.l HWIO_PMIC_ARB_OBS4_CHNL217_CONFIG_ADDR A:0xe646c84
y.create.l HWIO_PMIC_ARB_OBS4_CHNL218_CONFIG_ADDR A:0xe646d04
y.create.l HWIO_PMIC_ARB_OBS4_CHNL219_CONFIG_ADDR A:0xe646d84
y.create.l HWIO_PMIC_ARB_OBS4_CHNL220_CONFIG_ADDR A:0xe646e04
y.create.l HWIO_PMIC_ARB_OBS4_CHNL221_CONFIG_ADDR A:0xe646e84
y.create.l HWIO_PMIC_ARB_OBS4_CHNL222_CONFIG_ADDR A:0xe646f04
y.create.l HWIO_PMIC_ARB_OBS4_CHNL223_CONFIG_ADDR A:0xe646f84
y.create.l HWIO_PMIC_ARB_OBS4_CHNL224_CONFIG_ADDR A:0xe647004
y.create.l HWIO_PMIC_ARB_OBS4_CHNL225_CONFIG_ADDR A:0xe647084
y.create.l HWIO_PMIC_ARB_OBS4_CHNL226_CONFIG_ADDR A:0xe647104
y.create.l HWIO_PMIC_ARB_OBS4_CHNL227_CONFIG_ADDR A:0xe647184
y.create.l HWIO_PMIC_ARB_OBS4_CHNL228_CONFIG_ADDR A:0xe647204
y.create.l HWIO_PMIC_ARB_OBS4_CHNL229_CONFIG_ADDR A:0xe647284
y.create.l HWIO_PMIC_ARB_OBS4_CHNL230_CONFIG_ADDR A:0xe647304
y.create.l HWIO_PMIC_ARB_OBS4_CHNL231_CONFIG_ADDR A:0xe647384
y.create.l HWIO_PMIC_ARB_OBS4_CHNL232_CONFIG_ADDR A:0xe647404
y.create.l HWIO_PMIC_ARB_OBS4_CHNL233_CONFIG_ADDR A:0xe647484
y.create.l HWIO_PMIC_ARB_OBS4_CHNL234_CONFIG_ADDR A:0xe647504
y.create.l HWIO_PMIC_ARB_OBS4_CHNL235_CONFIG_ADDR A:0xe647584
y.create.l HWIO_PMIC_ARB_OBS4_CHNL236_CONFIG_ADDR A:0xe647604
y.create.l HWIO_PMIC_ARB_OBS4_CHNL237_CONFIG_ADDR A:0xe647684
y.create.l HWIO_PMIC_ARB_OBS4_CHNL238_CONFIG_ADDR A:0xe647704
y.create.l HWIO_PMIC_ARB_OBS4_CHNL239_CONFIG_ADDR A:0xe647784
y.create.l HWIO_PMIC_ARB_OBS4_CHNL240_CONFIG_ADDR A:0xe647804
y.create.l HWIO_PMIC_ARB_OBS4_CHNL241_CONFIG_ADDR A:0xe647884
y.create.l HWIO_PMIC_ARB_OBS4_CHNL242_CONFIG_ADDR A:0xe647904
y.create.l HWIO_PMIC_ARB_OBS4_CHNL243_CONFIG_ADDR A:0xe647984
y.create.l HWIO_PMIC_ARB_OBS4_CHNL244_CONFIG_ADDR A:0xe647a04
y.create.l HWIO_PMIC_ARB_OBS4_CHNL245_CONFIG_ADDR A:0xe647a84
y.create.l HWIO_PMIC_ARB_OBS4_CHNL246_CONFIG_ADDR A:0xe647b04
y.create.l HWIO_PMIC_ARB_OBS4_CHNL247_CONFIG_ADDR A:0xe647b84
y.create.l HWIO_PMIC_ARB_OBS4_CHNL248_CONFIG_ADDR A:0xe647c04
y.create.l HWIO_PMIC_ARB_OBS4_CHNL249_CONFIG_ADDR A:0xe647c84
y.create.l HWIO_PMIC_ARB_OBS4_CHNL250_CONFIG_ADDR A:0xe647d04
y.create.l HWIO_PMIC_ARB_OBS4_CHNL251_CONFIG_ADDR A:0xe647d84
y.create.l HWIO_PMIC_ARB_OBS4_CHNL252_CONFIG_ADDR A:0xe647e04
y.create.l HWIO_PMIC_ARB_OBS4_CHNL253_CONFIG_ADDR A:0xe647e84
y.create.l HWIO_PMIC_ARB_OBS4_CHNL254_CONFIG_ADDR A:0xe647f04
y.create.l HWIO_PMIC_ARB_OBS4_CHNL255_CONFIG_ADDR A:0xe647f84
y.create.l HWIO_PMIC_ARB_OBS0_CHNL0_STATUS_ADDR A:0xe600008
y.create.l HWIO_PMIC_ARB_OBS0_CHNL1_STATUS_ADDR A:0xe600088
y.create.l HWIO_PMIC_ARB_OBS0_CHNL2_STATUS_ADDR A:0xe600108
y.create.l HWIO_PMIC_ARB_OBS0_CHNL3_STATUS_ADDR A:0xe600188
y.create.l HWIO_PMIC_ARB_OBS0_CHNL4_STATUS_ADDR A:0xe600208
y.create.l HWIO_PMIC_ARB_OBS0_CHNL5_STATUS_ADDR A:0xe600288
y.create.l HWIO_PMIC_ARB_OBS0_CHNL6_STATUS_ADDR A:0xe600308
y.create.l HWIO_PMIC_ARB_OBS0_CHNL7_STATUS_ADDR A:0xe600388
y.create.l HWIO_PMIC_ARB_OBS0_CHNL8_STATUS_ADDR A:0xe600408
y.create.l HWIO_PMIC_ARB_OBS0_CHNL9_STATUS_ADDR A:0xe600488
y.create.l HWIO_PMIC_ARB_OBS0_CHNL10_STATUS_ADDR A:0xe600508
y.create.l HWIO_PMIC_ARB_OBS0_CHNL11_STATUS_ADDR A:0xe600588
y.create.l HWIO_PMIC_ARB_OBS0_CHNL12_STATUS_ADDR A:0xe600608
y.create.l HWIO_PMIC_ARB_OBS0_CHNL13_STATUS_ADDR A:0xe600688
y.create.l HWIO_PMIC_ARB_OBS0_CHNL14_STATUS_ADDR A:0xe600708
y.create.l HWIO_PMIC_ARB_OBS0_CHNL15_STATUS_ADDR A:0xe600788
y.create.l HWIO_PMIC_ARB_OBS0_CHNL16_STATUS_ADDR A:0xe600808
y.create.l HWIO_PMIC_ARB_OBS0_CHNL17_STATUS_ADDR A:0xe600888
y.create.l HWIO_PMIC_ARB_OBS0_CHNL18_STATUS_ADDR A:0xe600908
y.create.l HWIO_PMIC_ARB_OBS0_CHNL19_STATUS_ADDR A:0xe600988
y.create.l HWIO_PMIC_ARB_OBS0_CHNL20_STATUS_ADDR A:0xe600a08
y.create.l HWIO_PMIC_ARB_OBS0_CHNL21_STATUS_ADDR A:0xe600a88
y.create.l HWIO_PMIC_ARB_OBS0_CHNL22_STATUS_ADDR A:0xe600b08
y.create.l HWIO_PMIC_ARB_OBS0_CHNL23_STATUS_ADDR A:0xe600b88
y.create.l HWIO_PMIC_ARB_OBS0_CHNL24_STATUS_ADDR A:0xe600c08
y.create.l HWIO_PMIC_ARB_OBS0_CHNL25_STATUS_ADDR A:0xe600c88
y.create.l HWIO_PMIC_ARB_OBS0_CHNL26_STATUS_ADDR A:0xe600d08
y.create.l HWIO_PMIC_ARB_OBS0_CHNL27_STATUS_ADDR A:0xe600d88
y.create.l HWIO_PMIC_ARB_OBS0_CHNL28_STATUS_ADDR A:0xe600e08
y.create.l HWIO_PMIC_ARB_OBS0_CHNL29_STATUS_ADDR A:0xe600e88
y.create.l HWIO_PMIC_ARB_OBS0_CHNL30_STATUS_ADDR A:0xe600f08
y.create.l HWIO_PMIC_ARB_OBS0_CHNL31_STATUS_ADDR A:0xe600f88
y.create.l HWIO_PMIC_ARB_OBS0_CHNL32_STATUS_ADDR A:0xe601008
y.create.l HWIO_PMIC_ARB_OBS0_CHNL33_STATUS_ADDR A:0xe601088
y.create.l HWIO_PMIC_ARB_OBS0_CHNL34_STATUS_ADDR A:0xe601108
y.create.l HWIO_PMIC_ARB_OBS0_CHNL35_STATUS_ADDR A:0xe601188
y.create.l HWIO_PMIC_ARB_OBS0_CHNL36_STATUS_ADDR A:0xe601208
y.create.l HWIO_PMIC_ARB_OBS0_CHNL37_STATUS_ADDR A:0xe601288
y.create.l HWIO_PMIC_ARB_OBS0_CHNL38_STATUS_ADDR A:0xe601308
y.create.l HWIO_PMIC_ARB_OBS0_CHNL39_STATUS_ADDR A:0xe601388
y.create.l HWIO_PMIC_ARB_OBS0_CHNL40_STATUS_ADDR A:0xe601408
y.create.l HWIO_PMIC_ARB_OBS0_CHNL41_STATUS_ADDR A:0xe601488
y.create.l HWIO_PMIC_ARB_OBS0_CHNL42_STATUS_ADDR A:0xe601508
y.create.l HWIO_PMIC_ARB_OBS0_CHNL43_STATUS_ADDR A:0xe601588
y.create.l HWIO_PMIC_ARB_OBS0_CHNL44_STATUS_ADDR A:0xe601608
y.create.l HWIO_PMIC_ARB_OBS0_CHNL45_STATUS_ADDR A:0xe601688
y.create.l HWIO_PMIC_ARB_OBS0_CHNL46_STATUS_ADDR A:0xe601708
y.create.l HWIO_PMIC_ARB_OBS0_CHNL47_STATUS_ADDR A:0xe601788
y.create.l HWIO_PMIC_ARB_OBS0_CHNL48_STATUS_ADDR A:0xe601808
y.create.l HWIO_PMIC_ARB_OBS0_CHNL49_STATUS_ADDR A:0xe601888
y.create.l HWIO_PMIC_ARB_OBS0_CHNL50_STATUS_ADDR A:0xe601908
y.create.l HWIO_PMIC_ARB_OBS0_CHNL51_STATUS_ADDR A:0xe601988
y.create.l HWIO_PMIC_ARB_OBS0_CHNL52_STATUS_ADDR A:0xe601a08
y.create.l HWIO_PMIC_ARB_OBS0_CHNL53_STATUS_ADDR A:0xe601a88
y.create.l HWIO_PMIC_ARB_OBS0_CHNL54_STATUS_ADDR A:0xe601b08
y.create.l HWIO_PMIC_ARB_OBS0_CHNL55_STATUS_ADDR A:0xe601b88
y.create.l HWIO_PMIC_ARB_OBS0_CHNL56_STATUS_ADDR A:0xe601c08
y.create.l HWIO_PMIC_ARB_OBS0_CHNL57_STATUS_ADDR A:0xe601c88
y.create.l HWIO_PMIC_ARB_OBS0_CHNL58_STATUS_ADDR A:0xe601d08
y.create.l HWIO_PMIC_ARB_OBS0_CHNL59_STATUS_ADDR A:0xe601d88
y.create.l HWIO_PMIC_ARB_OBS0_CHNL60_STATUS_ADDR A:0xe601e08
y.create.l HWIO_PMIC_ARB_OBS0_CHNL61_STATUS_ADDR A:0xe601e88
y.create.l HWIO_PMIC_ARB_OBS0_CHNL62_STATUS_ADDR A:0xe601f08
y.create.l HWIO_PMIC_ARB_OBS0_CHNL63_STATUS_ADDR A:0xe601f88
y.create.l HWIO_PMIC_ARB_OBS0_CHNL64_STATUS_ADDR A:0xe602008
y.create.l HWIO_PMIC_ARB_OBS0_CHNL65_STATUS_ADDR A:0xe602088
y.create.l HWIO_PMIC_ARB_OBS0_CHNL66_STATUS_ADDR A:0xe602108
y.create.l HWIO_PMIC_ARB_OBS0_CHNL67_STATUS_ADDR A:0xe602188
y.create.l HWIO_PMIC_ARB_OBS0_CHNL68_STATUS_ADDR A:0xe602208
y.create.l HWIO_PMIC_ARB_OBS0_CHNL69_STATUS_ADDR A:0xe602288
y.create.l HWIO_PMIC_ARB_OBS0_CHNL70_STATUS_ADDR A:0xe602308
y.create.l HWIO_PMIC_ARB_OBS0_CHNL71_STATUS_ADDR A:0xe602388
y.create.l HWIO_PMIC_ARB_OBS0_CHNL72_STATUS_ADDR A:0xe602408
y.create.l HWIO_PMIC_ARB_OBS0_CHNL73_STATUS_ADDR A:0xe602488
y.create.l HWIO_PMIC_ARB_OBS0_CHNL74_STATUS_ADDR A:0xe602508
y.create.l HWIO_PMIC_ARB_OBS0_CHNL75_STATUS_ADDR A:0xe602588
y.create.l HWIO_PMIC_ARB_OBS0_CHNL76_STATUS_ADDR A:0xe602608
y.create.l HWIO_PMIC_ARB_OBS0_CHNL77_STATUS_ADDR A:0xe602688
y.create.l HWIO_PMIC_ARB_OBS0_CHNL78_STATUS_ADDR A:0xe602708
y.create.l HWIO_PMIC_ARB_OBS0_CHNL79_STATUS_ADDR A:0xe602788
y.create.l HWIO_PMIC_ARB_OBS0_CHNL80_STATUS_ADDR A:0xe602808
y.create.l HWIO_PMIC_ARB_OBS0_CHNL81_STATUS_ADDR A:0xe602888
y.create.l HWIO_PMIC_ARB_OBS0_CHNL82_STATUS_ADDR A:0xe602908
y.create.l HWIO_PMIC_ARB_OBS0_CHNL83_STATUS_ADDR A:0xe602988
y.create.l HWIO_PMIC_ARB_OBS0_CHNL84_STATUS_ADDR A:0xe602a08
y.create.l HWIO_PMIC_ARB_OBS0_CHNL85_STATUS_ADDR A:0xe602a88
y.create.l HWIO_PMIC_ARB_OBS0_CHNL86_STATUS_ADDR A:0xe602b08
y.create.l HWIO_PMIC_ARB_OBS0_CHNL87_STATUS_ADDR A:0xe602b88
y.create.l HWIO_PMIC_ARB_OBS0_CHNL88_STATUS_ADDR A:0xe602c08
y.create.l HWIO_PMIC_ARB_OBS0_CHNL89_STATUS_ADDR A:0xe602c88
y.create.l HWIO_PMIC_ARB_OBS0_CHNL90_STATUS_ADDR A:0xe602d08
y.create.l HWIO_PMIC_ARB_OBS0_CHNL91_STATUS_ADDR A:0xe602d88
y.create.l HWIO_PMIC_ARB_OBS0_CHNL92_STATUS_ADDR A:0xe602e08
y.create.l HWIO_PMIC_ARB_OBS0_CHNL93_STATUS_ADDR A:0xe602e88
y.create.l HWIO_PMIC_ARB_OBS0_CHNL94_STATUS_ADDR A:0xe602f08
y.create.l HWIO_PMIC_ARB_OBS0_CHNL95_STATUS_ADDR A:0xe602f88
y.create.l HWIO_PMIC_ARB_OBS0_CHNL96_STATUS_ADDR A:0xe603008
y.create.l HWIO_PMIC_ARB_OBS0_CHNL97_STATUS_ADDR A:0xe603088
y.create.l HWIO_PMIC_ARB_OBS0_CHNL98_STATUS_ADDR A:0xe603108
y.create.l HWIO_PMIC_ARB_OBS0_CHNL99_STATUS_ADDR A:0xe603188
y.create.l HWIO_PMIC_ARB_OBS0_CHNL100_STATUS_ADDR A:0xe603208
y.create.l HWIO_PMIC_ARB_OBS0_CHNL101_STATUS_ADDR A:0xe603288
y.create.l HWIO_PMIC_ARB_OBS0_CHNL102_STATUS_ADDR A:0xe603308
y.create.l HWIO_PMIC_ARB_OBS0_CHNL103_STATUS_ADDR A:0xe603388
y.create.l HWIO_PMIC_ARB_OBS0_CHNL104_STATUS_ADDR A:0xe603408
y.create.l HWIO_PMIC_ARB_OBS0_CHNL105_STATUS_ADDR A:0xe603488
y.create.l HWIO_PMIC_ARB_OBS0_CHNL106_STATUS_ADDR A:0xe603508
y.create.l HWIO_PMIC_ARB_OBS0_CHNL107_STATUS_ADDR A:0xe603588
y.create.l HWIO_PMIC_ARB_OBS0_CHNL108_STATUS_ADDR A:0xe603608
y.create.l HWIO_PMIC_ARB_OBS0_CHNL109_STATUS_ADDR A:0xe603688
y.create.l HWIO_PMIC_ARB_OBS0_CHNL110_STATUS_ADDR A:0xe603708
y.create.l HWIO_PMIC_ARB_OBS0_CHNL111_STATUS_ADDR A:0xe603788
y.create.l HWIO_PMIC_ARB_OBS0_CHNL112_STATUS_ADDR A:0xe603808
y.create.l HWIO_PMIC_ARB_OBS0_CHNL113_STATUS_ADDR A:0xe603888
y.create.l HWIO_PMIC_ARB_OBS0_CHNL114_STATUS_ADDR A:0xe603908
y.create.l HWIO_PMIC_ARB_OBS0_CHNL115_STATUS_ADDR A:0xe603988
y.create.l HWIO_PMIC_ARB_OBS0_CHNL116_STATUS_ADDR A:0xe603a08
y.create.l HWIO_PMIC_ARB_OBS0_CHNL117_STATUS_ADDR A:0xe603a88
y.create.l HWIO_PMIC_ARB_OBS0_CHNL118_STATUS_ADDR A:0xe603b08
y.create.l HWIO_PMIC_ARB_OBS0_CHNL119_STATUS_ADDR A:0xe603b88
y.create.l HWIO_PMIC_ARB_OBS0_CHNL120_STATUS_ADDR A:0xe603c08
y.create.l HWIO_PMIC_ARB_OBS0_CHNL121_STATUS_ADDR A:0xe603c88
y.create.l HWIO_PMIC_ARB_OBS0_CHNL122_STATUS_ADDR A:0xe603d08
y.create.l HWIO_PMIC_ARB_OBS0_CHNL123_STATUS_ADDR A:0xe603d88
y.create.l HWIO_PMIC_ARB_OBS0_CHNL124_STATUS_ADDR A:0xe603e08
y.create.l HWIO_PMIC_ARB_OBS0_CHNL125_STATUS_ADDR A:0xe603e88
y.create.l HWIO_PMIC_ARB_OBS0_CHNL126_STATUS_ADDR A:0xe603f08
y.create.l HWIO_PMIC_ARB_OBS0_CHNL127_STATUS_ADDR A:0xe603f88
y.create.l HWIO_PMIC_ARB_OBS0_CHNL128_STATUS_ADDR A:0xe604008
y.create.l HWIO_PMIC_ARB_OBS0_CHNL129_STATUS_ADDR A:0xe604088
y.create.l HWIO_PMIC_ARB_OBS0_CHNL130_STATUS_ADDR A:0xe604108
y.create.l HWIO_PMIC_ARB_OBS0_CHNL131_STATUS_ADDR A:0xe604188
y.create.l HWIO_PMIC_ARB_OBS0_CHNL132_STATUS_ADDR A:0xe604208
y.create.l HWIO_PMIC_ARB_OBS0_CHNL133_STATUS_ADDR A:0xe604288
y.create.l HWIO_PMIC_ARB_OBS0_CHNL134_STATUS_ADDR A:0xe604308
y.create.l HWIO_PMIC_ARB_OBS0_CHNL135_STATUS_ADDR A:0xe604388
y.create.l HWIO_PMIC_ARB_OBS0_CHNL136_STATUS_ADDR A:0xe604408
y.create.l HWIO_PMIC_ARB_OBS0_CHNL137_STATUS_ADDR A:0xe604488
y.create.l HWIO_PMIC_ARB_OBS0_CHNL138_STATUS_ADDR A:0xe604508
y.create.l HWIO_PMIC_ARB_OBS0_CHNL139_STATUS_ADDR A:0xe604588
y.create.l HWIO_PMIC_ARB_OBS0_CHNL140_STATUS_ADDR A:0xe604608
y.create.l HWIO_PMIC_ARB_OBS0_CHNL141_STATUS_ADDR A:0xe604688
y.create.l HWIO_PMIC_ARB_OBS0_CHNL142_STATUS_ADDR A:0xe604708
y.create.l HWIO_PMIC_ARB_OBS0_CHNL143_STATUS_ADDR A:0xe604788
y.create.l HWIO_PMIC_ARB_OBS0_CHNL144_STATUS_ADDR A:0xe604808
y.create.l HWIO_PMIC_ARB_OBS0_CHNL145_STATUS_ADDR A:0xe604888
y.create.l HWIO_PMIC_ARB_OBS0_CHNL146_STATUS_ADDR A:0xe604908
y.create.l HWIO_PMIC_ARB_OBS0_CHNL147_STATUS_ADDR A:0xe604988
y.create.l HWIO_PMIC_ARB_OBS0_CHNL148_STATUS_ADDR A:0xe604a08
y.create.l HWIO_PMIC_ARB_OBS0_CHNL149_STATUS_ADDR A:0xe604a88
y.create.l HWIO_PMIC_ARB_OBS0_CHNL150_STATUS_ADDR A:0xe604b08
y.create.l HWIO_PMIC_ARB_OBS0_CHNL151_STATUS_ADDR A:0xe604b88
y.create.l HWIO_PMIC_ARB_OBS0_CHNL152_STATUS_ADDR A:0xe604c08
y.create.l HWIO_PMIC_ARB_OBS0_CHNL153_STATUS_ADDR A:0xe604c88
y.create.l HWIO_PMIC_ARB_OBS0_CHNL154_STATUS_ADDR A:0xe604d08
y.create.l HWIO_PMIC_ARB_OBS0_CHNL155_STATUS_ADDR A:0xe604d88
y.create.l HWIO_PMIC_ARB_OBS0_CHNL156_STATUS_ADDR A:0xe604e08
y.create.l HWIO_PMIC_ARB_OBS0_CHNL157_STATUS_ADDR A:0xe604e88
y.create.l HWIO_PMIC_ARB_OBS0_CHNL158_STATUS_ADDR A:0xe604f08
y.create.l HWIO_PMIC_ARB_OBS0_CHNL159_STATUS_ADDR A:0xe604f88
y.create.l HWIO_PMIC_ARB_OBS0_CHNL160_STATUS_ADDR A:0xe605008
y.create.l HWIO_PMIC_ARB_OBS0_CHNL161_STATUS_ADDR A:0xe605088
y.create.l HWIO_PMIC_ARB_OBS0_CHNL162_STATUS_ADDR A:0xe605108
y.create.l HWIO_PMIC_ARB_OBS0_CHNL163_STATUS_ADDR A:0xe605188
y.create.l HWIO_PMIC_ARB_OBS0_CHNL164_STATUS_ADDR A:0xe605208
y.create.l HWIO_PMIC_ARB_OBS0_CHNL165_STATUS_ADDR A:0xe605288
y.create.l HWIO_PMIC_ARB_OBS0_CHNL166_STATUS_ADDR A:0xe605308
y.create.l HWIO_PMIC_ARB_OBS0_CHNL167_STATUS_ADDR A:0xe605388
y.create.l HWIO_PMIC_ARB_OBS0_CHNL168_STATUS_ADDR A:0xe605408
y.create.l HWIO_PMIC_ARB_OBS0_CHNL169_STATUS_ADDR A:0xe605488
y.create.l HWIO_PMIC_ARB_OBS0_CHNL170_STATUS_ADDR A:0xe605508
y.create.l HWIO_PMIC_ARB_OBS0_CHNL171_STATUS_ADDR A:0xe605588
y.create.l HWIO_PMIC_ARB_OBS0_CHNL172_STATUS_ADDR A:0xe605608
y.create.l HWIO_PMIC_ARB_OBS0_CHNL173_STATUS_ADDR A:0xe605688
y.create.l HWIO_PMIC_ARB_OBS0_CHNL174_STATUS_ADDR A:0xe605708
y.create.l HWIO_PMIC_ARB_OBS0_CHNL175_STATUS_ADDR A:0xe605788
y.create.l HWIO_PMIC_ARB_OBS0_CHNL176_STATUS_ADDR A:0xe605808
y.create.l HWIO_PMIC_ARB_OBS0_CHNL177_STATUS_ADDR A:0xe605888
y.create.l HWIO_PMIC_ARB_OBS0_CHNL178_STATUS_ADDR A:0xe605908
y.create.l HWIO_PMIC_ARB_OBS0_CHNL179_STATUS_ADDR A:0xe605988
y.create.l HWIO_PMIC_ARB_OBS0_CHNL180_STATUS_ADDR A:0xe605a08
y.create.l HWIO_PMIC_ARB_OBS0_CHNL181_STATUS_ADDR A:0xe605a88
y.create.l HWIO_PMIC_ARB_OBS0_CHNL182_STATUS_ADDR A:0xe605b08
y.create.l HWIO_PMIC_ARB_OBS0_CHNL183_STATUS_ADDR A:0xe605b88
y.create.l HWIO_PMIC_ARB_OBS0_CHNL184_STATUS_ADDR A:0xe605c08
y.create.l HWIO_PMIC_ARB_OBS0_CHNL185_STATUS_ADDR A:0xe605c88
y.create.l HWIO_PMIC_ARB_OBS0_CHNL186_STATUS_ADDR A:0xe605d08
y.create.l HWIO_PMIC_ARB_OBS0_CHNL187_STATUS_ADDR A:0xe605d88
y.create.l HWIO_PMIC_ARB_OBS0_CHNL188_STATUS_ADDR A:0xe605e08
y.create.l HWIO_PMIC_ARB_OBS0_CHNL189_STATUS_ADDR A:0xe605e88
y.create.l HWIO_PMIC_ARB_OBS0_CHNL190_STATUS_ADDR A:0xe605f08
y.create.l HWIO_PMIC_ARB_OBS0_CHNL191_STATUS_ADDR A:0xe605f88
y.create.l HWIO_PMIC_ARB_OBS0_CHNL192_STATUS_ADDR A:0xe606008
y.create.l HWIO_PMIC_ARB_OBS0_CHNL193_STATUS_ADDR A:0xe606088
y.create.l HWIO_PMIC_ARB_OBS0_CHNL194_STATUS_ADDR A:0xe606108
y.create.l HWIO_PMIC_ARB_OBS0_CHNL195_STATUS_ADDR A:0xe606188
y.create.l HWIO_PMIC_ARB_OBS0_CHNL196_STATUS_ADDR A:0xe606208
y.create.l HWIO_PMIC_ARB_OBS0_CHNL197_STATUS_ADDR A:0xe606288
y.create.l HWIO_PMIC_ARB_OBS0_CHNL198_STATUS_ADDR A:0xe606308
y.create.l HWIO_PMIC_ARB_OBS0_CHNL199_STATUS_ADDR A:0xe606388
y.create.l HWIO_PMIC_ARB_OBS0_CHNL200_STATUS_ADDR A:0xe606408
y.create.l HWIO_PMIC_ARB_OBS0_CHNL201_STATUS_ADDR A:0xe606488
y.create.l HWIO_PMIC_ARB_OBS0_CHNL202_STATUS_ADDR A:0xe606508
y.create.l HWIO_PMIC_ARB_OBS0_CHNL203_STATUS_ADDR A:0xe606588
y.create.l HWIO_PMIC_ARB_OBS0_CHNL204_STATUS_ADDR A:0xe606608
y.create.l HWIO_PMIC_ARB_OBS0_CHNL205_STATUS_ADDR A:0xe606688
y.create.l HWIO_PMIC_ARB_OBS0_CHNL206_STATUS_ADDR A:0xe606708
y.create.l HWIO_PMIC_ARB_OBS0_CHNL207_STATUS_ADDR A:0xe606788
y.create.l HWIO_PMIC_ARB_OBS0_CHNL208_STATUS_ADDR A:0xe606808
y.create.l HWIO_PMIC_ARB_OBS0_CHNL209_STATUS_ADDR A:0xe606888
y.create.l HWIO_PMIC_ARB_OBS0_CHNL210_STATUS_ADDR A:0xe606908
y.create.l HWIO_PMIC_ARB_OBS0_CHNL211_STATUS_ADDR A:0xe606988
y.create.l HWIO_PMIC_ARB_OBS0_CHNL212_STATUS_ADDR A:0xe606a08
y.create.l HWIO_PMIC_ARB_OBS0_CHNL213_STATUS_ADDR A:0xe606a88
y.create.l HWIO_PMIC_ARB_OBS0_CHNL214_STATUS_ADDR A:0xe606b08
y.create.l HWIO_PMIC_ARB_OBS0_CHNL215_STATUS_ADDR A:0xe606b88
y.create.l HWIO_PMIC_ARB_OBS0_CHNL216_STATUS_ADDR A:0xe606c08
y.create.l HWIO_PMIC_ARB_OBS0_CHNL217_STATUS_ADDR A:0xe606c88
y.create.l HWIO_PMIC_ARB_OBS0_CHNL218_STATUS_ADDR A:0xe606d08
y.create.l HWIO_PMIC_ARB_OBS0_CHNL219_STATUS_ADDR A:0xe606d88
y.create.l HWIO_PMIC_ARB_OBS0_CHNL220_STATUS_ADDR A:0xe606e08
y.create.l HWIO_PMIC_ARB_OBS0_CHNL221_STATUS_ADDR A:0xe606e88
y.create.l HWIO_PMIC_ARB_OBS0_CHNL222_STATUS_ADDR A:0xe606f08
y.create.l HWIO_PMIC_ARB_OBS0_CHNL223_STATUS_ADDR A:0xe606f88
y.create.l HWIO_PMIC_ARB_OBS0_CHNL224_STATUS_ADDR A:0xe607008
y.create.l HWIO_PMIC_ARB_OBS0_CHNL225_STATUS_ADDR A:0xe607088
y.create.l HWIO_PMIC_ARB_OBS0_CHNL226_STATUS_ADDR A:0xe607108
y.create.l HWIO_PMIC_ARB_OBS0_CHNL227_STATUS_ADDR A:0xe607188
y.create.l HWIO_PMIC_ARB_OBS0_CHNL228_STATUS_ADDR A:0xe607208
y.create.l HWIO_PMIC_ARB_OBS0_CHNL229_STATUS_ADDR A:0xe607288
y.create.l HWIO_PMIC_ARB_OBS0_CHNL230_STATUS_ADDR A:0xe607308
y.create.l HWIO_PMIC_ARB_OBS0_CHNL231_STATUS_ADDR A:0xe607388
y.create.l HWIO_PMIC_ARB_OBS0_CHNL232_STATUS_ADDR A:0xe607408
y.create.l HWIO_PMIC_ARB_OBS0_CHNL233_STATUS_ADDR A:0xe607488
y.create.l HWIO_PMIC_ARB_OBS0_CHNL234_STATUS_ADDR A:0xe607508
y.create.l HWIO_PMIC_ARB_OBS0_CHNL235_STATUS_ADDR A:0xe607588
y.create.l HWIO_PMIC_ARB_OBS0_CHNL236_STATUS_ADDR A:0xe607608
y.create.l HWIO_PMIC_ARB_OBS0_CHNL237_STATUS_ADDR A:0xe607688
y.create.l HWIO_PMIC_ARB_OBS0_CHNL238_STATUS_ADDR A:0xe607708
y.create.l HWIO_PMIC_ARB_OBS0_CHNL239_STATUS_ADDR A:0xe607788
y.create.l HWIO_PMIC_ARB_OBS0_CHNL240_STATUS_ADDR A:0xe607808
y.create.l HWIO_PMIC_ARB_OBS0_CHNL241_STATUS_ADDR A:0xe607888
y.create.l HWIO_PMIC_ARB_OBS0_CHNL242_STATUS_ADDR A:0xe607908
y.create.l HWIO_PMIC_ARB_OBS0_CHNL243_STATUS_ADDR A:0xe607988
y.create.l HWIO_PMIC_ARB_OBS0_CHNL244_STATUS_ADDR A:0xe607a08
y.create.l HWIO_PMIC_ARB_OBS0_CHNL245_STATUS_ADDR A:0xe607a88
y.create.l HWIO_PMIC_ARB_OBS0_CHNL246_STATUS_ADDR A:0xe607b08
y.create.l HWIO_PMIC_ARB_OBS0_CHNL247_STATUS_ADDR A:0xe607b88
y.create.l HWIO_PMIC_ARB_OBS0_CHNL248_STATUS_ADDR A:0xe607c08
y.create.l HWIO_PMIC_ARB_OBS0_CHNL249_STATUS_ADDR A:0xe607c88
y.create.l HWIO_PMIC_ARB_OBS0_CHNL250_STATUS_ADDR A:0xe607d08
y.create.l HWIO_PMIC_ARB_OBS0_CHNL251_STATUS_ADDR A:0xe607d88
y.create.l HWIO_PMIC_ARB_OBS0_CHNL252_STATUS_ADDR A:0xe607e08
y.create.l HWIO_PMIC_ARB_OBS0_CHNL253_STATUS_ADDR A:0xe607e88
y.create.l HWIO_PMIC_ARB_OBS0_CHNL254_STATUS_ADDR A:0xe607f08
y.create.l HWIO_PMIC_ARB_OBS0_CHNL255_STATUS_ADDR A:0xe607f88
y.create.l HWIO_PMIC_ARB_OBS1_CHNL0_STATUS_ADDR A:0xe610008
y.create.l HWIO_PMIC_ARB_OBS1_CHNL1_STATUS_ADDR A:0xe610088
y.create.l HWIO_PMIC_ARB_OBS1_CHNL2_STATUS_ADDR A:0xe610108
y.create.l HWIO_PMIC_ARB_OBS1_CHNL3_STATUS_ADDR A:0xe610188
y.create.l HWIO_PMIC_ARB_OBS1_CHNL4_STATUS_ADDR A:0xe610208
y.create.l HWIO_PMIC_ARB_OBS1_CHNL5_STATUS_ADDR A:0xe610288
y.create.l HWIO_PMIC_ARB_OBS1_CHNL6_STATUS_ADDR A:0xe610308
y.create.l HWIO_PMIC_ARB_OBS1_CHNL7_STATUS_ADDR A:0xe610388
y.create.l HWIO_PMIC_ARB_OBS1_CHNL8_STATUS_ADDR A:0xe610408
y.create.l HWIO_PMIC_ARB_OBS1_CHNL9_STATUS_ADDR A:0xe610488
y.create.l HWIO_PMIC_ARB_OBS1_CHNL10_STATUS_ADDR A:0xe610508
y.create.l HWIO_PMIC_ARB_OBS1_CHNL11_STATUS_ADDR A:0xe610588
y.create.l HWIO_PMIC_ARB_OBS1_CHNL12_STATUS_ADDR A:0xe610608
y.create.l HWIO_PMIC_ARB_OBS1_CHNL13_STATUS_ADDR A:0xe610688
y.create.l HWIO_PMIC_ARB_OBS1_CHNL14_STATUS_ADDR A:0xe610708
y.create.l HWIO_PMIC_ARB_OBS1_CHNL15_STATUS_ADDR A:0xe610788
y.create.l HWIO_PMIC_ARB_OBS1_CHNL16_STATUS_ADDR A:0xe610808
y.create.l HWIO_PMIC_ARB_OBS1_CHNL17_STATUS_ADDR A:0xe610888
y.create.l HWIO_PMIC_ARB_OBS1_CHNL18_STATUS_ADDR A:0xe610908
y.create.l HWIO_PMIC_ARB_OBS1_CHNL19_STATUS_ADDR A:0xe610988
y.create.l HWIO_PMIC_ARB_OBS1_CHNL20_STATUS_ADDR A:0xe610a08
y.create.l HWIO_PMIC_ARB_OBS1_CHNL21_STATUS_ADDR A:0xe610a88
y.create.l HWIO_PMIC_ARB_OBS1_CHNL22_STATUS_ADDR A:0xe610b08
y.create.l HWIO_PMIC_ARB_OBS1_CHNL23_STATUS_ADDR A:0xe610b88
y.create.l HWIO_PMIC_ARB_OBS1_CHNL24_STATUS_ADDR A:0xe610c08
y.create.l HWIO_PMIC_ARB_OBS1_CHNL25_STATUS_ADDR A:0xe610c88
y.create.l HWIO_PMIC_ARB_OBS1_CHNL26_STATUS_ADDR A:0xe610d08
y.create.l HWIO_PMIC_ARB_OBS1_CHNL27_STATUS_ADDR A:0xe610d88
y.create.l HWIO_PMIC_ARB_OBS1_CHNL28_STATUS_ADDR A:0xe610e08
y.create.l HWIO_PMIC_ARB_OBS1_CHNL29_STATUS_ADDR A:0xe610e88
y.create.l HWIO_PMIC_ARB_OBS1_CHNL30_STATUS_ADDR A:0xe610f08
y.create.l HWIO_PMIC_ARB_OBS1_CHNL31_STATUS_ADDR A:0xe610f88
y.create.l HWIO_PMIC_ARB_OBS1_CHNL32_STATUS_ADDR A:0xe611008
y.create.l HWIO_PMIC_ARB_OBS1_CHNL33_STATUS_ADDR A:0xe611088
y.create.l HWIO_PMIC_ARB_OBS1_CHNL34_STATUS_ADDR A:0xe611108
y.create.l HWIO_PMIC_ARB_OBS1_CHNL35_STATUS_ADDR A:0xe611188
y.create.l HWIO_PMIC_ARB_OBS1_CHNL36_STATUS_ADDR A:0xe611208
y.create.l HWIO_PMIC_ARB_OBS1_CHNL37_STATUS_ADDR A:0xe611288
y.create.l HWIO_PMIC_ARB_OBS1_CHNL38_STATUS_ADDR A:0xe611308
y.create.l HWIO_PMIC_ARB_OBS1_CHNL39_STATUS_ADDR A:0xe611388
y.create.l HWIO_PMIC_ARB_OBS1_CHNL40_STATUS_ADDR A:0xe611408
y.create.l HWIO_PMIC_ARB_OBS1_CHNL41_STATUS_ADDR A:0xe611488
y.create.l HWIO_PMIC_ARB_OBS1_CHNL42_STATUS_ADDR A:0xe611508
y.create.l HWIO_PMIC_ARB_OBS1_CHNL43_STATUS_ADDR A:0xe611588
y.create.l HWIO_PMIC_ARB_OBS1_CHNL44_STATUS_ADDR A:0xe611608
y.create.l HWIO_PMIC_ARB_OBS1_CHNL45_STATUS_ADDR A:0xe611688
y.create.l HWIO_PMIC_ARB_OBS1_CHNL46_STATUS_ADDR A:0xe611708
y.create.l HWIO_PMIC_ARB_OBS1_CHNL47_STATUS_ADDR A:0xe611788
y.create.l HWIO_PMIC_ARB_OBS1_CHNL48_STATUS_ADDR A:0xe611808
y.create.l HWIO_PMIC_ARB_OBS1_CHNL49_STATUS_ADDR A:0xe611888
y.create.l HWIO_PMIC_ARB_OBS1_CHNL50_STATUS_ADDR A:0xe611908
y.create.l HWIO_PMIC_ARB_OBS1_CHNL51_STATUS_ADDR A:0xe611988
y.create.l HWIO_PMIC_ARB_OBS1_CHNL52_STATUS_ADDR A:0xe611a08
y.create.l HWIO_PMIC_ARB_OBS1_CHNL53_STATUS_ADDR A:0xe611a88
y.create.l HWIO_PMIC_ARB_OBS1_CHNL54_STATUS_ADDR A:0xe611b08
y.create.l HWIO_PMIC_ARB_OBS1_CHNL55_STATUS_ADDR A:0xe611b88
y.create.l HWIO_PMIC_ARB_OBS1_CHNL56_STATUS_ADDR A:0xe611c08
y.create.l HWIO_PMIC_ARB_OBS1_CHNL57_STATUS_ADDR A:0xe611c88
y.create.l HWIO_PMIC_ARB_OBS1_CHNL58_STATUS_ADDR A:0xe611d08
y.create.l HWIO_PMIC_ARB_OBS1_CHNL59_STATUS_ADDR A:0xe611d88
y.create.l HWIO_PMIC_ARB_OBS1_CHNL60_STATUS_ADDR A:0xe611e08
y.create.l HWIO_PMIC_ARB_OBS1_CHNL61_STATUS_ADDR A:0xe611e88
y.create.l HWIO_PMIC_ARB_OBS1_CHNL62_STATUS_ADDR A:0xe611f08
y.create.l HWIO_PMIC_ARB_OBS1_CHNL63_STATUS_ADDR A:0xe611f88
y.create.l HWIO_PMIC_ARB_OBS1_CHNL64_STATUS_ADDR A:0xe612008
y.create.l HWIO_PMIC_ARB_OBS1_CHNL65_STATUS_ADDR A:0xe612088
y.create.l HWIO_PMIC_ARB_OBS1_CHNL66_STATUS_ADDR A:0xe612108
y.create.l HWIO_PMIC_ARB_OBS1_CHNL67_STATUS_ADDR A:0xe612188
y.create.l HWIO_PMIC_ARB_OBS1_CHNL68_STATUS_ADDR A:0xe612208
y.create.l HWIO_PMIC_ARB_OBS1_CHNL69_STATUS_ADDR A:0xe612288
y.create.l HWIO_PMIC_ARB_OBS1_CHNL70_STATUS_ADDR A:0xe612308
y.create.l HWIO_PMIC_ARB_OBS1_CHNL71_STATUS_ADDR A:0xe612388
y.create.l HWIO_PMIC_ARB_OBS1_CHNL72_STATUS_ADDR A:0xe612408
y.create.l HWIO_PMIC_ARB_OBS1_CHNL73_STATUS_ADDR A:0xe612488
y.create.l HWIO_PMIC_ARB_OBS1_CHNL74_STATUS_ADDR A:0xe612508
y.create.l HWIO_PMIC_ARB_OBS1_CHNL75_STATUS_ADDR A:0xe612588
y.create.l HWIO_PMIC_ARB_OBS1_CHNL76_STATUS_ADDR A:0xe612608
y.create.l HWIO_PMIC_ARB_OBS1_CHNL77_STATUS_ADDR A:0xe612688
y.create.l HWIO_PMIC_ARB_OBS1_CHNL78_STATUS_ADDR A:0xe612708
y.create.l HWIO_PMIC_ARB_OBS1_CHNL79_STATUS_ADDR A:0xe612788
y.create.l HWIO_PMIC_ARB_OBS1_CHNL80_STATUS_ADDR A:0xe612808
y.create.l HWIO_PMIC_ARB_OBS1_CHNL81_STATUS_ADDR A:0xe612888
y.create.l HWIO_PMIC_ARB_OBS1_CHNL82_STATUS_ADDR A:0xe612908
y.create.l HWIO_PMIC_ARB_OBS1_CHNL83_STATUS_ADDR A:0xe612988
y.create.l HWIO_PMIC_ARB_OBS1_CHNL84_STATUS_ADDR A:0xe612a08
y.create.l HWIO_PMIC_ARB_OBS1_CHNL85_STATUS_ADDR A:0xe612a88
y.create.l HWIO_PMIC_ARB_OBS1_CHNL86_STATUS_ADDR A:0xe612b08
y.create.l HWIO_PMIC_ARB_OBS1_CHNL87_STATUS_ADDR A:0xe612b88
y.create.l HWIO_PMIC_ARB_OBS1_CHNL88_STATUS_ADDR A:0xe612c08
y.create.l HWIO_PMIC_ARB_OBS1_CHNL89_STATUS_ADDR A:0xe612c88
y.create.l HWIO_PMIC_ARB_OBS1_CHNL90_STATUS_ADDR A:0xe612d08
y.create.l HWIO_PMIC_ARB_OBS1_CHNL91_STATUS_ADDR A:0xe612d88
y.create.l HWIO_PMIC_ARB_OBS1_CHNL92_STATUS_ADDR A:0xe612e08
y.create.l HWIO_PMIC_ARB_OBS1_CHNL93_STATUS_ADDR A:0xe612e88
y.create.l HWIO_PMIC_ARB_OBS1_CHNL94_STATUS_ADDR A:0xe612f08
y.create.l HWIO_PMIC_ARB_OBS1_CHNL95_STATUS_ADDR A:0xe612f88
y.create.l HWIO_PMIC_ARB_OBS1_CHNL96_STATUS_ADDR A:0xe613008
y.create.l HWIO_PMIC_ARB_OBS1_CHNL97_STATUS_ADDR A:0xe613088
y.create.l HWIO_PMIC_ARB_OBS1_CHNL98_STATUS_ADDR A:0xe613108
y.create.l HWIO_PMIC_ARB_OBS1_CHNL99_STATUS_ADDR A:0xe613188
y.create.l HWIO_PMIC_ARB_OBS1_CHNL100_STATUS_ADDR A:0xe613208
y.create.l HWIO_PMIC_ARB_OBS1_CHNL101_STATUS_ADDR A:0xe613288
y.create.l HWIO_PMIC_ARB_OBS1_CHNL102_STATUS_ADDR A:0xe613308
y.create.l HWIO_PMIC_ARB_OBS1_CHNL103_STATUS_ADDR A:0xe613388
y.create.l HWIO_PMIC_ARB_OBS1_CHNL104_STATUS_ADDR A:0xe613408
y.create.l HWIO_PMIC_ARB_OBS1_CHNL105_STATUS_ADDR A:0xe613488
y.create.l HWIO_PMIC_ARB_OBS1_CHNL106_STATUS_ADDR A:0xe613508
y.create.l HWIO_PMIC_ARB_OBS1_CHNL107_STATUS_ADDR A:0xe613588
y.create.l HWIO_PMIC_ARB_OBS1_CHNL108_STATUS_ADDR A:0xe613608
y.create.l HWIO_PMIC_ARB_OBS1_CHNL109_STATUS_ADDR A:0xe613688
y.create.l HWIO_PMIC_ARB_OBS1_CHNL110_STATUS_ADDR A:0xe613708
y.create.l HWIO_PMIC_ARB_OBS1_CHNL111_STATUS_ADDR A:0xe613788
y.create.l HWIO_PMIC_ARB_OBS1_CHNL112_STATUS_ADDR A:0xe613808
y.create.l HWIO_PMIC_ARB_OBS1_CHNL113_STATUS_ADDR A:0xe613888
y.create.l HWIO_PMIC_ARB_OBS1_CHNL114_STATUS_ADDR A:0xe613908
y.create.l HWIO_PMIC_ARB_OBS1_CHNL115_STATUS_ADDR A:0xe613988
y.create.l HWIO_PMIC_ARB_OBS1_CHNL116_STATUS_ADDR A:0xe613a08
y.create.l HWIO_PMIC_ARB_OBS1_CHNL117_STATUS_ADDR A:0xe613a88
y.create.l HWIO_PMIC_ARB_OBS1_CHNL118_STATUS_ADDR A:0xe613b08
y.create.l HWIO_PMIC_ARB_OBS1_CHNL119_STATUS_ADDR A:0xe613b88
y.create.l HWIO_PMIC_ARB_OBS1_CHNL120_STATUS_ADDR A:0xe613c08
y.create.l HWIO_PMIC_ARB_OBS1_CHNL121_STATUS_ADDR A:0xe613c88
y.create.l HWIO_PMIC_ARB_OBS1_CHNL122_STATUS_ADDR A:0xe613d08
y.create.l HWIO_PMIC_ARB_OBS1_CHNL123_STATUS_ADDR A:0xe613d88
y.create.l HWIO_PMIC_ARB_OBS1_CHNL124_STATUS_ADDR A:0xe613e08
y.create.l HWIO_PMIC_ARB_OBS1_CHNL125_STATUS_ADDR A:0xe613e88
y.create.l HWIO_PMIC_ARB_OBS1_CHNL126_STATUS_ADDR A:0xe613f08
y.create.l HWIO_PMIC_ARB_OBS1_CHNL127_STATUS_ADDR A:0xe613f88
y.create.l HWIO_PMIC_ARB_OBS1_CHNL128_STATUS_ADDR A:0xe614008
y.create.l HWIO_PMIC_ARB_OBS1_CHNL129_STATUS_ADDR A:0xe614088
y.create.l HWIO_PMIC_ARB_OBS1_CHNL130_STATUS_ADDR A:0xe614108
y.create.l HWIO_PMIC_ARB_OBS1_CHNL131_STATUS_ADDR A:0xe614188
y.create.l HWIO_PMIC_ARB_OBS1_CHNL132_STATUS_ADDR A:0xe614208
y.create.l HWIO_PMIC_ARB_OBS1_CHNL133_STATUS_ADDR A:0xe614288
y.create.l HWIO_PMIC_ARB_OBS1_CHNL134_STATUS_ADDR A:0xe614308
y.create.l HWIO_PMIC_ARB_OBS1_CHNL135_STATUS_ADDR A:0xe614388
y.create.l HWIO_PMIC_ARB_OBS1_CHNL136_STATUS_ADDR A:0xe614408
y.create.l HWIO_PMIC_ARB_OBS1_CHNL137_STATUS_ADDR A:0xe614488
y.create.l HWIO_PMIC_ARB_OBS1_CHNL138_STATUS_ADDR A:0xe614508
y.create.l HWIO_PMIC_ARB_OBS1_CHNL139_STATUS_ADDR A:0xe614588
y.create.l HWIO_PMIC_ARB_OBS1_CHNL140_STATUS_ADDR A:0xe614608
y.create.l HWIO_PMIC_ARB_OBS1_CHNL141_STATUS_ADDR A:0xe614688
y.create.l HWIO_PMIC_ARB_OBS1_CHNL142_STATUS_ADDR A:0xe614708
y.create.l HWIO_PMIC_ARB_OBS1_CHNL143_STATUS_ADDR A:0xe614788
y.create.l HWIO_PMIC_ARB_OBS1_CHNL144_STATUS_ADDR A:0xe614808
y.create.l HWIO_PMIC_ARB_OBS1_CHNL145_STATUS_ADDR A:0xe614888
y.create.l HWIO_PMIC_ARB_OBS1_CHNL146_STATUS_ADDR A:0xe614908
y.create.l HWIO_PMIC_ARB_OBS1_CHNL147_STATUS_ADDR A:0xe614988
y.create.l HWIO_PMIC_ARB_OBS1_CHNL148_STATUS_ADDR A:0xe614a08
y.create.l HWIO_PMIC_ARB_OBS1_CHNL149_STATUS_ADDR A:0xe614a88
y.create.l HWIO_PMIC_ARB_OBS1_CHNL150_STATUS_ADDR A:0xe614b08
y.create.l HWIO_PMIC_ARB_OBS1_CHNL151_STATUS_ADDR A:0xe614b88
y.create.l HWIO_PMIC_ARB_OBS1_CHNL152_STATUS_ADDR A:0xe614c08
y.create.l HWIO_PMIC_ARB_OBS1_CHNL153_STATUS_ADDR A:0xe614c88
y.create.l HWIO_PMIC_ARB_OBS1_CHNL154_STATUS_ADDR A:0xe614d08
y.create.l HWIO_PMIC_ARB_OBS1_CHNL155_STATUS_ADDR A:0xe614d88
y.create.l HWIO_PMIC_ARB_OBS1_CHNL156_STATUS_ADDR A:0xe614e08
y.create.l HWIO_PMIC_ARB_OBS1_CHNL157_STATUS_ADDR A:0xe614e88
y.create.l HWIO_PMIC_ARB_OBS1_CHNL158_STATUS_ADDR A:0xe614f08
y.create.l HWIO_PMIC_ARB_OBS1_CHNL159_STATUS_ADDR A:0xe614f88
y.create.l HWIO_PMIC_ARB_OBS1_CHNL160_STATUS_ADDR A:0xe615008
y.create.l HWIO_PMIC_ARB_OBS1_CHNL161_STATUS_ADDR A:0xe615088
y.create.l HWIO_PMIC_ARB_OBS1_CHNL162_STATUS_ADDR A:0xe615108
y.create.l HWIO_PMIC_ARB_OBS1_CHNL163_STATUS_ADDR A:0xe615188
y.create.l HWIO_PMIC_ARB_OBS1_CHNL164_STATUS_ADDR A:0xe615208
y.create.l HWIO_PMIC_ARB_OBS1_CHNL165_STATUS_ADDR A:0xe615288
y.create.l HWIO_PMIC_ARB_OBS1_CHNL166_STATUS_ADDR A:0xe615308
y.create.l HWIO_PMIC_ARB_OBS1_CHNL167_STATUS_ADDR A:0xe615388
y.create.l HWIO_PMIC_ARB_OBS1_CHNL168_STATUS_ADDR A:0xe615408
y.create.l HWIO_PMIC_ARB_OBS1_CHNL169_STATUS_ADDR A:0xe615488
y.create.l HWIO_PMIC_ARB_OBS1_CHNL170_STATUS_ADDR A:0xe615508
y.create.l HWIO_PMIC_ARB_OBS1_CHNL171_STATUS_ADDR A:0xe615588
y.create.l HWIO_PMIC_ARB_OBS1_CHNL172_STATUS_ADDR A:0xe615608
y.create.l HWIO_PMIC_ARB_OBS1_CHNL173_STATUS_ADDR A:0xe615688
y.create.l HWIO_PMIC_ARB_OBS1_CHNL174_STATUS_ADDR A:0xe615708
y.create.l HWIO_PMIC_ARB_OBS1_CHNL175_STATUS_ADDR A:0xe615788
y.create.l HWIO_PMIC_ARB_OBS1_CHNL176_STATUS_ADDR A:0xe615808
y.create.l HWIO_PMIC_ARB_OBS1_CHNL177_STATUS_ADDR A:0xe615888
y.create.l HWIO_PMIC_ARB_OBS1_CHNL178_STATUS_ADDR A:0xe615908
y.create.l HWIO_PMIC_ARB_OBS1_CHNL179_STATUS_ADDR A:0xe615988
y.create.l HWIO_PMIC_ARB_OBS1_CHNL180_STATUS_ADDR A:0xe615a08
y.create.l HWIO_PMIC_ARB_OBS1_CHNL181_STATUS_ADDR A:0xe615a88
y.create.l HWIO_PMIC_ARB_OBS1_CHNL182_STATUS_ADDR A:0xe615b08
y.create.l HWIO_PMIC_ARB_OBS1_CHNL183_STATUS_ADDR A:0xe615b88
y.create.l HWIO_PMIC_ARB_OBS1_CHNL184_STATUS_ADDR A:0xe615c08
y.create.l HWIO_PMIC_ARB_OBS1_CHNL185_STATUS_ADDR A:0xe615c88
y.create.l HWIO_PMIC_ARB_OBS1_CHNL186_STATUS_ADDR A:0xe615d08
y.create.l HWIO_PMIC_ARB_OBS1_CHNL187_STATUS_ADDR A:0xe615d88
y.create.l HWIO_PMIC_ARB_OBS1_CHNL188_STATUS_ADDR A:0xe615e08
y.create.l HWIO_PMIC_ARB_OBS1_CHNL189_STATUS_ADDR A:0xe615e88
y.create.l HWIO_PMIC_ARB_OBS1_CHNL190_STATUS_ADDR A:0xe615f08
y.create.l HWIO_PMIC_ARB_OBS1_CHNL191_STATUS_ADDR A:0xe615f88
y.create.l HWIO_PMIC_ARB_OBS1_CHNL192_STATUS_ADDR A:0xe616008
y.create.l HWIO_PMIC_ARB_OBS1_CHNL193_STATUS_ADDR A:0xe616088
y.create.l HWIO_PMIC_ARB_OBS1_CHNL194_STATUS_ADDR A:0xe616108
y.create.l HWIO_PMIC_ARB_OBS1_CHNL195_STATUS_ADDR A:0xe616188
y.create.l HWIO_PMIC_ARB_OBS1_CHNL196_STATUS_ADDR A:0xe616208
y.create.l HWIO_PMIC_ARB_OBS1_CHNL197_STATUS_ADDR A:0xe616288
y.create.l HWIO_PMIC_ARB_OBS1_CHNL198_STATUS_ADDR A:0xe616308
y.create.l HWIO_PMIC_ARB_OBS1_CHNL199_STATUS_ADDR A:0xe616388
y.create.l HWIO_PMIC_ARB_OBS1_CHNL200_STATUS_ADDR A:0xe616408
y.create.l HWIO_PMIC_ARB_OBS1_CHNL201_STATUS_ADDR A:0xe616488
y.create.l HWIO_PMIC_ARB_OBS1_CHNL202_STATUS_ADDR A:0xe616508
y.create.l HWIO_PMIC_ARB_OBS1_CHNL203_STATUS_ADDR A:0xe616588
y.create.l HWIO_PMIC_ARB_OBS1_CHNL204_STATUS_ADDR A:0xe616608
y.create.l HWIO_PMIC_ARB_OBS1_CHNL205_STATUS_ADDR A:0xe616688
y.create.l HWIO_PMIC_ARB_OBS1_CHNL206_STATUS_ADDR A:0xe616708
y.create.l HWIO_PMIC_ARB_OBS1_CHNL207_STATUS_ADDR A:0xe616788
y.create.l HWIO_PMIC_ARB_OBS1_CHNL208_STATUS_ADDR A:0xe616808
y.create.l HWIO_PMIC_ARB_OBS1_CHNL209_STATUS_ADDR A:0xe616888
y.create.l HWIO_PMIC_ARB_OBS1_CHNL210_STATUS_ADDR A:0xe616908
y.create.l HWIO_PMIC_ARB_OBS1_CHNL211_STATUS_ADDR A:0xe616988
y.create.l HWIO_PMIC_ARB_OBS1_CHNL212_STATUS_ADDR A:0xe616a08
y.create.l HWIO_PMIC_ARB_OBS1_CHNL213_STATUS_ADDR A:0xe616a88
y.create.l HWIO_PMIC_ARB_OBS1_CHNL214_STATUS_ADDR A:0xe616b08
y.create.l HWIO_PMIC_ARB_OBS1_CHNL215_STATUS_ADDR A:0xe616b88
y.create.l HWIO_PMIC_ARB_OBS1_CHNL216_STATUS_ADDR A:0xe616c08
y.create.l HWIO_PMIC_ARB_OBS1_CHNL217_STATUS_ADDR A:0xe616c88
y.create.l HWIO_PMIC_ARB_OBS1_CHNL218_STATUS_ADDR A:0xe616d08
y.create.l HWIO_PMIC_ARB_OBS1_CHNL219_STATUS_ADDR A:0xe616d88
y.create.l HWIO_PMIC_ARB_OBS1_CHNL220_STATUS_ADDR A:0xe616e08
y.create.l HWIO_PMIC_ARB_OBS1_CHNL221_STATUS_ADDR A:0xe616e88
y.create.l HWIO_PMIC_ARB_OBS1_CHNL222_STATUS_ADDR A:0xe616f08
y.create.l HWIO_PMIC_ARB_OBS1_CHNL223_STATUS_ADDR A:0xe616f88
y.create.l HWIO_PMIC_ARB_OBS1_CHNL224_STATUS_ADDR A:0xe617008
y.create.l HWIO_PMIC_ARB_OBS1_CHNL225_STATUS_ADDR A:0xe617088
y.create.l HWIO_PMIC_ARB_OBS1_CHNL226_STATUS_ADDR A:0xe617108
y.create.l HWIO_PMIC_ARB_OBS1_CHNL227_STATUS_ADDR A:0xe617188
y.create.l HWIO_PMIC_ARB_OBS1_CHNL228_STATUS_ADDR A:0xe617208
y.create.l HWIO_PMIC_ARB_OBS1_CHNL229_STATUS_ADDR A:0xe617288
y.create.l HWIO_PMIC_ARB_OBS1_CHNL230_STATUS_ADDR A:0xe617308
y.create.l HWIO_PMIC_ARB_OBS1_CHNL231_STATUS_ADDR A:0xe617388
y.create.l HWIO_PMIC_ARB_OBS1_CHNL232_STATUS_ADDR A:0xe617408
y.create.l HWIO_PMIC_ARB_OBS1_CHNL233_STATUS_ADDR A:0xe617488
y.create.l HWIO_PMIC_ARB_OBS1_CHNL234_STATUS_ADDR A:0xe617508
y.create.l HWIO_PMIC_ARB_OBS1_CHNL235_STATUS_ADDR A:0xe617588
y.create.l HWIO_PMIC_ARB_OBS1_CHNL236_STATUS_ADDR A:0xe617608
y.create.l HWIO_PMIC_ARB_OBS1_CHNL237_STATUS_ADDR A:0xe617688
y.create.l HWIO_PMIC_ARB_OBS1_CHNL238_STATUS_ADDR A:0xe617708
y.create.l HWIO_PMIC_ARB_OBS1_CHNL239_STATUS_ADDR A:0xe617788
y.create.l HWIO_PMIC_ARB_OBS1_CHNL240_STATUS_ADDR A:0xe617808
y.create.l HWIO_PMIC_ARB_OBS1_CHNL241_STATUS_ADDR A:0xe617888
y.create.l HWIO_PMIC_ARB_OBS1_CHNL242_STATUS_ADDR A:0xe617908
y.create.l HWIO_PMIC_ARB_OBS1_CHNL243_STATUS_ADDR A:0xe617988
y.create.l HWIO_PMIC_ARB_OBS1_CHNL244_STATUS_ADDR A:0xe617a08
y.create.l HWIO_PMIC_ARB_OBS1_CHNL245_STATUS_ADDR A:0xe617a88
y.create.l HWIO_PMIC_ARB_OBS1_CHNL246_STATUS_ADDR A:0xe617b08
y.create.l HWIO_PMIC_ARB_OBS1_CHNL247_STATUS_ADDR A:0xe617b88
y.create.l HWIO_PMIC_ARB_OBS1_CHNL248_STATUS_ADDR A:0xe617c08
y.create.l HWIO_PMIC_ARB_OBS1_CHNL249_STATUS_ADDR A:0xe617c88
y.create.l HWIO_PMIC_ARB_OBS1_CHNL250_STATUS_ADDR A:0xe617d08
y.create.l HWIO_PMIC_ARB_OBS1_CHNL251_STATUS_ADDR A:0xe617d88
y.create.l HWIO_PMIC_ARB_OBS1_CHNL252_STATUS_ADDR A:0xe617e08
y.create.l HWIO_PMIC_ARB_OBS1_CHNL253_STATUS_ADDR A:0xe617e88
y.create.l HWIO_PMIC_ARB_OBS1_CHNL254_STATUS_ADDR A:0xe617f08
y.create.l HWIO_PMIC_ARB_OBS1_CHNL255_STATUS_ADDR A:0xe617f88
y.create.l HWIO_PMIC_ARB_OBS2_CHNL0_STATUS_ADDR A:0xe620008
y.create.l HWIO_PMIC_ARB_OBS2_CHNL1_STATUS_ADDR A:0xe620088
y.create.l HWIO_PMIC_ARB_OBS2_CHNL2_STATUS_ADDR A:0xe620108
y.create.l HWIO_PMIC_ARB_OBS2_CHNL3_STATUS_ADDR A:0xe620188
y.create.l HWIO_PMIC_ARB_OBS2_CHNL4_STATUS_ADDR A:0xe620208
y.create.l HWIO_PMIC_ARB_OBS2_CHNL5_STATUS_ADDR A:0xe620288
y.create.l HWIO_PMIC_ARB_OBS2_CHNL6_STATUS_ADDR A:0xe620308
y.create.l HWIO_PMIC_ARB_OBS2_CHNL7_STATUS_ADDR A:0xe620388
y.create.l HWIO_PMIC_ARB_OBS2_CHNL8_STATUS_ADDR A:0xe620408
y.create.l HWIO_PMIC_ARB_OBS2_CHNL9_STATUS_ADDR A:0xe620488
y.create.l HWIO_PMIC_ARB_OBS2_CHNL10_STATUS_ADDR A:0xe620508
y.create.l HWIO_PMIC_ARB_OBS2_CHNL11_STATUS_ADDR A:0xe620588
y.create.l HWIO_PMIC_ARB_OBS2_CHNL12_STATUS_ADDR A:0xe620608
y.create.l HWIO_PMIC_ARB_OBS2_CHNL13_STATUS_ADDR A:0xe620688
y.create.l HWIO_PMIC_ARB_OBS2_CHNL14_STATUS_ADDR A:0xe620708
y.create.l HWIO_PMIC_ARB_OBS2_CHNL15_STATUS_ADDR A:0xe620788
y.create.l HWIO_PMIC_ARB_OBS2_CHNL16_STATUS_ADDR A:0xe620808
y.create.l HWIO_PMIC_ARB_OBS2_CHNL17_STATUS_ADDR A:0xe620888
y.create.l HWIO_PMIC_ARB_OBS2_CHNL18_STATUS_ADDR A:0xe620908
y.create.l HWIO_PMIC_ARB_OBS2_CHNL19_STATUS_ADDR A:0xe620988
y.create.l HWIO_PMIC_ARB_OBS2_CHNL20_STATUS_ADDR A:0xe620a08
y.create.l HWIO_PMIC_ARB_OBS2_CHNL21_STATUS_ADDR A:0xe620a88
y.create.l HWIO_PMIC_ARB_OBS2_CHNL22_STATUS_ADDR A:0xe620b08
y.create.l HWIO_PMIC_ARB_OBS2_CHNL23_STATUS_ADDR A:0xe620b88
y.create.l HWIO_PMIC_ARB_OBS2_CHNL24_STATUS_ADDR A:0xe620c08
y.create.l HWIO_PMIC_ARB_OBS2_CHNL25_STATUS_ADDR A:0xe620c88
y.create.l HWIO_PMIC_ARB_OBS2_CHNL26_STATUS_ADDR A:0xe620d08
y.create.l HWIO_PMIC_ARB_OBS2_CHNL27_STATUS_ADDR A:0xe620d88
y.create.l HWIO_PMIC_ARB_OBS2_CHNL28_STATUS_ADDR A:0xe620e08
y.create.l HWIO_PMIC_ARB_OBS2_CHNL29_STATUS_ADDR A:0xe620e88
y.create.l HWIO_PMIC_ARB_OBS2_CHNL30_STATUS_ADDR A:0xe620f08
y.create.l HWIO_PMIC_ARB_OBS2_CHNL31_STATUS_ADDR A:0xe620f88
y.create.l HWIO_PMIC_ARB_OBS2_CHNL32_STATUS_ADDR A:0xe621008
y.create.l HWIO_PMIC_ARB_OBS2_CHNL33_STATUS_ADDR A:0xe621088
y.create.l HWIO_PMIC_ARB_OBS2_CHNL34_STATUS_ADDR A:0xe621108
y.create.l HWIO_PMIC_ARB_OBS2_CHNL35_STATUS_ADDR A:0xe621188
y.create.l HWIO_PMIC_ARB_OBS2_CHNL36_STATUS_ADDR A:0xe621208
y.create.l HWIO_PMIC_ARB_OBS2_CHNL37_STATUS_ADDR A:0xe621288
y.create.l HWIO_PMIC_ARB_OBS2_CHNL38_STATUS_ADDR A:0xe621308
y.create.l HWIO_PMIC_ARB_OBS2_CHNL39_STATUS_ADDR A:0xe621388
y.create.l HWIO_PMIC_ARB_OBS2_CHNL40_STATUS_ADDR A:0xe621408
y.create.l HWIO_PMIC_ARB_OBS2_CHNL41_STATUS_ADDR A:0xe621488
y.create.l HWIO_PMIC_ARB_OBS2_CHNL42_STATUS_ADDR A:0xe621508
y.create.l HWIO_PMIC_ARB_OBS2_CHNL43_STATUS_ADDR A:0xe621588
y.create.l HWIO_PMIC_ARB_OBS2_CHNL44_STATUS_ADDR A:0xe621608
y.create.l HWIO_PMIC_ARB_OBS2_CHNL45_STATUS_ADDR A:0xe621688
y.create.l HWIO_PMIC_ARB_OBS2_CHNL46_STATUS_ADDR A:0xe621708
y.create.l HWIO_PMIC_ARB_OBS2_CHNL47_STATUS_ADDR A:0xe621788
y.create.l HWIO_PMIC_ARB_OBS2_CHNL48_STATUS_ADDR A:0xe621808
y.create.l HWIO_PMIC_ARB_OBS2_CHNL49_STATUS_ADDR A:0xe621888
y.create.l HWIO_PMIC_ARB_OBS2_CHNL50_STATUS_ADDR A:0xe621908
y.create.l HWIO_PMIC_ARB_OBS2_CHNL51_STATUS_ADDR A:0xe621988
y.create.l HWIO_PMIC_ARB_OBS2_CHNL52_STATUS_ADDR A:0xe621a08
y.create.l HWIO_PMIC_ARB_OBS2_CHNL53_STATUS_ADDR A:0xe621a88
y.create.l HWIO_PMIC_ARB_OBS2_CHNL54_STATUS_ADDR A:0xe621b08
y.create.l HWIO_PMIC_ARB_OBS2_CHNL55_STATUS_ADDR A:0xe621b88
y.create.l HWIO_PMIC_ARB_OBS2_CHNL56_STATUS_ADDR A:0xe621c08
y.create.l HWIO_PMIC_ARB_OBS2_CHNL57_STATUS_ADDR A:0xe621c88
y.create.l HWIO_PMIC_ARB_OBS2_CHNL58_STATUS_ADDR A:0xe621d08
y.create.l HWIO_PMIC_ARB_OBS2_CHNL59_STATUS_ADDR A:0xe621d88
y.create.l HWIO_PMIC_ARB_OBS2_CHNL60_STATUS_ADDR A:0xe621e08
y.create.l HWIO_PMIC_ARB_OBS2_CHNL61_STATUS_ADDR A:0xe621e88
y.create.l HWIO_PMIC_ARB_OBS2_CHNL62_STATUS_ADDR A:0xe621f08
y.create.l HWIO_PMIC_ARB_OBS2_CHNL63_STATUS_ADDR A:0xe621f88
y.create.l HWIO_PMIC_ARB_OBS2_CHNL64_STATUS_ADDR A:0xe622008
y.create.l HWIO_PMIC_ARB_OBS2_CHNL65_STATUS_ADDR A:0xe622088
y.create.l HWIO_PMIC_ARB_OBS2_CHNL66_STATUS_ADDR A:0xe622108
y.create.l HWIO_PMIC_ARB_OBS2_CHNL67_STATUS_ADDR A:0xe622188
y.create.l HWIO_PMIC_ARB_OBS2_CHNL68_STATUS_ADDR A:0xe622208
y.create.l HWIO_PMIC_ARB_OBS2_CHNL69_STATUS_ADDR A:0xe622288
y.create.l HWIO_PMIC_ARB_OBS2_CHNL70_STATUS_ADDR A:0xe622308
y.create.l HWIO_PMIC_ARB_OBS2_CHNL71_STATUS_ADDR A:0xe622388
y.create.l HWIO_PMIC_ARB_OBS2_CHNL72_STATUS_ADDR A:0xe622408
y.create.l HWIO_PMIC_ARB_OBS2_CHNL73_STATUS_ADDR A:0xe622488
y.create.l HWIO_PMIC_ARB_OBS2_CHNL74_STATUS_ADDR A:0xe622508
y.create.l HWIO_PMIC_ARB_OBS2_CHNL75_STATUS_ADDR A:0xe622588
y.create.l HWIO_PMIC_ARB_OBS2_CHNL76_STATUS_ADDR A:0xe622608
y.create.l HWIO_PMIC_ARB_OBS2_CHNL77_STATUS_ADDR A:0xe622688
y.create.l HWIO_PMIC_ARB_OBS2_CHNL78_STATUS_ADDR A:0xe622708
y.create.l HWIO_PMIC_ARB_OBS2_CHNL79_STATUS_ADDR A:0xe622788
y.create.l HWIO_PMIC_ARB_OBS2_CHNL80_STATUS_ADDR A:0xe622808
y.create.l HWIO_PMIC_ARB_OBS2_CHNL81_STATUS_ADDR A:0xe622888
y.create.l HWIO_PMIC_ARB_OBS2_CHNL82_STATUS_ADDR A:0xe622908
y.create.l HWIO_PMIC_ARB_OBS2_CHNL83_STATUS_ADDR A:0xe622988
y.create.l HWIO_PMIC_ARB_OBS2_CHNL84_STATUS_ADDR A:0xe622a08
y.create.l HWIO_PMIC_ARB_OBS2_CHNL85_STATUS_ADDR A:0xe622a88
y.create.l HWIO_PMIC_ARB_OBS2_CHNL86_STATUS_ADDR A:0xe622b08
y.create.l HWIO_PMIC_ARB_OBS2_CHNL87_STATUS_ADDR A:0xe622b88
y.create.l HWIO_PMIC_ARB_OBS2_CHNL88_STATUS_ADDR A:0xe622c08
y.create.l HWIO_PMIC_ARB_OBS2_CHNL89_STATUS_ADDR A:0xe622c88
y.create.l HWIO_PMIC_ARB_OBS2_CHNL90_STATUS_ADDR A:0xe622d08
y.create.l HWIO_PMIC_ARB_OBS2_CHNL91_STATUS_ADDR A:0xe622d88
y.create.l HWIO_PMIC_ARB_OBS2_CHNL92_STATUS_ADDR A:0xe622e08
y.create.l HWIO_PMIC_ARB_OBS2_CHNL93_STATUS_ADDR A:0xe622e88
y.create.l HWIO_PMIC_ARB_OBS2_CHNL94_STATUS_ADDR A:0xe622f08
y.create.l HWIO_PMIC_ARB_OBS2_CHNL95_STATUS_ADDR A:0xe622f88
y.create.l HWIO_PMIC_ARB_OBS2_CHNL96_STATUS_ADDR A:0xe623008
y.create.l HWIO_PMIC_ARB_OBS2_CHNL97_STATUS_ADDR A:0xe623088
y.create.l HWIO_PMIC_ARB_OBS2_CHNL98_STATUS_ADDR A:0xe623108
y.create.l HWIO_PMIC_ARB_OBS2_CHNL99_STATUS_ADDR A:0xe623188
y.create.l HWIO_PMIC_ARB_OBS2_CHNL100_STATUS_ADDR A:0xe623208
y.create.l HWIO_PMIC_ARB_OBS2_CHNL101_STATUS_ADDR A:0xe623288
y.create.l HWIO_PMIC_ARB_OBS2_CHNL102_STATUS_ADDR A:0xe623308
y.create.l HWIO_PMIC_ARB_OBS2_CHNL103_STATUS_ADDR A:0xe623388
y.create.l HWIO_PMIC_ARB_OBS2_CHNL104_STATUS_ADDR A:0xe623408
y.create.l HWIO_PMIC_ARB_OBS2_CHNL105_STATUS_ADDR A:0xe623488
y.create.l HWIO_PMIC_ARB_OBS2_CHNL106_STATUS_ADDR A:0xe623508
y.create.l HWIO_PMIC_ARB_OBS2_CHNL107_STATUS_ADDR A:0xe623588
y.create.l HWIO_PMIC_ARB_OBS2_CHNL108_STATUS_ADDR A:0xe623608
y.create.l HWIO_PMIC_ARB_OBS2_CHNL109_STATUS_ADDR A:0xe623688
y.create.l HWIO_PMIC_ARB_OBS2_CHNL110_STATUS_ADDR A:0xe623708
y.create.l HWIO_PMIC_ARB_OBS2_CHNL111_STATUS_ADDR A:0xe623788
y.create.l HWIO_PMIC_ARB_OBS2_CHNL112_STATUS_ADDR A:0xe623808
y.create.l HWIO_PMIC_ARB_OBS2_CHNL113_STATUS_ADDR A:0xe623888
y.create.l HWIO_PMIC_ARB_OBS2_CHNL114_STATUS_ADDR A:0xe623908
y.create.l HWIO_PMIC_ARB_OBS2_CHNL115_STATUS_ADDR A:0xe623988
y.create.l HWIO_PMIC_ARB_OBS2_CHNL116_STATUS_ADDR A:0xe623a08
y.create.l HWIO_PMIC_ARB_OBS2_CHNL117_STATUS_ADDR A:0xe623a88
y.create.l HWIO_PMIC_ARB_OBS2_CHNL118_STATUS_ADDR A:0xe623b08
y.create.l HWIO_PMIC_ARB_OBS2_CHNL119_STATUS_ADDR A:0xe623b88
y.create.l HWIO_PMIC_ARB_OBS2_CHNL120_STATUS_ADDR A:0xe623c08
y.create.l HWIO_PMIC_ARB_OBS2_CHNL121_STATUS_ADDR A:0xe623c88
y.create.l HWIO_PMIC_ARB_OBS2_CHNL122_STATUS_ADDR A:0xe623d08
y.create.l HWIO_PMIC_ARB_OBS2_CHNL123_STATUS_ADDR A:0xe623d88
y.create.l HWIO_PMIC_ARB_OBS2_CHNL124_STATUS_ADDR A:0xe623e08
y.create.l HWIO_PMIC_ARB_OBS2_CHNL125_STATUS_ADDR A:0xe623e88
y.create.l HWIO_PMIC_ARB_OBS2_CHNL126_STATUS_ADDR A:0xe623f08
y.create.l HWIO_PMIC_ARB_OBS2_CHNL127_STATUS_ADDR A:0xe623f88
y.create.l HWIO_PMIC_ARB_OBS2_CHNL128_STATUS_ADDR A:0xe624008
y.create.l HWIO_PMIC_ARB_OBS2_CHNL129_STATUS_ADDR A:0xe624088
y.create.l HWIO_PMIC_ARB_OBS2_CHNL130_STATUS_ADDR A:0xe624108
y.create.l HWIO_PMIC_ARB_OBS2_CHNL131_STATUS_ADDR A:0xe624188
y.create.l HWIO_PMIC_ARB_OBS2_CHNL132_STATUS_ADDR A:0xe624208
y.create.l HWIO_PMIC_ARB_OBS2_CHNL133_STATUS_ADDR A:0xe624288
y.create.l HWIO_PMIC_ARB_OBS2_CHNL134_STATUS_ADDR A:0xe624308
y.create.l HWIO_PMIC_ARB_OBS2_CHNL135_STATUS_ADDR A:0xe624388
y.create.l HWIO_PMIC_ARB_OBS2_CHNL136_STATUS_ADDR A:0xe624408
y.create.l HWIO_PMIC_ARB_OBS2_CHNL137_STATUS_ADDR A:0xe624488
y.create.l HWIO_PMIC_ARB_OBS2_CHNL138_STATUS_ADDR A:0xe624508
y.create.l HWIO_PMIC_ARB_OBS2_CHNL139_STATUS_ADDR A:0xe624588
y.create.l HWIO_PMIC_ARB_OBS2_CHNL140_STATUS_ADDR A:0xe624608
y.create.l HWIO_PMIC_ARB_OBS2_CHNL141_STATUS_ADDR A:0xe624688
y.create.l HWIO_PMIC_ARB_OBS2_CHNL142_STATUS_ADDR A:0xe624708
y.create.l HWIO_PMIC_ARB_OBS2_CHNL143_STATUS_ADDR A:0xe624788
y.create.l HWIO_PMIC_ARB_OBS2_CHNL144_STATUS_ADDR A:0xe624808
y.create.l HWIO_PMIC_ARB_OBS2_CHNL145_STATUS_ADDR A:0xe624888
y.create.l HWIO_PMIC_ARB_OBS2_CHNL146_STATUS_ADDR A:0xe624908
y.create.l HWIO_PMIC_ARB_OBS2_CHNL147_STATUS_ADDR A:0xe624988
y.create.l HWIO_PMIC_ARB_OBS2_CHNL148_STATUS_ADDR A:0xe624a08
y.create.l HWIO_PMIC_ARB_OBS2_CHNL149_STATUS_ADDR A:0xe624a88
y.create.l HWIO_PMIC_ARB_OBS2_CHNL150_STATUS_ADDR A:0xe624b08
y.create.l HWIO_PMIC_ARB_OBS2_CHNL151_STATUS_ADDR A:0xe624b88
y.create.l HWIO_PMIC_ARB_OBS2_CHNL152_STATUS_ADDR A:0xe624c08
y.create.l HWIO_PMIC_ARB_OBS2_CHNL153_STATUS_ADDR A:0xe624c88
y.create.l HWIO_PMIC_ARB_OBS2_CHNL154_STATUS_ADDR A:0xe624d08
y.create.l HWIO_PMIC_ARB_OBS2_CHNL155_STATUS_ADDR A:0xe624d88
y.create.l HWIO_PMIC_ARB_OBS2_CHNL156_STATUS_ADDR A:0xe624e08
y.create.l HWIO_PMIC_ARB_OBS2_CHNL157_STATUS_ADDR A:0xe624e88
y.create.l HWIO_PMIC_ARB_OBS2_CHNL158_STATUS_ADDR A:0xe624f08
y.create.l HWIO_PMIC_ARB_OBS2_CHNL159_STATUS_ADDR A:0xe624f88
y.create.l HWIO_PMIC_ARB_OBS2_CHNL160_STATUS_ADDR A:0xe625008
y.create.l HWIO_PMIC_ARB_OBS2_CHNL161_STATUS_ADDR A:0xe625088
y.create.l HWIO_PMIC_ARB_OBS2_CHNL162_STATUS_ADDR A:0xe625108
y.create.l HWIO_PMIC_ARB_OBS2_CHNL163_STATUS_ADDR A:0xe625188
y.create.l HWIO_PMIC_ARB_OBS2_CHNL164_STATUS_ADDR A:0xe625208
y.create.l HWIO_PMIC_ARB_OBS2_CHNL165_STATUS_ADDR A:0xe625288
y.create.l HWIO_PMIC_ARB_OBS2_CHNL166_STATUS_ADDR A:0xe625308
y.create.l HWIO_PMIC_ARB_OBS2_CHNL167_STATUS_ADDR A:0xe625388
y.create.l HWIO_PMIC_ARB_OBS2_CHNL168_STATUS_ADDR A:0xe625408
y.create.l HWIO_PMIC_ARB_OBS2_CHNL169_STATUS_ADDR A:0xe625488
y.create.l HWIO_PMIC_ARB_OBS2_CHNL170_STATUS_ADDR A:0xe625508
y.create.l HWIO_PMIC_ARB_OBS2_CHNL171_STATUS_ADDR A:0xe625588
y.create.l HWIO_PMIC_ARB_OBS2_CHNL172_STATUS_ADDR A:0xe625608
y.create.l HWIO_PMIC_ARB_OBS2_CHNL173_STATUS_ADDR A:0xe625688
y.create.l HWIO_PMIC_ARB_OBS2_CHNL174_STATUS_ADDR A:0xe625708
y.create.l HWIO_PMIC_ARB_OBS2_CHNL175_STATUS_ADDR A:0xe625788
y.create.l HWIO_PMIC_ARB_OBS2_CHNL176_STATUS_ADDR A:0xe625808
y.create.l HWIO_PMIC_ARB_OBS2_CHNL177_STATUS_ADDR A:0xe625888
y.create.l HWIO_PMIC_ARB_OBS2_CHNL178_STATUS_ADDR A:0xe625908
y.create.l HWIO_PMIC_ARB_OBS2_CHNL179_STATUS_ADDR A:0xe625988
y.create.l HWIO_PMIC_ARB_OBS2_CHNL180_STATUS_ADDR A:0xe625a08
y.create.l HWIO_PMIC_ARB_OBS2_CHNL181_STATUS_ADDR A:0xe625a88
y.create.l HWIO_PMIC_ARB_OBS2_CHNL182_STATUS_ADDR A:0xe625b08
y.create.l HWIO_PMIC_ARB_OBS2_CHNL183_STATUS_ADDR A:0xe625b88
y.create.l HWIO_PMIC_ARB_OBS2_CHNL184_STATUS_ADDR A:0xe625c08
y.create.l HWIO_PMIC_ARB_OBS2_CHNL185_STATUS_ADDR A:0xe625c88
y.create.l HWIO_PMIC_ARB_OBS2_CHNL186_STATUS_ADDR A:0xe625d08
y.create.l HWIO_PMIC_ARB_OBS2_CHNL187_STATUS_ADDR A:0xe625d88
y.create.l HWIO_PMIC_ARB_OBS2_CHNL188_STATUS_ADDR A:0xe625e08
y.create.l HWIO_PMIC_ARB_OBS2_CHNL189_STATUS_ADDR A:0xe625e88
y.create.l HWIO_PMIC_ARB_OBS2_CHNL190_STATUS_ADDR A:0xe625f08
y.create.l HWIO_PMIC_ARB_OBS2_CHNL191_STATUS_ADDR A:0xe625f88
y.create.l HWIO_PMIC_ARB_OBS2_CHNL192_STATUS_ADDR A:0xe626008
y.create.l HWIO_PMIC_ARB_OBS2_CHNL193_STATUS_ADDR A:0xe626088
y.create.l HWIO_PMIC_ARB_OBS2_CHNL194_STATUS_ADDR A:0xe626108
y.create.l HWIO_PMIC_ARB_OBS2_CHNL195_STATUS_ADDR A:0xe626188
y.create.l HWIO_PMIC_ARB_OBS2_CHNL196_STATUS_ADDR A:0xe626208
y.create.l HWIO_PMIC_ARB_OBS2_CHNL197_STATUS_ADDR A:0xe626288
y.create.l HWIO_PMIC_ARB_OBS2_CHNL198_STATUS_ADDR A:0xe626308
y.create.l HWIO_PMIC_ARB_OBS2_CHNL199_STATUS_ADDR A:0xe626388
y.create.l HWIO_PMIC_ARB_OBS2_CHNL200_STATUS_ADDR A:0xe626408
y.create.l HWIO_PMIC_ARB_OBS2_CHNL201_STATUS_ADDR A:0xe626488
y.create.l HWIO_PMIC_ARB_OBS2_CHNL202_STATUS_ADDR A:0xe626508
y.create.l HWIO_PMIC_ARB_OBS2_CHNL203_STATUS_ADDR A:0xe626588
y.create.l HWIO_PMIC_ARB_OBS2_CHNL204_STATUS_ADDR A:0xe626608
y.create.l HWIO_PMIC_ARB_OBS2_CHNL205_STATUS_ADDR A:0xe626688
y.create.l HWIO_PMIC_ARB_OBS2_CHNL206_STATUS_ADDR A:0xe626708
y.create.l HWIO_PMIC_ARB_OBS2_CHNL207_STATUS_ADDR A:0xe626788
y.create.l HWIO_PMIC_ARB_OBS2_CHNL208_STATUS_ADDR A:0xe626808
y.create.l HWIO_PMIC_ARB_OBS2_CHNL209_STATUS_ADDR A:0xe626888
y.create.l HWIO_PMIC_ARB_OBS2_CHNL210_STATUS_ADDR A:0xe626908
y.create.l HWIO_PMIC_ARB_OBS2_CHNL211_STATUS_ADDR A:0xe626988
y.create.l HWIO_PMIC_ARB_OBS2_CHNL212_STATUS_ADDR A:0xe626a08
y.create.l HWIO_PMIC_ARB_OBS2_CHNL213_STATUS_ADDR A:0xe626a88
y.create.l HWIO_PMIC_ARB_OBS2_CHNL214_STATUS_ADDR A:0xe626b08
y.create.l HWIO_PMIC_ARB_OBS2_CHNL215_STATUS_ADDR A:0xe626b88
y.create.l HWIO_PMIC_ARB_OBS2_CHNL216_STATUS_ADDR A:0xe626c08
y.create.l HWIO_PMIC_ARB_OBS2_CHNL217_STATUS_ADDR A:0xe626c88
y.create.l HWIO_PMIC_ARB_OBS2_CHNL218_STATUS_ADDR A:0xe626d08
y.create.l HWIO_PMIC_ARB_OBS2_CHNL219_STATUS_ADDR A:0xe626d88
y.create.l HWIO_PMIC_ARB_OBS2_CHNL220_STATUS_ADDR A:0xe626e08
y.create.l HWIO_PMIC_ARB_OBS2_CHNL221_STATUS_ADDR A:0xe626e88
y.create.l HWIO_PMIC_ARB_OBS2_CHNL222_STATUS_ADDR A:0xe626f08
y.create.l HWIO_PMIC_ARB_OBS2_CHNL223_STATUS_ADDR A:0xe626f88
y.create.l HWIO_PMIC_ARB_OBS2_CHNL224_STATUS_ADDR A:0xe627008
y.create.l HWIO_PMIC_ARB_OBS2_CHNL225_STATUS_ADDR A:0xe627088
y.create.l HWIO_PMIC_ARB_OBS2_CHNL226_STATUS_ADDR A:0xe627108
y.create.l HWIO_PMIC_ARB_OBS2_CHNL227_STATUS_ADDR A:0xe627188
y.create.l HWIO_PMIC_ARB_OBS2_CHNL228_STATUS_ADDR A:0xe627208
y.create.l HWIO_PMIC_ARB_OBS2_CHNL229_STATUS_ADDR A:0xe627288
y.create.l HWIO_PMIC_ARB_OBS2_CHNL230_STATUS_ADDR A:0xe627308
y.create.l HWIO_PMIC_ARB_OBS2_CHNL231_STATUS_ADDR A:0xe627388
y.create.l HWIO_PMIC_ARB_OBS2_CHNL232_STATUS_ADDR A:0xe627408
y.create.l HWIO_PMIC_ARB_OBS2_CHNL233_STATUS_ADDR A:0xe627488
y.create.l HWIO_PMIC_ARB_OBS2_CHNL234_STATUS_ADDR A:0xe627508
y.create.l HWIO_PMIC_ARB_OBS2_CHNL235_STATUS_ADDR A:0xe627588
y.create.l HWIO_PMIC_ARB_OBS2_CHNL236_STATUS_ADDR A:0xe627608
y.create.l HWIO_PMIC_ARB_OBS2_CHNL237_STATUS_ADDR A:0xe627688
y.create.l HWIO_PMIC_ARB_OBS2_CHNL238_STATUS_ADDR A:0xe627708
y.create.l HWIO_PMIC_ARB_OBS2_CHNL239_STATUS_ADDR A:0xe627788
y.create.l HWIO_PMIC_ARB_OBS2_CHNL240_STATUS_ADDR A:0xe627808
y.create.l HWIO_PMIC_ARB_OBS2_CHNL241_STATUS_ADDR A:0xe627888
y.create.l HWIO_PMIC_ARB_OBS2_CHNL242_STATUS_ADDR A:0xe627908
y.create.l HWIO_PMIC_ARB_OBS2_CHNL243_STATUS_ADDR A:0xe627988
y.create.l HWIO_PMIC_ARB_OBS2_CHNL244_STATUS_ADDR A:0xe627a08
y.create.l HWIO_PMIC_ARB_OBS2_CHNL245_STATUS_ADDR A:0xe627a88
y.create.l HWIO_PMIC_ARB_OBS2_CHNL246_STATUS_ADDR A:0xe627b08
y.create.l HWIO_PMIC_ARB_OBS2_CHNL247_STATUS_ADDR A:0xe627b88
y.create.l HWIO_PMIC_ARB_OBS2_CHNL248_STATUS_ADDR A:0xe627c08
y.create.l HWIO_PMIC_ARB_OBS2_CHNL249_STATUS_ADDR A:0xe627c88
y.create.l HWIO_PMIC_ARB_OBS2_CHNL250_STATUS_ADDR A:0xe627d08
y.create.l HWIO_PMIC_ARB_OBS2_CHNL251_STATUS_ADDR A:0xe627d88
y.create.l HWIO_PMIC_ARB_OBS2_CHNL252_STATUS_ADDR A:0xe627e08
y.create.l HWIO_PMIC_ARB_OBS2_CHNL253_STATUS_ADDR A:0xe627e88
y.create.l HWIO_PMIC_ARB_OBS2_CHNL254_STATUS_ADDR A:0xe627f08
y.create.l HWIO_PMIC_ARB_OBS2_CHNL255_STATUS_ADDR A:0xe627f88
y.create.l HWIO_PMIC_ARB_OBS3_CHNL0_STATUS_ADDR A:0xe630008
y.create.l HWIO_PMIC_ARB_OBS3_CHNL1_STATUS_ADDR A:0xe630088
y.create.l HWIO_PMIC_ARB_OBS3_CHNL2_STATUS_ADDR A:0xe630108
y.create.l HWIO_PMIC_ARB_OBS3_CHNL3_STATUS_ADDR A:0xe630188
y.create.l HWIO_PMIC_ARB_OBS3_CHNL4_STATUS_ADDR A:0xe630208
y.create.l HWIO_PMIC_ARB_OBS3_CHNL5_STATUS_ADDR A:0xe630288
y.create.l HWIO_PMIC_ARB_OBS3_CHNL6_STATUS_ADDR A:0xe630308
y.create.l HWIO_PMIC_ARB_OBS3_CHNL7_STATUS_ADDR A:0xe630388
y.create.l HWIO_PMIC_ARB_OBS3_CHNL8_STATUS_ADDR A:0xe630408
y.create.l HWIO_PMIC_ARB_OBS3_CHNL9_STATUS_ADDR A:0xe630488
y.create.l HWIO_PMIC_ARB_OBS3_CHNL10_STATUS_ADDR A:0xe630508
y.create.l HWIO_PMIC_ARB_OBS3_CHNL11_STATUS_ADDR A:0xe630588
y.create.l HWIO_PMIC_ARB_OBS3_CHNL12_STATUS_ADDR A:0xe630608
y.create.l HWIO_PMIC_ARB_OBS3_CHNL13_STATUS_ADDR A:0xe630688
y.create.l HWIO_PMIC_ARB_OBS3_CHNL14_STATUS_ADDR A:0xe630708
y.create.l HWIO_PMIC_ARB_OBS3_CHNL15_STATUS_ADDR A:0xe630788
y.create.l HWIO_PMIC_ARB_OBS3_CHNL16_STATUS_ADDR A:0xe630808
y.create.l HWIO_PMIC_ARB_OBS3_CHNL17_STATUS_ADDR A:0xe630888
y.create.l HWIO_PMIC_ARB_OBS3_CHNL18_STATUS_ADDR A:0xe630908
y.create.l HWIO_PMIC_ARB_OBS3_CHNL19_STATUS_ADDR A:0xe630988
y.create.l HWIO_PMIC_ARB_OBS3_CHNL20_STATUS_ADDR A:0xe630a08
y.create.l HWIO_PMIC_ARB_OBS3_CHNL21_STATUS_ADDR A:0xe630a88
y.create.l HWIO_PMIC_ARB_OBS3_CHNL22_STATUS_ADDR A:0xe630b08
y.create.l HWIO_PMIC_ARB_OBS3_CHNL23_STATUS_ADDR A:0xe630b88
y.create.l HWIO_PMIC_ARB_OBS3_CHNL24_STATUS_ADDR A:0xe630c08
y.create.l HWIO_PMIC_ARB_OBS3_CHNL25_STATUS_ADDR A:0xe630c88
y.create.l HWIO_PMIC_ARB_OBS3_CHNL26_STATUS_ADDR A:0xe630d08
y.create.l HWIO_PMIC_ARB_OBS3_CHNL27_STATUS_ADDR A:0xe630d88
y.create.l HWIO_PMIC_ARB_OBS3_CHNL28_STATUS_ADDR A:0xe630e08
y.create.l HWIO_PMIC_ARB_OBS3_CHNL29_STATUS_ADDR A:0xe630e88
y.create.l HWIO_PMIC_ARB_OBS3_CHNL30_STATUS_ADDR A:0xe630f08
y.create.l HWIO_PMIC_ARB_OBS3_CHNL31_STATUS_ADDR A:0xe630f88
y.create.l HWIO_PMIC_ARB_OBS3_CHNL32_STATUS_ADDR A:0xe631008
y.create.l HWIO_PMIC_ARB_OBS3_CHNL33_STATUS_ADDR A:0xe631088
y.create.l HWIO_PMIC_ARB_OBS3_CHNL34_STATUS_ADDR A:0xe631108
y.create.l HWIO_PMIC_ARB_OBS3_CHNL35_STATUS_ADDR A:0xe631188
y.create.l HWIO_PMIC_ARB_OBS3_CHNL36_STATUS_ADDR A:0xe631208
y.create.l HWIO_PMIC_ARB_OBS3_CHNL37_STATUS_ADDR A:0xe631288
y.create.l HWIO_PMIC_ARB_OBS3_CHNL38_STATUS_ADDR A:0xe631308
y.create.l HWIO_PMIC_ARB_OBS3_CHNL39_STATUS_ADDR A:0xe631388
y.create.l HWIO_PMIC_ARB_OBS3_CHNL40_STATUS_ADDR A:0xe631408
y.create.l HWIO_PMIC_ARB_OBS3_CHNL41_STATUS_ADDR A:0xe631488
y.create.l HWIO_PMIC_ARB_OBS3_CHNL42_STATUS_ADDR A:0xe631508
y.create.l HWIO_PMIC_ARB_OBS3_CHNL43_STATUS_ADDR A:0xe631588
y.create.l HWIO_PMIC_ARB_OBS3_CHNL44_STATUS_ADDR A:0xe631608
y.create.l HWIO_PMIC_ARB_OBS3_CHNL45_STATUS_ADDR A:0xe631688
y.create.l HWIO_PMIC_ARB_OBS3_CHNL46_STATUS_ADDR A:0xe631708
y.create.l HWIO_PMIC_ARB_OBS3_CHNL47_STATUS_ADDR A:0xe631788
y.create.l HWIO_PMIC_ARB_OBS3_CHNL48_STATUS_ADDR A:0xe631808
y.create.l HWIO_PMIC_ARB_OBS3_CHNL49_STATUS_ADDR A:0xe631888
y.create.l HWIO_PMIC_ARB_OBS3_CHNL50_STATUS_ADDR A:0xe631908
y.create.l HWIO_PMIC_ARB_OBS3_CHNL51_STATUS_ADDR A:0xe631988
y.create.l HWIO_PMIC_ARB_OBS3_CHNL52_STATUS_ADDR A:0xe631a08
y.create.l HWIO_PMIC_ARB_OBS3_CHNL53_STATUS_ADDR A:0xe631a88
y.create.l HWIO_PMIC_ARB_OBS3_CHNL54_STATUS_ADDR A:0xe631b08
y.create.l HWIO_PMIC_ARB_OBS3_CHNL55_STATUS_ADDR A:0xe631b88
y.create.l HWIO_PMIC_ARB_OBS3_CHNL56_STATUS_ADDR A:0xe631c08
y.create.l HWIO_PMIC_ARB_OBS3_CHNL57_STATUS_ADDR A:0xe631c88
y.create.l HWIO_PMIC_ARB_OBS3_CHNL58_STATUS_ADDR A:0xe631d08
y.create.l HWIO_PMIC_ARB_OBS3_CHNL59_STATUS_ADDR A:0xe631d88
y.create.l HWIO_PMIC_ARB_OBS3_CHNL60_STATUS_ADDR A:0xe631e08
y.create.l HWIO_PMIC_ARB_OBS3_CHNL61_STATUS_ADDR A:0xe631e88
y.create.l HWIO_PMIC_ARB_OBS3_CHNL62_STATUS_ADDR A:0xe631f08
y.create.l HWIO_PMIC_ARB_OBS3_CHNL63_STATUS_ADDR A:0xe631f88
y.create.l HWIO_PMIC_ARB_OBS3_CHNL64_STATUS_ADDR A:0xe632008
y.create.l HWIO_PMIC_ARB_OBS3_CHNL65_STATUS_ADDR A:0xe632088
y.create.l HWIO_PMIC_ARB_OBS3_CHNL66_STATUS_ADDR A:0xe632108
y.create.l HWIO_PMIC_ARB_OBS3_CHNL67_STATUS_ADDR A:0xe632188
y.create.l HWIO_PMIC_ARB_OBS3_CHNL68_STATUS_ADDR A:0xe632208
y.create.l HWIO_PMIC_ARB_OBS3_CHNL69_STATUS_ADDR A:0xe632288
y.create.l HWIO_PMIC_ARB_OBS3_CHNL70_STATUS_ADDR A:0xe632308
y.create.l HWIO_PMIC_ARB_OBS3_CHNL71_STATUS_ADDR A:0xe632388
y.create.l HWIO_PMIC_ARB_OBS3_CHNL72_STATUS_ADDR A:0xe632408
y.create.l HWIO_PMIC_ARB_OBS3_CHNL73_STATUS_ADDR A:0xe632488
y.create.l HWIO_PMIC_ARB_OBS3_CHNL74_STATUS_ADDR A:0xe632508
y.create.l HWIO_PMIC_ARB_OBS3_CHNL75_STATUS_ADDR A:0xe632588
y.create.l HWIO_PMIC_ARB_OBS3_CHNL76_STATUS_ADDR A:0xe632608
y.create.l HWIO_PMIC_ARB_OBS3_CHNL77_STATUS_ADDR A:0xe632688
y.create.l HWIO_PMIC_ARB_OBS3_CHNL78_STATUS_ADDR A:0xe632708
y.create.l HWIO_PMIC_ARB_OBS3_CHNL79_STATUS_ADDR A:0xe632788
y.create.l HWIO_PMIC_ARB_OBS3_CHNL80_STATUS_ADDR A:0xe632808
y.create.l HWIO_PMIC_ARB_OBS3_CHNL81_STATUS_ADDR A:0xe632888
y.create.l HWIO_PMIC_ARB_OBS3_CHNL82_STATUS_ADDR A:0xe632908
y.create.l HWIO_PMIC_ARB_OBS3_CHNL83_STATUS_ADDR A:0xe632988
y.create.l HWIO_PMIC_ARB_OBS3_CHNL84_STATUS_ADDR A:0xe632a08
y.create.l HWIO_PMIC_ARB_OBS3_CHNL85_STATUS_ADDR A:0xe632a88
y.create.l HWIO_PMIC_ARB_OBS3_CHNL86_STATUS_ADDR A:0xe632b08
y.create.l HWIO_PMIC_ARB_OBS3_CHNL87_STATUS_ADDR A:0xe632b88
y.create.l HWIO_PMIC_ARB_OBS3_CHNL88_STATUS_ADDR A:0xe632c08
y.create.l HWIO_PMIC_ARB_OBS3_CHNL89_STATUS_ADDR A:0xe632c88
y.create.l HWIO_PMIC_ARB_OBS3_CHNL90_STATUS_ADDR A:0xe632d08
y.create.l HWIO_PMIC_ARB_OBS3_CHNL91_STATUS_ADDR A:0xe632d88
y.create.l HWIO_PMIC_ARB_OBS3_CHNL92_STATUS_ADDR A:0xe632e08
y.create.l HWIO_PMIC_ARB_OBS3_CHNL93_STATUS_ADDR A:0xe632e88
y.create.l HWIO_PMIC_ARB_OBS3_CHNL94_STATUS_ADDR A:0xe632f08
y.create.l HWIO_PMIC_ARB_OBS3_CHNL95_STATUS_ADDR A:0xe632f88
y.create.l HWIO_PMIC_ARB_OBS3_CHNL96_STATUS_ADDR A:0xe633008
y.create.l HWIO_PMIC_ARB_OBS3_CHNL97_STATUS_ADDR A:0xe633088
y.create.l HWIO_PMIC_ARB_OBS3_CHNL98_STATUS_ADDR A:0xe633108
y.create.l HWIO_PMIC_ARB_OBS3_CHNL99_STATUS_ADDR A:0xe633188
y.create.l HWIO_PMIC_ARB_OBS3_CHNL100_STATUS_ADDR A:0xe633208
y.create.l HWIO_PMIC_ARB_OBS3_CHNL101_STATUS_ADDR A:0xe633288
y.create.l HWIO_PMIC_ARB_OBS3_CHNL102_STATUS_ADDR A:0xe633308
y.create.l HWIO_PMIC_ARB_OBS3_CHNL103_STATUS_ADDR A:0xe633388
y.create.l HWIO_PMIC_ARB_OBS3_CHNL104_STATUS_ADDR A:0xe633408
y.create.l HWIO_PMIC_ARB_OBS3_CHNL105_STATUS_ADDR A:0xe633488
y.create.l HWIO_PMIC_ARB_OBS3_CHNL106_STATUS_ADDR A:0xe633508
y.create.l HWIO_PMIC_ARB_OBS3_CHNL107_STATUS_ADDR A:0xe633588
y.create.l HWIO_PMIC_ARB_OBS3_CHNL108_STATUS_ADDR A:0xe633608
y.create.l HWIO_PMIC_ARB_OBS3_CHNL109_STATUS_ADDR A:0xe633688
y.create.l HWIO_PMIC_ARB_OBS3_CHNL110_STATUS_ADDR A:0xe633708
y.create.l HWIO_PMIC_ARB_OBS3_CHNL111_STATUS_ADDR A:0xe633788
y.create.l HWIO_PMIC_ARB_OBS3_CHNL112_STATUS_ADDR A:0xe633808
y.create.l HWIO_PMIC_ARB_OBS3_CHNL113_STATUS_ADDR A:0xe633888
y.create.l HWIO_PMIC_ARB_OBS3_CHNL114_STATUS_ADDR A:0xe633908
y.create.l HWIO_PMIC_ARB_OBS3_CHNL115_STATUS_ADDR A:0xe633988
y.create.l HWIO_PMIC_ARB_OBS3_CHNL116_STATUS_ADDR A:0xe633a08
y.create.l HWIO_PMIC_ARB_OBS3_CHNL117_STATUS_ADDR A:0xe633a88
y.create.l HWIO_PMIC_ARB_OBS3_CHNL118_STATUS_ADDR A:0xe633b08
y.create.l HWIO_PMIC_ARB_OBS3_CHNL119_STATUS_ADDR A:0xe633b88
y.create.l HWIO_PMIC_ARB_OBS3_CHNL120_STATUS_ADDR A:0xe633c08
y.create.l HWIO_PMIC_ARB_OBS3_CHNL121_STATUS_ADDR A:0xe633c88
y.create.l HWIO_PMIC_ARB_OBS3_CHNL122_STATUS_ADDR A:0xe633d08
y.create.l HWIO_PMIC_ARB_OBS3_CHNL123_STATUS_ADDR A:0xe633d88
y.create.l HWIO_PMIC_ARB_OBS3_CHNL124_STATUS_ADDR A:0xe633e08
y.create.l HWIO_PMIC_ARB_OBS3_CHNL125_STATUS_ADDR A:0xe633e88
y.create.l HWIO_PMIC_ARB_OBS3_CHNL126_STATUS_ADDR A:0xe633f08
y.create.l HWIO_PMIC_ARB_OBS3_CHNL127_STATUS_ADDR A:0xe633f88
y.create.l HWIO_PMIC_ARB_OBS3_CHNL128_STATUS_ADDR A:0xe634008
y.create.l HWIO_PMIC_ARB_OBS3_CHNL129_STATUS_ADDR A:0xe634088
y.create.l HWIO_PMIC_ARB_OBS3_CHNL130_STATUS_ADDR A:0xe634108
y.create.l HWIO_PMIC_ARB_OBS3_CHNL131_STATUS_ADDR A:0xe634188
y.create.l HWIO_PMIC_ARB_OBS3_CHNL132_STATUS_ADDR A:0xe634208
y.create.l HWIO_PMIC_ARB_OBS3_CHNL133_STATUS_ADDR A:0xe634288
y.create.l HWIO_PMIC_ARB_OBS3_CHNL134_STATUS_ADDR A:0xe634308
y.create.l HWIO_PMIC_ARB_OBS3_CHNL135_STATUS_ADDR A:0xe634388
y.create.l HWIO_PMIC_ARB_OBS3_CHNL136_STATUS_ADDR A:0xe634408
y.create.l HWIO_PMIC_ARB_OBS3_CHNL137_STATUS_ADDR A:0xe634488
y.create.l HWIO_PMIC_ARB_OBS3_CHNL138_STATUS_ADDR A:0xe634508
y.create.l HWIO_PMIC_ARB_OBS3_CHNL139_STATUS_ADDR A:0xe634588
y.create.l HWIO_PMIC_ARB_OBS3_CHNL140_STATUS_ADDR A:0xe634608
y.create.l HWIO_PMIC_ARB_OBS3_CHNL141_STATUS_ADDR A:0xe634688
y.create.l HWIO_PMIC_ARB_OBS3_CHNL142_STATUS_ADDR A:0xe634708
y.create.l HWIO_PMIC_ARB_OBS3_CHNL143_STATUS_ADDR A:0xe634788
y.create.l HWIO_PMIC_ARB_OBS3_CHNL144_STATUS_ADDR A:0xe634808
y.create.l HWIO_PMIC_ARB_OBS3_CHNL145_STATUS_ADDR A:0xe634888
y.create.l HWIO_PMIC_ARB_OBS3_CHNL146_STATUS_ADDR A:0xe634908
y.create.l HWIO_PMIC_ARB_OBS3_CHNL147_STATUS_ADDR A:0xe634988
y.create.l HWIO_PMIC_ARB_OBS3_CHNL148_STATUS_ADDR A:0xe634a08
y.create.l HWIO_PMIC_ARB_OBS3_CHNL149_STATUS_ADDR A:0xe634a88
y.create.l HWIO_PMIC_ARB_OBS3_CHNL150_STATUS_ADDR A:0xe634b08
y.create.l HWIO_PMIC_ARB_OBS3_CHNL151_STATUS_ADDR A:0xe634b88
y.create.l HWIO_PMIC_ARB_OBS3_CHNL152_STATUS_ADDR A:0xe634c08
y.create.l HWIO_PMIC_ARB_OBS3_CHNL153_STATUS_ADDR A:0xe634c88
y.create.l HWIO_PMIC_ARB_OBS3_CHNL154_STATUS_ADDR A:0xe634d08
y.create.l HWIO_PMIC_ARB_OBS3_CHNL155_STATUS_ADDR A:0xe634d88
y.create.l HWIO_PMIC_ARB_OBS3_CHNL156_STATUS_ADDR A:0xe634e08
y.create.l HWIO_PMIC_ARB_OBS3_CHNL157_STATUS_ADDR A:0xe634e88
y.create.l HWIO_PMIC_ARB_OBS3_CHNL158_STATUS_ADDR A:0xe634f08
y.create.l HWIO_PMIC_ARB_OBS3_CHNL159_STATUS_ADDR A:0xe634f88
y.create.l HWIO_PMIC_ARB_OBS3_CHNL160_STATUS_ADDR A:0xe635008
y.create.l HWIO_PMIC_ARB_OBS3_CHNL161_STATUS_ADDR A:0xe635088
y.create.l HWIO_PMIC_ARB_OBS3_CHNL162_STATUS_ADDR A:0xe635108
y.create.l HWIO_PMIC_ARB_OBS3_CHNL163_STATUS_ADDR A:0xe635188
y.create.l HWIO_PMIC_ARB_OBS3_CHNL164_STATUS_ADDR A:0xe635208
y.create.l HWIO_PMIC_ARB_OBS3_CHNL165_STATUS_ADDR A:0xe635288
y.create.l HWIO_PMIC_ARB_OBS3_CHNL166_STATUS_ADDR A:0xe635308
y.create.l HWIO_PMIC_ARB_OBS3_CHNL167_STATUS_ADDR A:0xe635388
y.create.l HWIO_PMIC_ARB_OBS3_CHNL168_STATUS_ADDR A:0xe635408
y.create.l HWIO_PMIC_ARB_OBS3_CHNL169_STATUS_ADDR A:0xe635488
y.create.l HWIO_PMIC_ARB_OBS3_CHNL170_STATUS_ADDR A:0xe635508
y.create.l HWIO_PMIC_ARB_OBS3_CHNL171_STATUS_ADDR A:0xe635588
y.create.l HWIO_PMIC_ARB_OBS3_CHNL172_STATUS_ADDR A:0xe635608
y.create.l HWIO_PMIC_ARB_OBS3_CHNL173_STATUS_ADDR A:0xe635688
y.create.l HWIO_PMIC_ARB_OBS3_CHNL174_STATUS_ADDR A:0xe635708
y.create.l HWIO_PMIC_ARB_OBS3_CHNL175_STATUS_ADDR A:0xe635788
y.create.l HWIO_PMIC_ARB_OBS3_CHNL176_STATUS_ADDR A:0xe635808
y.create.l HWIO_PMIC_ARB_OBS3_CHNL177_STATUS_ADDR A:0xe635888
y.create.l HWIO_PMIC_ARB_OBS3_CHNL178_STATUS_ADDR A:0xe635908
y.create.l HWIO_PMIC_ARB_OBS3_CHNL179_STATUS_ADDR A:0xe635988
y.create.l HWIO_PMIC_ARB_OBS3_CHNL180_STATUS_ADDR A:0xe635a08
y.create.l HWIO_PMIC_ARB_OBS3_CHNL181_STATUS_ADDR A:0xe635a88
y.create.l HWIO_PMIC_ARB_OBS3_CHNL182_STATUS_ADDR A:0xe635b08
y.create.l HWIO_PMIC_ARB_OBS3_CHNL183_STATUS_ADDR A:0xe635b88
y.create.l HWIO_PMIC_ARB_OBS3_CHNL184_STATUS_ADDR A:0xe635c08
y.create.l HWIO_PMIC_ARB_OBS3_CHNL185_STATUS_ADDR A:0xe635c88
y.create.l HWIO_PMIC_ARB_OBS3_CHNL186_STATUS_ADDR A:0xe635d08
y.create.l HWIO_PMIC_ARB_OBS3_CHNL187_STATUS_ADDR A:0xe635d88
y.create.l HWIO_PMIC_ARB_OBS3_CHNL188_STATUS_ADDR A:0xe635e08
y.create.l HWIO_PMIC_ARB_OBS3_CHNL189_STATUS_ADDR A:0xe635e88
y.create.l HWIO_PMIC_ARB_OBS3_CHNL190_STATUS_ADDR A:0xe635f08
y.create.l HWIO_PMIC_ARB_OBS3_CHNL191_STATUS_ADDR A:0xe635f88
y.create.l HWIO_PMIC_ARB_OBS3_CHNL192_STATUS_ADDR A:0xe636008
y.create.l HWIO_PMIC_ARB_OBS3_CHNL193_STATUS_ADDR A:0xe636088
y.create.l HWIO_PMIC_ARB_OBS3_CHNL194_STATUS_ADDR A:0xe636108
y.create.l HWIO_PMIC_ARB_OBS3_CHNL195_STATUS_ADDR A:0xe636188
y.create.l HWIO_PMIC_ARB_OBS3_CHNL196_STATUS_ADDR A:0xe636208
y.create.l HWIO_PMIC_ARB_OBS3_CHNL197_STATUS_ADDR A:0xe636288
y.create.l HWIO_PMIC_ARB_OBS3_CHNL198_STATUS_ADDR A:0xe636308
y.create.l HWIO_PMIC_ARB_OBS3_CHNL199_STATUS_ADDR A:0xe636388
y.create.l HWIO_PMIC_ARB_OBS3_CHNL200_STATUS_ADDR A:0xe636408
y.create.l HWIO_PMIC_ARB_OBS3_CHNL201_STATUS_ADDR A:0xe636488
y.create.l HWIO_PMIC_ARB_OBS3_CHNL202_STATUS_ADDR A:0xe636508
y.create.l HWIO_PMIC_ARB_OBS3_CHNL203_STATUS_ADDR A:0xe636588
y.create.l HWIO_PMIC_ARB_OBS3_CHNL204_STATUS_ADDR A:0xe636608
y.create.l HWIO_PMIC_ARB_OBS3_CHNL205_STATUS_ADDR A:0xe636688
y.create.l HWIO_PMIC_ARB_OBS3_CHNL206_STATUS_ADDR A:0xe636708
y.create.l HWIO_PMIC_ARB_OBS3_CHNL207_STATUS_ADDR A:0xe636788
y.create.l HWIO_PMIC_ARB_OBS3_CHNL208_STATUS_ADDR A:0xe636808
y.create.l HWIO_PMIC_ARB_OBS3_CHNL209_STATUS_ADDR A:0xe636888
y.create.l HWIO_PMIC_ARB_OBS3_CHNL210_STATUS_ADDR A:0xe636908
y.create.l HWIO_PMIC_ARB_OBS3_CHNL211_STATUS_ADDR A:0xe636988
y.create.l HWIO_PMIC_ARB_OBS3_CHNL212_STATUS_ADDR A:0xe636a08
y.create.l HWIO_PMIC_ARB_OBS3_CHNL213_STATUS_ADDR A:0xe636a88
y.create.l HWIO_PMIC_ARB_OBS3_CHNL214_STATUS_ADDR A:0xe636b08
y.create.l HWIO_PMIC_ARB_OBS3_CHNL215_STATUS_ADDR A:0xe636b88
y.create.l HWIO_PMIC_ARB_OBS3_CHNL216_STATUS_ADDR A:0xe636c08
y.create.l HWIO_PMIC_ARB_OBS3_CHNL217_STATUS_ADDR A:0xe636c88
y.create.l HWIO_PMIC_ARB_OBS3_CHNL218_STATUS_ADDR A:0xe636d08
y.create.l HWIO_PMIC_ARB_OBS3_CHNL219_STATUS_ADDR A:0xe636d88
y.create.l HWIO_PMIC_ARB_OBS3_CHNL220_STATUS_ADDR A:0xe636e08
y.create.l HWIO_PMIC_ARB_OBS3_CHNL221_STATUS_ADDR A:0xe636e88
y.create.l HWIO_PMIC_ARB_OBS3_CHNL222_STATUS_ADDR A:0xe636f08
y.create.l HWIO_PMIC_ARB_OBS3_CHNL223_STATUS_ADDR A:0xe636f88
y.create.l HWIO_PMIC_ARB_OBS3_CHNL224_STATUS_ADDR A:0xe637008
y.create.l HWIO_PMIC_ARB_OBS3_CHNL225_STATUS_ADDR A:0xe637088
y.create.l HWIO_PMIC_ARB_OBS3_CHNL226_STATUS_ADDR A:0xe637108
y.create.l HWIO_PMIC_ARB_OBS3_CHNL227_STATUS_ADDR A:0xe637188
y.create.l HWIO_PMIC_ARB_OBS3_CHNL228_STATUS_ADDR A:0xe637208
y.create.l HWIO_PMIC_ARB_OBS3_CHNL229_STATUS_ADDR A:0xe637288
y.create.l HWIO_PMIC_ARB_OBS3_CHNL230_STATUS_ADDR A:0xe637308
y.create.l HWIO_PMIC_ARB_OBS3_CHNL231_STATUS_ADDR A:0xe637388
y.create.l HWIO_PMIC_ARB_OBS3_CHNL232_STATUS_ADDR A:0xe637408
y.create.l HWIO_PMIC_ARB_OBS3_CHNL233_STATUS_ADDR A:0xe637488
y.create.l HWIO_PMIC_ARB_OBS3_CHNL234_STATUS_ADDR A:0xe637508
y.create.l HWIO_PMIC_ARB_OBS3_CHNL235_STATUS_ADDR A:0xe637588
y.create.l HWIO_PMIC_ARB_OBS3_CHNL236_STATUS_ADDR A:0xe637608
y.create.l HWIO_PMIC_ARB_OBS3_CHNL237_STATUS_ADDR A:0xe637688
y.create.l HWIO_PMIC_ARB_OBS3_CHNL238_STATUS_ADDR A:0xe637708
y.create.l HWIO_PMIC_ARB_OBS3_CHNL239_STATUS_ADDR A:0xe637788
y.create.l HWIO_PMIC_ARB_OBS3_CHNL240_STATUS_ADDR A:0xe637808
y.create.l HWIO_PMIC_ARB_OBS3_CHNL241_STATUS_ADDR A:0xe637888
y.create.l HWIO_PMIC_ARB_OBS3_CHNL242_STATUS_ADDR A:0xe637908
y.create.l HWIO_PMIC_ARB_OBS3_CHNL243_STATUS_ADDR A:0xe637988
y.create.l HWIO_PMIC_ARB_OBS3_CHNL244_STATUS_ADDR A:0xe637a08
y.create.l HWIO_PMIC_ARB_OBS3_CHNL245_STATUS_ADDR A:0xe637a88
y.create.l HWIO_PMIC_ARB_OBS3_CHNL246_STATUS_ADDR A:0xe637b08
y.create.l HWIO_PMIC_ARB_OBS3_CHNL247_STATUS_ADDR A:0xe637b88
y.create.l HWIO_PMIC_ARB_OBS3_CHNL248_STATUS_ADDR A:0xe637c08
y.create.l HWIO_PMIC_ARB_OBS3_CHNL249_STATUS_ADDR A:0xe637c88
y.create.l HWIO_PMIC_ARB_OBS3_CHNL250_STATUS_ADDR A:0xe637d08
y.create.l HWIO_PMIC_ARB_OBS3_CHNL251_STATUS_ADDR A:0xe637d88
y.create.l HWIO_PMIC_ARB_OBS3_CHNL252_STATUS_ADDR A:0xe637e08
y.create.l HWIO_PMIC_ARB_OBS3_CHNL253_STATUS_ADDR A:0xe637e88
y.create.l HWIO_PMIC_ARB_OBS3_CHNL254_STATUS_ADDR A:0xe637f08
y.create.l HWIO_PMIC_ARB_OBS3_CHNL255_STATUS_ADDR A:0xe637f88
y.create.l HWIO_PMIC_ARB_OBS4_CHNL0_STATUS_ADDR A:0xe640008
y.create.l HWIO_PMIC_ARB_OBS4_CHNL1_STATUS_ADDR A:0xe640088
y.create.l HWIO_PMIC_ARB_OBS4_CHNL2_STATUS_ADDR A:0xe640108
y.create.l HWIO_PMIC_ARB_OBS4_CHNL3_STATUS_ADDR A:0xe640188
y.create.l HWIO_PMIC_ARB_OBS4_CHNL4_STATUS_ADDR A:0xe640208
y.create.l HWIO_PMIC_ARB_OBS4_CHNL5_STATUS_ADDR A:0xe640288
y.create.l HWIO_PMIC_ARB_OBS4_CHNL6_STATUS_ADDR A:0xe640308
y.create.l HWIO_PMIC_ARB_OBS4_CHNL7_STATUS_ADDR A:0xe640388
y.create.l HWIO_PMIC_ARB_OBS4_CHNL8_STATUS_ADDR A:0xe640408
y.create.l HWIO_PMIC_ARB_OBS4_CHNL9_STATUS_ADDR A:0xe640488
y.create.l HWIO_PMIC_ARB_OBS4_CHNL10_STATUS_ADDR A:0xe640508
y.create.l HWIO_PMIC_ARB_OBS4_CHNL11_STATUS_ADDR A:0xe640588
y.create.l HWIO_PMIC_ARB_OBS4_CHNL12_STATUS_ADDR A:0xe640608
y.create.l HWIO_PMIC_ARB_OBS4_CHNL13_STATUS_ADDR A:0xe640688
y.create.l HWIO_PMIC_ARB_OBS4_CHNL14_STATUS_ADDR A:0xe640708
y.create.l HWIO_PMIC_ARB_OBS4_CHNL15_STATUS_ADDR A:0xe640788
y.create.l HWIO_PMIC_ARB_OBS4_CHNL16_STATUS_ADDR A:0xe640808
y.create.l HWIO_PMIC_ARB_OBS4_CHNL17_STATUS_ADDR A:0xe640888
y.create.l HWIO_PMIC_ARB_OBS4_CHNL18_STATUS_ADDR A:0xe640908
y.create.l HWIO_PMIC_ARB_OBS4_CHNL19_STATUS_ADDR A:0xe640988
y.create.l HWIO_PMIC_ARB_OBS4_CHNL20_STATUS_ADDR A:0xe640a08
y.create.l HWIO_PMIC_ARB_OBS4_CHNL21_STATUS_ADDR A:0xe640a88
y.create.l HWIO_PMIC_ARB_OBS4_CHNL22_STATUS_ADDR A:0xe640b08
y.create.l HWIO_PMIC_ARB_OBS4_CHNL23_STATUS_ADDR A:0xe640b88
y.create.l HWIO_PMIC_ARB_OBS4_CHNL24_STATUS_ADDR A:0xe640c08
y.create.l HWIO_PMIC_ARB_OBS4_CHNL25_STATUS_ADDR A:0xe640c88
y.create.l HWIO_PMIC_ARB_OBS4_CHNL26_STATUS_ADDR A:0xe640d08
y.create.l HWIO_PMIC_ARB_OBS4_CHNL27_STATUS_ADDR A:0xe640d88
y.create.l HWIO_PMIC_ARB_OBS4_CHNL28_STATUS_ADDR A:0xe640e08
y.create.l HWIO_PMIC_ARB_OBS4_CHNL29_STATUS_ADDR A:0xe640e88
y.create.l HWIO_PMIC_ARB_OBS4_CHNL30_STATUS_ADDR A:0xe640f08
y.create.l HWIO_PMIC_ARB_OBS4_CHNL31_STATUS_ADDR A:0xe640f88
y.create.l HWIO_PMIC_ARB_OBS4_CHNL32_STATUS_ADDR A:0xe641008
y.create.l HWIO_PMIC_ARB_OBS4_CHNL33_STATUS_ADDR A:0xe641088
y.create.l HWIO_PMIC_ARB_OBS4_CHNL34_STATUS_ADDR A:0xe641108
y.create.l HWIO_PMIC_ARB_OBS4_CHNL35_STATUS_ADDR A:0xe641188
y.create.l HWIO_PMIC_ARB_OBS4_CHNL36_STATUS_ADDR A:0xe641208
y.create.l HWIO_PMIC_ARB_OBS4_CHNL37_STATUS_ADDR A:0xe641288
y.create.l HWIO_PMIC_ARB_OBS4_CHNL38_STATUS_ADDR A:0xe641308
y.create.l HWIO_PMIC_ARB_OBS4_CHNL39_STATUS_ADDR A:0xe641388
y.create.l HWIO_PMIC_ARB_OBS4_CHNL40_STATUS_ADDR A:0xe641408
y.create.l HWIO_PMIC_ARB_OBS4_CHNL41_STATUS_ADDR A:0xe641488
y.create.l HWIO_PMIC_ARB_OBS4_CHNL42_STATUS_ADDR A:0xe641508
y.create.l HWIO_PMIC_ARB_OBS4_CHNL43_STATUS_ADDR A:0xe641588
y.create.l HWIO_PMIC_ARB_OBS4_CHNL44_STATUS_ADDR A:0xe641608
y.create.l HWIO_PMIC_ARB_OBS4_CHNL45_STATUS_ADDR A:0xe641688
y.create.l HWIO_PMIC_ARB_OBS4_CHNL46_STATUS_ADDR A:0xe641708
y.create.l HWIO_PMIC_ARB_OBS4_CHNL47_STATUS_ADDR A:0xe641788
y.create.l HWIO_PMIC_ARB_OBS4_CHNL48_STATUS_ADDR A:0xe641808
y.create.l HWIO_PMIC_ARB_OBS4_CHNL49_STATUS_ADDR A:0xe641888
y.create.l HWIO_PMIC_ARB_OBS4_CHNL50_STATUS_ADDR A:0xe641908
y.create.l HWIO_PMIC_ARB_OBS4_CHNL51_STATUS_ADDR A:0xe641988
y.create.l HWIO_PMIC_ARB_OBS4_CHNL52_STATUS_ADDR A:0xe641a08
y.create.l HWIO_PMIC_ARB_OBS4_CHNL53_STATUS_ADDR A:0xe641a88
y.create.l HWIO_PMIC_ARB_OBS4_CHNL54_STATUS_ADDR A:0xe641b08
y.create.l HWIO_PMIC_ARB_OBS4_CHNL55_STATUS_ADDR A:0xe641b88
y.create.l HWIO_PMIC_ARB_OBS4_CHNL56_STATUS_ADDR A:0xe641c08
y.create.l HWIO_PMIC_ARB_OBS4_CHNL57_STATUS_ADDR A:0xe641c88
y.create.l HWIO_PMIC_ARB_OBS4_CHNL58_STATUS_ADDR A:0xe641d08
y.create.l HWIO_PMIC_ARB_OBS4_CHNL59_STATUS_ADDR A:0xe641d88
y.create.l HWIO_PMIC_ARB_OBS4_CHNL60_STATUS_ADDR A:0xe641e08
y.create.l HWIO_PMIC_ARB_OBS4_CHNL61_STATUS_ADDR A:0xe641e88
y.create.l HWIO_PMIC_ARB_OBS4_CHNL62_STATUS_ADDR A:0xe641f08
y.create.l HWIO_PMIC_ARB_OBS4_CHNL63_STATUS_ADDR A:0xe641f88
y.create.l HWIO_PMIC_ARB_OBS4_CHNL64_STATUS_ADDR A:0xe642008
y.create.l HWIO_PMIC_ARB_OBS4_CHNL65_STATUS_ADDR A:0xe642088
y.create.l HWIO_PMIC_ARB_OBS4_CHNL66_STATUS_ADDR A:0xe642108
y.create.l HWIO_PMIC_ARB_OBS4_CHNL67_STATUS_ADDR A:0xe642188
y.create.l HWIO_PMIC_ARB_OBS4_CHNL68_STATUS_ADDR A:0xe642208
y.create.l HWIO_PMIC_ARB_OBS4_CHNL69_STATUS_ADDR A:0xe642288
y.create.l HWIO_PMIC_ARB_OBS4_CHNL70_STATUS_ADDR A:0xe642308
y.create.l HWIO_PMIC_ARB_OBS4_CHNL71_STATUS_ADDR A:0xe642388
y.create.l HWIO_PMIC_ARB_OBS4_CHNL72_STATUS_ADDR A:0xe642408
y.create.l HWIO_PMIC_ARB_OBS4_CHNL73_STATUS_ADDR A:0xe642488
y.create.l HWIO_PMIC_ARB_OBS4_CHNL74_STATUS_ADDR A:0xe642508
y.create.l HWIO_PMIC_ARB_OBS4_CHNL75_STATUS_ADDR A:0xe642588
y.create.l HWIO_PMIC_ARB_OBS4_CHNL76_STATUS_ADDR A:0xe642608
y.create.l HWIO_PMIC_ARB_OBS4_CHNL77_STATUS_ADDR A:0xe642688
y.create.l HWIO_PMIC_ARB_OBS4_CHNL78_STATUS_ADDR A:0xe642708
y.create.l HWIO_PMIC_ARB_OBS4_CHNL79_STATUS_ADDR A:0xe642788
y.create.l HWIO_PMIC_ARB_OBS4_CHNL80_STATUS_ADDR A:0xe642808
y.create.l HWIO_PMIC_ARB_OBS4_CHNL81_STATUS_ADDR A:0xe642888
y.create.l HWIO_PMIC_ARB_OBS4_CHNL82_STATUS_ADDR A:0xe642908
y.create.l HWIO_PMIC_ARB_OBS4_CHNL83_STATUS_ADDR A:0xe642988
y.create.l HWIO_PMIC_ARB_OBS4_CHNL84_STATUS_ADDR A:0xe642a08
y.create.l HWIO_PMIC_ARB_OBS4_CHNL85_STATUS_ADDR A:0xe642a88
y.create.l HWIO_PMIC_ARB_OBS4_CHNL86_STATUS_ADDR A:0xe642b08
y.create.l HWIO_PMIC_ARB_OBS4_CHNL87_STATUS_ADDR A:0xe642b88
y.create.l HWIO_PMIC_ARB_OBS4_CHNL88_STATUS_ADDR A:0xe642c08
y.create.l HWIO_PMIC_ARB_OBS4_CHNL89_STATUS_ADDR A:0xe642c88
y.create.l HWIO_PMIC_ARB_OBS4_CHNL90_STATUS_ADDR A:0xe642d08
y.create.l HWIO_PMIC_ARB_OBS4_CHNL91_STATUS_ADDR A:0xe642d88
y.create.l HWIO_PMIC_ARB_OBS4_CHNL92_STATUS_ADDR A:0xe642e08
y.create.l HWIO_PMIC_ARB_OBS4_CHNL93_STATUS_ADDR A:0xe642e88
y.create.l HWIO_PMIC_ARB_OBS4_CHNL94_STATUS_ADDR A:0xe642f08
y.create.l HWIO_PMIC_ARB_OBS4_CHNL95_STATUS_ADDR A:0xe642f88
y.create.l HWIO_PMIC_ARB_OBS4_CHNL96_STATUS_ADDR A:0xe643008
y.create.l HWIO_PMIC_ARB_OBS4_CHNL97_STATUS_ADDR A:0xe643088
y.create.l HWIO_PMIC_ARB_OBS4_CHNL98_STATUS_ADDR A:0xe643108
y.create.l HWIO_PMIC_ARB_OBS4_CHNL99_STATUS_ADDR A:0xe643188
y.create.l HWIO_PMIC_ARB_OBS4_CHNL100_STATUS_ADDR A:0xe643208
y.create.l HWIO_PMIC_ARB_OBS4_CHNL101_STATUS_ADDR A:0xe643288
y.create.l HWIO_PMIC_ARB_OBS4_CHNL102_STATUS_ADDR A:0xe643308
y.create.l HWIO_PMIC_ARB_OBS4_CHNL103_STATUS_ADDR A:0xe643388
y.create.l HWIO_PMIC_ARB_OBS4_CHNL104_STATUS_ADDR A:0xe643408
y.create.l HWIO_PMIC_ARB_OBS4_CHNL105_STATUS_ADDR A:0xe643488
y.create.l HWIO_PMIC_ARB_OBS4_CHNL106_STATUS_ADDR A:0xe643508
y.create.l HWIO_PMIC_ARB_OBS4_CHNL107_STATUS_ADDR A:0xe643588
y.create.l HWIO_PMIC_ARB_OBS4_CHNL108_STATUS_ADDR A:0xe643608
y.create.l HWIO_PMIC_ARB_OBS4_CHNL109_STATUS_ADDR A:0xe643688
y.create.l HWIO_PMIC_ARB_OBS4_CHNL110_STATUS_ADDR A:0xe643708
y.create.l HWIO_PMIC_ARB_OBS4_CHNL111_STATUS_ADDR A:0xe643788
y.create.l HWIO_PMIC_ARB_OBS4_CHNL112_STATUS_ADDR A:0xe643808
y.create.l HWIO_PMIC_ARB_OBS4_CHNL113_STATUS_ADDR A:0xe643888
y.create.l HWIO_PMIC_ARB_OBS4_CHNL114_STATUS_ADDR A:0xe643908
y.create.l HWIO_PMIC_ARB_OBS4_CHNL115_STATUS_ADDR A:0xe643988
y.create.l HWIO_PMIC_ARB_OBS4_CHNL116_STATUS_ADDR A:0xe643a08
y.create.l HWIO_PMIC_ARB_OBS4_CHNL117_STATUS_ADDR A:0xe643a88
y.create.l HWIO_PMIC_ARB_OBS4_CHNL118_STATUS_ADDR A:0xe643b08
y.create.l HWIO_PMIC_ARB_OBS4_CHNL119_STATUS_ADDR A:0xe643b88
y.create.l HWIO_PMIC_ARB_OBS4_CHNL120_STATUS_ADDR A:0xe643c08
y.create.l HWIO_PMIC_ARB_OBS4_CHNL121_STATUS_ADDR A:0xe643c88
y.create.l HWIO_PMIC_ARB_OBS4_CHNL122_STATUS_ADDR A:0xe643d08
y.create.l HWIO_PMIC_ARB_OBS4_CHNL123_STATUS_ADDR A:0xe643d88
y.create.l HWIO_PMIC_ARB_OBS4_CHNL124_STATUS_ADDR A:0xe643e08
y.create.l HWIO_PMIC_ARB_OBS4_CHNL125_STATUS_ADDR A:0xe643e88
y.create.l HWIO_PMIC_ARB_OBS4_CHNL126_STATUS_ADDR A:0xe643f08
y.create.l HWIO_PMIC_ARB_OBS4_CHNL127_STATUS_ADDR A:0xe643f88
y.create.l HWIO_PMIC_ARB_OBS4_CHNL128_STATUS_ADDR A:0xe644008
y.create.l HWIO_PMIC_ARB_OBS4_CHNL129_STATUS_ADDR A:0xe644088
y.create.l HWIO_PMIC_ARB_OBS4_CHNL130_STATUS_ADDR A:0xe644108
y.create.l HWIO_PMIC_ARB_OBS4_CHNL131_STATUS_ADDR A:0xe644188
y.create.l HWIO_PMIC_ARB_OBS4_CHNL132_STATUS_ADDR A:0xe644208
y.create.l HWIO_PMIC_ARB_OBS4_CHNL133_STATUS_ADDR A:0xe644288
y.create.l HWIO_PMIC_ARB_OBS4_CHNL134_STATUS_ADDR A:0xe644308
y.create.l HWIO_PMIC_ARB_OBS4_CHNL135_STATUS_ADDR A:0xe644388
y.create.l HWIO_PMIC_ARB_OBS4_CHNL136_STATUS_ADDR A:0xe644408
y.create.l HWIO_PMIC_ARB_OBS4_CHNL137_STATUS_ADDR A:0xe644488
y.create.l HWIO_PMIC_ARB_OBS4_CHNL138_STATUS_ADDR A:0xe644508
y.create.l HWIO_PMIC_ARB_OBS4_CHNL139_STATUS_ADDR A:0xe644588
y.create.l HWIO_PMIC_ARB_OBS4_CHNL140_STATUS_ADDR A:0xe644608
y.create.l HWIO_PMIC_ARB_OBS4_CHNL141_STATUS_ADDR A:0xe644688
y.create.l HWIO_PMIC_ARB_OBS4_CHNL142_STATUS_ADDR A:0xe644708
y.create.l HWIO_PMIC_ARB_OBS4_CHNL143_STATUS_ADDR A:0xe644788
y.create.l HWIO_PMIC_ARB_OBS4_CHNL144_STATUS_ADDR A:0xe644808
y.create.l HWIO_PMIC_ARB_OBS4_CHNL145_STATUS_ADDR A:0xe644888
y.create.l HWIO_PMIC_ARB_OBS4_CHNL146_STATUS_ADDR A:0xe644908
y.create.l HWIO_PMIC_ARB_OBS4_CHNL147_STATUS_ADDR A:0xe644988
y.create.l HWIO_PMIC_ARB_OBS4_CHNL148_STATUS_ADDR A:0xe644a08
y.create.l HWIO_PMIC_ARB_OBS4_CHNL149_STATUS_ADDR A:0xe644a88
y.create.l HWIO_PMIC_ARB_OBS4_CHNL150_STATUS_ADDR A:0xe644b08
y.create.l HWIO_PMIC_ARB_OBS4_CHNL151_STATUS_ADDR A:0xe644b88
y.create.l HWIO_PMIC_ARB_OBS4_CHNL152_STATUS_ADDR A:0xe644c08
y.create.l HWIO_PMIC_ARB_OBS4_CHNL153_STATUS_ADDR A:0xe644c88
y.create.l HWIO_PMIC_ARB_OBS4_CHNL154_STATUS_ADDR A:0xe644d08
y.create.l HWIO_PMIC_ARB_OBS4_CHNL155_STATUS_ADDR A:0xe644d88
y.create.l HWIO_PMIC_ARB_OBS4_CHNL156_STATUS_ADDR A:0xe644e08
y.create.l HWIO_PMIC_ARB_OBS4_CHNL157_STATUS_ADDR A:0xe644e88
y.create.l HWIO_PMIC_ARB_OBS4_CHNL158_STATUS_ADDR A:0xe644f08
y.create.l HWIO_PMIC_ARB_OBS4_CHNL159_STATUS_ADDR A:0xe644f88
y.create.l HWIO_PMIC_ARB_OBS4_CHNL160_STATUS_ADDR A:0xe645008
y.create.l HWIO_PMIC_ARB_OBS4_CHNL161_STATUS_ADDR A:0xe645088
y.create.l HWIO_PMIC_ARB_OBS4_CHNL162_STATUS_ADDR A:0xe645108
y.create.l HWIO_PMIC_ARB_OBS4_CHNL163_STATUS_ADDR A:0xe645188
y.create.l HWIO_PMIC_ARB_OBS4_CHNL164_STATUS_ADDR A:0xe645208
y.create.l HWIO_PMIC_ARB_OBS4_CHNL165_STATUS_ADDR A:0xe645288
y.create.l HWIO_PMIC_ARB_OBS4_CHNL166_STATUS_ADDR A:0xe645308
y.create.l HWIO_PMIC_ARB_OBS4_CHNL167_STATUS_ADDR A:0xe645388
y.create.l HWIO_PMIC_ARB_OBS4_CHNL168_STATUS_ADDR A:0xe645408
y.create.l HWIO_PMIC_ARB_OBS4_CHNL169_STATUS_ADDR A:0xe645488
y.create.l HWIO_PMIC_ARB_OBS4_CHNL170_STATUS_ADDR A:0xe645508
y.create.l HWIO_PMIC_ARB_OBS4_CHNL171_STATUS_ADDR A:0xe645588
y.create.l HWIO_PMIC_ARB_OBS4_CHNL172_STATUS_ADDR A:0xe645608
y.create.l HWIO_PMIC_ARB_OBS4_CHNL173_STATUS_ADDR A:0xe645688
y.create.l HWIO_PMIC_ARB_OBS4_CHNL174_STATUS_ADDR A:0xe645708
y.create.l HWIO_PMIC_ARB_OBS4_CHNL175_STATUS_ADDR A:0xe645788
y.create.l HWIO_PMIC_ARB_OBS4_CHNL176_STATUS_ADDR A:0xe645808
y.create.l HWIO_PMIC_ARB_OBS4_CHNL177_STATUS_ADDR A:0xe645888
y.create.l HWIO_PMIC_ARB_OBS4_CHNL178_STATUS_ADDR A:0xe645908
y.create.l HWIO_PMIC_ARB_OBS4_CHNL179_STATUS_ADDR A:0xe645988
y.create.l HWIO_PMIC_ARB_OBS4_CHNL180_STATUS_ADDR A:0xe645a08
y.create.l HWIO_PMIC_ARB_OBS4_CHNL181_STATUS_ADDR A:0xe645a88
y.create.l HWIO_PMIC_ARB_OBS4_CHNL182_STATUS_ADDR A:0xe645b08
y.create.l HWIO_PMIC_ARB_OBS4_CHNL183_STATUS_ADDR A:0xe645b88
y.create.l HWIO_PMIC_ARB_OBS4_CHNL184_STATUS_ADDR A:0xe645c08
y.create.l HWIO_PMIC_ARB_OBS4_CHNL185_STATUS_ADDR A:0xe645c88
y.create.l HWIO_PMIC_ARB_OBS4_CHNL186_STATUS_ADDR A:0xe645d08
y.create.l HWIO_PMIC_ARB_OBS4_CHNL187_STATUS_ADDR A:0xe645d88
y.create.l HWIO_PMIC_ARB_OBS4_CHNL188_STATUS_ADDR A:0xe645e08
y.create.l HWIO_PMIC_ARB_OBS4_CHNL189_STATUS_ADDR A:0xe645e88
y.create.l HWIO_PMIC_ARB_OBS4_CHNL190_STATUS_ADDR A:0xe645f08
y.create.l HWIO_PMIC_ARB_OBS4_CHNL191_STATUS_ADDR A:0xe645f88
y.create.l HWIO_PMIC_ARB_OBS4_CHNL192_STATUS_ADDR A:0xe646008
y.create.l HWIO_PMIC_ARB_OBS4_CHNL193_STATUS_ADDR A:0xe646088
y.create.l HWIO_PMIC_ARB_OBS4_CHNL194_STATUS_ADDR A:0xe646108
y.create.l HWIO_PMIC_ARB_OBS4_CHNL195_STATUS_ADDR A:0xe646188
y.create.l HWIO_PMIC_ARB_OBS4_CHNL196_STATUS_ADDR A:0xe646208
y.create.l HWIO_PMIC_ARB_OBS4_CHNL197_STATUS_ADDR A:0xe646288
y.create.l HWIO_PMIC_ARB_OBS4_CHNL198_STATUS_ADDR A:0xe646308
y.create.l HWIO_PMIC_ARB_OBS4_CHNL199_STATUS_ADDR A:0xe646388
y.create.l HWIO_PMIC_ARB_OBS4_CHNL200_STATUS_ADDR A:0xe646408
y.create.l HWIO_PMIC_ARB_OBS4_CHNL201_STATUS_ADDR A:0xe646488
y.create.l HWIO_PMIC_ARB_OBS4_CHNL202_STATUS_ADDR A:0xe646508
y.create.l HWIO_PMIC_ARB_OBS4_CHNL203_STATUS_ADDR A:0xe646588
y.create.l HWIO_PMIC_ARB_OBS4_CHNL204_STATUS_ADDR A:0xe646608
y.create.l HWIO_PMIC_ARB_OBS4_CHNL205_STATUS_ADDR A:0xe646688
y.create.l HWIO_PMIC_ARB_OBS4_CHNL206_STATUS_ADDR A:0xe646708
y.create.l HWIO_PMIC_ARB_OBS4_CHNL207_STATUS_ADDR A:0xe646788
y.create.l HWIO_PMIC_ARB_OBS4_CHNL208_STATUS_ADDR A:0xe646808
y.create.l HWIO_PMIC_ARB_OBS4_CHNL209_STATUS_ADDR A:0xe646888
y.create.l HWIO_PMIC_ARB_OBS4_CHNL210_STATUS_ADDR A:0xe646908
y.create.l HWIO_PMIC_ARB_OBS4_CHNL211_STATUS_ADDR A:0xe646988
y.create.l HWIO_PMIC_ARB_OBS4_CHNL212_STATUS_ADDR A:0xe646a08
y.create.l HWIO_PMIC_ARB_OBS4_CHNL213_STATUS_ADDR A:0xe646a88
y.create.l HWIO_PMIC_ARB_OBS4_CHNL214_STATUS_ADDR A:0xe646b08
y.create.l HWIO_PMIC_ARB_OBS4_CHNL215_STATUS_ADDR A:0xe646b88
y.create.l HWIO_PMIC_ARB_OBS4_CHNL216_STATUS_ADDR A:0xe646c08
y.create.l HWIO_PMIC_ARB_OBS4_CHNL217_STATUS_ADDR A:0xe646c88
y.create.l HWIO_PMIC_ARB_OBS4_CHNL218_STATUS_ADDR A:0xe646d08
y.create.l HWIO_PMIC_ARB_OBS4_CHNL219_STATUS_ADDR A:0xe646d88
y.create.l HWIO_PMIC_ARB_OBS4_CHNL220_STATUS_ADDR A:0xe646e08
y.create.l HWIO_PMIC_ARB_OBS4_CHNL221_STATUS_ADDR A:0xe646e88
y.create.l HWIO_PMIC_ARB_OBS4_CHNL222_STATUS_ADDR A:0xe646f08
y.create.l HWIO_PMIC_ARB_OBS4_CHNL223_STATUS_ADDR A:0xe646f88
y.create.l HWIO_PMIC_ARB_OBS4_CHNL224_STATUS_ADDR A:0xe647008
y.create.l HWIO_PMIC_ARB_OBS4_CHNL225_STATUS_ADDR A:0xe647088
y.create.l HWIO_PMIC_ARB_OBS4_CHNL226_STATUS_ADDR A:0xe647108
y.create.l HWIO_PMIC_ARB_OBS4_CHNL227_STATUS_ADDR A:0xe647188
y.create.l HWIO_PMIC_ARB_OBS4_CHNL228_STATUS_ADDR A:0xe647208
y.create.l HWIO_PMIC_ARB_OBS4_CHNL229_STATUS_ADDR A:0xe647288
y.create.l HWIO_PMIC_ARB_OBS4_CHNL230_STATUS_ADDR A:0xe647308
y.create.l HWIO_PMIC_ARB_OBS4_CHNL231_STATUS_ADDR A:0xe647388
y.create.l HWIO_PMIC_ARB_OBS4_CHNL232_STATUS_ADDR A:0xe647408
y.create.l HWIO_PMIC_ARB_OBS4_CHNL233_STATUS_ADDR A:0xe647488
y.create.l HWIO_PMIC_ARB_OBS4_CHNL234_STATUS_ADDR A:0xe647508
y.create.l HWIO_PMIC_ARB_OBS4_CHNL235_STATUS_ADDR A:0xe647588
y.create.l HWIO_PMIC_ARB_OBS4_CHNL236_STATUS_ADDR A:0xe647608
y.create.l HWIO_PMIC_ARB_OBS4_CHNL237_STATUS_ADDR A:0xe647688
y.create.l HWIO_PMIC_ARB_OBS4_CHNL238_STATUS_ADDR A:0xe647708
y.create.l HWIO_PMIC_ARB_OBS4_CHNL239_STATUS_ADDR A:0xe647788
y.create.l HWIO_PMIC_ARB_OBS4_CHNL240_STATUS_ADDR A:0xe647808
y.create.l HWIO_PMIC_ARB_OBS4_CHNL241_STATUS_ADDR A:0xe647888
y.create.l HWIO_PMIC_ARB_OBS4_CHNL242_STATUS_ADDR A:0xe647908
y.create.l HWIO_PMIC_ARB_OBS4_CHNL243_STATUS_ADDR A:0xe647988
y.create.l HWIO_PMIC_ARB_OBS4_CHNL244_STATUS_ADDR A:0xe647a08
y.create.l HWIO_PMIC_ARB_OBS4_CHNL245_STATUS_ADDR A:0xe647a88
y.create.l HWIO_PMIC_ARB_OBS4_CHNL246_STATUS_ADDR A:0xe647b08
y.create.l HWIO_PMIC_ARB_OBS4_CHNL247_STATUS_ADDR A:0xe647b88
y.create.l HWIO_PMIC_ARB_OBS4_CHNL248_STATUS_ADDR A:0xe647c08
y.create.l HWIO_PMIC_ARB_OBS4_CHNL249_STATUS_ADDR A:0xe647c88
y.create.l HWIO_PMIC_ARB_OBS4_CHNL250_STATUS_ADDR A:0xe647d08
y.create.l HWIO_PMIC_ARB_OBS4_CHNL251_STATUS_ADDR A:0xe647d88
y.create.l HWIO_PMIC_ARB_OBS4_CHNL252_STATUS_ADDR A:0xe647e08
y.create.l HWIO_PMIC_ARB_OBS4_CHNL253_STATUS_ADDR A:0xe647e88
y.create.l HWIO_PMIC_ARB_OBS4_CHNL254_STATUS_ADDR A:0xe647f08
y.create.l HWIO_PMIC_ARB_OBS4_CHNL255_STATUS_ADDR A:0xe647f88
y.create.l HWIO_PMIC_ARB_OBS0_CHNL0_RDATA0_ADDR A:0xe600018
y.create.l HWIO_PMIC_ARB_OBS0_CHNL1_RDATA0_ADDR A:0xe600098
y.create.l HWIO_PMIC_ARB_OBS0_CHNL2_RDATA0_ADDR A:0xe600118
y.create.l HWIO_PMIC_ARB_OBS0_CHNL3_RDATA0_ADDR A:0xe600198
y.create.l HWIO_PMIC_ARB_OBS0_CHNL4_RDATA0_ADDR A:0xe600218
y.create.l HWIO_PMIC_ARB_OBS0_CHNL5_RDATA0_ADDR A:0xe600298
y.create.l HWIO_PMIC_ARB_OBS0_CHNL6_RDATA0_ADDR A:0xe600318
y.create.l HWIO_PMIC_ARB_OBS0_CHNL7_RDATA0_ADDR A:0xe600398
y.create.l HWIO_PMIC_ARB_OBS0_CHNL8_RDATA0_ADDR A:0xe600418
y.create.l HWIO_PMIC_ARB_OBS0_CHNL9_RDATA0_ADDR A:0xe600498
y.create.l HWIO_PMIC_ARB_OBS0_CHNL10_RDATA0_ADDR A:0xe600518
y.create.l HWIO_PMIC_ARB_OBS0_CHNL11_RDATA0_ADDR A:0xe600598
y.create.l HWIO_PMIC_ARB_OBS0_CHNL12_RDATA0_ADDR A:0xe600618
y.create.l HWIO_PMIC_ARB_OBS0_CHNL13_RDATA0_ADDR A:0xe600698
y.create.l HWIO_PMIC_ARB_OBS0_CHNL14_RDATA0_ADDR A:0xe600718
y.create.l HWIO_PMIC_ARB_OBS0_CHNL15_RDATA0_ADDR A:0xe600798
y.create.l HWIO_PMIC_ARB_OBS0_CHNL16_RDATA0_ADDR A:0xe600818
y.create.l HWIO_PMIC_ARB_OBS0_CHNL17_RDATA0_ADDR A:0xe600898
y.create.l HWIO_PMIC_ARB_OBS0_CHNL18_RDATA0_ADDR A:0xe600918
y.create.l HWIO_PMIC_ARB_OBS0_CHNL19_RDATA0_ADDR A:0xe600998
y.create.l HWIO_PMIC_ARB_OBS0_CHNL20_RDATA0_ADDR A:0xe600a18
y.create.l HWIO_PMIC_ARB_OBS0_CHNL21_RDATA0_ADDR A:0xe600a98
y.create.l HWIO_PMIC_ARB_OBS0_CHNL22_RDATA0_ADDR A:0xe600b18
y.create.l HWIO_PMIC_ARB_OBS0_CHNL23_RDATA0_ADDR A:0xe600b98
y.create.l HWIO_PMIC_ARB_OBS0_CHNL24_RDATA0_ADDR A:0xe600c18
y.create.l HWIO_PMIC_ARB_OBS0_CHNL25_RDATA0_ADDR A:0xe600c98
y.create.l HWIO_PMIC_ARB_OBS0_CHNL26_RDATA0_ADDR A:0xe600d18
y.create.l HWIO_PMIC_ARB_OBS0_CHNL27_RDATA0_ADDR A:0xe600d98
y.create.l HWIO_PMIC_ARB_OBS0_CHNL28_RDATA0_ADDR A:0xe600e18
y.create.l HWIO_PMIC_ARB_OBS0_CHNL29_RDATA0_ADDR A:0xe600e98
y.create.l HWIO_PMIC_ARB_OBS0_CHNL30_RDATA0_ADDR A:0xe600f18
y.create.l HWIO_PMIC_ARB_OBS0_CHNL31_RDATA0_ADDR A:0xe600f98
y.create.l HWIO_PMIC_ARB_OBS0_CHNL32_RDATA0_ADDR A:0xe601018
y.create.l HWIO_PMIC_ARB_OBS0_CHNL33_RDATA0_ADDR A:0xe601098
y.create.l HWIO_PMIC_ARB_OBS0_CHNL34_RDATA0_ADDR A:0xe601118
y.create.l HWIO_PMIC_ARB_OBS0_CHNL35_RDATA0_ADDR A:0xe601198
y.create.l HWIO_PMIC_ARB_OBS0_CHNL36_RDATA0_ADDR A:0xe601218
y.create.l HWIO_PMIC_ARB_OBS0_CHNL37_RDATA0_ADDR A:0xe601298
y.create.l HWIO_PMIC_ARB_OBS0_CHNL38_RDATA0_ADDR A:0xe601318
y.create.l HWIO_PMIC_ARB_OBS0_CHNL39_RDATA0_ADDR A:0xe601398
y.create.l HWIO_PMIC_ARB_OBS0_CHNL40_RDATA0_ADDR A:0xe601418
y.create.l HWIO_PMIC_ARB_OBS0_CHNL41_RDATA0_ADDR A:0xe601498
y.create.l HWIO_PMIC_ARB_OBS0_CHNL42_RDATA0_ADDR A:0xe601518
y.create.l HWIO_PMIC_ARB_OBS0_CHNL43_RDATA0_ADDR A:0xe601598
y.create.l HWIO_PMIC_ARB_OBS0_CHNL44_RDATA0_ADDR A:0xe601618
y.create.l HWIO_PMIC_ARB_OBS0_CHNL45_RDATA0_ADDR A:0xe601698
y.create.l HWIO_PMIC_ARB_OBS0_CHNL46_RDATA0_ADDR A:0xe601718
y.create.l HWIO_PMIC_ARB_OBS0_CHNL47_RDATA0_ADDR A:0xe601798
y.create.l HWIO_PMIC_ARB_OBS0_CHNL48_RDATA0_ADDR A:0xe601818
y.create.l HWIO_PMIC_ARB_OBS0_CHNL49_RDATA0_ADDR A:0xe601898
y.create.l HWIO_PMIC_ARB_OBS0_CHNL50_RDATA0_ADDR A:0xe601918
y.create.l HWIO_PMIC_ARB_OBS0_CHNL51_RDATA0_ADDR A:0xe601998
y.create.l HWIO_PMIC_ARB_OBS0_CHNL52_RDATA0_ADDR A:0xe601a18
y.create.l HWIO_PMIC_ARB_OBS0_CHNL53_RDATA0_ADDR A:0xe601a98
y.create.l HWIO_PMIC_ARB_OBS0_CHNL54_RDATA0_ADDR A:0xe601b18
y.create.l HWIO_PMIC_ARB_OBS0_CHNL55_RDATA0_ADDR A:0xe601b98
y.create.l HWIO_PMIC_ARB_OBS0_CHNL56_RDATA0_ADDR A:0xe601c18
y.create.l HWIO_PMIC_ARB_OBS0_CHNL57_RDATA0_ADDR A:0xe601c98
y.create.l HWIO_PMIC_ARB_OBS0_CHNL58_RDATA0_ADDR A:0xe601d18
y.create.l HWIO_PMIC_ARB_OBS0_CHNL59_RDATA0_ADDR A:0xe601d98
y.create.l HWIO_PMIC_ARB_OBS0_CHNL60_RDATA0_ADDR A:0xe601e18
y.create.l HWIO_PMIC_ARB_OBS0_CHNL61_RDATA0_ADDR A:0xe601e98
y.create.l HWIO_PMIC_ARB_OBS0_CHNL62_RDATA0_ADDR A:0xe601f18
y.create.l HWIO_PMIC_ARB_OBS0_CHNL63_RDATA0_ADDR A:0xe601f98
y.create.l HWIO_PMIC_ARB_OBS0_CHNL64_RDATA0_ADDR A:0xe602018
y.create.l HWIO_PMIC_ARB_OBS0_CHNL65_RDATA0_ADDR A:0xe602098
y.create.l HWIO_PMIC_ARB_OBS0_CHNL66_RDATA0_ADDR A:0xe602118
y.create.l HWIO_PMIC_ARB_OBS0_CHNL67_RDATA0_ADDR A:0xe602198
y.create.l HWIO_PMIC_ARB_OBS0_CHNL68_RDATA0_ADDR A:0xe602218
y.create.l HWIO_PMIC_ARB_OBS0_CHNL69_RDATA0_ADDR A:0xe602298
y.create.l HWIO_PMIC_ARB_OBS0_CHNL70_RDATA0_ADDR A:0xe602318
y.create.l HWIO_PMIC_ARB_OBS0_CHNL71_RDATA0_ADDR A:0xe602398
y.create.l HWIO_PMIC_ARB_OBS0_CHNL72_RDATA0_ADDR A:0xe602418
y.create.l HWIO_PMIC_ARB_OBS0_CHNL73_RDATA0_ADDR A:0xe602498
y.create.l HWIO_PMIC_ARB_OBS0_CHNL74_RDATA0_ADDR A:0xe602518
y.create.l HWIO_PMIC_ARB_OBS0_CHNL75_RDATA0_ADDR A:0xe602598
y.create.l HWIO_PMIC_ARB_OBS0_CHNL76_RDATA0_ADDR A:0xe602618
y.create.l HWIO_PMIC_ARB_OBS0_CHNL77_RDATA0_ADDR A:0xe602698
y.create.l HWIO_PMIC_ARB_OBS0_CHNL78_RDATA0_ADDR A:0xe602718
y.create.l HWIO_PMIC_ARB_OBS0_CHNL79_RDATA0_ADDR A:0xe602798
y.create.l HWIO_PMIC_ARB_OBS0_CHNL80_RDATA0_ADDR A:0xe602818
y.create.l HWIO_PMIC_ARB_OBS0_CHNL81_RDATA0_ADDR A:0xe602898
y.create.l HWIO_PMIC_ARB_OBS0_CHNL82_RDATA0_ADDR A:0xe602918
y.create.l HWIO_PMIC_ARB_OBS0_CHNL83_RDATA0_ADDR A:0xe602998
y.create.l HWIO_PMIC_ARB_OBS0_CHNL84_RDATA0_ADDR A:0xe602a18
y.create.l HWIO_PMIC_ARB_OBS0_CHNL85_RDATA0_ADDR A:0xe602a98
y.create.l HWIO_PMIC_ARB_OBS0_CHNL86_RDATA0_ADDR A:0xe602b18
y.create.l HWIO_PMIC_ARB_OBS0_CHNL87_RDATA0_ADDR A:0xe602b98
y.create.l HWIO_PMIC_ARB_OBS0_CHNL88_RDATA0_ADDR A:0xe602c18
y.create.l HWIO_PMIC_ARB_OBS0_CHNL89_RDATA0_ADDR A:0xe602c98
y.create.l HWIO_PMIC_ARB_OBS0_CHNL90_RDATA0_ADDR A:0xe602d18
y.create.l HWIO_PMIC_ARB_OBS0_CHNL91_RDATA0_ADDR A:0xe602d98
y.create.l HWIO_PMIC_ARB_OBS0_CHNL92_RDATA0_ADDR A:0xe602e18
y.create.l HWIO_PMIC_ARB_OBS0_CHNL93_RDATA0_ADDR A:0xe602e98
y.create.l HWIO_PMIC_ARB_OBS0_CHNL94_RDATA0_ADDR A:0xe602f18
y.create.l HWIO_PMIC_ARB_OBS0_CHNL95_RDATA0_ADDR A:0xe602f98
y.create.l HWIO_PMIC_ARB_OBS0_CHNL96_RDATA0_ADDR A:0xe603018
y.create.l HWIO_PMIC_ARB_OBS0_CHNL97_RDATA0_ADDR A:0xe603098
y.create.l HWIO_PMIC_ARB_OBS0_CHNL98_RDATA0_ADDR A:0xe603118
y.create.l HWIO_PMIC_ARB_OBS0_CHNL99_RDATA0_ADDR A:0xe603198
y.create.l HWIO_PMIC_ARB_OBS0_CHNL100_RDATA0_ADDR A:0xe603218
y.create.l HWIO_PMIC_ARB_OBS0_CHNL101_RDATA0_ADDR A:0xe603298
y.create.l HWIO_PMIC_ARB_OBS0_CHNL102_RDATA0_ADDR A:0xe603318
y.create.l HWIO_PMIC_ARB_OBS0_CHNL103_RDATA0_ADDR A:0xe603398
y.create.l HWIO_PMIC_ARB_OBS0_CHNL104_RDATA0_ADDR A:0xe603418
y.create.l HWIO_PMIC_ARB_OBS0_CHNL105_RDATA0_ADDR A:0xe603498
y.create.l HWIO_PMIC_ARB_OBS0_CHNL106_RDATA0_ADDR A:0xe603518
y.create.l HWIO_PMIC_ARB_OBS0_CHNL107_RDATA0_ADDR A:0xe603598
y.create.l HWIO_PMIC_ARB_OBS0_CHNL108_RDATA0_ADDR A:0xe603618
y.create.l HWIO_PMIC_ARB_OBS0_CHNL109_RDATA0_ADDR A:0xe603698
y.create.l HWIO_PMIC_ARB_OBS0_CHNL110_RDATA0_ADDR A:0xe603718
y.create.l HWIO_PMIC_ARB_OBS0_CHNL111_RDATA0_ADDR A:0xe603798
y.create.l HWIO_PMIC_ARB_OBS0_CHNL112_RDATA0_ADDR A:0xe603818
y.create.l HWIO_PMIC_ARB_OBS0_CHNL113_RDATA0_ADDR A:0xe603898
y.create.l HWIO_PMIC_ARB_OBS0_CHNL114_RDATA0_ADDR A:0xe603918
y.create.l HWIO_PMIC_ARB_OBS0_CHNL115_RDATA0_ADDR A:0xe603998
y.create.l HWIO_PMIC_ARB_OBS0_CHNL116_RDATA0_ADDR A:0xe603a18
y.create.l HWIO_PMIC_ARB_OBS0_CHNL117_RDATA0_ADDR A:0xe603a98
y.create.l HWIO_PMIC_ARB_OBS0_CHNL118_RDATA0_ADDR A:0xe603b18
y.create.l HWIO_PMIC_ARB_OBS0_CHNL119_RDATA0_ADDR A:0xe603b98
y.create.l HWIO_PMIC_ARB_OBS0_CHNL120_RDATA0_ADDR A:0xe603c18
y.create.l HWIO_PMIC_ARB_OBS0_CHNL121_RDATA0_ADDR A:0xe603c98
y.create.l HWIO_PMIC_ARB_OBS0_CHNL122_RDATA0_ADDR A:0xe603d18
y.create.l HWIO_PMIC_ARB_OBS0_CHNL123_RDATA0_ADDR A:0xe603d98
y.create.l HWIO_PMIC_ARB_OBS0_CHNL124_RDATA0_ADDR A:0xe603e18
y.create.l HWIO_PMIC_ARB_OBS0_CHNL125_RDATA0_ADDR A:0xe603e98
y.create.l HWIO_PMIC_ARB_OBS0_CHNL126_RDATA0_ADDR A:0xe603f18
y.create.l HWIO_PMIC_ARB_OBS0_CHNL127_RDATA0_ADDR A:0xe603f98
y.create.l HWIO_PMIC_ARB_OBS0_CHNL128_RDATA0_ADDR A:0xe604018
y.create.l HWIO_PMIC_ARB_OBS0_CHNL129_RDATA0_ADDR A:0xe604098
y.create.l HWIO_PMIC_ARB_OBS0_CHNL130_RDATA0_ADDR A:0xe604118
y.create.l HWIO_PMIC_ARB_OBS0_CHNL131_RDATA0_ADDR A:0xe604198
y.create.l HWIO_PMIC_ARB_OBS0_CHNL132_RDATA0_ADDR A:0xe604218
y.create.l HWIO_PMIC_ARB_OBS0_CHNL133_RDATA0_ADDR A:0xe604298
y.create.l HWIO_PMIC_ARB_OBS0_CHNL134_RDATA0_ADDR A:0xe604318
y.create.l HWIO_PMIC_ARB_OBS0_CHNL135_RDATA0_ADDR A:0xe604398
y.create.l HWIO_PMIC_ARB_OBS0_CHNL136_RDATA0_ADDR A:0xe604418
y.create.l HWIO_PMIC_ARB_OBS0_CHNL137_RDATA0_ADDR A:0xe604498
y.create.l HWIO_PMIC_ARB_OBS0_CHNL138_RDATA0_ADDR A:0xe604518
y.create.l HWIO_PMIC_ARB_OBS0_CHNL139_RDATA0_ADDR A:0xe604598
y.create.l HWIO_PMIC_ARB_OBS0_CHNL140_RDATA0_ADDR A:0xe604618
y.create.l HWIO_PMIC_ARB_OBS0_CHNL141_RDATA0_ADDR A:0xe604698
y.create.l HWIO_PMIC_ARB_OBS0_CHNL142_RDATA0_ADDR A:0xe604718
y.create.l HWIO_PMIC_ARB_OBS0_CHNL143_RDATA0_ADDR A:0xe604798
y.create.l HWIO_PMIC_ARB_OBS0_CHNL144_RDATA0_ADDR A:0xe604818
y.create.l HWIO_PMIC_ARB_OBS0_CHNL145_RDATA0_ADDR A:0xe604898
y.create.l HWIO_PMIC_ARB_OBS0_CHNL146_RDATA0_ADDR A:0xe604918
y.create.l HWIO_PMIC_ARB_OBS0_CHNL147_RDATA0_ADDR A:0xe604998
y.create.l HWIO_PMIC_ARB_OBS0_CHNL148_RDATA0_ADDR A:0xe604a18
y.create.l HWIO_PMIC_ARB_OBS0_CHNL149_RDATA0_ADDR A:0xe604a98
y.create.l HWIO_PMIC_ARB_OBS0_CHNL150_RDATA0_ADDR A:0xe604b18
y.create.l HWIO_PMIC_ARB_OBS0_CHNL151_RDATA0_ADDR A:0xe604b98
y.create.l HWIO_PMIC_ARB_OBS0_CHNL152_RDATA0_ADDR A:0xe604c18
y.create.l HWIO_PMIC_ARB_OBS0_CHNL153_RDATA0_ADDR A:0xe604c98
y.create.l HWIO_PMIC_ARB_OBS0_CHNL154_RDATA0_ADDR A:0xe604d18
y.create.l HWIO_PMIC_ARB_OBS0_CHNL155_RDATA0_ADDR A:0xe604d98
y.create.l HWIO_PMIC_ARB_OBS0_CHNL156_RDATA0_ADDR A:0xe604e18
y.create.l HWIO_PMIC_ARB_OBS0_CHNL157_RDATA0_ADDR A:0xe604e98
y.create.l HWIO_PMIC_ARB_OBS0_CHNL158_RDATA0_ADDR A:0xe604f18
y.create.l HWIO_PMIC_ARB_OBS0_CHNL159_RDATA0_ADDR A:0xe604f98
y.create.l HWIO_PMIC_ARB_OBS0_CHNL160_RDATA0_ADDR A:0xe605018
y.create.l HWIO_PMIC_ARB_OBS0_CHNL161_RDATA0_ADDR A:0xe605098
y.create.l HWIO_PMIC_ARB_OBS0_CHNL162_RDATA0_ADDR A:0xe605118
y.create.l HWIO_PMIC_ARB_OBS0_CHNL163_RDATA0_ADDR A:0xe605198
y.create.l HWIO_PMIC_ARB_OBS0_CHNL164_RDATA0_ADDR A:0xe605218
y.create.l HWIO_PMIC_ARB_OBS0_CHNL165_RDATA0_ADDR A:0xe605298
y.create.l HWIO_PMIC_ARB_OBS0_CHNL166_RDATA0_ADDR A:0xe605318
y.create.l HWIO_PMIC_ARB_OBS0_CHNL167_RDATA0_ADDR A:0xe605398
y.create.l HWIO_PMIC_ARB_OBS0_CHNL168_RDATA0_ADDR A:0xe605418
y.create.l HWIO_PMIC_ARB_OBS0_CHNL169_RDATA0_ADDR A:0xe605498
y.create.l HWIO_PMIC_ARB_OBS0_CHNL170_RDATA0_ADDR A:0xe605518
y.create.l HWIO_PMIC_ARB_OBS0_CHNL171_RDATA0_ADDR A:0xe605598
y.create.l HWIO_PMIC_ARB_OBS0_CHNL172_RDATA0_ADDR A:0xe605618
y.create.l HWIO_PMIC_ARB_OBS0_CHNL173_RDATA0_ADDR A:0xe605698
y.create.l HWIO_PMIC_ARB_OBS0_CHNL174_RDATA0_ADDR A:0xe605718
y.create.l HWIO_PMIC_ARB_OBS0_CHNL175_RDATA0_ADDR A:0xe605798
y.create.l HWIO_PMIC_ARB_OBS0_CHNL176_RDATA0_ADDR A:0xe605818
y.create.l HWIO_PMIC_ARB_OBS0_CHNL177_RDATA0_ADDR A:0xe605898
y.create.l HWIO_PMIC_ARB_OBS0_CHNL178_RDATA0_ADDR A:0xe605918
y.create.l HWIO_PMIC_ARB_OBS0_CHNL179_RDATA0_ADDR A:0xe605998
y.create.l HWIO_PMIC_ARB_OBS0_CHNL180_RDATA0_ADDR A:0xe605a18
y.create.l HWIO_PMIC_ARB_OBS0_CHNL181_RDATA0_ADDR A:0xe605a98
y.create.l HWIO_PMIC_ARB_OBS0_CHNL182_RDATA0_ADDR A:0xe605b18
y.create.l HWIO_PMIC_ARB_OBS0_CHNL183_RDATA0_ADDR A:0xe605b98
y.create.l HWIO_PMIC_ARB_OBS0_CHNL184_RDATA0_ADDR A:0xe605c18
y.create.l HWIO_PMIC_ARB_OBS0_CHNL185_RDATA0_ADDR A:0xe605c98
y.create.l HWIO_PMIC_ARB_OBS0_CHNL186_RDATA0_ADDR A:0xe605d18
y.create.l HWIO_PMIC_ARB_OBS0_CHNL187_RDATA0_ADDR A:0xe605d98
y.create.l HWIO_PMIC_ARB_OBS0_CHNL188_RDATA0_ADDR A:0xe605e18
y.create.l HWIO_PMIC_ARB_OBS0_CHNL189_RDATA0_ADDR A:0xe605e98
y.create.l HWIO_PMIC_ARB_OBS0_CHNL190_RDATA0_ADDR A:0xe605f18
y.create.l HWIO_PMIC_ARB_OBS0_CHNL191_RDATA0_ADDR A:0xe605f98
y.create.l HWIO_PMIC_ARB_OBS0_CHNL192_RDATA0_ADDR A:0xe606018
y.create.l HWIO_PMIC_ARB_OBS0_CHNL193_RDATA0_ADDR A:0xe606098
y.create.l HWIO_PMIC_ARB_OBS0_CHNL194_RDATA0_ADDR A:0xe606118
y.create.l HWIO_PMIC_ARB_OBS0_CHNL195_RDATA0_ADDR A:0xe606198
y.create.l HWIO_PMIC_ARB_OBS0_CHNL196_RDATA0_ADDR A:0xe606218
y.create.l HWIO_PMIC_ARB_OBS0_CHNL197_RDATA0_ADDR A:0xe606298
y.create.l HWIO_PMIC_ARB_OBS0_CHNL198_RDATA0_ADDR A:0xe606318
y.create.l HWIO_PMIC_ARB_OBS0_CHNL199_RDATA0_ADDR A:0xe606398
y.create.l HWIO_PMIC_ARB_OBS0_CHNL200_RDATA0_ADDR A:0xe606418
y.create.l HWIO_PMIC_ARB_OBS0_CHNL201_RDATA0_ADDR A:0xe606498
y.create.l HWIO_PMIC_ARB_OBS0_CHNL202_RDATA0_ADDR A:0xe606518
y.create.l HWIO_PMIC_ARB_OBS0_CHNL203_RDATA0_ADDR A:0xe606598
y.create.l HWIO_PMIC_ARB_OBS0_CHNL204_RDATA0_ADDR A:0xe606618
y.create.l HWIO_PMIC_ARB_OBS0_CHNL205_RDATA0_ADDR A:0xe606698
y.create.l HWIO_PMIC_ARB_OBS0_CHNL206_RDATA0_ADDR A:0xe606718
y.create.l HWIO_PMIC_ARB_OBS0_CHNL207_RDATA0_ADDR A:0xe606798
y.create.l HWIO_PMIC_ARB_OBS0_CHNL208_RDATA0_ADDR A:0xe606818
y.create.l HWIO_PMIC_ARB_OBS0_CHNL209_RDATA0_ADDR A:0xe606898
y.create.l HWIO_PMIC_ARB_OBS0_CHNL210_RDATA0_ADDR A:0xe606918
y.create.l HWIO_PMIC_ARB_OBS0_CHNL211_RDATA0_ADDR A:0xe606998
y.create.l HWIO_PMIC_ARB_OBS0_CHNL212_RDATA0_ADDR A:0xe606a18
y.create.l HWIO_PMIC_ARB_OBS0_CHNL213_RDATA0_ADDR A:0xe606a98
y.create.l HWIO_PMIC_ARB_OBS0_CHNL214_RDATA0_ADDR A:0xe606b18
y.create.l HWIO_PMIC_ARB_OBS0_CHNL215_RDATA0_ADDR A:0xe606b98
y.create.l HWIO_PMIC_ARB_OBS0_CHNL216_RDATA0_ADDR A:0xe606c18
y.create.l HWIO_PMIC_ARB_OBS0_CHNL217_RDATA0_ADDR A:0xe606c98
y.create.l HWIO_PMIC_ARB_OBS0_CHNL218_RDATA0_ADDR A:0xe606d18
y.create.l HWIO_PMIC_ARB_OBS0_CHNL219_RDATA0_ADDR A:0xe606d98
y.create.l HWIO_PMIC_ARB_OBS0_CHNL220_RDATA0_ADDR A:0xe606e18
y.create.l HWIO_PMIC_ARB_OBS0_CHNL221_RDATA0_ADDR A:0xe606e98
y.create.l HWIO_PMIC_ARB_OBS0_CHNL222_RDATA0_ADDR A:0xe606f18
y.create.l HWIO_PMIC_ARB_OBS0_CHNL223_RDATA0_ADDR A:0xe606f98
y.create.l HWIO_PMIC_ARB_OBS0_CHNL224_RDATA0_ADDR A:0xe607018
y.create.l HWIO_PMIC_ARB_OBS0_CHNL225_RDATA0_ADDR A:0xe607098
y.create.l HWIO_PMIC_ARB_OBS0_CHNL226_RDATA0_ADDR A:0xe607118
y.create.l HWIO_PMIC_ARB_OBS0_CHNL227_RDATA0_ADDR A:0xe607198
y.create.l HWIO_PMIC_ARB_OBS0_CHNL228_RDATA0_ADDR A:0xe607218
y.create.l HWIO_PMIC_ARB_OBS0_CHNL229_RDATA0_ADDR A:0xe607298
y.create.l HWIO_PMIC_ARB_OBS0_CHNL230_RDATA0_ADDR A:0xe607318
y.create.l HWIO_PMIC_ARB_OBS0_CHNL231_RDATA0_ADDR A:0xe607398
y.create.l HWIO_PMIC_ARB_OBS0_CHNL232_RDATA0_ADDR A:0xe607418
y.create.l HWIO_PMIC_ARB_OBS0_CHNL233_RDATA0_ADDR A:0xe607498
y.create.l HWIO_PMIC_ARB_OBS0_CHNL234_RDATA0_ADDR A:0xe607518
y.create.l HWIO_PMIC_ARB_OBS0_CHNL235_RDATA0_ADDR A:0xe607598
y.create.l HWIO_PMIC_ARB_OBS0_CHNL236_RDATA0_ADDR A:0xe607618
y.create.l HWIO_PMIC_ARB_OBS0_CHNL237_RDATA0_ADDR A:0xe607698
y.create.l HWIO_PMIC_ARB_OBS0_CHNL238_RDATA0_ADDR A:0xe607718
y.create.l HWIO_PMIC_ARB_OBS0_CHNL239_RDATA0_ADDR A:0xe607798
y.create.l HWIO_PMIC_ARB_OBS0_CHNL240_RDATA0_ADDR A:0xe607818
y.create.l HWIO_PMIC_ARB_OBS0_CHNL241_RDATA0_ADDR A:0xe607898
y.create.l HWIO_PMIC_ARB_OBS0_CHNL242_RDATA0_ADDR A:0xe607918
y.create.l HWIO_PMIC_ARB_OBS0_CHNL243_RDATA0_ADDR A:0xe607998
y.create.l HWIO_PMIC_ARB_OBS0_CHNL244_RDATA0_ADDR A:0xe607a18
y.create.l HWIO_PMIC_ARB_OBS0_CHNL245_RDATA0_ADDR A:0xe607a98
y.create.l HWIO_PMIC_ARB_OBS0_CHNL246_RDATA0_ADDR A:0xe607b18
y.create.l HWIO_PMIC_ARB_OBS0_CHNL247_RDATA0_ADDR A:0xe607b98
y.create.l HWIO_PMIC_ARB_OBS0_CHNL248_RDATA0_ADDR A:0xe607c18
y.create.l HWIO_PMIC_ARB_OBS0_CHNL249_RDATA0_ADDR A:0xe607c98
y.create.l HWIO_PMIC_ARB_OBS0_CHNL250_RDATA0_ADDR A:0xe607d18
y.create.l HWIO_PMIC_ARB_OBS0_CHNL251_RDATA0_ADDR A:0xe607d98
y.create.l HWIO_PMIC_ARB_OBS0_CHNL252_RDATA0_ADDR A:0xe607e18
y.create.l HWIO_PMIC_ARB_OBS0_CHNL253_RDATA0_ADDR A:0xe607e98
y.create.l HWIO_PMIC_ARB_OBS0_CHNL254_RDATA0_ADDR A:0xe607f18
y.create.l HWIO_PMIC_ARB_OBS0_CHNL255_RDATA0_ADDR A:0xe607f98
y.create.l HWIO_PMIC_ARB_OBS1_CHNL0_RDATA0_ADDR A:0xe610018
y.create.l HWIO_PMIC_ARB_OBS1_CHNL1_RDATA0_ADDR A:0xe610098
y.create.l HWIO_PMIC_ARB_OBS1_CHNL2_RDATA0_ADDR A:0xe610118
y.create.l HWIO_PMIC_ARB_OBS1_CHNL3_RDATA0_ADDR A:0xe610198
y.create.l HWIO_PMIC_ARB_OBS1_CHNL4_RDATA0_ADDR A:0xe610218
y.create.l HWIO_PMIC_ARB_OBS1_CHNL5_RDATA0_ADDR A:0xe610298
y.create.l HWIO_PMIC_ARB_OBS1_CHNL6_RDATA0_ADDR A:0xe610318
y.create.l HWIO_PMIC_ARB_OBS1_CHNL7_RDATA0_ADDR A:0xe610398
y.create.l HWIO_PMIC_ARB_OBS1_CHNL8_RDATA0_ADDR A:0xe610418
y.create.l HWIO_PMIC_ARB_OBS1_CHNL9_RDATA0_ADDR A:0xe610498
y.create.l HWIO_PMIC_ARB_OBS1_CHNL10_RDATA0_ADDR A:0xe610518
y.create.l HWIO_PMIC_ARB_OBS1_CHNL11_RDATA0_ADDR A:0xe610598
y.create.l HWIO_PMIC_ARB_OBS1_CHNL12_RDATA0_ADDR A:0xe610618
y.create.l HWIO_PMIC_ARB_OBS1_CHNL13_RDATA0_ADDR A:0xe610698
y.create.l HWIO_PMIC_ARB_OBS1_CHNL14_RDATA0_ADDR A:0xe610718
y.create.l HWIO_PMIC_ARB_OBS1_CHNL15_RDATA0_ADDR A:0xe610798
y.create.l HWIO_PMIC_ARB_OBS1_CHNL16_RDATA0_ADDR A:0xe610818
y.create.l HWIO_PMIC_ARB_OBS1_CHNL17_RDATA0_ADDR A:0xe610898
y.create.l HWIO_PMIC_ARB_OBS1_CHNL18_RDATA0_ADDR A:0xe610918
y.create.l HWIO_PMIC_ARB_OBS1_CHNL19_RDATA0_ADDR A:0xe610998
y.create.l HWIO_PMIC_ARB_OBS1_CHNL20_RDATA0_ADDR A:0xe610a18
y.create.l HWIO_PMIC_ARB_OBS1_CHNL21_RDATA0_ADDR A:0xe610a98
y.create.l HWIO_PMIC_ARB_OBS1_CHNL22_RDATA0_ADDR A:0xe610b18
y.create.l HWIO_PMIC_ARB_OBS1_CHNL23_RDATA0_ADDR A:0xe610b98
y.create.l HWIO_PMIC_ARB_OBS1_CHNL24_RDATA0_ADDR A:0xe610c18
y.create.l HWIO_PMIC_ARB_OBS1_CHNL25_RDATA0_ADDR A:0xe610c98
y.create.l HWIO_PMIC_ARB_OBS1_CHNL26_RDATA0_ADDR A:0xe610d18
y.create.l HWIO_PMIC_ARB_OBS1_CHNL27_RDATA0_ADDR A:0xe610d98
y.create.l HWIO_PMIC_ARB_OBS1_CHNL28_RDATA0_ADDR A:0xe610e18
y.create.l HWIO_PMIC_ARB_OBS1_CHNL29_RDATA0_ADDR A:0xe610e98
y.create.l HWIO_PMIC_ARB_OBS1_CHNL30_RDATA0_ADDR A:0xe610f18
y.create.l HWIO_PMIC_ARB_OBS1_CHNL31_RDATA0_ADDR A:0xe610f98
y.create.l HWIO_PMIC_ARB_OBS1_CHNL32_RDATA0_ADDR A:0xe611018
y.create.l HWIO_PMIC_ARB_OBS1_CHNL33_RDATA0_ADDR A:0xe611098
y.create.l HWIO_PMIC_ARB_OBS1_CHNL34_RDATA0_ADDR A:0xe611118
y.create.l HWIO_PMIC_ARB_OBS1_CHNL35_RDATA0_ADDR A:0xe611198
y.create.l HWIO_PMIC_ARB_OBS1_CHNL36_RDATA0_ADDR A:0xe611218
y.create.l HWIO_PMIC_ARB_OBS1_CHNL37_RDATA0_ADDR A:0xe611298
y.create.l HWIO_PMIC_ARB_OBS1_CHNL38_RDATA0_ADDR A:0xe611318
y.create.l HWIO_PMIC_ARB_OBS1_CHNL39_RDATA0_ADDR A:0xe611398
y.create.l HWIO_PMIC_ARB_OBS1_CHNL40_RDATA0_ADDR A:0xe611418
y.create.l HWIO_PMIC_ARB_OBS1_CHNL41_RDATA0_ADDR A:0xe611498
y.create.l HWIO_PMIC_ARB_OBS1_CHNL42_RDATA0_ADDR A:0xe611518
y.create.l HWIO_PMIC_ARB_OBS1_CHNL43_RDATA0_ADDR A:0xe611598
y.create.l HWIO_PMIC_ARB_OBS1_CHNL44_RDATA0_ADDR A:0xe611618
y.create.l HWIO_PMIC_ARB_OBS1_CHNL45_RDATA0_ADDR A:0xe611698
y.create.l HWIO_PMIC_ARB_OBS1_CHNL46_RDATA0_ADDR A:0xe611718
y.create.l HWIO_PMIC_ARB_OBS1_CHNL47_RDATA0_ADDR A:0xe611798
y.create.l HWIO_PMIC_ARB_OBS1_CHNL48_RDATA0_ADDR A:0xe611818
y.create.l HWIO_PMIC_ARB_OBS1_CHNL49_RDATA0_ADDR A:0xe611898
y.create.l HWIO_PMIC_ARB_OBS1_CHNL50_RDATA0_ADDR A:0xe611918
y.create.l HWIO_PMIC_ARB_OBS1_CHNL51_RDATA0_ADDR A:0xe611998
y.create.l HWIO_PMIC_ARB_OBS1_CHNL52_RDATA0_ADDR A:0xe611a18
y.create.l HWIO_PMIC_ARB_OBS1_CHNL53_RDATA0_ADDR A:0xe611a98
y.create.l HWIO_PMIC_ARB_OBS1_CHNL54_RDATA0_ADDR A:0xe611b18
y.create.l HWIO_PMIC_ARB_OBS1_CHNL55_RDATA0_ADDR A:0xe611b98
y.create.l HWIO_PMIC_ARB_OBS1_CHNL56_RDATA0_ADDR A:0xe611c18
y.create.l HWIO_PMIC_ARB_OBS1_CHNL57_RDATA0_ADDR A:0xe611c98
y.create.l HWIO_PMIC_ARB_OBS1_CHNL58_RDATA0_ADDR A:0xe611d18
y.create.l HWIO_PMIC_ARB_OBS1_CHNL59_RDATA0_ADDR A:0xe611d98
y.create.l HWIO_PMIC_ARB_OBS1_CHNL60_RDATA0_ADDR A:0xe611e18
y.create.l HWIO_PMIC_ARB_OBS1_CHNL61_RDATA0_ADDR A:0xe611e98
y.create.l HWIO_PMIC_ARB_OBS1_CHNL62_RDATA0_ADDR A:0xe611f18
y.create.l HWIO_PMIC_ARB_OBS1_CHNL63_RDATA0_ADDR A:0xe611f98
y.create.l HWIO_PMIC_ARB_OBS1_CHNL64_RDATA0_ADDR A:0xe612018
y.create.l HWIO_PMIC_ARB_OBS1_CHNL65_RDATA0_ADDR A:0xe612098
y.create.l HWIO_PMIC_ARB_OBS1_CHNL66_RDATA0_ADDR A:0xe612118
y.create.l HWIO_PMIC_ARB_OBS1_CHNL67_RDATA0_ADDR A:0xe612198
y.create.l HWIO_PMIC_ARB_OBS1_CHNL68_RDATA0_ADDR A:0xe612218
y.create.l HWIO_PMIC_ARB_OBS1_CHNL69_RDATA0_ADDR A:0xe612298
y.create.l HWIO_PMIC_ARB_OBS1_CHNL70_RDATA0_ADDR A:0xe612318
y.create.l HWIO_PMIC_ARB_OBS1_CHNL71_RDATA0_ADDR A:0xe612398
y.create.l HWIO_PMIC_ARB_OBS1_CHNL72_RDATA0_ADDR A:0xe612418
y.create.l HWIO_PMIC_ARB_OBS1_CHNL73_RDATA0_ADDR A:0xe612498
y.create.l HWIO_PMIC_ARB_OBS1_CHNL74_RDATA0_ADDR A:0xe612518
y.create.l HWIO_PMIC_ARB_OBS1_CHNL75_RDATA0_ADDR A:0xe612598
y.create.l HWIO_PMIC_ARB_OBS1_CHNL76_RDATA0_ADDR A:0xe612618
y.create.l HWIO_PMIC_ARB_OBS1_CHNL77_RDATA0_ADDR A:0xe612698
y.create.l HWIO_PMIC_ARB_OBS1_CHNL78_RDATA0_ADDR A:0xe612718
y.create.l HWIO_PMIC_ARB_OBS1_CHNL79_RDATA0_ADDR A:0xe612798
y.create.l HWIO_PMIC_ARB_OBS1_CHNL80_RDATA0_ADDR A:0xe612818
y.create.l HWIO_PMIC_ARB_OBS1_CHNL81_RDATA0_ADDR A:0xe612898
y.create.l HWIO_PMIC_ARB_OBS1_CHNL82_RDATA0_ADDR A:0xe612918
y.create.l HWIO_PMIC_ARB_OBS1_CHNL83_RDATA0_ADDR A:0xe612998
y.create.l HWIO_PMIC_ARB_OBS1_CHNL84_RDATA0_ADDR A:0xe612a18
y.create.l HWIO_PMIC_ARB_OBS1_CHNL85_RDATA0_ADDR A:0xe612a98
y.create.l HWIO_PMIC_ARB_OBS1_CHNL86_RDATA0_ADDR A:0xe612b18
y.create.l HWIO_PMIC_ARB_OBS1_CHNL87_RDATA0_ADDR A:0xe612b98
y.create.l HWIO_PMIC_ARB_OBS1_CHNL88_RDATA0_ADDR A:0xe612c18
y.create.l HWIO_PMIC_ARB_OBS1_CHNL89_RDATA0_ADDR A:0xe612c98
y.create.l HWIO_PMIC_ARB_OBS1_CHNL90_RDATA0_ADDR A:0xe612d18
y.create.l HWIO_PMIC_ARB_OBS1_CHNL91_RDATA0_ADDR A:0xe612d98
y.create.l HWIO_PMIC_ARB_OBS1_CHNL92_RDATA0_ADDR A:0xe612e18
y.create.l HWIO_PMIC_ARB_OBS1_CHNL93_RDATA0_ADDR A:0xe612e98
y.create.l HWIO_PMIC_ARB_OBS1_CHNL94_RDATA0_ADDR A:0xe612f18
y.create.l HWIO_PMIC_ARB_OBS1_CHNL95_RDATA0_ADDR A:0xe612f98
y.create.l HWIO_PMIC_ARB_OBS1_CHNL96_RDATA0_ADDR A:0xe613018
y.create.l HWIO_PMIC_ARB_OBS1_CHNL97_RDATA0_ADDR A:0xe613098
y.create.l HWIO_PMIC_ARB_OBS1_CHNL98_RDATA0_ADDR A:0xe613118
y.create.l HWIO_PMIC_ARB_OBS1_CHNL99_RDATA0_ADDR A:0xe613198
y.create.l HWIO_PMIC_ARB_OBS1_CHNL100_RDATA0_ADDR A:0xe613218
y.create.l HWIO_PMIC_ARB_OBS1_CHNL101_RDATA0_ADDR A:0xe613298
y.create.l HWIO_PMIC_ARB_OBS1_CHNL102_RDATA0_ADDR A:0xe613318
y.create.l HWIO_PMIC_ARB_OBS1_CHNL103_RDATA0_ADDR A:0xe613398
y.create.l HWIO_PMIC_ARB_OBS1_CHNL104_RDATA0_ADDR A:0xe613418
y.create.l HWIO_PMIC_ARB_OBS1_CHNL105_RDATA0_ADDR A:0xe613498
y.create.l HWIO_PMIC_ARB_OBS1_CHNL106_RDATA0_ADDR A:0xe613518
y.create.l HWIO_PMIC_ARB_OBS1_CHNL107_RDATA0_ADDR A:0xe613598
y.create.l HWIO_PMIC_ARB_OBS1_CHNL108_RDATA0_ADDR A:0xe613618
y.create.l HWIO_PMIC_ARB_OBS1_CHNL109_RDATA0_ADDR A:0xe613698
y.create.l HWIO_PMIC_ARB_OBS1_CHNL110_RDATA0_ADDR A:0xe613718
y.create.l HWIO_PMIC_ARB_OBS1_CHNL111_RDATA0_ADDR A:0xe613798
y.create.l HWIO_PMIC_ARB_OBS1_CHNL112_RDATA0_ADDR A:0xe613818
y.create.l HWIO_PMIC_ARB_OBS1_CHNL113_RDATA0_ADDR A:0xe613898
y.create.l HWIO_PMIC_ARB_OBS1_CHNL114_RDATA0_ADDR A:0xe613918
y.create.l HWIO_PMIC_ARB_OBS1_CHNL115_RDATA0_ADDR A:0xe613998
y.create.l HWIO_PMIC_ARB_OBS1_CHNL116_RDATA0_ADDR A:0xe613a18
y.create.l HWIO_PMIC_ARB_OBS1_CHNL117_RDATA0_ADDR A:0xe613a98
y.create.l HWIO_PMIC_ARB_OBS1_CHNL118_RDATA0_ADDR A:0xe613b18
y.create.l HWIO_PMIC_ARB_OBS1_CHNL119_RDATA0_ADDR A:0xe613b98
y.create.l HWIO_PMIC_ARB_OBS1_CHNL120_RDATA0_ADDR A:0xe613c18
y.create.l HWIO_PMIC_ARB_OBS1_CHNL121_RDATA0_ADDR A:0xe613c98
y.create.l HWIO_PMIC_ARB_OBS1_CHNL122_RDATA0_ADDR A:0xe613d18
y.create.l HWIO_PMIC_ARB_OBS1_CHNL123_RDATA0_ADDR A:0xe613d98
y.create.l HWIO_PMIC_ARB_OBS1_CHNL124_RDATA0_ADDR A:0xe613e18
y.create.l HWIO_PMIC_ARB_OBS1_CHNL125_RDATA0_ADDR A:0xe613e98
y.create.l HWIO_PMIC_ARB_OBS1_CHNL126_RDATA0_ADDR A:0xe613f18
y.create.l HWIO_PMIC_ARB_OBS1_CHNL127_RDATA0_ADDR A:0xe613f98
y.create.l HWIO_PMIC_ARB_OBS1_CHNL128_RDATA0_ADDR A:0xe614018
y.create.l HWIO_PMIC_ARB_OBS1_CHNL129_RDATA0_ADDR A:0xe614098
y.create.l HWIO_PMIC_ARB_OBS1_CHNL130_RDATA0_ADDR A:0xe614118
y.create.l HWIO_PMIC_ARB_OBS1_CHNL131_RDATA0_ADDR A:0xe614198
y.create.l HWIO_PMIC_ARB_OBS1_CHNL132_RDATA0_ADDR A:0xe614218
y.create.l HWIO_PMIC_ARB_OBS1_CHNL133_RDATA0_ADDR A:0xe614298
y.create.l HWIO_PMIC_ARB_OBS1_CHNL134_RDATA0_ADDR A:0xe614318
y.create.l HWIO_PMIC_ARB_OBS1_CHNL135_RDATA0_ADDR A:0xe614398
y.create.l HWIO_PMIC_ARB_OBS1_CHNL136_RDATA0_ADDR A:0xe614418
y.create.l HWIO_PMIC_ARB_OBS1_CHNL137_RDATA0_ADDR A:0xe614498
y.create.l HWIO_PMIC_ARB_OBS1_CHNL138_RDATA0_ADDR A:0xe614518
y.create.l HWIO_PMIC_ARB_OBS1_CHNL139_RDATA0_ADDR A:0xe614598
y.create.l HWIO_PMIC_ARB_OBS1_CHNL140_RDATA0_ADDR A:0xe614618
y.create.l HWIO_PMIC_ARB_OBS1_CHNL141_RDATA0_ADDR A:0xe614698
y.create.l HWIO_PMIC_ARB_OBS1_CHNL142_RDATA0_ADDR A:0xe614718
y.create.l HWIO_PMIC_ARB_OBS1_CHNL143_RDATA0_ADDR A:0xe614798
y.create.l HWIO_PMIC_ARB_OBS1_CHNL144_RDATA0_ADDR A:0xe614818
y.create.l HWIO_PMIC_ARB_OBS1_CHNL145_RDATA0_ADDR A:0xe614898
y.create.l HWIO_PMIC_ARB_OBS1_CHNL146_RDATA0_ADDR A:0xe614918
y.create.l HWIO_PMIC_ARB_OBS1_CHNL147_RDATA0_ADDR A:0xe614998
y.create.l HWIO_PMIC_ARB_OBS1_CHNL148_RDATA0_ADDR A:0xe614a18
y.create.l HWIO_PMIC_ARB_OBS1_CHNL149_RDATA0_ADDR A:0xe614a98
y.create.l HWIO_PMIC_ARB_OBS1_CHNL150_RDATA0_ADDR A:0xe614b18
y.create.l HWIO_PMIC_ARB_OBS1_CHNL151_RDATA0_ADDR A:0xe614b98
y.create.l HWIO_PMIC_ARB_OBS1_CHNL152_RDATA0_ADDR A:0xe614c18
y.create.l HWIO_PMIC_ARB_OBS1_CHNL153_RDATA0_ADDR A:0xe614c98
y.create.l HWIO_PMIC_ARB_OBS1_CHNL154_RDATA0_ADDR A:0xe614d18
y.create.l HWIO_PMIC_ARB_OBS1_CHNL155_RDATA0_ADDR A:0xe614d98
y.create.l HWIO_PMIC_ARB_OBS1_CHNL156_RDATA0_ADDR A:0xe614e18
y.create.l HWIO_PMIC_ARB_OBS1_CHNL157_RDATA0_ADDR A:0xe614e98
y.create.l HWIO_PMIC_ARB_OBS1_CHNL158_RDATA0_ADDR A:0xe614f18
y.create.l HWIO_PMIC_ARB_OBS1_CHNL159_RDATA0_ADDR A:0xe614f98
y.create.l HWIO_PMIC_ARB_OBS1_CHNL160_RDATA0_ADDR A:0xe615018
y.create.l HWIO_PMIC_ARB_OBS1_CHNL161_RDATA0_ADDR A:0xe615098
y.create.l HWIO_PMIC_ARB_OBS1_CHNL162_RDATA0_ADDR A:0xe615118
y.create.l HWIO_PMIC_ARB_OBS1_CHNL163_RDATA0_ADDR A:0xe615198
y.create.l HWIO_PMIC_ARB_OBS1_CHNL164_RDATA0_ADDR A:0xe615218
y.create.l HWIO_PMIC_ARB_OBS1_CHNL165_RDATA0_ADDR A:0xe615298
y.create.l HWIO_PMIC_ARB_OBS1_CHNL166_RDATA0_ADDR A:0xe615318
y.create.l HWIO_PMIC_ARB_OBS1_CHNL167_RDATA0_ADDR A:0xe615398
y.create.l HWIO_PMIC_ARB_OBS1_CHNL168_RDATA0_ADDR A:0xe615418
y.create.l HWIO_PMIC_ARB_OBS1_CHNL169_RDATA0_ADDR A:0xe615498
y.create.l HWIO_PMIC_ARB_OBS1_CHNL170_RDATA0_ADDR A:0xe615518
y.create.l HWIO_PMIC_ARB_OBS1_CHNL171_RDATA0_ADDR A:0xe615598
y.create.l HWIO_PMIC_ARB_OBS1_CHNL172_RDATA0_ADDR A:0xe615618
y.create.l HWIO_PMIC_ARB_OBS1_CHNL173_RDATA0_ADDR A:0xe615698
y.create.l HWIO_PMIC_ARB_OBS1_CHNL174_RDATA0_ADDR A:0xe615718
y.create.l HWIO_PMIC_ARB_OBS1_CHNL175_RDATA0_ADDR A:0xe615798
y.create.l HWIO_PMIC_ARB_OBS1_CHNL176_RDATA0_ADDR A:0xe615818
y.create.l HWIO_PMIC_ARB_OBS1_CHNL177_RDATA0_ADDR A:0xe615898
y.create.l HWIO_PMIC_ARB_OBS1_CHNL178_RDATA0_ADDR A:0xe615918
y.create.l HWIO_PMIC_ARB_OBS1_CHNL179_RDATA0_ADDR A:0xe615998
y.create.l HWIO_PMIC_ARB_OBS1_CHNL180_RDATA0_ADDR A:0xe615a18
y.create.l HWIO_PMIC_ARB_OBS1_CHNL181_RDATA0_ADDR A:0xe615a98
y.create.l HWIO_PMIC_ARB_OBS1_CHNL182_RDATA0_ADDR A:0xe615b18
y.create.l HWIO_PMIC_ARB_OBS1_CHNL183_RDATA0_ADDR A:0xe615b98
y.create.l HWIO_PMIC_ARB_OBS1_CHNL184_RDATA0_ADDR A:0xe615c18
y.create.l HWIO_PMIC_ARB_OBS1_CHNL185_RDATA0_ADDR A:0xe615c98
y.create.l HWIO_PMIC_ARB_OBS1_CHNL186_RDATA0_ADDR A:0xe615d18
y.create.l HWIO_PMIC_ARB_OBS1_CHNL187_RDATA0_ADDR A:0xe615d98
y.create.l HWIO_PMIC_ARB_OBS1_CHNL188_RDATA0_ADDR A:0xe615e18
y.create.l HWIO_PMIC_ARB_OBS1_CHNL189_RDATA0_ADDR A:0xe615e98
y.create.l HWIO_PMIC_ARB_OBS1_CHNL190_RDATA0_ADDR A:0xe615f18
y.create.l HWIO_PMIC_ARB_OBS1_CHNL191_RDATA0_ADDR A:0xe615f98
y.create.l HWIO_PMIC_ARB_OBS1_CHNL192_RDATA0_ADDR A:0xe616018
y.create.l HWIO_PMIC_ARB_OBS1_CHNL193_RDATA0_ADDR A:0xe616098
y.create.l HWIO_PMIC_ARB_OBS1_CHNL194_RDATA0_ADDR A:0xe616118
y.create.l HWIO_PMIC_ARB_OBS1_CHNL195_RDATA0_ADDR A:0xe616198
y.create.l HWIO_PMIC_ARB_OBS1_CHNL196_RDATA0_ADDR A:0xe616218
y.create.l HWIO_PMIC_ARB_OBS1_CHNL197_RDATA0_ADDR A:0xe616298
y.create.l HWIO_PMIC_ARB_OBS1_CHNL198_RDATA0_ADDR A:0xe616318
y.create.l HWIO_PMIC_ARB_OBS1_CHNL199_RDATA0_ADDR A:0xe616398
y.create.l HWIO_PMIC_ARB_OBS1_CHNL200_RDATA0_ADDR A:0xe616418
y.create.l HWIO_PMIC_ARB_OBS1_CHNL201_RDATA0_ADDR A:0xe616498
y.create.l HWIO_PMIC_ARB_OBS1_CHNL202_RDATA0_ADDR A:0xe616518
y.create.l HWIO_PMIC_ARB_OBS1_CHNL203_RDATA0_ADDR A:0xe616598
y.create.l HWIO_PMIC_ARB_OBS1_CHNL204_RDATA0_ADDR A:0xe616618
y.create.l HWIO_PMIC_ARB_OBS1_CHNL205_RDATA0_ADDR A:0xe616698
y.create.l HWIO_PMIC_ARB_OBS1_CHNL206_RDATA0_ADDR A:0xe616718
y.create.l HWIO_PMIC_ARB_OBS1_CHNL207_RDATA0_ADDR A:0xe616798
y.create.l HWIO_PMIC_ARB_OBS1_CHNL208_RDATA0_ADDR A:0xe616818
y.create.l HWIO_PMIC_ARB_OBS1_CHNL209_RDATA0_ADDR A:0xe616898
y.create.l HWIO_PMIC_ARB_OBS1_CHNL210_RDATA0_ADDR A:0xe616918
y.create.l HWIO_PMIC_ARB_OBS1_CHNL211_RDATA0_ADDR A:0xe616998
y.create.l HWIO_PMIC_ARB_OBS1_CHNL212_RDATA0_ADDR A:0xe616a18
y.create.l HWIO_PMIC_ARB_OBS1_CHNL213_RDATA0_ADDR A:0xe616a98
y.create.l HWIO_PMIC_ARB_OBS1_CHNL214_RDATA0_ADDR A:0xe616b18
y.create.l HWIO_PMIC_ARB_OBS1_CHNL215_RDATA0_ADDR A:0xe616b98
y.create.l HWIO_PMIC_ARB_OBS1_CHNL216_RDATA0_ADDR A:0xe616c18
y.create.l HWIO_PMIC_ARB_OBS1_CHNL217_RDATA0_ADDR A:0xe616c98
y.create.l HWIO_PMIC_ARB_OBS1_CHNL218_RDATA0_ADDR A:0xe616d18
y.create.l HWIO_PMIC_ARB_OBS1_CHNL219_RDATA0_ADDR A:0xe616d98
y.create.l HWIO_PMIC_ARB_OBS1_CHNL220_RDATA0_ADDR A:0xe616e18
y.create.l HWIO_PMIC_ARB_OBS1_CHNL221_RDATA0_ADDR A:0xe616e98
y.create.l HWIO_PMIC_ARB_OBS1_CHNL222_RDATA0_ADDR A:0xe616f18
y.create.l HWIO_PMIC_ARB_OBS1_CHNL223_RDATA0_ADDR A:0xe616f98
y.create.l HWIO_PMIC_ARB_OBS1_CHNL224_RDATA0_ADDR A:0xe617018
y.create.l HWIO_PMIC_ARB_OBS1_CHNL225_RDATA0_ADDR A:0xe617098
y.create.l HWIO_PMIC_ARB_OBS1_CHNL226_RDATA0_ADDR A:0xe617118
y.create.l HWIO_PMIC_ARB_OBS1_CHNL227_RDATA0_ADDR A:0xe617198
y.create.l HWIO_PMIC_ARB_OBS1_CHNL228_RDATA0_ADDR A:0xe617218
y.create.l HWIO_PMIC_ARB_OBS1_CHNL229_RDATA0_ADDR A:0xe617298
y.create.l HWIO_PMIC_ARB_OBS1_CHNL230_RDATA0_ADDR A:0xe617318
y.create.l HWIO_PMIC_ARB_OBS1_CHNL231_RDATA0_ADDR A:0xe617398
y.create.l HWIO_PMIC_ARB_OBS1_CHNL232_RDATA0_ADDR A:0xe617418
y.create.l HWIO_PMIC_ARB_OBS1_CHNL233_RDATA0_ADDR A:0xe617498
y.create.l HWIO_PMIC_ARB_OBS1_CHNL234_RDATA0_ADDR A:0xe617518
y.create.l HWIO_PMIC_ARB_OBS1_CHNL235_RDATA0_ADDR A:0xe617598
y.create.l HWIO_PMIC_ARB_OBS1_CHNL236_RDATA0_ADDR A:0xe617618
y.create.l HWIO_PMIC_ARB_OBS1_CHNL237_RDATA0_ADDR A:0xe617698
y.create.l HWIO_PMIC_ARB_OBS1_CHNL238_RDATA0_ADDR A:0xe617718
y.create.l HWIO_PMIC_ARB_OBS1_CHNL239_RDATA0_ADDR A:0xe617798
y.create.l HWIO_PMIC_ARB_OBS1_CHNL240_RDATA0_ADDR A:0xe617818
y.create.l HWIO_PMIC_ARB_OBS1_CHNL241_RDATA0_ADDR A:0xe617898
y.create.l HWIO_PMIC_ARB_OBS1_CHNL242_RDATA0_ADDR A:0xe617918
y.create.l HWIO_PMIC_ARB_OBS1_CHNL243_RDATA0_ADDR A:0xe617998
y.create.l HWIO_PMIC_ARB_OBS1_CHNL244_RDATA0_ADDR A:0xe617a18
y.create.l HWIO_PMIC_ARB_OBS1_CHNL245_RDATA0_ADDR A:0xe617a98
y.create.l HWIO_PMIC_ARB_OBS1_CHNL246_RDATA0_ADDR A:0xe617b18
y.create.l HWIO_PMIC_ARB_OBS1_CHNL247_RDATA0_ADDR A:0xe617b98
y.create.l HWIO_PMIC_ARB_OBS1_CHNL248_RDATA0_ADDR A:0xe617c18
y.create.l HWIO_PMIC_ARB_OBS1_CHNL249_RDATA0_ADDR A:0xe617c98
y.create.l HWIO_PMIC_ARB_OBS1_CHNL250_RDATA0_ADDR A:0xe617d18
y.create.l HWIO_PMIC_ARB_OBS1_CHNL251_RDATA0_ADDR A:0xe617d98
y.create.l HWIO_PMIC_ARB_OBS1_CHNL252_RDATA0_ADDR A:0xe617e18
y.create.l HWIO_PMIC_ARB_OBS1_CHNL253_RDATA0_ADDR A:0xe617e98
y.create.l HWIO_PMIC_ARB_OBS1_CHNL254_RDATA0_ADDR A:0xe617f18
y.create.l HWIO_PMIC_ARB_OBS1_CHNL255_RDATA0_ADDR A:0xe617f98
y.create.l HWIO_PMIC_ARB_OBS2_CHNL0_RDATA0_ADDR A:0xe620018
y.create.l HWIO_PMIC_ARB_OBS2_CHNL1_RDATA0_ADDR A:0xe620098
y.create.l HWIO_PMIC_ARB_OBS2_CHNL2_RDATA0_ADDR A:0xe620118
y.create.l HWIO_PMIC_ARB_OBS2_CHNL3_RDATA0_ADDR A:0xe620198
y.create.l HWIO_PMIC_ARB_OBS2_CHNL4_RDATA0_ADDR A:0xe620218
y.create.l HWIO_PMIC_ARB_OBS2_CHNL5_RDATA0_ADDR A:0xe620298
y.create.l HWIO_PMIC_ARB_OBS2_CHNL6_RDATA0_ADDR A:0xe620318
y.create.l HWIO_PMIC_ARB_OBS2_CHNL7_RDATA0_ADDR A:0xe620398
y.create.l HWIO_PMIC_ARB_OBS2_CHNL8_RDATA0_ADDR A:0xe620418
y.create.l HWIO_PMIC_ARB_OBS2_CHNL9_RDATA0_ADDR A:0xe620498
y.create.l HWIO_PMIC_ARB_OBS2_CHNL10_RDATA0_ADDR A:0xe620518
y.create.l HWIO_PMIC_ARB_OBS2_CHNL11_RDATA0_ADDR A:0xe620598
y.create.l HWIO_PMIC_ARB_OBS2_CHNL12_RDATA0_ADDR A:0xe620618
y.create.l HWIO_PMIC_ARB_OBS2_CHNL13_RDATA0_ADDR A:0xe620698
y.create.l HWIO_PMIC_ARB_OBS2_CHNL14_RDATA0_ADDR A:0xe620718
y.create.l HWIO_PMIC_ARB_OBS2_CHNL15_RDATA0_ADDR A:0xe620798
y.create.l HWIO_PMIC_ARB_OBS2_CHNL16_RDATA0_ADDR A:0xe620818
y.create.l HWIO_PMIC_ARB_OBS2_CHNL17_RDATA0_ADDR A:0xe620898
y.create.l HWIO_PMIC_ARB_OBS2_CHNL18_RDATA0_ADDR A:0xe620918
y.create.l HWIO_PMIC_ARB_OBS2_CHNL19_RDATA0_ADDR A:0xe620998
y.create.l HWIO_PMIC_ARB_OBS2_CHNL20_RDATA0_ADDR A:0xe620a18
y.create.l HWIO_PMIC_ARB_OBS2_CHNL21_RDATA0_ADDR A:0xe620a98
y.create.l HWIO_PMIC_ARB_OBS2_CHNL22_RDATA0_ADDR A:0xe620b18
y.create.l HWIO_PMIC_ARB_OBS2_CHNL23_RDATA0_ADDR A:0xe620b98
y.create.l HWIO_PMIC_ARB_OBS2_CHNL24_RDATA0_ADDR A:0xe620c18
y.create.l HWIO_PMIC_ARB_OBS2_CHNL25_RDATA0_ADDR A:0xe620c98
y.create.l HWIO_PMIC_ARB_OBS2_CHNL26_RDATA0_ADDR A:0xe620d18
y.create.l HWIO_PMIC_ARB_OBS2_CHNL27_RDATA0_ADDR A:0xe620d98
y.create.l HWIO_PMIC_ARB_OBS2_CHNL28_RDATA0_ADDR A:0xe620e18
y.create.l HWIO_PMIC_ARB_OBS2_CHNL29_RDATA0_ADDR A:0xe620e98
y.create.l HWIO_PMIC_ARB_OBS2_CHNL30_RDATA0_ADDR A:0xe620f18
y.create.l HWIO_PMIC_ARB_OBS2_CHNL31_RDATA0_ADDR A:0xe620f98
y.create.l HWIO_PMIC_ARB_OBS2_CHNL32_RDATA0_ADDR A:0xe621018
y.create.l HWIO_PMIC_ARB_OBS2_CHNL33_RDATA0_ADDR A:0xe621098
y.create.l HWIO_PMIC_ARB_OBS2_CHNL34_RDATA0_ADDR A:0xe621118
y.create.l HWIO_PMIC_ARB_OBS2_CHNL35_RDATA0_ADDR A:0xe621198
y.create.l HWIO_PMIC_ARB_OBS2_CHNL36_RDATA0_ADDR A:0xe621218
y.create.l HWIO_PMIC_ARB_OBS2_CHNL37_RDATA0_ADDR A:0xe621298
y.create.l HWIO_PMIC_ARB_OBS2_CHNL38_RDATA0_ADDR A:0xe621318
y.create.l HWIO_PMIC_ARB_OBS2_CHNL39_RDATA0_ADDR A:0xe621398
y.create.l HWIO_PMIC_ARB_OBS2_CHNL40_RDATA0_ADDR A:0xe621418
y.create.l HWIO_PMIC_ARB_OBS2_CHNL41_RDATA0_ADDR A:0xe621498
y.create.l HWIO_PMIC_ARB_OBS2_CHNL42_RDATA0_ADDR A:0xe621518
y.create.l HWIO_PMIC_ARB_OBS2_CHNL43_RDATA0_ADDR A:0xe621598
y.create.l HWIO_PMIC_ARB_OBS2_CHNL44_RDATA0_ADDR A:0xe621618
y.create.l HWIO_PMIC_ARB_OBS2_CHNL45_RDATA0_ADDR A:0xe621698
y.create.l HWIO_PMIC_ARB_OBS2_CHNL46_RDATA0_ADDR A:0xe621718
y.create.l HWIO_PMIC_ARB_OBS2_CHNL47_RDATA0_ADDR A:0xe621798
y.create.l HWIO_PMIC_ARB_OBS2_CHNL48_RDATA0_ADDR A:0xe621818
y.create.l HWIO_PMIC_ARB_OBS2_CHNL49_RDATA0_ADDR A:0xe621898
y.create.l HWIO_PMIC_ARB_OBS2_CHNL50_RDATA0_ADDR A:0xe621918
y.create.l HWIO_PMIC_ARB_OBS2_CHNL51_RDATA0_ADDR A:0xe621998
y.create.l HWIO_PMIC_ARB_OBS2_CHNL52_RDATA0_ADDR A:0xe621a18
y.create.l HWIO_PMIC_ARB_OBS2_CHNL53_RDATA0_ADDR A:0xe621a98
y.create.l HWIO_PMIC_ARB_OBS2_CHNL54_RDATA0_ADDR A:0xe621b18
y.create.l HWIO_PMIC_ARB_OBS2_CHNL55_RDATA0_ADDR A:0xe621b98
y.create.l HWIO_PMIC_ARB_OBS2_CHNL56_RDATA0_ADDR A:0xe621c18
y.create.l HWIO_PMIC_ARB_OBS2_CHNL57_RDATA0_ADDR A:0xe621c98
y.create.l HWIO_PMIC_ARB_OBS2_CHNL58_RDATA0_ADDR A:0xe621d18
y.create.l HWIO_PMIC_ARB_OBS2_CHNL59_RDATA0_ADDR A:0xe621d98
y.create.l HWIO_PMIC_ARB_OBS2_CHNL60_RDATA0_ADDR A:0xe621e18
y.create.l HWIO_PMIC_ARB_OBS2_CHNL61_RDATA0_ADDR A:0xe621e98
y.create.l HWIO_PMIC_ARB_OBS2_CHNL62_RDATA0_ADDR A:0xe621f18
y.create.l HWIO_PMIC_ARB_OBS2_CHNL63_RDATA0_ADDR A:0xe621f98
y.create.l HWIO_PMIC_ARB_OBS2_CHNL64_RDATA0_ADDR A:0xe622018
y.create.l HWIO_PMIC_ARB_OBS2_CHNL65_RDATA0_ADDR A:0xe622098
y.create.l HWIO_PMIC_ARB_OBS2_CHNL66_RDATA0_ADDR A:0xe622118
y.create.l HWIO_PMIC_ARB_OBS2_CHNL67_RDATA0_ADDR A:0xe622198
y.create.l HWIO_PMIC_ARB_OBS2_CHNL68_RDATA0_ADDR A:0xe622218
y.create.l HWIO_PMIC_ARB_OBS2_CHNL69_RDATA0_ADDR A:0xe622298
y.create.l HWIO_PMIC_ARB_OBS2_CHNL70_RDATA0_ADDR A:0xe622318
y.create.l HWIO_PMIC_ARB_OBS2_CHNL71_RDATA0_ADDR A:0xe622398
y.create.l HWIO_PMIC_ARB_OBS2_CHNL72_RDATA0_ADDR A:0xe622418
y.create.l HWIO_PMIC_ARB_OBS2_CHNL73_RDATA0_ADDR A:0xe622498
y.create.l HWIO_PMIC_ARB_OBS2_CHNL74_RDATA0_ADDR A:0xe622518
y.create.l HWIO_PMIC_ARB_OBS2_CHNL75_RDATA0_ADDR A:0xe622598
y.create.l HWIO_PMIC_ARB_OBS2_CHNL76_RDATA0_ADDR A:0xe622618
y.create.l HWIO_PMIC_ARB_OBS2_CHNL77_RDATA0_ADDR A:0xe622698
y.create.l HWIO_PMIC_ARB_OBS2_CHNL78_RDATA0_ADDR A:0xe622718
y.create.l HWIO_PMIC_ARB_OBS2_CHNL79_RDATA0_ADDR A:0xe622798
y.create.l HWIO_PMIC_ARB_OBS2_CHNL80_RDATA0_ADDR A:0xe622818
y.create.l HWIO_PMIC_ARB_OBS2_CHNL81_RDATA0_ADDR A:0xe622898
y.create.l HWIO_PMIC_ARB_OBS2_CHNL82_RDATA0_ADDR A:0xe622918
y.create.l HWIO_PMIC_ARB_OBS2_CHNL83_RDATA0_ADDR A:0xe622998
y.create.l HWIO_PMIC_ARB_OBS2_CHNL84_RDATA0_ADDR A:0xe622a18
y.create.l HWIO_PMIC_ARB_OBS2_CHNL85_RDATA0_ADDR A:0xe622a98
y.create.l HWIO_PMIC_ARB_OBS2_CHNL86_RDATA0_ADDR A:0xe622b18
y.create.l HWIO_PMIC_ARB_OBS2_CHNL87_RDATA0_ADDR A:0xe622b98
y.create.l HWIO_PMIC_ARB_OBS2_CHNL88_RDATA0_ADDR A:0xe622c18
y.create.l HWIO_PMIC_ARB_OBS2_CHNL89_RDATA0_ADDR A:0xe622c98
y.create.l HWIO_PMIC_ARB_OBS2_CHNL90_RDATA0_ADDR A:0xe622d18
y.create.l HWIO_PMIC_ARB_OBS2_CHNL91_RDATA0_ADDR A:0xe622d98
y.create.l HWIO_PMIC_ARB_OBS2_CHNL92_RDATA0_ADDR A:0xe622e18
y.create.l HWIO_PMIC_ARB_OBS2_CHNL93_RDATA0_ADDR A:0xe622e98
y.create.l HWIO_PMIC_ARB_OBS2_CHNL94_RDATA0_ADDR A:0xe622f18
y.create.l HWIO_PMIC_ARB_OBS2_CHNL95_RDATA0_ADDR A:0xe622f98
y.create.l HWIO_PMIC_ARB_OBS2_CHNL96_RDATA0_ADDR A:0xe623018
y.create.l HWIO_PMIC_ARB_OBS2_CHNL97_RDATA0_ADDR A:0xe623098
y.create.l HWIO_PMIC_ARB_OBS2_CHNL98_RDATA0_ADDR A:0xe623118
y.create.l HWIO_PMIC_ARB_OBS2_CHNL99_RDATA0_ADDR A:0xe623198
y.create.l HWIO_PMIC_ARB_OBS2_CHNL100_RDATA0_ADDR A:0xe623218
y.create.l HWIO_PMIC_ARB_OBS2_CHNL101_RDATA0_ADDR A:0xe623298
y.create.l HWIO_PMIC_ARB_OBS2_CHNL102_RDATA0_ADDR A:0xe623318
y.create.l HWIO_PMIC_ARB_OBS2_CHNL103_RDATA0_ADDR A:0xe623398
y.create.l HWIO_PMIC_ARB_OBS2_CHNL104_RDATA0_ADDR A:0xe623418
y.create.l HWIO_PMIC_ARB_OBS2_CHNL105_RDATA0_ADDR A:0xe623498
y.create.l HWIO_PMIC_ARB_OBS2_CHNL106_RDATA0_ADDR A:0xe623518
y.create.l HWIO_PMIC_ARB_OBS2_CHNL107_RDATA0_ADDR A:0xe623598
y.create.l HWIO_PMIC_ARB_OBS2_CHNL108_RDATA0_ADDR A:0xe623618
y.create.l HWIO_PMIC_ARB_OBS2_CHNL109_RDATA0_ADDR A:0xe623698
y.create.l HWIO_PMIC_ARB_OBS2_CHNL110_RDATA0_ADDR A:0xe623718
y.create.l HWIO_PMIC_ARB_OBS2_CHNL111_RDATA0_ADDR A:0xe623798
y.create.l HWIO_PMIC_ARB_OBS2_CHNL112_RDATA0_ADDR A:0xe623818
y.create.l HWIO_PMIC_ARB_OBS2_CHNL113_RDATA0_ADDR A:0xe623898
y.create.l HWIO_PMIC_ARB_OBS2_CHNL114_RDATA0_ADDR A:0xe623918
y.create.l HWIO_PMIC_ARB_OBS2_CHNL115_RDATA0_ADDR A:0xe623998
y.create.l HWIO_PMIC_ARB_OBS2_CHNL116_RDATA0_ADDR A:0xe623a18
y.create.l HWIO_PMIC_ARB_OBS2_CHNL117_RDATA0_ADDR A:0xe623a98
y.create.l HWIO_PMIC_ARB_OBS2_CHNL118_RDATA0_ADDR A:0xe623b18
y.create.l HWIO_PMIC_ARB_OBS2_CHNL119_RDATA0_ADDR A:0xe623b98
y.create.l HWIO_PMIC_ARB_OBS2_CHNL120_RDATA0_ADDR A:0xe623c18
y.create.l HWIO_PMIC_ARB_OBS2_CHNL121_RDATA0_ADDR A:0xe623c98
y.create.l HWIO_PMIC_ARB_OBS2_CHNL122_RDATA0_ADDR A:0xe623d18
y.create.l HWIO_PMIC_ARB_OBS2_CHNL123_RDATA0_ADDR A:0xe623d98
y.create.l HWIO_PMIC_ARB_OBS2_CHNL124_RDATA0_ADDR A:0xe623e18
y.create.l HWIO_PMIC_ARB_OBS2_CHNL125_RDATA0_ADDR A:0xe623e98
y.create.l HWIO_PMIC_ARB_OBS2_CHNL126_RDATA0_ADDR A:0xe623f18
y.create.l HWIO_PMIC_ARB_OBS2_CHNL127_RDATA0_ADDR A:0xe623f98
y.create.l HWIO_PMIC_ARB_OBS2_CHNL128_RDATA0_ADDR A:0xe624018
y.create.l HWIO_PMIC_ARB_OBS2_CHNL129_RDATA0_ADDR A:0xe624098
y.create.l HWIO_PMIC_ARB_OBS2_CHNL130_RDATA0_ADDR A:0xe624118
y.create.l HWIO_PMIC_ARB_OBS2_CHNL131_RDATA0_ADDR A:0xe624198
y.create.l HWIO_PMIC_ARB_OBS2_CHNL132_RDATA0_ADDR A:0xe624218
y.create.l HWIO_PMIC_ARB_OBS2_CHNL133_RDATA0_ADDR A:0xe624298
y.create.l HWIO_PMIC_ARB_OBS2_CHNL134_RDATA0_ADDR A:0xe624318
y.create.l HWIO_PMIC_ARB_OBS2_CHNL135_RDATA0_ADDR A:0xe624398
y.create.l HWIO_PMIC_ARB_OBS2_CHNL136_RDATA0_ADDR A:0xe624418
y.create.l HWIO_PMIC_ARB_OBS2_CHNL137_RDATA0_ADDR A:0xe624498
y.create.l HWIO_PMIC_ARB_OBS2_CHNL138_RDATA0_ADDR A:0xe624518
y.create.l HWIO_PMIC_ARB_OBS2_CHNL139_RDATA0_ADDR A:0xe624598
y.create.l HWIO_PMIC_ARB_OBS2_CHNL140_RDATA0_ADDR A:0xe624618
y.create.l HWIO_PMIC_ARB_OBS2_CHNL141_RDATA0_ADDR A:0xe624698
y.create.l HWIO_PMIC_ARB_OBS2_CHNL142_RDATA0_ADDR A:0xe624718
y.create.l HWIO_PMIC_ARB_OBS2_CHNL143_RDATA0_ADDR A:0xe624798
y.create.l HWIO_PMIC_ARB_OBS2_CHNL144_RDATA0_ADDR A:0xe624818
y.create.l HWIO_PMIC_ARB_OBS2_CHNL145_RDATA0_ADDR A:0xe624898
y.create.l HWIO_PMIC_ARB_OBS2_CHNL146_RDATA0_ADDR A:0xe624918
y.create.l HWIO_PMIC_ARB_OBS2_CHNL147_RDATA0_ADDR A:0xe624998
y.create.l HWIO_PMIC_ARB_OBS2_CHNL148_RDATA0_ADDR A:0xe624a18
y.create.l HWIO_PMIC_ARB_OBS2_CHNL149_RDATA0_ADDR A:0xe624a98
y.create.l HWIO_PMIC_ARB_OBS2_CHNL150_RDATA0_ADDR A:0xe624b18
y.create.l HWIO_PMIC_ARB_OBS2_CHNL151_RDATA0_ADDR A:0xe624b98
y.create.l HWIO_PMIC_ARB_OBS2_CHNL152_RDATA0_ADDR A:0xe624c18
y.create.l HWIO_PMIC_ARB_OBS2_CHNL153_RDATA0_ADDR A:0xe624c98
y.create.l HWIO_PMIC_ARB_OBS2_CHNL154_RDATA0_ADDR A:0xe624d18
y.create.l HWIO_PMIC_ARB_OBS2_CHNL155_RDATA0_ADDR A:0xe624d98
y.create.l HWIO_PMIC_ARB_OBS2_CHNL156_RDATA0_ADDR A:0xe624e18
y.create.l HWIO_PMIC_ARB_OBS2_CHNL157_RDATA0_ADDR A:0xe624e98
y.create.l HWIO_PMIC_ARB_OBS2_CHNL158_RDATA0_ADDR A:0xe624f18
y.create.l HWIO_PMIC_ARB_OBS2_CHNL159_RDATA0_ADDR A:0xe624f98
y.create.l HWIO_PMIC_ARB_OBS2_CHNL160_RDATA0_ADDR A:0xe625018
y.create.l HWIO_PMIC_ARB_OBS2_CHNL161_RDATA0_ADDR A:0xe625098
y.create.l HWIO_PMIC_ARB_OBS2_CHNL162_RDATA0_ADDR A:0xe625118
y.create.l HWIO_PMIC_ARB_OBS2_CHNL163_RDATA0_ADDR A:0xe625198
y.create.l HWIO_PMIC_ARB_OBS2_CHNL164_RDATA0_ADDR A:0xe625218
y.create.l HWIO_PMIC_ARB_OBS2_CHNL165_RDATA0_ADDR A:0xe625298
y.create.l HWIO_PMIC_ARB_OBS2_CHNL166_RDATA0_ADDR A:0xe625318
y.create.l HWIO_PMIC_ARB_OBS2_CHNL167_RDATA0_ADDR A:0xe625398
y.create.l HWIO_PMIC_ARB_OBS2_CHNL168_RDATA0_ADDR A:0xe625418
y.create.l HWIO_PMIC_ARB_OBS2_CHNL169_RDATA0_ADDR A:0xe625498
y.create.l HWIO_PMIC_ARB_OBS2_CHNL170_RDATA0_ADDR A:0xe625518
y.create.l HWIO_PMIC_ARB_OBS2_CHNL171_RDATA0_ADDR A:0xe625598
y.create.l HWIO_PMIC_ARB_OBS2_CHNL172_RDATA0_ADDR A:0xe625618
y.create.l HWIO_PMIC_ARB_OBS2_CHNL173_RDATA0_ADDR A:0xe625698
y.create.l HWIO_PMIC_ARB_OBS2_CHNL174_RDATA0_ADDR A:0xe625718
y.create.l HWIO_PMIC_ARB_OBS2_CHNL175_RDATA0_ADDR A:0xe625798
y.create.l HWIO_PMIC_ARB_OBS2_CHNL176_RDATA0_ADDR A:0xe625818
y.create.l HWIO_PMIC_ARB_OBS2_CHNL177_RDATA0_ADDR A:0xe625898
y.create.l HWIO_PMIC_ARB_OBS2_CHNL178_RDATA0_ADDR A:0xe625918
y.create.l HWIO_PMIC_ARB_OBS2_CHNL179_RDATA0_ADDR A:0xe625998
y.create.l HWIO_PMIC_ARB_OBS2_CHNL180_RDATA0_ADDR A:0xe625a18
y.create.l HWIO_PMIC_ARB_OBS2_CHNL181_RDATA0_ADDR A:0xe625a98
y.create.l HWIO_PMIC_ARB_OBS2_CHNL182_RDATA0_ADDR A:0xe625b18
y.create.l HWIO_PMIC_ARB_OBS2_CHNL183_RDATA0_ADDR A:0xe625b98
y.create.l HWIO_PMIC_ARB_OBS2_CHNL184_RDATA0_ADDR A:0xe625c18
y.create.l HWIO_PMIC_ARB_OBS2_CHNL185_RDATA0_ADDR A:0xe625c98
y.create.l HWIO_PMIC_ARB_OBS2_CHNL186_RDATA0_ADDR A:0xe625d18
y.create.l HWIO_PMIC_ARB_OBS2_CHNL187_RDATA0_ADDR A:0xe625d98
y.create.l HWIO_PMIC_ARB_OBS2_CHNL188_RDATA0_ADDR A:0xe625e18
y.create.l HWIO_PMIC_ARB_OBS2_CHNL189_RDATA0_ADDR A:0xe625e98
y.create.l HWIO_PMIC_ARB_OBS2_CHNL190_RDATA0_ADDR A:0xe625f18
y.create.l HWIO_PMIC_ARB_OBS2_CHNL191_RDATA0_ADDR A:0xe625f98
y.create.l HWIO_PMIC_ARB_OBS2_CHNL192_RDATA0_ADDR A:0xe626018
y.create.l HWIO_PMIC_ARB_OBS2_CHNL193_RDATA0_ADDR A:0xe626098
y.create.l HWIO_PMIC_ARB_OBS2_CHNL194_RDATA0_ADDR A:0xe626118
y.create.l HWIO_PMIC_ARB_OBS2_CHNL195_RDATA0_ADDR A:0xe626198
y.create.l HWIO_PMIC_ARB_OBS2_CHNL196_RDATA0_ADDR A:0xe626218
y.create.l HWIO_PMIC_ARB_OBS2_CHNL197_RDATA0_ADDR A:0xe626298
y.create.l HWIO_PMIC_ARB_OBS2_CHNL198_RDATA0_ADDR A:0xe626318
y.create.l HWIO_PMIC_ARB_OBS2_CHNL199_RDATA0_ADDR A:0xe626398
y.create.l HWIO_PMIC_ARB_OBS2_CHNL200_RDATA0_ADDR A:0xe626418
y.create.l HWIO_PMIC_ARB_OBS2_CHNL201_RDATA0_ADDR A:0xe626498
y.create.l HWIO_PMIC_ARB_OBS2_CHNL202_RDATA0_ADDR A:0xe626518
y.create.l HWIO_PMIC_ARB_OBS2_CHNL203_RDATA0_ADDR A:0xe626598
y.create.l HWIO_PMIC_ARB_OBS2_CHNL204_RDATA0_ADDR A:0xe626618
y.create.l HWIO_PMIC_ARB_OBS2_CHNL205_RDATA0_ADDR A:0xe626698
y.create.l HWIO_PMIC_ARB_OBS2_CHNL206_RDATA0_ADDR A:0xe626718
y.create.l HWIO_PMIC_ARB_OBS2_CHNL207_RDATA0_ADDR A:0xe626798
y.create.l HWIO_PMIC_ARB_OBS2_CHNL208_RDATA0_ADDR A:0xe626818
y.create.l HWIO_PMIC_ARB_OBS2_CHNL209_RDATA0_ADDR A:0xe626898
y.create.l HWIO_PMIC_ARB_OBS2_CHNL210_RDATA0_ADDR A:0xe626918
y.create.l HWIO_PMIC_ARB_OBS2_CHNL211_RDATA0_ADDR A:0xe626998
y.create.l HWIO_PMIC_ARB_OBS2_CHNL212_RDATA0_ADDR A:0xe626a18
y.create.l HWIO_PMIC_ARB_OBS2_CHNL213_RDATA0_ADDR A:0xe626a98
y.create.l HWIO_PMIC_ARB_OBS2_CHNL214_RDATA0_ADDR A:0xe626b18
y.create.l HWIO_PMIC_ARB_OBS2_CHNL215_RDATA0_ADDR A:0xe626b98
y.create.l HWIO_PMIC_ARB_OBS2_CHNL216_RDATA0_ADDR A:0xe626c18
y.create.l HWIO_PMIC_ARB_OBS2_CHNL217_RDATA0_ADDR A:0xe626c98
y.create.l HWIO_PMIC_ARB_OBS2_CHNL218_RDATA0_ADDR A:0xe626d18
y.create.l HWIO_PMIC_ARB_OBS2_CHNL219_RDATA0_ADDR A:0xe626d98
y.create.l HWIO_PMIC_ARB_OBS2_CHNL220_RDATA0_ADDR A:0xe626e18
y.create.l HWIO_PMIC_ARB_OBS2_CHNL221_RDATA0_ADDR A:0xe626e98
y.create.l HWIO_PMIC_ARB_OBS2_CHNL222_RDATA0_ADDR A:0xe626f18
y.create.l HWIO_PMIC_ARB_OBS2_CHNL223_RDATA0_ADDR A:0xe626f98
y.create.l HWIO_PMIC_ARB_OBS2_CHNL224_RDATA0_ADDR A:0xe627018
y.create.l HWIO_PMIC_ARB_OBS2_CHNL225_RDATA0_ADDR A:0xe627098
y.create.l HWIO_PMIC_ARB_OBS2_CHNL226_RDATA0_ADDR A:0xe627118
y.create.l HWIO_PMIC_ARB_OBS2_CHNL227_RDATA0_ADDR A:0xe627198
y.create.l HWIO_PMIC_ARB_OBS2_CHNL228_RDATA0_ADDR A:0xe627218
y.create.l HWIO_PMIC_ARB_OBS2_CHNL229_RDATA0_ADDR A:0xe627298
y.create.l HWIO_PMIC_ARB_OBS2_CHNL230_RDATA0_ADDR A:0xe627318
y.create.l HWIO_PMIC_ARB_OBS2_CHNL231_RDATA0_ADDR A:0xe627398
y.create.l HWIO_PMIC_ARB_OBS2_CHNL232_RDATA0_ADDR A:0xe627418
y.create.l HWIO_PMIC_ARB_OBS2_CHNL233_RDATA0_ADDR A:0xe627498
y.create.l HWIO_PMIC_ARB_OBS2_CHNL234_RDATA0_ADDR A:0xe627518
y.create.l HWIO_PMIC_ARB_OBS2_CHNL235_RDATA0_ADDR A:0xe627598
y.create.l HWIO_PMIC_ARB_OBS2_CHNL236_RDATA0_ADDR A:0xe627618
y.create.l HWIO_PMIC_ARB_OBS2_CHNL237_RDATA0_ADDR A:0xe627698
y.create.l HWIO_PMIC_ARB_OBS2_CHNL238_RDATA0_ADDR A:0xe627718
y.create.l HWIO_PMIC_ARB_OBS2_CHNL239_RDATA0_ADDR A:0xe627798
y.create.l HWIO_PMIC_ARB_OBS2_CHNL240_RDATA0_ADDR A:0xe627818
y.create.l HWIO_PMIC_ARB_OBS2_CHNL241_RDATA0_ADDR A:0xe627898
y.create.l HWIO_PMIC_ARB_OBS2_CHNL242_RDATA0_ADDR A:0xe627918
y.create.l HWIO_PMIC_ARB_OBS2_CHNL243_RDATA0_ADDR A:0xe627998
y.create.l HWIO_PMIC_ARB_OBS2_CHNL244_RDATA0_ADDR A:0xe627a18
y.create.l HWIO_PMIC_ARB_OBS2_CHNL245_RDATA0_ADDR A:0xe627a98
y.create.l HWIO_PMIC_ARB_OBS2_CHNL246_RDATA0_ADDR A:0xe627b18
y.create.l HWIO_PMIC_ARB_OBS2_CHNL247_RDATA0_ADDR A:0xe627b98
y.create.l HWIO_PMIC_ARB_OBS2_CHNL248_RDATA0_ADDR A:0xe627c18
y.create.l HWIO_PMIC_ARB_OBS2_CHNL249_RDATA0_ADDR A:0xe627c98
y.create.l HWIO_PMIC_ARB_OBS2_CHNL250_RDATA0_ADDR A:0xe627d18
y.create.l HWIO_PMIC_ARB_OBS2_CHNL251_RDATA0_ADDR A:0xe627d98
y.create.l HWIO_PMIC_ARB_OBS2_CHNL252_RDATA0_ADDR A:0xe627e18
y.create.l HWIO_PMIC_ARB_OBS2_CHNL253_RDATA0_ADDR A:0xe627e98
y.create.l HWIO_PMIC_ARB_OBS2_CHNL254_RDATA0_ADDR A:0xe627f18
y.create.l HWIO_PMIC_ARB_OBS2_CHNL255_RDATA0_ADDR A:0xe627f98
y.create.l HWIO_PMIC_ARB_OBS3_CHNL0_RDATA0_ADDR A:0xe630018
y.create.l HWIO_PMIC_ARB_OBS3_CHNL1_RDATA0_ADDR A:0xe630098
y.create.l HWIO_PMIC_ARB_OBS3_CHNL2_RDATA0_ADDR A:0xe630118
y.create.l HWIO_PMIC_ARB_OBS3_CHNL3_RDATA0_ADDR A:0xe630198
y.create.l HWIO_PMIC_ARB_OBS3_CHNL4_RDATA0_ADDR A:0xe630218
y.create.l HWIO_PMIC_ARB_OBS3_CHNL5_RDATA0_ADDR A:0xe630298
y.create.l HWIO_PMIC_ARB_OBS3_CHNL6_RDATA0_ADDR A:0xe630318
y.create.l HWIO_PMIC_ARB_OBS3_CHNL7_RDATA0_ADDR A:0xe630398
y.create.l HWIO_PMIC_ARB_OBS3_CHNL8_RDATA0_ADDR A:0xe630418
y.create.l HWIO_PMIC_ARB_OBS3_CHNL9_RDATA0_ADDR A:0xe630498
y.create.l HWIO_PMIC_ARB_OBS3_CHNL10_RDATA0_ADDR A:0xe630518
y.create.l HWIO_PMIC_ARB_OBS3_CHNL11_RDATA0_ADDR A:0xe630598
y.create.l HWIO_PMIC_ARB_OBS3_CHNL12_RDATA0_ADDR A:0xe630618
y.create.l HWIO_PMIC_ARB_OBS3_CHNL13_RDATA0_ADDR A:0xe630698
y.create.l HWIO_PMIC_ARB_OBS3_CHNL14_RDATA0_ADDR A:0xe630718
y.create.l HWIO_PMIC_ARB_OBS3_CHNL15_RDATA0_ADDR A:0xe630798
y.create.l HWIO_PMIC_ARB_OBS3_CHNL16_RDATA0_ADDR A:0xe630818
y.create.l HWIO_PMIC_ARB_OBS3_CHNL17_RDATA0_ADDR A:0xe630898
y.create.l HWIO_PMIC_ARB_OBS3_CHNL18_RDATA0_ADDR A:0xe630918
y.create.l HWIO_PMIC_ARB_OBS3_CHNL19_RDATA0_ADDR A:0xe630998
y.create.l HWIO_PMIC_ARB_OBS3_CHNL20_RDATA0_ADDR A:0xe630a18
y.create.l HWIO_PMIC_ARB_OBS3_CHNL21_RDATA0_ADDR A:0xe630a98
y.create.l HWIO_PMIC_ARB_OBS3_CHNL22_RDATA0_ADDR A:0xe630b18
y.create.l HWIO_PMIC_ARB_OBS3_CHNL23_RDATA0_ADDR A:0xe630b98
y.create.l HWIO_PMIC_ARB_OBS3_CHNL24_RDATA0_ADDR A:0xe630c18
y.create.l HWIO_PMIC_ARB_OBS3_CHNL25_RDATA0_ADDR A:0xe630c98
y.create.l HWIO_PMIC_ARB_OBS3_CHNL26_RDATA0_ADDR A:0xe630d18
y.create.l HWIO_PMIC_ARB_OBS3_CHNL27_RDATA0_ADDR A:0xe630d98
y.create.l HWIO_PMIC_ARB_OBS3_CHNL28_RDATA0_ADDR A:0xe630e18
y.create.l HWIO_PMIC_ARB_OBS3_CHNL29_RDATA0_ADDR A:0xe630e98
y.create.l HWIO_PMIC_ARB_OBS3_CHNL30_RDATA0_ADDR A:0xe630f18
y.create.l HWIO_PMIC_ARB_OBS3_CHNL31_RDATA0_ADDR A:0xe630f98
y.create.l HWIO_PMIC_ARB_OBS3_CHNL32_RDATA0_ADDR A:0xe631018
y.create.l HWIO_PMIC_ARB_OBS3_CHNL33_RDATA0_ADDR A:0xe631098
y.create.l HWIO_PMIC_ARB_OBS3_CHNL34_RDATA0_ADDR A:0xe631118
y.create.l HWIO_PMIC_ARB_OBS3_CHNL35_RDATA0_ADDR A:0xe631198
y.create.l HWIO_PMIC_ARB_OBS3_CHNL36_RDATA0_ADDR A:0xe631218
y.create.l HWIO_PMIC_ARB_OBS3_CHNL37_RDATA0_ADDR A:0xe631298
y.create.l HWIO_PMIC_ARB_OBS3_CHNL38_RDATA0_ADDR A:0xe631318
y.create.l HWIO_PMIC_ARB_OBS3_CHNL39_RDATA0_ADDR A:0xe631398
y.create.l HWIO_PMIC_ARB_OBS3_CHNL40_RDATA0_ADDR A:0xe631418
y.create.l HWIO_PMIC_ARB_OBS3_CHNL41_RDATA0_ADDR A:0xe631498
y.create.l HWIO_PMIC_ARB_OBS3_CHNL42_RDATA0_ADDR A:0xe631518
y.create.l HWIO_PMIC_ARB_OBS3_CHNL43_RDATA0_ADDR A:0xe631598
y.create.l HWIO_PMIC_ARB_OBS3_CHNL44_RDATA0_ADDR A:0xe631618
y.create.l HWIO_PMIC_ARB_OBS3_CHNL45_RDATA0_ADDR A:0xe631698
y.create.l HWIO_PMIC_ARB_OBS3_CHNL46_RDATA0_ADDR A:0xe631718
y.create.l HWIO_PMIC_ARB_OBS3_CHNL47_RDATA0_ADDR A:0xe631798
y.create.l HWIO_PMIC_ARB_OBS3_CHNL48_RDATA0_ADDR A:0xe631818
y.create.l HWIO_PMIC_ARB_OBS3_CHNL49_RDATA0_ADDR A:0xe631898
y.create.l HWIO_PMIC_ARB_OBS3_CHNL50_RDATA0_ADDR A:0xe631918
y.create.l HWIO_PMIC_ARB_OBS3_CHNL51_RDATA0_ADDR A:0xe631998
y.create.l HWIO_PMIC_ARB_OBS3_CHNL52_RDATA0_ADDR A:0xe631a18
y.create.l HWIO_PMIC_ARB_OBS3_CHNL53_RDATA0_ADDR A:0xe631a98
y.create.l HWIO_PMIC_ARB_OBS3_CHNL54_RDATA0_ADDR A:0xe631b18
y.create.l HWIO_PMIC_ARB_OBS3_CHNL55_RDATA0_ADDR A:0xe631b98
y.create.l HWIO_PMIC_ARB_OBS3_CHNL56_RDATA0_ADDR A:0xe631c18
y.create.l HWIO_PMIC_ARB_OBS3_CHNL57_RDATA0_ADDR A:0xe631c98
y.create.l HWIO_PMIC_ARB_OBS3_CHNL58_RDATA0_ADDR A:0xe631d18
y.create.l HWIO_PMIC_ARB_OBS3_CHNL59_RDATA0_ADDR A:0xe631d98
y.create.l HWIO_PMIC_ARB_OBS3_CHNL60_RDATA0_ADDR A:0xe631e18
y.create.l HWIO_PMIC_ARB_OBS3_CHNL61_RDATA0_ADDR A:0xe631e98
y.create.l HWIO_PMIC_ARB_OBS3_CHNL62_RDATA0_ADDR A:0xe631f18
y.create.l HWIO_PMIC_ARB_OBS3_CHNL63_RDATA0_ADDR A:0xe631f98
y.create.l HWIO_PMIC_ARB_OBS3_CHNL64_RDATA0_ADDR A:0xe632018
y.create.l HWIO_PMIC_ARB_OBS3_CHNL65_RDATA0_ADDR A:0xe632098
y.create.l HWIO_PMIC_ARB_OBS3_CHNL66_RDATA0_ADDR A:0xe632118
y.create.l HWIO_PMIC_ARB_OBS3_CHNL67_RDATA0_ADDR A:0xe632198
y.create.l HWIO_PMIC_ARB_OBS3_CHNL68_RDATA0_ADDR A:0xe632218
y.create.l HWIO_PMIC_ARB_OBS3_CHNL69_RDATA0_ADDR A:0xe632298
y.create.l HWIO_PMIC_ARB_OBS3_CHNL70_RDATA0_ADDR A:0xe632318
y.create.l HWIO_PMIC_ARB_OBS3_CHNL71_RDATA0_ADDR A:0xe632398
y.create.l HWIO_PMIC_ARB_OBS3_CHNL72_RDATA0_ADDR A:0xe632418
y.create.l HWIO_PMIC_ARB_OBS3_CHNL73_RDATA0_ADDR A:0xe632498
y.create.l HWIO_PMIC_ARB_OBS3_CHNL74_RDATA0_ADDR A:0xe632518
y.create.l HWIO_PMIC_ARB_OBS3_CHNL75_RDATA0_ADDR A:0xe632598
y.create.l HWIO_PMIC_ARB_OBS3_CHNL76_RDATA0_ADDR A:0xe632618
y.create.l HWIO_PMIC_ARB_OBS3_CHNL77_RDATA0_ADDR A:0xe632698
y.create.l HWIO_PMIC_ARB_OBS3_CHNL78_RDATA0_ADDR A:0xe632718
y.create.l HWIO_PMIC_ARB_OBS3_CHNL79_RDATA0_ADDR A:0xe632798
y.create.l HWIO_PMIC_ARB_OBS3_CHNL80_RDATA0_ADDR A:0xe632818
y.create.l HWIO_PMIC_ARB_OBS3_CHNL81_RDATA0_ADDR A:0xe632898
y.create.l HWIO_PMIC_ARB_OBS3_CHNL82_RDATA0_ADDR A:0xe632918
y.create.l HWIO_PMIC_ARB_OBS3_CHNL83_RDATA0_ADDR A:0xe632998
y.create.l HWIO_PMIC_ARB_OBS3_CHNL84_RDATA0_ADDR A:0xe632a18
y.create.l HWIO_PMIC_ARB_OBS3_CHNL85_RDATA0_ADDR A:0xe632a98
y.create.l HWIO_PMIC_ARB_OBS3_CHNL86_RDATA0_ADDR A:0xe632b18
y.create.l HWIO_PMIC_ARB_OBS3_CHNL87_RDATA0_ADDR A:0xe632b98
y.create.l HWIO_PMIC_ARB_OBS3_CHNL88_RDATA0_ADDR A:0xe632c18
y.create.l HWIO_PMIC_ARB_OBS3_CHNL89_RDATA0_ADDR A:0xe632c98
y.create.l HWIO_PMIC_ARB_OBS3_CHNL90_RDATA0_ADDR A:0xe632d18
y.create.l HWIO_PMIC_ARB_OBS3_CHNL91_RDATA0_ADDR A:0xe632d98
y.create.l HWIO_PMIC_ARB_OBS3_CHNL92_RDATA0_ADDR A:0xe632e18
y.create.l HWIO_PMIC_ARB_OBS3_CHNL93_RDATA0_ADDR A:0xe632e98
y.create.l HWIO_PMIC_ARB_OBS3_CHNL94_RDATA0_ADDR A:0xe632f18
y.create.l HWIO_PMIC_ARB_OBS3_CHNL95_RDATA0_ADDR A:0xe632f98
y.create.l HWIO_PMIC_ARB_OBS3_CHNL96_RDATA0_ADDR A:0xe633018
y.create.l HWIO_PMIC_ARB_OBS3_CHNL97_RDATA0_ADDR A:0xe633098
y.create.l HWIO_PMIC_ARB_OBS3_CHNL98_RDATA0_ADDR A:0xe633118
y.create.l HWIO_PMIC_ARB_OBS3_CHNL99_RDATA0_ADDR A:0xe633198
y.create.l HWIO_PMIC_ARB_OBS3_CHNL100_RDATA0_ADDR A:0xe633218
y.create.l HWIO_PMIC_ARB_OBS3_CHNL101_RDATA0_ADDR A:0xe633298
y.create.l HWIO_PMIC_ARB_OBS3_CHNL102_RDATA0_ADDR A:0xe633318
y.create.l HWIO_PMIC_ARB_OBS3_CHNL103_RDATA0_ADDR A:0xe633398
y.create.l HWIO_PMIC_ARB_OBS3_CHNL104_RDATA0_ADDR A:0xe633418
y.create.l HWIO_PMIC_ARB_OBS3_CHNL105_RDATA0_ADDR A:0xe633498
y.create.l HWIO_PMIC_ARB_OBS3_CHNL106_RDATA0_ADDR A:0xe633518
y.create.l HWIO_PMIC_ARB_OBS3_CHNL107_RDATA0_ADDR A:0xe633598
y.create.l HWIO_PMIC_ARB_OBS3_CHNL108_RDATA0_ADDR A:0xe633618
y.create.l HWIO_PMIC_ARB_OBS3_CHNL109_RDATA0_ADDR A:0xe633698
y.create.l HWIO_PMIC_ARB_OBS3_CHNL110_RDATA0_ADDR A:0xe633718
y.create.l HWIO_PMIC_ARB_OBS3_CHNL111_RDATA0_ADDR A:0xe633798
y.create.l HWIO_PMIC_ARB_OBS3_CHNL112_RDATA0_ADDR A:0xe633818
y.create.l HWIO_PMIC_ARB_OBS3_CHNL113_RDATA0_ADDR A:0xe633898
y.create.l HWIO_PMIC_ARB_OBS3_CHNL114_RDATA0_ADDR A:0xe633918
y.create.l HWIO_PMIC_ARB_OBS3_CHNL115_RDATA0_ADDR A:0xe633998
y.create.l HWIO_PMIC_ARB_OBS3_CHNL116_RDATA0_ADDR A:0xe633a18
y.create.l HWIO_PMIC_ARB_OBS3_CHNL117_RDATA0_ADDR A:0xe633a98
y.create.l HWIO_PMIC_ARB_OBS3_CHNL118_RDATA0_ADDR A:0xe633b18
y.create.l HWIO_PMIC_ARB_OBS3_CHNL119_RDATA0_ADDR A:0xe633b98
y.create.l HWIO_PMIC_ARB_OBS3_CHNL120_RDATA0_ADDR A:0xe633c18
y.create.l HWIO_PMIC_ARB_OBS3_CHNL121_RDATA0_ADDR A:0xe633c98
y.create.l HWIO_PMIC_ARB_OBS3_CHNL122_RDATA0_ADDR A:0xe633d18
y.create.l HWIO_PMIC_ARB_OBS3_CHNL123_RDATA0_ADDR A:0xe633d98
y.create.l HWIO_PMIC_ARB_OBS3_CHNL124_RDATA0_ADDR A:0xe633e18
y.create.l HWIO_PMIC_ARB_OBS3_CHNL125_RDATA0_ADDR A:0xe633e98
y.create.l HWIO_PMIC_ARB_OBS3_CHNL126_RDATA0_ADDR A:0xe633f18
y.create.l HWIO_PMIC_ARB_OBS3_CHNL127_RDATA0_ADDR A:0xe633f98
y.create.l HWIO_PMIC_ARB_OBS3_CHNL128_RDATA0_ADDR A:0xe634018
y.create.l HWIO_PMIC_ARB_OBS3_CHNL129_RDATA0_ADDR A:0xe634098
y.create.l HWIO_PMIC_ARB_OBS3_CHNL130_RDATA0_ADDR A:0xe634118
y.create.l HWIO_PMIC_ARB_OBS3_CHNL131_RDATA0_ADDR A:0xe634198
y.create.l HWIO_PMIC_ARB_OBS3_CHNL132_RDATA0_ADDR A:0xe634218
y.create.l HWIO_PMIC_ARB_OBS3_CHNL133_RDATA0_ADDR A:0xe634298
y.create.l HWIO_PMIC_ARB_OBS3_CHNL134_RDATA0_ADDR A:0xe634318
y.create.l HWIO_PMIC_ARB_OBS3_CHNL135_RDATA0_ADDR A:0xe634398
y.create.l HWIO_PMIC_ARB_OBS3_CHNL136_RDATA0_ADDR A:0xe634418
y.create.l HWIO_PMIC_ARB_OBS3_CHNL137_RDATA0_ADDR A:0xe634498
y.create.l HWIO_PMIC_ARB_OBS3_CHNL138_RDATA0_ADDR A:0xe634518
y.create.l HWIO_PMIC_ARB_OBS3_CHNL139_RDATA0_ADDR A:0xe634598
y.create.l HWIO_PMIC_ARB_OBS3_CHNL140_RDATA0_ADDR A:0xe634618
y.create.l HWIO_PMIC_ARB_OBS3_CHNL141_RDATA0_ADDR A:0xe634698
y.create.l HWIO_PMIC_ARB_OBS3_CHNL142_RDATA0_ADDR A:0xe634718
y.create.l HWIO_PMIC_ARB_OBS3_CHNL143_RDATA0_ADDR A:0xe634798
y.create.l HWIO_PMIC_ARB_OBS3_CHNL144_RDATA0_ADDR A:0xe634818
y.create.l HWIO_PMIC_ARB_OBS3_CHNL145_RDATA0_ADDR A:0xe634898
y.create.l HWIO_PMIC_ARB_OBS3_CHNL146_RDATA0_ADDR A:0xe634918
y.create.l HWIO_PMIC_ARB_OBS3_CHNL147_RDATA0_ADDR A:0xe634998
y.create.l HWIO_PMIC_ARB_OBS3_CHNL148_RDATA0_ADDR A:0xe634a18
y.create.l HWIO_PMIC_ARB_OBS3_CHNL149_RDATA0_ADDR A:0xe634a98
y.create.l HWIO_PMIC_ARB_OBS3_CHNL150_RDATA0_ADDR A:0xe634b18
y.create.l HWIO_PMIC_ARB_OBS3_CHNL151_RDATA0_ADDR A:0xe634b98
y.create.l HWIO_PMIC_ARB_OBS3_CHNL152_RDATA0_ADDR A:0xe634c18
y.create.l HWIO_PMIC_ARB_OBS3_CHNL153_RDATA0_ADDR A:0xe634c98
y.create.l HWIO_PMIC_ARB_OBS3_CHNL154_RDATA0_ADDR A:0xe634d18
y.create.l HWIO_PMIC_ARB_OBS3_CHNL155_RDATA0_ADDR A:0xe634d98
y.create.l HWIO_PMIC_ARB_OBS3_CHNL156_RDATA0_ADDR A:0xe634e18
y.create.l HWIO_PMIC_ARB_OBS3_CHNL157_RDATA0_ADDR A:0xe634e98
y.create.l HWIO_PMIC_ARB_OBS3_CHNL158_RDATA0_ADDR A:0xe634f18
y.create.l HWIO_PMIC_ARB_OBS3_CHNL159_RDATA0_ADDR A:0xe634f98
y.create.l HWIO_PMIC_ARB_OBS3_CHNL160_RDATA0_ADDR A:0xe635018
y.create.l HWIO_PMIC_ARB_OBS3_CHNL161_RDATA0_ADDR A:0xe635098
y.create.l HWIO_PMIC_ARB_OBS3_CHNL162_RDATA0_ADDR A:0xe635118
y.create.l HWIO_PMIC_ARB_OBS3_CHNL163_RDATA0_ADDR A:0xe635198
y.create.l HWIO_PMIC_ARB_OBS3_CHNL164_RDATA0_ADDR A:0xe635218
y.create.l HWIO_PMIC_ARB_OBS3_CHNL165_RDATA0_ADDR A:0xe635298
y.create.l HWIO_PMIC_ARB_OBS3_CHNL166_RDATA0_ADDR A:0xe635318
y.create.l HWIO_PMIC_ARB_OBS3_CHNL167_RDATA0_ADDR A:0xe635398
y.create.l HWIO_PMIC_ARB_OBS3_CHNL168_RDATA0_ADDR A:0xe635418
y.create.l HWIO_PMIC_ARB_OBS3_CHNL169_RDATA0_ADDR A:0xe635498
y.create.l HWIO_PMIC_ARB_OBS3_CHNL170_RDATA0_ADDR A:0xe635518
y.create.l HWIO_PMIC_ARB_OBS3_CHNL171_RDATA0_ADDR A:0xe635598
y.create.l HWIO_PMIC_ARB_OBS3_CHNL172_RDATA0_ADDR A:0xe635618
y.create.l HWIO_PMIC_ARB_OBS3_CHNL173_RDATA0_ADDR A:0xe635698
y.create.l HWIO_PMIC_ARB_OBS3_CHNL174_RDATA0_ADDR A:0xe635718
y.create.l HWIO_PMIC_ARB_OBS3_CHNL175_RDATA0_ADDR A:0xe635798
y.create.l HWIO_PMIC_ARB_OBS3_CHNL176_RDATA0_ADDR A:0xe635818
y.create.l HWIO_PMIC_ARB_OBS3_CHNL177_RDATA0_ADDR A:0xe635898
y.create.l HWIO_PMIC_ARB_OBS3_CHNL178_RDATA0_ADDR A:0xe635918
y.create.l HWIO_PMIC_ARB_OBS3_CHNL179_RDATA0_ADDR A:0xe635998
y.create.l HWIO_PMIC_ARB_OBS3_CHNL180_RDATA0_ADDR A:0xe635a18
y.create.l HWIO_PMIC_ARB_OBS3_CHNL181_RDATA0_ADDR A:0xe635a98
y.create.l HWIO_PMIC_ARB_OBS3_CHNL182_RDATA0_ADDR A:0xe635b18
y.create.l HWIO_PMIC_ARB_OBS3_CHNL183_RDATA0_ADDR A:0xe635b98
y.create.l HWIO_PMIC_ARB_OBS3_CHNL184_RDATA0_ADDR A:0xe635c18
y.create.l HWIO_PMIC_ARB_OBS3_CHNL185_RDATA0_ADDR A:0xe635c98
y.create.l HWIO_PMIC_ARB_OBS3_CHNL186_RDATA0_ADDR A:0xe635d18
y.create.l HWIO_PMIC_ARB_OBS3_CHNL187_RDATA0_ADDR A:0xe635d98
y.create.l HWIO_PMIC_ARB_OBS3_CHNL188_RDATA0_ADDR A:0xe635e18
y.create.l HWIO_PMIC_ARB_OBS3_CHNL189_RDATA0_ADDR A:0xe635e98
y.create.l HWIO_PMIC_ARB_OBS3_CHNL190_RDATA0_ADDR A:0xe635f18
y.create.l HWIO_PMIC_ARB_OBS3_CHNL191_RDATA0_ADDR A:0xe635f98
y.create.l HWIO_PMIC_ARB_OBS3_CHNL192_RDATA0_ADDR A:0xe636018
y.create.l HWIO_PMIC_ARB_OBS3_CHNL193_RDATA0_ADDR A:0xe636098
y.create.l HWIO_PMIC_ARB_OBS3_CHNL194_RDATA0_ADDR A:0xe636118
y.create.l HWIO_PMIC_ARB_OBS3_CHNL195_RDATA0_ADDR A:0xe636198
y.create.l HWIO_PMIC_ARB_OBS3_CHNL196_RDATA0_ADDR A:0xe636218
y.create.l HWIO_PMIC_ARB_OBS3_CHNL197_RDATA0_ADDR A:0xe636298
y.create.l HWIO_PMIC_ARB_OBS3_CHNL198_RDATA0_ADDR A:0xe636318
y.create.l HWIO_PMIC_ARB_OBS3_CHNL199_RDATA0_ADDR A:0xe636398
y.create.l HWIO_PMIC_ARB_OBS3_CHNL200_RDATA0_ADDR A:0xe636418
y.create.l HWIO_PMIC_ARB_OBS3_CHNL201_RDATA0_ADDR A:0xe636498
y.create.l HWIO_PMIC_ARB_OBS3_CHNL202_RDATA0_ADDR A:0xe636518
y.create.l HWIO_PMIC_ARB_OBS3_CHNL203_RDATA0_ADDR A:0xe636598
y.create.l HWIO_PMIC_ARB_OBS3_CHNL204_RDATA0_ADDR A:0xe636618
y.create.l HWIO_PMIC_ARB_OBS3_CHNL205_RDATA0_ADDR A:0xe636698
y.create.l HWIO_PMIC_ARB_OBS3_CHNL206_RDATA0_ADDR A:0xe636718
y.create.l HWIO_PMIC_ARB_OBS3_CHNL207_RDATA0_ADDR A:0xe636798
y.create.l HWIO_PMIC_ARB_OBS3_CHNL208_RDATA0_ADDR A:0xe636818
y.create.l HWIO_PMIC_ARB_OBS3_CHNL209_RDATA0_ADDR A:0xe636898
y.create.l HWIO_PMIC_ARB_OBS3_CHNL210_RDATA0_ADDR A:0xe636918
y.create.l HWIO_PMIC_ARB_OBS3_CHNL211_RDATA0_ADDR A:0xe636998
y.create.l HWIO_PMIC_ARB_OBS3_CHNL212_RDATA0_ADDR A:0xe636a18
y.create.l HWIO_PMIC_ARB_OBS3_CHNL213_RDATA0_ADDR A:0xe636a98
y.create.l HWIO_PMIC_ARB_OBS3_CHNL214_RDATA0_ADDR A:0xe636b18
y.create.l HWIO_PMIC_ARB_OBS3_CHNL215_RDATA0_ADDR A:0xe636b98
y.create.l HWIO_PMIC_ARB_OBS3_CHNL216_RDATA0_ADDR A:0xe636c18
y.create.l HWIO_PMIC_ARB_OBS3_CHNL217_RDATA0_ADDR A:0xe636c98
y.create.l HWIO_PMIC_ARB_OBS3_CHNL218_RDATA0_ADDR A:0xe636d18
y.create.l HWIO_PMIC_ARB_OBS3_CHNL219_RDATA0_ADDR A:0xe636d98
y.create.l HWIO_PMIC_ARB_OBS3_CHNL220_RDATA0_ADDR A:0xe636e18
y.create.l HWIO_PMIC_ARB_OBS3_CHNL221_RDATA0_ADDR A:0xe636e98
y.create.l HWIO_PMIC_ARB_OBS3_CHNL222_RDATA0_ADDR A:0xe636f18
y.create.l HWIO_PMIC_ARB_OBS3_CHNL223_RDATA0_ADDR A:0xe636f98
y.create.l HWIO_PMIC_ARB_OBS3_CHNL224_RDATA0_ADDR A:0xe637018
y.create.l HWIO_PMIC_ARB_OBS3_CHNL225_RDATA0_ADDR A:0xe637098
y.create.l HWIO_PMIC_ARB_OBS3_CHNL226_RDATA0_ADDR A:0xe637118
y.create.l HWIO_PMIC_ARB_OBS3_CHNL227_RDATA0_ADDR A:0xe637198
y.create.l HWIO_PMIC_ARB_OBS3_CHNL228_RDATA0_ADDR A:0xe637218
y.create.l HWIO_PMIC_ARB_OBS3_CHNL229_RDATA0_ADDR A:0xe637298
y.create.l HWIO_PMIC_ARB_OBS3_CHNL230_RDATA0_ADDR A:0xe637318
y.create.l HWIO_PMIC_ARB_OBS3_CHNL231_RDATA0_ADDR A:0xe637398
y.create.l HWIO_PMIC_ARB_OBS3_CHNL232_RDATA0_ADDR A:0xe637418
y.create.l HWIO_PMIC_ARB_OBS3_CHNL233_RDATA0_ADDR A:0xe637498
y.create.l HWIO_PMIC_ARB_OBS3_CHNL234_RDATA0_ADDR A:0xe637518
y.create.l HWIO_PMIC_ARB_OBS3_CHNL235_RDATA0_ADDR A:0xe637598
y.create.l HWIO_PMIC_ARB_OBS3_CHNL236_RDATA0_ADDR A:0xe637618
y.create.l HWIO_PMIC_ARB_OBS3_CHNL237_RDATA0_ADDR A:0xe637698
y.create.l HWIO_PMIC_ARB_OBS3_CHNL238_RDATA0_ADDR A:0xe637718
y.create.l HWIO_PMIC_ARB_OBS3_CHNL239_RDATA0_ADDR A:0xe637798
y.create.l HWIO_PMIC_ARB_OBS3_CHNL240_RDATA0_ADDR A:0xe637818
y.create.l HWIO_PMIC_ARB_OBS3_CHNL241_RDATA0_ADDR A:0xe637898
y.create.l HWIO_PMIC_ARB_OBS3_CHNL242_RDATA0_ADDR A:0xe637918
y.create.l HWIO_PMIC_ARB_OBS3_CHNL243_RDATA0_ADDR A:0xe637998
y.create.l HWIO_PMIC_ARB_OBS3_CHNL244_RDATA0_ADDR A:0xe637a18
y.create.l HWIO_PMIC_ARB_OBS3_CHNL245_RDATA0_ADDR A:0xe637a98
y.create.l HWIO_PMIC_ARB_OBS3_CHNL246_RDATA0_ADDR A:0xe637b18
y.create.l HWIO_PMIC_ARB_OBS3_CHNL247_RDATA0_ADDR A:0xe637b98
y.create.l HWIO_PMIC_ARB_OBS3_CHNL248_RDATA0_ADDR A:0xe637c18
y.create.l HWIO_PMIC_ARB_OBS3_CHNL249_RDATA0_ADDR A:0xe637c98
y.create.l HWIO_PMIC_ARB_OBS3_CHNL250_RDATA0_ADDR A:0xe637d18
y.create.l HWIO_PMIC_ARB_OBS3_CHNL251_RDATA0_ADDR A:0xe637d98
y.create.l HWIO_PMIC_ARB_OBS3_CHNL252_RDATA0_ADDR A:0xe637e18
y.create.l HWIO_PMIC_ARB_OBS3_CHNL253_RDATA0_ADDR A:0xe637e98
y.create.l HWIO_PMIC_ARB_OBS3_CHNL254_RDATA0_ADDR A:0xe637f18
y.create.l HWIO_PMIC_ARB_OBS3_CHNL255_RDATA0_ADDR A:0xe637f98
y.create.l HWIO_PMIC_ARB_OBS4_CHNL0_RDATA0_ADDR A:0xe640018
y.create.l HWIO_PMIC_ARB_OBS4_CHNL1_RDATA0_ADDR A:0xe640098
y.create.l HWIO_PMIC_ARB_OBS4_CHNL2_RDATA0_ADDR A:0xe640118
y.create.l HWIO_PMIC_ARB_OBS4_CHNL3_RDATA0_ADDR A:0xe640198
y.create.l HWIO_PMIC_ARB_OBS4_CHNL4_RDATA0_ADDR A:0xe640218
y.create.l HWIO_PMIC_ARB_OBS4_CHNL5_RDATA0_ADDR A:0xe640298
y.create.l HWIO_PMIC_ARB_OBS4_CHNL6_RDATA0_ADDR A:0xe640318
y.create.l HWIO_PMIC_ARB_OBS4_CHNL7_RDATA0_ADDR A:0xe640398
y.create.l HWIO_PMIC_ARB_OBS4_CHNL8_RDATA0_ADDR A:0xe640418
y.create.l HWIO_PMIC_ARB_OBS4_CHNL9_RDATA0_ADDR A:0xe640498
y.create.l HWIO_PMIC_ARB_OBS4_CHNL10_RDATA0_ADDR A:0xe640518
y.create.l HWIO_PMIC_ARB_OBS4_CHNL11_RDATA0_ADDR A:0xe640598
y.create.l HWIO_PMIC_ARB_OBS4_CHNL12_RDATA0_ADDR A:0xe640618
y.create.l HWIO_PMIC_ARB_OBS4_CHNL13_RDATA0_ADDR A:0xe640698
y.create.l HWIO_PMIC_ARB_OBS4_CHNL14_RDATA0_ADDR A:0xe640718
y.create.l HWIO_PMIC_ARB_OBS4_CHNL15_RDATA0_ADDR A:0xe640798
y.create.l HWIO_PMIC_ARB_OBS4_CHNL16_RDATA0_ADDR A:0xe640818
y.create.l HWIO_PMIC_ARB_OBS4_CHNL17_RDATA0_ADDR A:0xe640898
y.create.l HWIO_PMIC_ARB_OBS4_CHNL18_RDATA0_ADDR A:0xe640918
y.create.l HWIO_PMIC_ARB_OBS4_CHNL19_RDATA0_ADDR A:0xe640998
y.create.l HWIO_PMIC_ARB_OBS4_CHNL20_RDATA0_ADDR A:0xe640a18
y.create.l HWIO_PMIC_ARB_OBS4_CHNL21_RDATA0_ADDR A:0xe640a98
y.create.l HWIO_PMIC_ARB_OBS4_CHNL22_RDATA0_ADDR A:0xe640b18
y.create.l HWIO_PMIC_ARB_OBS4_CHNL23_RDATA0_ADDR A:0xe640b98
y.create.l HWIO_PMIC_ARB_OBS4_CHNL24_RDATA0_ADDR A:0xe640c18
y.create.l HWIO_PMIC_ARB_OBS4_CHNL25_RDATA0_ADDR A:0xe640c98
y.create.l HWIO_PMIC_ARB_OBS4_CHNL26_RDATA0_ADDR A:0xe640d18
y.create.l HWIO_PMIC_ARB_OBS4_CHNL27_RDATA0_ADDR A:0xe640d98
y.create.l HWIO_PMIC_ARB_OBS4_CHNL28_RDATA0_ADDR A:0xe640e18
y.create.l HWIO_PMIC_ARB_OBS4_CHNL29_RDATA0_ADDR A:0xe640e98
y.create.l HWIO_PMIC_ARB_OBS4_CHNL30_RDATA0_ADDR A:0xe640f18
y.create.l HWIO_PMIC_ARB_OBS4_CHNL31_RDATA0_ADDR A:0xe640f98
y.create.l HWIO_PMIC_ARB_OBS4_CHNL32_RDATA0_ADDR A:0xe641018
y.create.l HWIO_PMIC_ARB_OBS4_CHNL33_RDATA0_ADDR A:0xe641098
y.create.l HWIO_PMIC_ARB_OBS4_CHNL34_RDATA0_ADDR A:0xe641118
y.create.l HWIO_PMIC_ARB_OBS4_CHNL35_RDATA0_ADDR A:0xe641198
y.create.l HWIO_PMIC_ARB_OBS4_CHNL36_RDATA0_ADDR A:0xe641218
y.create.l HWIO_PMIC_ARB_OBS4_CHNL37_RDATA0_ADDR A:0xe641298
y.create.l HWIO_PMIC_ARB_OBS4_CHNL38_RDATA0_ADDR A:0xe641318
y.create.l HWIO_PMIC_ARB_OBS4_CHNL39_RDATA0_ADDR A:0xe641398
y.create.l HWIO_PMIC_ARB_OBS4_CHNL40_RDATA0_ADDR A:0xe641418
y.create.l HWIO_PMIC_ARB_OBS4_CHNL41_RDATA0_ADDR A:0xe641498
y.create.l HWIO_PMIC_ARB_OBS4_CHNL42_RDATA0_ADDR A:0xe641518
y.create.l HWIO_PMIC_ARB_OBS4_CHNL43_RDATA0_ADDR A:0xe641598
y.create.l HWIO_PMIC_ARB_OBS4_CHNL44_RDATA0_ADDR A:0xe641618
y.create.l HWIO_PMIC_ARB_OBS4_CHNL45_RDATA0_ADDR A:0xe641698
y.create.l HWIO_PMIC_ARB_OBS4_CHNL46_RDATA0_ADDR A:0xe641718
y.create.l HWIO_PMIC_ARB_OBS4_CHNL47_RDATA0_ADDR A:0xe641798
y.create.l HWIO_PMIC_ARB_OBS4_CHNL48_RDATA0_ADDR A:0xe641818
y.create.l HWIO_PMIC_ARB_OBS4_CHNL49_RDATA0_ADDR A:0xe641898
y.create.l HWIO_PMIC_ARB_OBS4_CHNL50_RDATA0_ADDR A:0xe641918
y.create.l HWIO_PMIC_ARB_OBS4_CHNL51_RDATA0_ADDR A:0xe641998
y.create.l HWIO_PMIC_ARB_OBS4_CHNL52_RDATA0_ADDR A:0xe641a18
y.create.l HWIO_PMIC_ARB_OBS4_CHNL53_RDATA0_ADDR A:0xe641a98
y.create.l HWIO_PMIC_ARB_OBS4_CHNL54_RDATA0_ADDR A:0xe641b18
y.create.l HWIO_PMIC_ARB_OBS4_CHNL55_RDATA0_ADDR A:0xe641b98
y.create.l HWIO_PMIC_ARB_OBS4_CHNL56_RDATA0_ADDR A:0xe641c18
y.create.l HWIO_PMIC_ARB_OBS4_CHNL57_RDATA0_ADDR A:0xe641c98
y.create.l HWIO_PMIC_ARB_OBS4_CHNL58_RDATA0_ADDR A:0xe641d18
y.create.l HWIO_PMIC_ARB_OBS4_CHNL59_RDATA0_ADDR A:0xe641d98
y.create.l HWIO_PMIC_ARB_OBS4_CHNL60_RDATA0_ADDR A:0xe641e18
y.create.l HWIO_PMIC_ARB_OBS4_CHNL61_RDATA0_ADDR A:0xe641e98
y.create.l HWIO_PMIC_ARB_OBS4_CHNL62_RDATA0_ADDR A:0xe641f18
y.create.l HWIO_PMIC_ARB_OBS4_CHNL63_RDATA0_ADDR A:0xe641f98
y.create.l HWIO_PMIC_ARB_OBS4_CHNL64_RDATA0_ADDR A:0xe642018
y.create.l HWIO_PMIC_ARB_OBS4_CHNL65_RDATA0_ADDR A:0xe642098
y.create.l HWIO_PMIC_ARB_OBS4_CHNL66_RDATA0_ADDR A:0xe642118
y.create.l HWIO_PMIC_ARB_OBS4_CHNL67_RDATA0_ADDR A:0xe642198
y.create.l HWIO_PMIC_ARB_OBS4_CHNL68_RDATA0_ADDR A:0xe642218
y.create.l HWIO_PMIC_ARB_OBS4_CHNL69_RDATA0_ADDR A:0xe642298
y.create.l HWIO_PMIC_ARB_OBS4_CHNL70_RDATA0_ADDR A:0xe642318
y.create.l HWIO_PMIC_ARB_OBS4_CHNL71_RDATA0_ADDR A:0xe642398
y.create.l HWIO_PMIC_ARB_OBS4_CHNL72_RDATA0_ADDR A:0xe642418
y.create.l HWIO_PMIC_ARB_OBS4_CHNL73_RDATA0_ADDR A:0xe642498
y.create.l HWIO_PMIC_ARB_OBS4_CHNL74_RDATA0_ADDR A:0xe642518
y.create.l HWIO_PMIC_ARB_OBS4_CHNL75_RDATA0_ADDR A:0xe642598
y.create.l HWIO_PMIC_ARB_OBS4_CHNL76_RDATA0_ADDR A:0xe642618
y.create.l HWIO_PMIC_ARB_OBS4_CHNL77_RDATA0_ADDR A:0xe642698
y.create.l HWIO_PMIC_ARB_OBS4_CHNL78_RDATA0_ADDR A:0xe642718
y.create.l HWIO_PMIC_ARB_OBS4_CHNL79_RDATA0_ADDR A:0xe642798
y.create.l HWIO_PMIC_ARB_OBS4_CHNL80_RDATA0_ADDR A:0xe642818
y.create.l HWIO_PMIC_ARB_OBS4_CHNL81_RDATA0_ADDR A:0xe642898
y.create.l HWIO_PMIC_ARB_OBS4_CHNL82_RDATA0_ADDR A:0xe642918
y.create.l HWIO_PMIC_ARB_OBS4_CHNL83_RDATA0_ADDR A:0xe642998
y.create.l HWIO_PMIC_ARB_OBS4_CHNL84_RDATA0_ADDR A:0xe642a18
y.create.l HWIO_PMIC_ARB_OBS4_CHNL85_RDATA0_ADDR A:0xe642a98
y.create.l HWIO_PMIC_ARB_OBS4_CHNL86_RDATA0_ADDR A:0xe642b18
y.create.l HWIO_PMIC_ARB_OBS4_CHNL87_RDATA0_ADDR A:0xe642b98
y.create.l HWIO_PMIC_ARB_OBS4_CHNL88_RDATA0_ADDR A:0xe642c18
y.create.l HWIO_PMIC_ARB_OBS4_CHNL89_RDATA0_ADDR A:0xe642c98
y.create.l HWIO_PMIC_ARB_OBS4_CHNL90_RDATA0_ADDR A:0xe642d18
y.create.l HWIO_PMIC_ARB_OBS4_CHNL91_RDATA0_ADDR A:0xe642d98
y.create.l HWIO_PMIC_ARB_OBS4_CHNL92_RDATA0_ADDR A:0xe642e18
y.create.l HWIO_PMIC_ARB_OBS4_CHNL93_RDATA0_ADDR A:0xe642e98
y.create.l HWIO_PMIC_ARB_OBS4_CHNL94_RDATA0_ADDR A:0xe642f18
y.create.l HWIO_PMIC_ARB_OBS4_CHNL95_RDATA0_ADDR A:0xe642f98
y.create.l HWIO_PMIC_ARB_OBS4_CHNL96_RDATA0_ADDR A:0xe643018
y.create.l HWIO_PMIC_ARB_OBS4_CHNL97_RDATA0_ADDR A:0xe643098
y.create.l HWIO_PMIC_ARB_OBS4_CHNL98_RDATA0_ADDR A:0xe643118
y.create.l HWIO_PMIC_ARB_OBS4_CHNL99_RDATA0_ADDR A:0xe643198
y.create.l HWIO_PMIC_ARB_OBS4_CHNL100_RDATA0_ADDR A:0xe643218
y.create.l HWIO_PMIC_ARB_OBS4_CHNL101_RDATA0_ADDR A:0xe643298
y.create.l HWIO_PMIC_ARB_OBS4_CHNL102_RDATA0_ADDR A:0xe643318
y.create.l HWIO_PMIC_ARB_OBS4_CHNL103_RDATA0_ADDR A:0xe643398
y.create.l HWIO_PMIC_ARB_OBS4_CHNL104_RDATA0_ADDR A:0xe643418
y.create.l HWIO_PMIC_ARB_OBS4_CHNL105_RDATA0_ADDR A:0xe643498
y.create.l HWIO_PMIC_ARB_OBS4_CHNL106_RDATA0_ADDR A:0xe643518
y.create.l HWIO_PMIC_ARB_OBS4_CHNL107_RDATA0_ADDR A:0xe643598
y.create.l HWIO_PMIC_ARB_OBS4_CHNL108_RDATA0_ADDR A:0xe643618
y.create.l HWIO_PMIC_ARB_OBS4_CHNL109_RDATA0_ADDR A:0xe643698
y.create.l HWIO_PMIC_ARB_OBS4_CHNL110_RDATA0_ADDR A:0xe643718
y.create.l HWIO_PMIC_ARB_OBS4_CHNL111_RDATA0_ADDR A:0xe643798
y.create.l HWIO_PMIC_ARB_OBS4_CHNL112_RDATA0_ADDR A:0xe643818
y.create.l HWIO_PMIC_ARB_OBS4_CHNL113_RDATA0_ADDR A:0xe643898
y.create.l HWIO_PMIC_ARB_OBS4_CHNL114_RDATA0_ADDR A:0xe643918
y.create.l HWIO_PMIC_ARB_OBS4_CHNL115_RDATA0_ADDR A:0xe643998
y.create.l HWIO_PMIC_ARB_OBS4_CHNL116_RDATA0_ADDR A:0xe643a18
y.create.l HWIO_PMIC_ARB_OBS4_CHNL117_RDATA0_ADDR A:0xe643a98
y.create.l HWIO_PMIC_ARB_OBS4_CHNL118_RDATA0_ADDR A:0xe643b18
y.create.l HWIO_PMIC_ARB_OBS4_CHNL119_RDATA0_ADDR A:0xe643b98
y.create.l HWIO_PMIC_ARB_OBS4_CHNL120_RDATA0_ADDR A:0xe643c18
y.create.l HWIO_PMIC_ARB_OBS4_CHNL121_RDATA0_ADDR A:0xe643c98
y.create.l HWIO_PMIC_ARB_OBS4_CHNL122_RDATA0_ADDR A:0xe643d18
y.create.l HWIO_PMIC_ARB_OBS4_CHNL123_RDATA0_ADDR A:0xe643d98
y.create.l HWIO_PMIC_ARB_OBS4_CHNL124_RDATA0_ADDR A:0xe643e18
y.create.l HWIO_PMIC_ARB_OBS4_CHNL125_RDATA0_ADDR A:0xe643e98
y.create.l HWIO_PMIC_ARB_OBS4_CHNL126_RDATA0_ADDR A:0xe643f18
y.create.l HWIO_PMIC_ARB_OBS4_CHNL127_RDATA0_ADDR A:0xe643f98
y.create.l HWIO_PMIC_ARB_OBS4_CHNL128_RDATA0_ADDR A:0xe644018
y.create.l HWIO_PMIC_ARB_OBS4_CHNL129_RDATA0_ADDR A:0xe644098
y.create.l HWIO_PMIC_ARB_OBS4_CHNL130_RDATA0_ADDR A:0xe644118
y.create.l HWIO_PMIC_ARB_OBS4_CHNL131_RDATA0_ADDR A:0xe644198
y.create.l HWIO_PMIC_ARB_OBS4_CHNL132_RDATA0_ADDR A:0xe644218
y.create.l HWIO_PMIC_ARB_OBS4_CHNL133_RDATA0_ADDR A:0xe644298
y.create.l HWIO_PMIC_ARB_OBS4_CHNL134_RDATA0_ADDR A:0xe644318
y.create.l HWIO_PMIC_ARB_OBS4_CHNL135_RDATA0_ADDR A:0xe644398
y.create.l HWIO_PMIC_ARB_OBS4_CHNL136_RDATA0_ADDR A:0xe644418
y.create.l HWIO_PMIC_ARB_OBS4_CHNL137_RDATA0_ADDR A:0xe644498
y.create.l HWIO_PMIC_ARB_OBS4_CHNL138_RDATA0_ADDR A:0xe644518
y.create.l HWIO_PMIC_ARB_OBS4_CHNL139_RDATA0_ADDR A:0xe644598
y.create.l HWIO_PMIC_ARB_OBS4_CHNL140_RDATA0_ADDR A:0xe644618
y.create.l HWIO_PMIC_ARB_OBS4_CHNL141_RDATA0_ADDR A:0xe644698
y.create.l HWIO_PMIC_ARB_OBS4_CHNL142_RDATA0_ADDR A:0xe644718
y.create.l HWIO_PMIC_ARB_OBS4_CHNL143_RDATA0_ADDR A:0xe644798
y.create.l HWIO_PMIC_ARB_OBS4_CHNL144_RDATA0_ADDR A:0xe644818
y.create.l HWIO_PMIC_ARB_OBS4_CHNL145_RDATA0_ADDR A:0xe644898
y.create.l HWIO_PMIC_ARB_OBS4_CHNL146_RDATA0_ADDR A:0xe644918
y.create.l HWIO_PMIC_ARB_OBS4_CHNL147_RDATA0_ADDR A:0xe644998
y.create.l HWIO_PMIC_ARB_OBS4_CHNL148_RDATA0_ADDR A:0xe644a18
y.create.l HWIO_PMIC_ARB_OBS4_CHNL149_RDATA0_ADDR A:0xe644a98
y.create.l HWIO_PMIC_ARB_OBS4_CHNL150_RDATA0_ADDR A:0xe644b18
y.create.l HWIO_PMIC_ARB_OBS4_CHNL151_RDATA0_ADDR A:0xe644b98
y.create.l HWIO_PMIC_ARB_OBS4_CHNL152_RDATA0_ADDR A:0xe644c18
y.create.l HWIO_PMIC_ARB_OBS4_CHNL153_RDATA0_ADDR A:0xe644c98
y.create.l HWIO_PMIC_ARB_OBS4_CHNL154_RDATA0_ADDR A:0xe644d18
y.create.l HWIO_PMIC_ARB_OBS4_CHNL155_RDATA0_ADDR A:0xe644d98
y.create.l HWIO_PMIC_ARB_OBS4_CHNL156_RDATA0_ADDR A:0xe644e18
y.create.l HWIO_PMIC_ARB_OBS4_CHNL157_RDATA0_ADDR A:0xe644e98
y.create.l HWIO_PMIC_ARB_OBS4_CHNL158_RDATA0_ADDR A:0xe644f18
y.create.l HWIO_PMIC_ARB_OBS4_CHNL159_RDATA0_ADDR A:0xe644f98
y.create.l HWIO_PMIC_ARB_OBS4_CHNL160_RDATA0_ADDR A:0xe645018
y.create.l HWIO_PMIC_ARB_OBS4_CHNL161_RDATA0_ADDR A:0xe645098
y.create.l HWIO_PMIC_ARB_OBS4_CHNL162_RDATA0_ADDR A:0xe645118
y.create.l HWIO_PMIC_ARB_OBS4_CHNL163_RDATA0_ADDR A:0xe645198
y.create.l HWIO_PMIC_ARB_OBS4_CHNL164_RDATA0_ADDR A:0xe645218
y.create.l HWIO_PMIC_ARB_OBS4_CHNL165_RDATA0_ADDR A:0xe645298
y.create.l HWIO_PMIC_ARB_OBS4_CHNL166_RDATA0_ADDR A:0xe645318
y.create.l HWIO_PMIC_ARB_OBS4_CHNL167_RDATA0_ADDR A:0xe645398
y.create.l HWIO_PMIC_ARB_OBS4_CHNL168_RDATA0_ADDR A:0xe645418
y.create.l HWIO_PMIC_ARB_OBS4_CHNL169_RDATA0_ADDR A:0xe645498
y.create.l HWIO_PMIC_ARB_OBS4_CHNL170_RDATA0_ADDR A:0xe645518
y.create.l HWIO_PMIC_ARB_OBS4_CHNL171_RDATA0_ADDR A:0xe645598
y.create.l HWIO_PMIC_ARB_OBS4_CHNL172_RDATA0_ADDR A:0xe645618
y.create.l HWIO_PMIC_ARB_OBS4_CHNL173_RDATA0_ADDR A:0xe645698
y.create.l HWIO_PMIC_ARB_OBS4_CHNL174_RDATA0_ADDR A:0xe645718
y.create.l HWIO_PMIC_ARB_OBS4_CHNL175_RDATA0_ADDR A:0xe645798
y.create.l HWIO_PMIC_ARB_OBS4_CHNL176_RDATA0_ADDR A:0xe645818
y.create.l HWIO_PMIC_ARB_OBS4_CHNL177_RDATA0_ADDR A:0xe645898
y.create.l HWIO_PMIC_ARB_OBS4_CHNL178_RDATA0_ADDR A:0xe645918
y.create.l HWIO_PMIC_ARB_OBS4_CHNL179_RDATA0_ADDR A:0xe645998
y.create.l HWIO_PMIC_ARB_OBS4_CHNL180_RDATA0_ADDR A:0xe645a18
y.create.l HWIO_PMIC_ARB_OBS4_CHNL181_RDATA0_ADDR A:0xe645a98
y.create.l HWIO_PMIC_ARB_OBS4_CHNL182_RDATA0_ADDR A:0xe645b18
y.create.l HWIO_PMIC_ARB_OBS4_CHNL183_RDATA0_ADDR A:0xe645b98
y.create.l HWIO_PMIC_ARB_OBS4_CHNL184_RDATA0_ADDR A:0xe645c18
y.create.l HWIO_PMIC_ARB_OBS4_CHNL185_RDATA0_ADDR A:0xe645c98
y.create.l HWIO_PMIC_ARB_OBS4_CHNL186_RDATA0_ADDR A:0xe645d18
y.create.l HWIO_PMIC_ARB_OBS4_CHNL187_RDATA0_ADDR A:0xe645d98
y.create.l HWIO_PMIC_ARB_OBS4_CHNL188_RDATA0_ADDR A:0xe645e18
y.create.l HWIO_PMIC_ARB_OBS4_CHNL189_RDATA0_ADDR A:0xe645e98
y.create.l HWIO_PMIC_ARB_OBS4_CHNL190_RDATA0_ADDR A:0xe645f18
y.create.l HWIO_PMIC_ARB_OBS4_CHNL191_RDATA0_ADDR A:0xe645f98
y.create.l HWIO_PMIC_ARB_OBS4_CHNL192_RDATA0_ADDR A:0xe646018
y.create.l HWIO_PMIC_ARB_OBS4_CHNL193_RDATA0_ADDR A:0xe646098
y.create.l HWIO_PMIC_ARB_OBS4_CHNL194_RDATA0_ADDR A:0xe646118
y.create.l HWIO_PMIC_ARB_OBS4_CHNL195_RDATA0_ADDR A:0xe646198
y.create.l HWIO_PMIC_ARB_OBS4_CHNL196_RDATA0_ADDR A:0xe646218
y.create.l HWIO_PMIC_ARB_OBS4_CHNL197_RDATA0_ADDR A:0xe646298
y.create.l HWIO_PMIC_ARB_OBS4_CHNL198_RDATA0_ADDR A:0xe646318
y.create.l HWIO_PMIC_ARB_OBS4_CHNL199_RDATA0_ADDR A:0xe646398
y.create.l HWIO_PMIC_ARB_OBS4_CHNL200_RDATA0_ADDR A:0xe646418
y.create.l HWIO_PMIC_ARB_OBS4_CHNL201_RDATA0_ADDR A:0xe646498
y.create.l HWIO_PMIC_ARB_OBS4_CHNL202_RDATA0_ADDR A:0xe646518
y.create.l HWIO_PMIC_ARB_OBS4_CHNL203_RDATA0_ADDR A:0xe646598
y.create.l HWIO_PMIC_ARB_OBS4_CHNL204_RDATA0_ADDR A:0xe646618
y.create.l HWIO_PMIC_ARB_OBS4_CHNL205_RDATA0_ADDR A:0xe646698
y.create.l HWIO_PMIC_ARB_OBS4_CHNL206_RDATA0_ADDR A:0xe646718
y.create.l HWIO_PMIC_ARB_OBS4_CHNL207_RDATA0_ADDR A:0xe646798
y.create.l HWIO_PMIC_ARB_OBS4_CHNL208_RDATA0_ADDR A:0xe646818
y.create.l HWIO_PMIC_ARB_OBS4_CHNL209_RDATA0_ADDR A:0xe646898
y.create.l HWIO_PMIC_ARB_OBS4_CHNL210_RDATA0_ADDR A:0xe646918
y.create.l HWIO_PMIC_ARB_OBS4_CHNL211_RDATA0_ADDR A:0xe646998
y.create.l HWIO_PMIC_ARB_OBS4_CHNL212_RDATA0_ADDR A:0xe646a18
y.create.l HWIO_PMIC_ARB_OBS4_CHNL213_RDATA0_ADDR A:0xe646a98
y.create.l HWIO_PMIC_ARB_OBS4_CHNL214_RDATA0_ADDR A:0xe646b18
y.create.l HWIO_PMIC_ARB_OBS4_CHNL215_RDATA0_ADDR A:0xe646b98
y.create.l HWIO_PMIC_ARB_OBS4_CHNL216_RDATA0_ADDR A:0xe646c18
y.create.l HWIO_PMIC_ARB_OBS4_CHNL217_RDATA0_ADDR A:0xe646c98
y.create.l HWIO_PMIC_ARB_OBS4_CHNL218_RDATA0_ADDR A:0xe646d18
y.create.l HWIO_PMIC_ARB_OBS4_CHNL219_RDATA0_ADDR A:0xe646d98
y.create.l HWIO_PMIC_ARB_OBS4_CHNL220_RDATA0_ADDR A:0xe646e18
y.create.l HWIO_PMIC_ARB_OBS4_CHNL221_RDATA0_ADDR A:0xe646e98
y.create.l HWIO_PMIC_ARB_OBS4_CHNL222_RDATA0_ADDR A:0xe646f18
y.create.l HWIO_PMIC_ARB_OBS4_CHNL223_RDATA0_ADDR A:0xe646f98
y.create.l HWIO_PMIC_ARB_OBS4_CHNL224_RDATA0_ADDR A:0xe647018
y.create.l HWIO_PMIC_ARB_OBS4_CHNL225_RDATA0_ADDR A:0xe647098
y.create.l HWIO_PMIC_ARB_OBS4_CHNL226_RDATA0_ADDR A:0xe647118
y.create.l HWIO_PMIC_ARB_OBS4_CHNL227_RDATA0_ADDR A:0xe647198
y.create.l HWIO_PMIC_ARB_OBS4_CHNL228_RDATA0_ADDR A:0xe647218
y.create.l HWIO_PMIC_ARB_OBS4_CHNL229_RDATA0_ADDR A:0xe647298
y.create.l HWIO_PMIC_ARB_OBS4_CHNL230_RDATA0_ADDR A:0xe647318
y.create.l HWIO_PMIC_ARB_OBS4_CHNL231_RDATA0_ADDR A:0xe647398
y.create.l HWIO_PMIC_ARB_OBS4_CHNL232_RDATA0_ADDR A:0xe647418
y.create.l HWIO_PMIC_ARB_OBS4_CHNL233_RDATA0_ADDR A:0xe647498
y.create.l HWIO_PMIC_ARB_OBS4_CHNL234_RDATA0_ADDR A:0xe647518
y.create.l HWIO_PMIC_ARB_OBS4_CHNL235_RDATA0_ADDR A:0xe647598
y.create.l HWIO_PMIC_ARB_OBS4_CHNL236_RDATA0_ADDR A:0xe647618
y.create.l HWIO_PMIC_ARB_OBS4_CHNL237_RDATA0_ADDR A:0xe647698
y.create.l HWIO_PMIC_ARB_OBS4_CHNL238_RDATA0_ADDR A:0xe647718
y.create.l HWIO_PMIC_ARB_OBS4_CHNL239_RDATA0_ADDR A:0xe647798
y.create.l HWIO_PMIC_ARB_OBS4_CHNL240_RDATA0_ADDR A:0xe647818
y.create.l HWIO_PMIC_ARB_OBS4_CHNL241_RDATA0_ADDR A:0xe647898
y.create.l HWIO_PMIC_ARB_OBS4_CHNL242_RDATA0_ADDR A:0xe647918
y.create.l HWIO_PMIC_ARB_OBS4_CHNL243_RDATA0_ADDR A:0xe647998
y.create.l HWIO_PMIC_ARB_OBS4_CHNL244_RDATA0_ADDR A:0xe647a18
y.create.l HWIO_PMIC_ARB_OBS4_CHNL245_RDATA0_ADDR A:0xe647a98
y.create.l HWIO_PMIC_ARB_OBS4_CHNL246_RDATA0_ADDR A:0xe647b18
y.create.l HWIO_PMIC_ARB_OBS4_CHNL247_RDATA0_ADDR A:0xe647b98
y.create.l HWIO_PMIC_ARB_OBS4_CHNL248_RDATA0_ADDR A:0xe647c18
y.create.l HWIO_PMIC_ARB_OBS4_CHNL249_RDATA0_ADDR A:0xe647c98
y.create.l HWIO_PMIC_ARB_OBS4_CHNL250_RDATA0_ADDR A:0xe647d18
y.create.l HWIO_PMIC_ARB_OBS4_CHNL251_RDATA0_ADDR A:0xe647d98
y.create.l HWIO_PMIC_ARB_OBS4_CHNL252_RDATA0_ADDR A:0xe647e18
y.create.l HWIO_PMIC_ARB_OBS4_CHNL253_RDATA0_ADDR A:0xe647e98
y.create.l HWIO_PMIC_ARB_OBS4_CHNL254_RDATA0_ADDR A:0xe647f18
y.create.l HWIO_PMIC_ARB_OBS4_CHNL255_RDATA0_ADDR A:0xe647f98
y.create.l HWIO_PMIC_ARB_OBS0_CHNL0_RDATA1_ADDR A:0xe60001c
y.create.l HWIO_PMIC_ARB_OBS0_CHNL1_RDATA1_ADDR A:0xe60009c
y.create.l HWIO_PMIC_ARB_OBS0_CHNL2_RDATA1_ADDR A:0xe60011c
y.create.l HWIO_PMIC_ARB_OBS0_CHNL3_RDATA1_ADDR A:0xe60019c
y.create.l HWIO_PMIC_ARB_OBS0_CHNL4_RDATA1_ADDR A:0xe60021c
y.create.l HWIO_PMIC_ARB_OBS0_CHNL5_RDATA1_ADDR A:0xe60029c
y.create.l HWIO_PMIC_ARB_OBS0_CHNL6_RDATA1_ADDR A:0xe60031c
y.create.l HWIO_PMIC_ARB_OBS0_CHNL7_RDATA1_ADDR A:0xe60039c
y.create.l HWIO_PMIC_ARB_OBS0_CHNL8_RDATA1_ADDR A:0xe60041c
y.create.l HWIO_PMIC_ARB_OBS0_CHNL9_RDATA1_ADDR A:0xe60049c
y.create.l HWIO_PMIC_ARB_OBS0_CHNL10_RDATA1_ADDR A:0xe60051c
y.create.l HWIO_PMIC_ARB_OBS0_CHNL11_RDATA1_ADDR A:0xe60059c
y.create.l HWIO_PMIC_ARB_OBS0_CHNL12_RDATA1_ADDR A:0xe60061c
y.create.l HWIO_PMIC_ARB_OBS0_CHNL13_RDATA1_ADDR A:0xe60069c
y.create.l HWIO_PMIC_ARB_OBS0_CHNL14_RDATA1_ADDR A:0xe60071c
y.create.l HWIO_PMIC_ARB_OBS0_CHNL15_RDATA1_ADDR A:0xe60079c
y.create.l HWIO_PMIC_ARB_OBS0_CHNL16_RDATA1_ADDR A:0xe60081c
y.create.l HWIO_PMIC_ARB_OBS0_CHNL17_RDATA1_ADDR A:0xe60089c
y.create.l HWIO_PMIC_ARB_OBS0_CHNL18_RDATA1_ADDR A:0xe60091c
y.create.l HWIO_PMIC_ARB_OBS0_CHNL19_RDATA1_ADDR A:0xe60099c
y.create.l HWIO_PMIC_ARB_OBS0_CHNL20_RDATA1_ADDR A:0xe600a1c
y.create.l HWIO_PMIC_ARB_OBS0_CHNL21_RDATA1_ADDR A:0xe600a9c
y.create.l HWIO_PMIC_ARB_OBS0_CHNL22_RDATA1_ADDR A:0xe600b1c
y.create.l HWIO_PMIC_ARB_OBS0_CHNL23_RDATA1_ADDR A:0xe600b9c
y.create.l HWIO_PMIC_ARB_OBS0_CHNL24_RDATA1_ADDR A:0xe600c1c
y.create.l HWIO_PMIC_ARB_OBS0_CHNL25_RDATA1_ADDR A:0xe600c9c
y.create.l HWIO_PMIC_ARB_OBS0_CHNL26_RDATA1_ADDR A:0xe600d1c
y.create.l HWIO_PMIC_ARB_OBS0_CHNL27_RDATA1_ADDR A:0xe600d9c
y.create.l HWIO_PMIC_ARB_OBS0_CHNL28_RDATA1_ADDR A:0xe600e1c
y.create.l HWIO_PMIC_ARB_OBS0_CHNL29_RDATA1_ADDR A:0xe600e9c
y.create.l HWIO_PMIC_ARB_OBS0_CHNL30_RDATA1_ADDR A:0xe600f1c
y.create.l HWIO_PMIC_ARB_OBS0_CHNL31_RDATA1_ADDR A:0xe600f9c
y.create.l HWIO_PMIC_ARB_OBS0_CHNL32_RDATA1_ADDR A:0xe60101c
y.create.l HWIO_PMIC_ARB_OBS0_CHNL33_RDATA1_ADDR A:0xe60109c
y.create.l HWIO_PMIC_ARB_OBS0_CHNL34_RDATA1_ADDR A:0xe60111c
y.create.l HWIO_PMIC_ARB_OBS0_CHNL35_RDATA1_ADDR A:0xe60119c
y.create.l HWIO_PMIC_ARB_OBS0_CHNL36_RDATA1_ADDR A:0xe60121c
y.create.l HWIO_PMIC_ARB_OBS0_CHNL37_RDATA1_ADDR A:0xe60129c
y.create.l HWIO_PMIC_ARB_OBS0_CHNL38_RDATA1_ADDR A:0xe60131c
y.create.l HWIO_PMIC_ARB_OBS0_CHNL39_RDATA1_ADDR A:0xe60139c
y.create.l HWIO_PMIC_ARB_OBS0_CHNL40_RDATA1_ADDR A:0xe60141c
y.create.l HWIO_PMIC_ARB_OBS0_CHNL41_RDATA1_ADDR A:0xe60149c
y.create.l HWIO_PMIC_ARB_OBS0_CHNL42_RDATA1_ADDR A:0xe60151c
y.create.l HWIO_PMIC_ARB_OBS0_CHNL43_RDATA1_ADDR A:0xe60159c
y.create.l HWIO_PMIC_ARB_OBS0_CHNL44_RDATA1_ADDR A:0xe60161c
y.create.l HWIO_PMIC_ARB_OBS0_CHNL45_RDATA1_ADDR A:0xe60169c
y.create.l HWIO_PMIC_ARB_OBS0_CHNL46_RDATA1_ADDR A:0xe60171c
y.create.l HWIO_PMIC_ARB_OBS0_CHNL47_RDATA1_ADDR A:0xe60179c
y.create.l HWIO_PMIC_ARB_OBS0_CHNL48_RDATA1_ADDR A:0xe60181c
y.create.l HWIO_PMIC_ARB_OBS0_CHNL49_RDATA1_ADDR A:0xe60189c
y.create.l HWIO_PMIC_ARB_OBS0_CHNL50_RDATA1_ADDR A:0xe60191c
y.create.l HWIO_PMIC_ARB_OBS0_CHNL51_RDATA1_ADDR A:0xe60199c
y.create.l HWIO_PMIC_ARB_OBS0_CHNL52_RDATA1_ADDR A:0xe601a1c
y.create.l HWIO_PMIC_ARB_OBS0_CHNL53_RDATA1_ADDR A:0xe601a9c
y.create.l HWIO_PMIC_ARB_OBS0_CHNL54_RDATA1_ADDR A:0xe601b1c
y.create.l HWIO_PMIC_ARB_OBS0_CHNL55_RDATA1_ADDR A:0xe601b9c
y.create.l HWIO_PMIC_ARB_OBS0_CHNL56_RDATA1_ADDR A:0xe601c1c
y.create.l HWIO_PMIC_ARB_OBS0_CHNL57_RDATA1_ADDR A:0xe601c9c
y.create.l HWIO_PMIC_ARB_OBS0_CHNL58_RDATA1_ADDR A:0xe601d1c
y.create.l HWIO_PMIC_ARB_OBS0_CHNL59_RDATA1_ADDR A:0xe601d9c
y.create.l HWIO_PMIC_ARB_OBS0_CHNL60_RDATA1_ADDR A:0xe601e1c
y.create.l HWIO_PMIC_ARB_OBS0_CHNL61_RDATA1_ADDR A:0xe601e9c
y.create.l HWIO_PMIC_ARB_OBS0_CHNL62_RDATA1_ADDR A:0xe601f1c
y.create.l HWIO_PMIC_ARB_OBS0_CHNL63_RDATA1_ADDR A:0xe601f9c
y.create.l HWIO_PMIC_ARB_OBS0_CHNL64_RDATA1_ADDR A:0xe60201c
y.create.l HWIO_PMIC_ARB_OBS0_CHNL65_RDATA1_ADDR A:0xe60209c
y.create.l HWIO_PMIC_ARB_OBS0_CHNL66_RDATA1_ADDR A:0xe60211c
y.create.l HWIO_PMIC_ARB_OBS0_CHNL67_RDATA1_ADDR A:0xe60219c
y.create.l HWIO_PMIC_ARB_OBS0_CHNL68_RDATA1_ADDR A:0xe60221c
y.create.l HWIO_PMIC_ARB_OBS0_CHNL69_RDATA1_ADDR A:0xe60229c
y.create.l HWIO_PMIC_ARB_OBS0_CHNL70_RDATA1_ADDR A:0xe60231c
y.create.l HWIO_PMIC_ARB_OBS0_CHNL71_RDATA1_ADDR A:0xe60239c
y.create.l HWIO_PMIC_ARB_OBS0_CHNL72_RDATA1_ADDR A:0xe60241c
y.create.l HWIO_PMIC_ARB_OBS0_CHNL73_RDATA1_ADDR A:0xe60249c
y.create.l HWIO_PMIC_ARB_OBS0_CHNL74_RDATA1_ADDR A:0xe60251c
y.create.l HWIO_PMIC_ARB_OBS0_CHNL75_RDATA1_ADDR A:0xe60259c
y.create.l HWIO_PMIC_ARB_OBS0_CHNL76_RDATA1_ADDR A:0xe60261c
y.create.l HWIO_PMIC_ARB_OBS0_CHNL77_RDATA1_ADDR A:0xe60269c
y.create.l HWIO_PMIC_ARB_OBS0_CHNL78_RDATA1_ADDR A:0xe60271c
y.create.l HWIO_PMIC_ARB_OBS0_CHNL79_RDATA1_ADDR A:0xe60279c
y.create.l HWIO_PMIC_ARB_OBS0_CHNL80_RDATA1_ADDR A:0xe60281c
y.create.l HWIO_PMIC_ARB_OBS0_CHNL81_RDATA1_ADDR A:0xe60289c
y.create.l HWIO_PMIC_ARB_OBS0_CHNL82_RDATA1_ADDR A:0xe60291c
y.create.l HWIO_PMIC_ARB_OBS0_CHNL83_RDATA1_ADDR A:0xe60299c
y.create.l HWIO_PMIC_ARB_OBS0_CHNL84_RDATA1_ADDR A:0xe602a1c
y.create.l HWIO_PMIC_ARB_OBS0_CHNL85_RDATA1_ADDR A:0xe602a9c
y.create.l HWIO_PMIC_ARB_OBS0_CHNL86_RDATA1_ADDR A:0xe602b1c
y.create.l HWIO_PMIC_ARB_OBS0_CHNL87_RDATA1_ADDR A:0xe602b9c
y.create.l HWIO_PMIC_ARB_OBS0_CHNL88_RDATA1_ADDR A:0xe602c1c
y.create.l HWIO_PMIC_ARB_OBS0_CHNL89_RDATA1_ADDR A:0xe602c9c
y.create.l HWIO_PMIC_ARB_OBS0_CHNL90_RDATA1_ADDR A:0xe602d1c
y.create.l HWIO_PMIC_ARB_OBS0_CHNL91_RDATA1_ADDR A:0xe602d9c
y.create.l HWIO_PMIC_ARB_OBS0_CHNL92_RDATA1_ADDR A:0xe602e1c
y.create.l HWIO_PMIC_ARB_OBS0_CHNL93_RDATA1_ADDR A:0xe602e9c
y.create.l HWIO_PMIC_ARB_OBS0_CHNL94_RDATA1_ADDR A:0xe602f1c
y.create.l HWIO_PMIC_ARB_OBS0_CHNL95_RDATA1_ADDR A:0xe602f9c
y.create.l HWIO_PMIC_ARB_OBS0_CHNL96_RDATA1_ADDR A:0xe60301c
y.create.l HWIO_PMIC_ARB_OBS0_CHNL97_RDATA1_ADDR A:0xe60309c
y.create.l HWIO_PMIC_ARB_OBS0_CHNL98_RDATA1_ADDR A:0xe60311c
y.create.l HWIO_PMIC_ARB_OBS0_CHNL99_RDATA1_ADDR A:0xe60319c
y.create.l HWIO_PMIC_ARB_OBS0_CHNL100_RDATA1_ADDR A:0xe60321c
y.create.l HWIO_PMIC_ARB_OBS0_CHNL101_RDATA1_ADDR A:0xe60329c
y.create.l HWIO_PMIC_ARB_OBS0_CHNL102_RDATA1_ADDR A:0xe60331c
y.create.l HWIO_PMIC_ARB_OBS0_CHNL103_RDATA1_ADDR A:0xe60339c
y.create.l HWIO_PMIC_ARB_OBS0_CHNL104_RDATA1_ADDR A:0xe60341c
y.create.l HWIO_PMIC_ARB_OBS0_CHNL105_RDATA1_ADDR A:0xe60349c
y.create.l HWIO_PMIC_ARB_OBS0_CHNL106_RDATA1_ADDR A:0xe60351c
y.create.l HWIO_PMIC_ARB_OBS0_CHNL107_RDATA1_ADDR A:0xe60359c
y.create.l HWIO_PMIC_ARB_OBS0_CHNL108_RDATA1_ADDR A:0xe60361c
y.create.l HWIO_PMIC_ARB_OBS0_CHNL109_RDATA1_ADDR A:0xe60369c
y.create.l HWIO_PMIC_ARB_OBS0_CHNL110_RDATA1_ADDR A:0xe60371c
y.create.l HWIO_PMIC_ARB_OBS0_CHNL111_RDATA1_ADDR A:0xe60379c
y.create.l HWIO_PMIC_ARB_OBS0_CHNL112_RDATA1_ADDR A:0xe60381c
y.create.l HWIO_PMIC_ARB_OBS0_CHNL113_RDATA1_ADDR A:0xe60389c
y.create.l HWIO_PMIC_ARB_OBS0_CHNL114_RDATA1_ADDR A:0xe60391c
y.create.l HWIO_PMIC_ARB_OBS0_CHNL115_RDATA1_ADDR A:0xe60399c
y.create.l HWIO_PMIC_ARB_OBS0_CHNL116_RDATA1_ADDR A:0xe603a1c
y.create.l HWIO_PMIC_ARB_OBS0_CHNL117_RDATA1_ADDR A:0xe603a9c
y.create.l HWIO_PMIC_ARB_OBS0_CHNL118_RDATA1_ADDR A:0xe603b1c
y.create.l HWIO_PMIC_ARB_OBS0_CHNL119_RDATA1_ADDR A:0xe603b9c
y.create.l HWIO_PMIC_ARB_OBS0_CHNL120_RDATA1_ADDR A:0xe603c1c
y.create.l HWIO_PMIC_ARB_OBS0_CHNL121_RDATA1_ADDR A:0xe603c9c
y.create.l HWIO_PMIC_ARB_OBS0_CHNL122_RDATA1_ADDR A:0xe603d1c
y.create.l HWIO_PMIC_ARB_OBS0_CHNL123_RDATA1_ADDR A:0xe603d9c
y.create.l HWIO_PMIC_ARB_OBS0_CHNL124_RDATA1_ADDR A:0xe603e1c
y.create.l HWIO_PMIC_ARB_OBS0_CHNL125_RDATA1_ADDR A:0xe603e9c
y.create.l HWIO_PMIC_ARB_OBS0_CHNL126_RDATA1_ADDR A:0xe603f1c
y.create.l HWIO_PMIC_ARB_OBS0_CHNL127_RDATA1_ADDR A:0xe603f9c
y.create.l HWIO_PMIC_ARB_OBS0_CHNL128_RDATA1_ADDR A:0xe60401c
y.create.l HWIO_PMIC_ARB_OBS0_CHNL129_RDATA1_ADDR A:0xe60409c
y.create.l HWIO_PMIC_ARB_OBS0_CHNL130_RDATA1_ADDR A:0xe60411c
y.create.l HWIO_PMIC_ARB_OBS0_CHNL131_RDATA1_ADDR A:0xe60419c
y.create.l HWIO_PMIC_ARB_OBS0_CHNL132_RDATA1_ADDR A:0xe60421c
y.create.l HWIO_PMIC_ARB_OBS0_CHNL133_RDATA1_ADDR A:0xe60429c
y.create.l HWIO_PMIC_ARB_OBS0_CHNL134_RDATA1_ADDR A:0xe60431c
y.create.l HWIO_PMIC_ARB_OBS0_CHNL135_RDATA1_ADDR A:0xe60439c
y.create.l HWIO_PMIC_ARB_OBS0_CHNL136_RDATA1_ADDR A:0xe60441c
y.create.l HWIO_PMIC_ARB_OBS0_CHNL137_RDATA1_ADDR A:0xe60449c
y.create.l HWIO_PMIC_ARB_OBS0_CHNL138_RDATA1_ADDR A:0xe60451c
y.create.l HWIO_PMIC_ARB_OBS0_CHNL139_RDATA1_ADDR A:0xe60459c
y.create.l HWIO_PMIC_ARB_OBS0_CHNL140_RDATA1_ADDR A:0xe60461c
y.create.l HWIO_PMIC_ARB_OBS0_CHNL141_RDATA1_ADDR A:0xe60469c
y.create.l HWIO_PMIC_ARB_OBS0_CHNL142_RDATA1_ADDR A:0xe60471c
y.create.l HWIO_PMIC_ARB_OBS0_CHNL143_RDATA1_ADDR A:0xe60479c
y.create.l HWIO_PMIC_ARB_OBS0_CHNL144_RDATA1_ADDR A:0xe60481c
y.create.l HWIO_PMIC_ARB_OBS0_CHNL145_RDATA1_ADDR A:0xe60489c
y.create.l HWIO_PMIC_ARB_OBS0_CHNL146_RDATA1_ADDR A:0xe60491c
y.create.l HWIO_PMIC_ARB_OBS0_CHNL147_RDATA1_ADDR A:0xe60499c
y.create.l HWIO_PMIC_ARB_OBS0_CHNL148_RDATA1_ADDR A:0xe604a1c
y.create.l HWIO_PMIC_ARB_OBS0_CHNL149_RDATA1_ADDR A:0xe604a9c
y.create.l HWIO_PMIC_ARB_OBS0_CHNL150_RDATA1_ADDR A:0xe604b1c
y.create.l HWIO_PMIC_ARB_OBS0_CHNL151_RDATA1_ADDR A:0xe604b9c
y.create.l HWIO_PMIC_ARB_OBS0_CHNL152_RDATA1_ADDR A:0xe604c1c
y.create.l HWIO_PMIC_ARB_OBS0_CHNL153_RDATA1_ADDR A:0xe604c9c
y.create.l HWIO_PMIC_ARB_OBS0_CHNL154_RDATA1_ADDR A:0xe604d1c
y.create.l HWIO_PMIC_ARB_OBS0_CHNL155_RDATA1_ADDR A:0xe604d9c
y.create.l HWIO_PMIC_ARB_OBS0_CHNL156_RDATA1_ADDR A:0xe604e1c
y.create.l HWIO_PMIC_ARB_OBS0_CHNL157_RDATA1_ADDR A:0xe604e9c
y.create.l HWIO_PMIC_ARB_OBS0_CHNL158_RDATA1_ADDR A:0xe604f1c
y.create.l HWIO_PMIC_ARB_OBS0_CHNL159_RDATA1_ADDR A:0xe604f9c
y.create.l HWIO_PMIC_ARB_OBS0_CHNL160_RDATA1_ADDR A:0xe60501c
y.create.l HWIO_PMIC_ARB_OBS0_CHNL161_RDATA1_ADDR A:0xe60509c
y.create.l HWIO_PMIC_ARB_OBS0_CHNL162_RDATA1_ADDR A:0xe60511c
y.create.l HWIO_PMIC_ARB_OBS0_CHNL163_RDATA1_ADDR A:0xe60519c
y.create.l HWIO_PMIC_ARB_OBS0_CHNL164_RDATA1_ADDR A:0xe60521c
y.create.l HWIO_PMIC_ARB_OBS0_CHNL165_RDATA1_ADDR A:0xe60529c
y.create.l HWIO_PMIC_ARB_OBS0_CHNL166_RDATA1_ADDR A:0xe60531c
y.create.l HWIO_PMIC_ARB_OBS0_CHNL167_RDATA1_ADDR A:0xe60539c
y.create.l HWIO_PMIC_ARB_OBS0_CHNL168_RDATA1_ADDR A:0xe60541c
y.create.l HWIO_PMIC_ARB_OBS0_CHNL169_RDATA1_ADDR A:0xe60549c
y.create.l HWIO_PMIC_ARB_OBS0_CHNL170_RDATA1_ADDR A:0xe60551c
y.create.l HWIO_PMIC_ARB_OBS0_CHNL171_RDATA1_ADDR A:0xe60559c
y.create.l HWIO_PMIC_ARB_OBS0_CHNL172_RDATA1_ADDR A:0xe60561c
y.create.l HWIO_PMIC_ARB_OBS0_CHNL173_RDATA1_ADDR A:0xe60569c
y.create.l HWIO_PMIC_ARB_OBS0_CHNL174_RDATA1_ADDR A:0xe60571c
y.create.l HWIO_PMIC_ARB_OBS0_CHNL175_RDATA1_ADDR A:0xe60579c
y.create.l HWIO_PMIC_ARB_OBS0_CHNL176_RDATA1_ADDR A:0xe60581c
y.create.l HWIO_PMIC_ARB_OBS0_CHNL177_RDATA1_ADDR A:0xe60589c
y.create.l HWIO_PMIC_ARB_OBS0_CHNL178_RDATA1_ADDR A:0xe60591c
y.create.l HWIO_PMIC_ARB_OBS0_CHNL179_RDATA1_ADDR A:0xe60599c
y.create.l HWIO_PMIC_ARB_OBS0_CHNL180_RDATA1_ADDR A:0xe605a1c
y.create.l HWIO_PMIC_ARB_OBS0_CHNL181_RDATA1_ADDR A:0xe605a9c
y.create.l HWIO_PMIC_ARB_OBS0_CHNL182_RDATA1_ADDR A:0xe605b1c
y.create.l HWIO_PMIC_ARB_OBS0_CHNL183_RDATA1_ADDR A:0xe605b9c
y.create.l HWIO_PMIC_ARB_OBS0_CHNL184_RDATA1_ADDR A:0xe605c1c
y.create.l HWIO_PMIC_ARB_OBS0_CHNL185_RDATA1_ADDR A:0xe605c9c
y.create.l HWIO_PMIC_ARB_OBS0_CHNL186_RDATA1_ADDR A:0xe605d1c
y.create.l HWIO_PMIC_ARB_OBS0_CHNL187_RDATA1_ADDR A:0xe605d9c
y.create.l HWIO_PMIC_ARB_OBS0_CHNL188_RDATA1_ADDR A:0xe605e1c
y.create.l HWIO_PMIC_ARB_OBS0_CHNL189_RDATA1_ADDR A:0xe605e9c
y.create.l HWIO_PMIC_ARB_OBS0_CHNL190_RDATA1_ADDR A:0xe605f1c
y.create.l HWIO_PMIC_ARB_OBS0_CHNL191_RDATA1_ADDR A:0xe605f9c
y.create.l HWIO_PMIC_ARB_OBS0_CHNL192_RDATA1_ADDR A:0xe60601c
y.create.l HWIO_PMIC_ARB_OBS0_CHNL193_RDATA1_ADDR A:0xe60609c
y.create.l HWIO_PMIC_ARB_OBS0_CHNL194_RDATA1_ADDR A:0xe60611c
y.create.l HWIO_PMIC_ARB_OBS0_CHNL195_RDATA1_ADDR A:0xe60619c
y.create.l HWIO_PMIC_ARB_OBS0_CHNL196_RDATA1_ADDR A:0xe60621c
y.create.l HWIO_PMIC_ARB_OBS0_CHNL197_RDATA1_ADDR A:0xe60629c
y.create.l HWIO_PMIC_ARB_OBS0_CHNL198_RDATA1_ADDR A:0xe60631c
y.create.l HWIO_PMIC_ARB_OBS0_CHNL199_RDATA1_ADDR A:0xe60639c
y.create.l HWIO_PMIC_ARB_OBS0_CHNL200_RDATA1_ADDR A:0xe60641c
y.create.l HWIO_PMIC_ARB_OBS0_CHNL201_RDATA1_ADDR A:0xe60649c
y.create.l HWIO_PMIC_ARB_OBS0_CHNL202_RDATA1_ADDR A:0xe60651c
y.create.l HWIO_PMIC_ARB_OBS0_CHNL203_RDATA1_ADDR A:0xe60659c
y.create.l HWIO_PMIC_ARB_OBS0_CHNL204_RDATA1_ADDR A:0xe60661c
y.create.l HWIO_PMIC_ARB_OBS0_CHNL205_RDATA1_ADDR A:0xe60669c
y.create.l HWIO_PMIC_ARB_OBS0_CHNL206_RDATA1_ADDR A:0xe60671c
y.create.l HWIO_PMIC_ARB_OBS0_CHNL207_RDATA1_ADDR A:0xe60679c
y.create.l HWIO_PMIC_ARB_OBS0_CHNL208_RDATA1_ADDR A:0xe60681c
y.create.l HWIO_PMIC_ARB_OBS0_CHNL209_RDATA1_ADDR A:0xe60689c
y.create.l HWIO_PMIC_ARB_OBS0_CHNL210_RDATA1_ADDR A:0xe60691c
y.create.l HWIO_PMIC_ARB_OBS0_CHNL211_RDATA1_ADDR A:0xe60699c
y.create.l HWIO_PMIC_ARB_OBS0_CHNL212_RDATA1_ADDR A:0xe606a1c
y.create.l HWIO_PMIC_ARB_OBS0_CHNL213_RDATA1_ADDR A:0xe606a9c
y.create.l HWIO_PMIC_ARB_OBS0_CHNL214_RDATA1_ADDR A:0xe606b1c
y.create.l HWIO_PMIC_ARB_OBS0_CHNL215_RDATA1_ADDR A:0xe606b9c
y.create.l HWIO_PMIC_ARB_OBS0_CHNL216_RDATA1_ADDR A:0xe606c1c
y.create.l HWIO_PMIC_ARB_OBS0_CHNL217_RDATA1_ADDR A:0xe606c9c
y.create.l HWIO_PMIC_ARB_OBS0_CHNL218_RDATA1_ADDR A:0xe606d1c
y.create.l HWIO_PMIC_ARB_OBS0_CHNL219_RDATA1_ADDR A:0xe606d9c
y.create.l HWIO_PMIC_ARB_OBS0_CHNL220_RDATA1_ADDR A:0xe606e1c
y.create.l HWIO_PMIC_ARB_OBS0_CHNL221_RDATA1_ADDR A:0xe606e9c
y.create.l HWIO_PMIC_ARB_OBS0_CHNL222_RDATA1_ADDR A:0xe606f1c
y.create.l HWIO_PMIC_ARB_OBS0_CHNL223_RDATA1_ADDR A:0xe606f9c
y.create.l HWIO_PMIC_ARB_OBS0_CHNL224_RDATA1_ADDR A:0xe60701c
y.create.l HWIO_PMIC_ARB_OBS0_CHNL225_RDATA1_ADDR A:0xe60709c
y.create.l HWIO_PMIC_ARB_OBS0_CHNL226_RDATA1_ADDR A:0xe60711c
y.create.l HWIO_PMIC_ARB_OBS0_CHNL227_RDATA1_ADDR A:0xe60719c
y.create.l HWIO_PMIC_ARB_OBS0_CHNL228_RDATA1_ADDR A:0xe60721c
y.create.l HWIO_PMIC_ARB_OBS0_CHNL229_RDATA1_ADDR A:0xe60729c
y.create.l HWIO_PMIC_ARB_OBS0_CHNL230_RDATA1_ADDR A:0xe60731c
y.create.l HWIO_PMIC_ARB_OBS0_CHNL231_RDATA1_ADDR A:0xe60739c
y.create.l HWIO_PMIC_ARB_OBS0_CHNL232_RDATA1_ADDR A:0xe60741c
y.create.l HWIO_PMIC_ARB_OBS0_CHNL233_RDATA1_ADDR A:0xe60749c
y.create.l HWIO_PMIC_ARB_OBS0_CHNL234_RDATA1_ADDR A:0xe60751c
y.create.l HWIO_PMIC_ARB_OBS0_CHNL235_RDATA1_ADDR A:0xe60759c
y.create.l HWIO_PMIC_ARB_OBS0_CHNL236_RDATA1_ADDR A:0xe60761c
y.create.l HWIO_PMIC_ARB_OBS0_CHNL237_RDATA1_ADDR A:0xe60769c
y.create.l HWIO_PMIC_ARB_OBS0_CHNL238_RDATA1_ADDR A:0xe60771c
y.create.l HWIO_PMIC_ARB_OBS0_CHNL239_RDATA1_ADDR A:0xe60779c
y.create.l HWIO_PMIC_ARB_OBS0_CHNL240_RDATA1_ADDR A:0xe60781c
y.create.l HWIO_PMIC_ARB_OBS0_CHNL241_RDATA1_ADDR A:0xe60789c
y.create.l HWIO_PMIC_ARB_OBS0_CHNL242_RDATA1_ADDR A:0xe60791c
y.create.l HWIO_PMIC_ARB_OBS0_CHNL243_RDATA1_ADDR A:0xe60799c
y.create.l HWIO_PMIC_ARB_OBS0_CHNL244_RDATA1_ADDR A:0xe607a1c
y.create.l HWIO_PMIC_ARB_OBS0_CHNL245_RDATA1_ADDR A:0xe607a9c
y.create.l HWIO_PMIC_ARB_OBS0_CHNL246_RDATA1_ADDR A:0xe607b1c
y.create.l HWIO_PMIC_ARB_OBS0_CHNL247_RDATA1_ADDR A:0xe607b9c
y.create.l HWIO_PMIC_ARB_OBS0_CHNL248_RDATA1_ADDR A:0xe607c1c
y.create.l HWIO_PMIC_ARB_OBS0_CHNL249_RDATA1_ADDR A:0xe607c9c
y.create.l HWIO_PMIC_ARB_OBS0_CHNL250_RDATA1_ADDR A:0xe607d1c
y.create.l HWIO_PMIC_ARB_OBS0_CHNL251_RDATA1_ADDR A:0xe607d9c
y.create.l HWIO_PMIC_ARB_OBS0_CHNL252_RDATA1_ADDR A:0xe607e1c
y.create.l HWIO_PMIC_ARB_OBS0_CHNL253_RDATA1_ADDR A:0xe607e9c
y.create.l HWIO_PMIC_ARB_OBS0_CHNL254_RDATA1_ADDR A:0xe607f1c
y.create.l HWIO_PMIC_ARB_OBS0_CHNL255_RDATA1_ADDR A:0xe607f9c
y.create.l HWIO_PMIC_ARB_OBS1_CHNL0_RDATA1_ADDR A:0xe61001c
y.create.l HWIO_PMIC_ARB_OBS1_CHNL1_RDATA1_ADDR A:0xe61009c
y.create.l HWIO_PMIC_ARB_OBS1_CHNL2_RDATA1_ADDR A:0xe61011c
y.create.l HWIO_PMIC_ARB_OBS1_CHNL3_RDATA1_ADDR A:0xe61019c
y.create.l HWIO_PMIC_ARB_OBS1_CHNL4_RDATA1_ADDR A:0xe61021c
y.create.l HWIO_PMIC_ARB_OBS1_CHNL5_RDATA1_ADDR A:0xe61029c
y.create.l HWIO_PMIC_ARB_OBS1_CHNL6_RDATA1_ADDR A:0xe61031c
y.create.l HWIO_PMIC_ARB_OBS1_CHNL7_RDATA1_ADDR A:0xe61039c
y.create.l HWIO_PMIC_ARB_OBS1_CHNL8_RDATA1_ADDR A:0xe61041c
y.create.l HWIO_PMIC_ARB_OBS1_CHNL9_RDATA1_ADDR A:0xe61049c
y.create.l HWIO_PMIC_ARB_OBS1_CHNL10_RDATA1_ADDR A:0xe61051c
y.create.l HWIO_PMIC_ARB_OBS1_CHNL11_RDATA1_ADDR A:0xe61059c
y.create.l HWIO_PMIC_ARB_OBS1_CHNL12_RDATA1_ADDR A:0xe61061c
y.create.l HWIO_PMIC_ARB_OBS1_CHNL13_RDATA1_ADDR A:0xe61069c
y.create.l HWIO_PMIC_ARB_OBS1_CHNL14_RDATA1_ADDR A:0xe61071c
y.create.l HWIO_PMIC_ARB_OBS1_CHNL15_RDATA1_ADDR A:0xe61079c
y.create.l HWIO_PMIC_ARB_OBS1_CHNL16_RDATA1_ADDR A:0xe61081c
y.create.l HWIO_PMIC_ARB_OBS1_CHNL17_RDATA1_ADDR A:0xe61089c
y.create.l HWIO_PMIC_ARB_OBS1_CHNL18_RDATA1_ADDR A:0xe61091c
y.create.l HWIO_PMIC_ARB_OBS1_CHNL19_RDATA1_ADDR A:0xe61099c
y.create.l HWIO_PMIC_ARB_OBS1_CHNL20_RDATA1_ADDR A:0xe610a1c
y.create.l HWIO_PMIC_ARB_OBS1_CHNL21_RDATA1_ADDR A:0xe610a9c
y.create.l HWIO_PMIC_ARB_OBS1_CHNL22_RDATA1_ADDR A:0xe610b1c
y.create.l HWIO_PMIC_ARB_OBS1_CHNL23_RDATA1_ADDR A:0xe610b9c
y.create.l HWIO_PMIC_ARB_OBS1_CHNL24_RDATA1_ADDR A:0xe610c1c
y.create.l HWIO_PMIC_ARB_OBS1_CHNL25_RDATA1_ADDR A:0xe610c9c
y.create.l HWIO_PMIC_ARB_OBS1_CHNL26_RDATA1_ADDR A:0xe610d1c
y.create.l HWIO_PMIC_ARB_OBS1_CHNL27_RDATA1_ADDR A:0xe610d9c
y.create.l HWIO_PMIC_ARB_OBS1_CHNL28_RDATA1_ADDR A:0xe610e1c
y.create.l HWIO_PMIC_ARB_OBS1_CHNL29_RDATA1_ADDR A:0xe610e9c
y.create.l HWIO_PMIC_ARB_OBS1_CHNL30_RDATA1_ADDR A:0xe610f1c
y.create.l HWIO_PMIC_ARB_OBS1_CHNL31_RDATA1_ADDR A:0xe610f9c
y.create.l HWIO_PMIC_ARB_OBS1_CHNL32_RDATA1_ADDR A:0xe61101c
y.create.l HWIO_PMIC_ARB_OBS1_CHNL33_RDATA1_ADDR A:0xe61109c
y.create.l HWIO_PMIC_ARB_OBS1_CHNL34_RDATA1_ADDR A:0xe61111c
y.create.l HWIO_PMIC_ARB_OBS1_CHNL35_RDATA1_ADDR A:0xe61119c
y.create.l HWIO_PMIC_ARB_OBS1_CHNL36_RDATA1_ADDR A:0xe61121c
y.create.l HWIO_PMIC_ARB_OBS1_CHNL37_RDATA1_ADDR A:0xe61129c
y.create.l HWIO_PMIC_ARB_OBS1_CHNL38_RDATA1_ADDR A:0xe61131c
y.create.l HWIO_PMIC_ARB_OBS1_CHNL39_RDATA1_ADDR A:0xe61139c
y.create.l HWIO_PMIC_ARB_OBS1_CHNL40_RDATA1_ADDR A:0xe61141c
y.create.l HWIO_PMIC_ARB_OBS1_CHNL41_RDATA1_ADDR A:0xe61149c
y.create.l HWIO_PMIC_ARB_OBS1_CHNL42_RDATA1_ADDR A:0xe61151c
y.create.l HWIO_PMIC_ARB_OBS1_CHNL43_RDATA1_ADDR A:0xe61159c
y.create.l HWIO_PMIC_ARB_OBS1_CHNL44_RDATA1_ADDR A:0xe61161c
y.create.l HWIO_PMIC_ARB_OBS1_CHNL45_RDATA1_ADDR A:0xe61169c
y.create.l HWIO_PMIC_ARB_OBS1_CHNL46_RDATA1_ADDR A:0xe61171c
y.create.l HWIO_PMIC_ARB_OBS1_CHNL47_RDATA1_ADDR A:0xe61179c
y.create.l HWIO_PMIC_ARB_OBS1_CHNL48_RDATA1_ADDR A:0xe61181c
y.create.l HWIO_PMIC_ARB_OBS1_CHNL49_RDATA1_ADDR A:0xe61189c
y.create.l HWIO_PMIC_ARB_OBS1_CHNL50_RDATA1_ADDR A:0xe61191c
y.create.l HWIO_PMIC_ARB_OBS1_CHNL51_RDATA1_ADDR A:0xe61199c
y.create.l HWIO_PMIC_ARB_OBS1_CHNL52_RDATA1_ADDR A:0xe611a1c
y.create.l HWIO_PMIC_ARB_OBS1_CHNL53_RDATA1_ADDR A:0xe611a9c
y.create.l HWIO_PMIC_ARB_OBS1_CHNL54_RDATA1_ADDR A:0xe611b1c
y.create.l HWIO_PMIC_ARB_OBS1_CHNL55_RDATA1_ADDR A:0xe611b9c
y.create.l HWIO_PMIC_ARB_OBS1_CHNL56_RDATA1_ADDR A:0xe611c1c
y.create.l HWIO_PMIC_ARB_OBS1_CHNL57_RDATA1_ADDR A:0xe611c9c
y.create.l HWIO_PMIC_ARB_OBS1_CHNL58_RDATA1_ADDR A:0xe611d1c
y.create.l HWIO_PMIC_ARB_OBS1_CHNL59_RDATA1_ADDR A:0xe611d9c
y.create.l HWIO_PMIC_ARB_OBS1_CHNL60_RDATA1_ADDR A:0xe611e1c
y.create.l HWIO_PMIC_ARB_OBS1_CHNL61_RDATA1_ADDR A:0xe611e9c
y.create.l HWIO_PMIC_ARB_OBS1_CHNL62_RDATA1_ADDR A:0xe611f1c
y.create.l HWIO_PMIC_ARB_OBS1_CHNL63_RDATA1_ADDR A:0xe611f9c
y.create.l HWIO_PMIC_ARB_OBS1_CHNL64_RDATA1_ADDR A:0xe61201c
y.create.l HWIO_PMIC_ARB_OBS1_CHNL65_RDATA1_ADDR A:0xe61209c
y.create.l HWIO_PMIC_ARB_OBS1_CHNL66_RDATA1_ADDR A:0xe61211c
y.create.l HWIO_PMIC_ARB_OBS1_CHNL67_RDATA1_ADDR A:0xe61219c
y.create.l HWIO_PMIC_ARB_OBS1_CHNL68_RDATA1_ADDR A:0xe61221c
y.create.l HWIO_PMIC_ARB_OBS1_CHNL69_RDATA1_ADDR A:0xe61229c
y.create.l HWIO_PMIC_ARB_OBS1_CHNL70_RDATA1_ADDR A:0xe61231c
y.create.l HWIO_PMIC_ARB_OBS1_CHNL71_RDATA1_ADDR A:0xe61239c
y.create.l HWIO_PMIC_ARB_OBS1_CHNL72_RDATA1_ADDR A:0xe61241c
y.create.l HWIO_PMIC_ARB_OBS1_CHNL73_RDATA1_ADDR A:0xe61249c
y.create.l HWIO_PMIC_ARB_OBS1_CHNL74_RDATA1_ADDR A:0xe61251c
y.create.l HWIO_PMIC_ARB_OBS1_CHNL75_RDATA1_ADDR A:0xe61259c
y.create.l HWIO_PMIC_ARB_OBS1_CHNL76_RDATA1_ADDR A:0xe61261c
y.create.l HWIO_PMIC_ARB_OBS1_CHNL77_RDATA1_ADDR A:0xe61269c
y.create.l HWIO_PMIC_ARB_OBS1_CHNL78_RDATA1_ADDR A:0xe61271c
y.create.l HWIO_PMIC_ARB_OBS1_CHNL79_RDATA1_ADDR A:0xe61279c
y.create.l HWIO_PMIC_ARB_OBS1_CHNL80_RDATA1_ADDR A:0xe61281c
y.create.l HWIO_PMIC_ARB_OBS1_CHNL81_RDATA1_ADDR A:0xe61289c
y.create.l HWIO_PMIC_ARB_OBS1_CHNL82_RDATA1_ADDR A:0xe61291c
y.create.l HWIO_PMIC_ARB_OBS1_CHNL83_RDATA1_ADDR A:0xe61299c
y.create.l HWIO_PMIC_ARB_OBS1_CHNL84_RDATA1_ADDR A:0xe612a1c
y.create.l HWIO_PMIC_ARB_OBS1_CHNL85_RDATA1_ADDR A:0xe612a9c
y.create.l HWIO_PMIC_ARB_OBS1_CHNL86_RDATA1_ADDR A:0xe612b1c
y.create.l HWIO_PMIC_ARB_OBS1_CHNL87_RDATA1_ADDR A:0xe612b9c
y.create.l HWIO_PMIC_ARB_OBS1_CHNL88_RDATA1_ADDR A:0xe612c1c
y.create.l HWIO_PMIC_ARB_OBS1_CHNL89_RDATA1_ADDR A:0xe612c9c
y.create.l HWIO_PMIC_ARB_OBS1_CHNL90_RDATA1_ADDR A:0xe612d1c
y.create.l HWIO_PMIC_ARB_OBS1_CHNL91_RDATA1_ADDR A:0xe612d9c
y.create.l HWIO_PMIC_ARB_OBS1_CHNL92_RDATA1_ADDR A:0xe612e1c
y.create.l HWIO_PMIC_ARB_OBS1_CHNL93_RDATA1_ADDR A:0xe612e9c
y.create.l HWIO_PMIC_ARB_OBS1_CHNL94_RDATA1_ADDR A:0xe612f1c
y.create.l HWIO_PMIC_ARB_OBS1_CHNL95_RDATA1_ADDR A:0xe612f9c
y.create.l HWIO_PMIC_ARB_OBS1_CHNL96_RDATA1_ADDR A:0xe61301c
y.create.l HWIO_PMIC_ARB_OBS1_CHNL97_RDATA1_ADDR A:0xe61309c
y.create.l HWIO_PMIC_ARB_OBS1_CHNL98_RDATA1_ADDR A:0xe61311c
y.create.l HWIO_PMIC_ARB_OBS1_CHNL99_RDATA1_ADDR A:0xe61319c
y.create.l HWIO_PMIC_ARB_OBS1_CHNL100_RDATA1_ADDR A:0xe61321c
y.create.l HWIO_PMIC_ARB_OBS1_CHNL101_RDATA1_ADDR A:0xe61329c
y.create.l HWIO_PMIC_ARB_OBS1_CHNL102_RDATA1_ADDR A:0xe61331c
y.create.l HWIO_PMIC_ARB_OBS1_CHNL103_RDATA1_ADDR A:0xe61339c
y.create.l HWIO_PMIC_ARB_OBS1_CHNL104_RDATA1_ADDR A:0xe61341c
y.create.l HWIO_PMIC_ARB_OBS1_CHNL105_RDATA1_ADDR A:0xe61349c
y.create.l HWIO_PMIC_ARB_OBS1_CHNL106_RDATA1_ADDR A:0xe61351c
y.create.l HWIO_PMIC_ARB_OBS1_CHNL107_RDATA1_ADDR A:0xe61359c
y.create.l HWIO_PMIC_ARB_OBS1_CHNL108_RDATA1_ADDR A:0xe61361c
y.create.l HWIO_PMIC_ARB_OBS1_CHNL109_RDATA1_ADDR A:0xe61369c
y.create.l HWIO_PMIC_ARB_OBS1_CHNL110_RDATA1_ADDR A:0xe61371c
y.create.l HWIO_PMIC_ARB_OBS1_CHNL111_RDATA1_ADDR A:0xe61379c
y.create.l HWIO_PMIC_ARB_OBS1_CHNL112_RDATA1_ADDR A:0xe61381c
y.create.l HWIO_PMIC_ARB_OBS1_CHNL113_RDATA1_ADDR A:0xe61389c
y.create.l HWIO_PMIC_ARB_OBS1_CHNL114_RDATA1_ADDR A:0xe61391c
y.create.l HWIO_PMIC_ARB_OBS1_CHNL115_RDATA1_ADDR A:0xe61399c
y.create.l HWIO_PMIC_ARB_OBS1_CHNL116_RDATA1_ADDR A:0xe613a1c
y.create.l HWIO_PMIC_ARB_OBS1_CHNL117_RDATA1_ADDR A:0xe613a9c
y.create.l HWIO_PMIC_ARB_OBS1_CHNL118_RDATA1_ADDR A:0xe613b1c
y.create.l HWIO_PMIC_ARB_OBS1_CHNL119_RDATA1_ADDR A:0xe613b9c
y.create.l HWIO_PMIC_ARB_OBS1_CHNL120_RDATA1_ADDR A:0xe613c1c
y.create.l HWIO_PMIC_ARB_OBS1_CHNL121_RDATA1_ADDR A:0xe613c9c
y.create.l HWIO_PMIC_ARB_OBS1_CHNL122_RDATA1_ADDR A:0xe613d1c
y.create.l HWIO_PMIC_ARB_OBS1_CHNL123_RDATA1_ADDR A:0xe613d9c
y.create.l HWIO_PMIC_ARB_OBS1_CHNL124_RDATA1_ADDR A:0xe613e1c
y.create.l HWIO_PMIC_ARB_OBS1_CHNL125_RDATA1_ADDR A:0xe613e9c
y.create.l HWIO_PMIC_ARB_OBS1_CHNL126_RDATA1_ADDR A:0xe613f1c
y.create.l HWIO_PMIC_ARB_OBS1_CHNL127_RDATA1_ADDR A:0xe613f9c
y.create.l HWIO_PMIC_ARB_OBS1_CHNL128_RDATA1_ADDR A:0xe61401c
y.create.l HWIO_PMIC_ARB_OBS1_CHNL129_RDATA1_ADDR A:0xe61409c
y.create.l HWIO_PMIC_ARB_OBS1_CHNL130_RDATA1_ADDR A:0xe61411c
y.create.l HWIO_PMIC_ARB_OBS1_CHNL131_RDATA1_ADDR A:0xe61419c
y.create.l HWIO_PMIC_ARB_OBS1_CHNL132_RDATA1_ADDR A:0xe61421c
y.create.l HWIO_PMIC_ARB_OBS1_CHNL133_RDATA1_ADDR A:0xe61429c
y.create.l HWIO_PMIC_ARB_OBS1_CHNL134_RDATA1_ADDR A:0xe61431c
y.create.l HWIO_PMIC_ARB_OBS1_CHNL135_RDATA1_ADDR A:0xe61439c
y.create.l HWIO_PMIC_ARB_OBS1_CHNL136_RDATA1_ADDR A:0xe61441c
y.create.l HWIO_PMIC_ARB_OBS1_CHNL137_RDATA1_ADDR A:0xe61449c
y.create.l HWIO_PMIC_ARB_OBS1_CHNL138_RDATA1_ADDR A:0xe61451c
y.create.l HWIO_PMIC_ARB_OBS1_CHNL139_RDATA1_ADDR A:0xe61459c
y.create.l HWIO_PMIC_ARB_OBS1_CHNL140_RDATA1_ADDR A:0xe61461c
y.create.l HWIO_PMIC_ARB_OBS1_CHNL141_RDATA1_ADDR A:0xe61469c
y.create.l HWIO_PMIC_ARB_OBS1_CHNL142_RDATA1_ADDR A:0xe61471c
y.create.l HWIO_PMIC_ARB_OBS1_CHNL143_RDATA1_ADDR A:0xe61479c
y.create.l HWIO_PMIC_ARB_OBS1_CHNL144_RDATA1_ADDR A:0xe61481c
y.create.l HWIO_PMIC_ARB_OBS1_CHNL145_RDATA1_ADDR A:0xe61489c
y.create.l HWIO_PMIC_ARB_OBS1_CHNL146_RDATA1_ADDR A:0xe61491c
y.create.l HWIO_PMIC_ARB_OBS1_CHNL147_RDATA1_ADDR A:0xe61499c
y.create.l HWIO_PMIC_ARB_OBS1_CHNL148_RDATA1_ADDR A:0xe614a1c
y.create.l HWIO_PMIC_ARB_OBS1_CHNL149_RDATA1_ADDR A:0xe614a9c
y.create.l HWIO_PMIC_ARB_OBS1_CHNL150_RDATA1_ADDR A:0xe614b1c
y.create.l HWIO_PMIC_ARB_OBS1_CHNL151_RDATA1_ADDR A:0xe614b9c
y.create.l HWIO_PMIC_ARB_OBS1_CHNL152_RDATA1_ADDR A:0xe614c1c
y.create.l HWIO_PMIC_ARB_OBS1_CHNL153_RDATA1_ADDR A:0xe614c9c
y.create.l HWIO_PMIC_ARB_OBS1_CHNL154_RDATA1_ADDR A:0xe614d1c
y.create.l HWIO_PMIC_ARB_OBS1_CHNL155_RDATA1_ADDR A:0xe614d9c
y.create.l HWIO_PMIC_ARB_OBS1_CHNL156_RDATA1_ADDR A:0xe614e1c
y.create.l HWIO_PMIC_ARB_OBS1_CHNL157_RDATA1_ADDR A:0xe614e9c
y.create.l HWIO_PMIC_ARB_OBS1_CHNL158_RDATA1_ADDR A:0xe614f1c
y.create.l HWIO_PMIC_ARB_OBS1_CHNL159_RDATA1_ADDR A:0xe614f9c
y.create.l HWIO_PMIC_ARB_OBS1_CHNL160_RDATA1_ADDR A:0xe61501c
y.create.l HWIO_PMIC_ARB_OBS1_CHNL161_RDATA1_ADDR A:0xe61509c
y.create.l HWIO_PMIC_ARB_OBS1_CHNL162_RDATA1_ADDR A:0xe61511c
y.create.l HWIO_PMIC_ARB_OBS1_CHNL163_RDATA1_ADDR A:0xe61519c
y.create.l HWIO_PMIC_ARB_OBS1_CHNL164_RDATA1_ADDR A:0xe61521c
y.create.l HWIO_PMIC_ARB_OBS1_CHNL165_RDATA1_ADDR A:0xe61529c
y.create.l HWIO_PMIC_ARB_OBS1_CHNL166_RDATA1_ADDR A:0xe61531c
y.create.l HWIO_PMIC_ARB_OBS1_CHNL167_RDATA1_ADDR A:0xe61539c
y.create.l HWIO_PMIC_ARB_OBS1_CHNL168_RDATA1_ADDR A:0xe61541c
y.create.l HWIO_PMIC_ARB_OBS1_CHNL169_RDATA1_ADDR A:0xe61549c
y.create.l HWIO_PMIC_ARB_OBS1_CHNL170_RDATA1_ADDR A:0xe61551c
y.create.l HWIO_PMIC_ARB_OBS1_CHNL171_RDATA1_ADDR A:0xe61559c
y.create.l HWIO_PMIC_ARB_OBS1_CHNL172_RDATA1_ADDR A:0xe61561c
y.create.l HWIO_PMIC_ARB_OBS1_CHNL173_RDATA1_ADDR A:0xe61569c
y.create.l HWIO_PMIC_ARB_OBS1_CHNL174_RDATA1_ADDR A:0xe61571c
y.create.l HWIO_PMIC_ARB_OBS1_CHNL175_RDATA1_ADDR A:0xe61579c
y.create.l HWIO_PMIC_ARB_OBS1_CHNL176_RDATA1_ADDR A:0xe61581c
y.create.l HWIO_PMIC_ARB_OBS1_CHNL177_RDATA1_ADDR A:0xe61589c
y.create.l HWIO_PMIC_ARB_OBS1_CHNL178_RDATA1_ADDR A:0xe61591c
y.create.l HWIO_PMIC_ARB_OBS1_CHNL179_RDATA1_ADDR A:0xe61599c
y.create.l HWIO_PMIC_ARB_OBS1_CHNL180_RDATA1_ADDR A:0xe615a1c
y.create.l HWIO_PMIC_ARB_OBS1_CHNL181_RDATA1_ADDR A:0xe615a9c
y.create.l HWIO_PMIC_ARB_OBS1_CHNL182_RDATA1_ADDR A:0xe615b1c
y.create.l HWIO_PMIC_ARB_OBS1_CHNL183_RDATA1_ADDR A:0xe615b9c
y.create.l HWIO_PMIC_ARB_OBS1_CHNL184_RDATA1_ADDR A:0xe615c1c
y.create.l HWIO_PMIC_ARB_OBS1_CHNL185_RDATA1_ADDR A:0xe615c9c
y.create.l HWIO_PMIC_ARB_OBS1_CHNL186_RDATA1_ADDR A:0xe615d1c
y.create.l HWIO_PMIC_ARB_OBS1_CHNL187_RDATA1_ADDR A:0xe615d9c
y.create.l HWIO_PMIC_ARB_OBS1_CHNL188_RDATA1_ADDR A:0xe615e1c
y.create.l HWIO_PMIC_ARB_OBS1_CHNL189_RDATA1_ADDR A:0xe615e9c
y.create.l HWIO_PMIC_ARB_OBS1_CHNL190_RDATA1_ADDR A:0xe615f1c
y.create.l HWIO_PMIC_ARB_OBS1_CHNL191_RDATA1_ADDR A:0xe615f9c
y.create.l HWIO_PMIC_ARB_OBS1_CHNL192_RDATA1_ADDR A:0xe61601c
y.create.l HWIO_PMIC_ARB_OBS1_CHNL193_RDATA1_ADDR A:0xe61609c
y.create.l HWIO_PMIC_ARB_OBS1_CHNL194_RDATA1_ADDR A:0xe61611c
y.create.l HWIO_PMIC_ARB_OBS1_CHNL195_RDATA1_ADDR A:0xe61619c
y.create.l HWIO_PMIC_ARB_OBS1_CHNL196_RDATA1_ADDR A:0xe61621c
y.create.l HWIO_PMIC_ARB_OBS1_CHNL197_RDATA1_ADDR A:0xe61629c
y.create.l HWIO_PMIC_ARB_OBS1_CHNL198_RDATA1_ADDR A:0xe61631c
y.create.l HWIO_PMIC_ARB_OBS1_CHNL199_RDATA1_ADDR A:0xe61639c
y.create.l HWIO_PMIC_ARB_OBS1_CHNL200_RDATA1_ADDR A:0xe61641c
y.create.l HWIO_PMIC_ARB_OBS1_CHNL201_RDATA1_ADDR A:0xe61649c
y.create.l HWIO_PMIC_ARB_OBS1_CHNL202_RDATA1_ADDR A:0xe61651c
y.create.l HWIO_PMIC_ARB_OBS1_CHNL203_RDATA1_ADDR A:0xe61659c
y.create.l HWIO_PMIC_ARB_OBS1_CHNL204_RDATA1_ADDR A:0xe61661c
y.create.l HWIO_PMIC_ARB_OBS1_CHNL205_RDATA1_ADDR A:0xe61669c
y.create.l HWIO_PMIC_ARB_OBS1_CHNL206_RDATA1_ADDR A:0xe61671c
y.create.l HWIO_PMIC_ARB_OBS1_CHNL207_RDATA1_ADDR A:0xe61679c
y.create.l HWIO_PMIC_ARB_OBS1_CHNL208_RDATA1_ADDR A:0xe61681c
y.create.l HWIO_PMIC_ARB_OBS1_CHNL209_RDATA1_ADDR A:0xe61689c
y.create.l HWIO_PMIC_ARB_OBS1_CHNL210_RDATA1_ADDR A:0xe61691c
y.create.l HWIO_PMIC_ARB_OBS1_CHNL211_RDATA1_ADDR A:0xe61699c
y.create.l HWIO_PMIC_ARB_OBS1_CHNL212_RDATA1_ADDR A:0xe616a1c
y.create.l HWIO_PMIC_ARB_OBS1_CHNL213_RDATA1_ADDR A:0xe616a9c
y.create.l HWIO_PMIC_ARB_OBS1_CHNL214_RDATA1_ADDR A:0xe616b1c
y.create.l HWIO_PMIC_ARB_OBS1_CHNL215_RDATA1_ADDR A:0xe616b9c
y.create.l HWIO_PMIC_ARB_OBS1_CHNL216_RDATA1_ADDR A:0xe616c1c
y.create.l HWIO_PMIC_ARB_OBS1_CHNL217_RDATA1_ADDR A:0xe616c9c
y.create.l HWIO_PMIC_ARB_OBS1_CHNL218_RDATA1_ADDR A:0xe616d1c
y.create.l HWIO_PMIC_ARB_OBS1_CHNL219_RDATA1_ADDR A:0xe616d9c
y.create.l HWIO_PMIC_ARB_OBS1_CHNL220_RDATA1_ADDR A:0xe616e1c
y.create.l HWIO_PMIC_ARB_OBS1_CHNL221_RDATA1_ADDR A:0xe616e9c
y.create.l HWIO_PMIC_ARB_OBS1_CHNL222_RDATA1_ADDR A:0xe616f1c
y.create.l HWIO_PMIC_ARB_OBS1_CHNL223_RDATA1_ADDR A:0xe616f9c
y.create.l HWIO_PMIC_ARB_OBS1_CHNL224_RDATA1_ADDR A:0xe61701c
y.create.l HWIO_PMIC_ARB_OBS1_CHNL225_RDATA1_ADDR A:0xe61709c
y.create.l HWIO_PMIC_ARB_OBS1_CHNL226_RDATA1_ADDR A:0xe61711c
y.create.l HWIO_PMIC_ARB_OBS1_CHNL227_RDATA1_ADDR A:0xe61719c
y.create.l HWIO_PMIC_ARB_OBS1_CHNL228_RDATA1_ADDR A:0xe61721c
y.create.l HWIO_PMIC_ARB_OBS1_CHNL229_RDATA1_ADDR A:0xe61729c
y.create.l HWIO_PMIC_ARB_OBS1_CHNL230_RDATA1_ADDR A:0xe61731c
y.create.l HWIO_PMIC_ARB_OBS1_CHNL231_RDATA1_ADDR A:0xe61739c
y.create.l HWIO_PMIC_ARB_OBS1_CHNL232_RDATA1_ADDR A:0xe61741c
y.create.l HWIO_PMIC_ARB_OBS1_CHNL233_RDATA1_ADDR A:0xe61749c
y.create.l HWIO_PMIC_ARB_OBS1_CHNL234_RDATA1_ADDR A:0xe61751c
y.create.l HWIO_PMIC_ARB_OBS1_CHNL235_RDATA1_ADDR A:0xe61759c
y.create.l HWIO_PMIC_ARB_OBS1_CHNL236_RDATA1_ADDR A:0xe61761c
y.create.l HWIO_PMIC_ARB_OBS1_CHNL237_RDATA1_ADDR A:0xe61769c
y.create.l HWIO_PMIC_ARB_OBS1_CHNL238_RDATA1_ADDR A:0xe61771c
y.create.l HWIO_PMIC_ARB_OBS1_CHNL239_RDATA1_ADDR A:0xe61779c
y.create.l HWIO_PMIC_ARB_OBS1_CHNL240_RDATA1_ADDR A:0xe61781c
y.create.l HWIO_PMIC_ARB_OBS1_CHNL241_RDATA1_ADDR A:0xe61789c
y.create.l HWIO_PMIC_ARB_OBS1_CHNL242_RDATA1_ADDR A:0xe61791c
y.create.l HWIO_PMIC_ARB_OBS1_CHNL243_RDATA1_ADDR A:0xe61799c
y.create.l HWIO_PMIC_ARB_OBS1_CHNL244_RDATA1_ADDR A:0xe617a1c
y.create.l HWIO_PMIC_ARB_OBS1_CHNL245_RDATA1_ADDR A:0xe617a9c
y.create.l HWIO_PMIC_ARB_OBS1_CHNL246_RDATA1_ADDR A:0xe617b1c
y.create.l HWIO_PMIC_ARB_OBS1_CHNL247_RDATA1_ADDR A:0xe617b9c
y.create.l HWIO_PMIC_ARB_OBS1_CHNL248_RDATA1_ADDR A:0xe617c1c
y.create.l HWIO_PMIC_ARB_OBS1_CHNL249_RDATA1_ADDR A:0xe617c9c
y.create.l HWIO_PMIC_ARB_OBS1_CHNL250_RDATA1_ADDR A:0xe617d1c
y.create.l HWIO_PMIC_ARB_OBS1_CHNL251_RDATA1_ADDR A:0xe617d9c
y.create.l HWIO_PMIC_ARB_OBS1_CHNL252_RDATA1_ADDR A:0xe617e1c
y.create.l HWIO_PMIC_ARB_OBS1_CHNL253_RDATA1_ADDR A:0xe617e9c
y.create.l HWIO_PMIC_ARB_OBS1_CHNL254_RDATA1_ADDR A:0xe617f1c
y.create.l HWIO_PMIC_ARB_OBS1_CHNL255_RDATA1_ADDR A:0xe617f9c
y.create.l HWIO_PMIC_ARB_OBS2_CHNL0_RDATA1_ADDR A:0xe62001c
y.create.l HWIO_PMIC_ARB_OBS2_CHNL1_RDATA1_ADDR A:0xe62009c
y.create.l HWIO_PMIC_ARB_OBS2_CHNL2_RDATA1_ADDR A:0xe62011c
y.create.l HWIO_PMIC_ARB_OBS2_CHNL3_RDATA1_ADDR A:0xe62019c
y.create.l HWIO_PMIC_ARB_OBS2_CHNL4_RDATA1_ADDR A:0xe62021c
y.create.l HWIO_PMIC_ARB_OBS2_CHNL5_RDATA1_ADDR A:0xe62029c
y.create.l HWIO_PMIC_ARB_OBS2_CHNL6_RDATA1_ADDR A:0xe62031c
y.create.l HWIO_PMIC_ARB_OBS2_CHNL7_RDATA1_ADDR A:0xe62039c
y.create.l HWIO_PMIC_ARB_OBS2_CHNL8_RDATA1_ADDR A:0xe62041c
y.create.l HWIO_PMIC_ARB_OBS2_CHNL9_RDATA1_ADDR A:0xe62049c
y.create.l HWIO_PMIC_ARB_OBS2_CHNL10_RDATA1_ADDR A:0xe62051c
y.create.l HWIO_PMIC_ARB_OBS2_CHNL11_RDATA1_ADDR A:0xe62059c
y.create.l HWIO_PMIC_ARB_OBS2_CHNL12_RDATA1_ADDR A:0xe62061c
y.create.l HWIO_PMIC_ARB_OBS2_CHNL13_RDATA1_ADDR A:0xe62069c
y.create.l HWIO_PMIC_ARB_OBS2_CHNL14_RDATA1_ADDR A:0xe62071c
y.create.l HWIO_PMIC_ARB_OBS2_CHNL15_RDATA1_ADDR A:0xe62079c
y.create.l HWIO_PMIC_ARB_OBS2_CHNL16_RDATA1_ADDR A:0xe62081c
y.create.l HWIO_PMIC_ARB_OBS2_CHNL17_RDATA1_ADDR A:0xe62089c
y.create.l HWIO_PMIC_ARB_OBS2_CHNL18_RDATA1_ADDR A:0xe62091c
y.create.l HWIO_PMIC_ARB_OBS2_CHNL19_RDATA1_ADDR A:0xe62099c
y.create.l HWIO_PMIC_ARB_OBS2_CHNL20_RDATA1_ADDR A:0xe620a1c
y.create.l HWIO_PMIC_ARB_OBS2_CHNL21_RDATA1_ADDR A:0xe620a9c
y.create.l HWIO_PMIC_ARB_OBS2_CHNL22_RDATA1_ADDR A:0xe620b1c
y.create.l HWIO_PMIC_ARB_OBS2_CHNL23_RDATA1_ADDR A:0xe620b9c
y.create.l HWIO_PMIC_ARB_OBS2_CHNL24_RDATA1_ADDR A:0xe620c1c
y.create.l HWIO_PMIC_ARB_OBS2_CHNL25_RDATA1_ADDR A:0xe620c9c
y.create.l HWIO_PMIC_ARB_OBS2_CHNL26_RDATA1_ADDR A:0xe620d1c
y.create.l HWIO_PMIC_ARB_OBS2_CHNL27_RDATA1_ADDR A:0xe620d9c
y.create.l HWIO_PMIC_ARB_OBS2_CHNL28_RDATA1_ADDR A:0xe620e1c
y.create.l HWIO_PMIC_ARB_OBS2_CHNL29_RDATA1_ADDR A:0xe620e9c
y.create.l HWIO_PMIC_ARB_OBS2_CHNL30_RDATA1_ADDR A:0xe620f1c
y.create.l HWIO_PMIC_ARB_OBS2_CHNL31_RDATA1_ADDR A:0xe620f9c
y.create.l HWIO_PMIC_ARB_OBS2_CHNL32_RDATA1_ADDR A:0xe62101c
y.create.l HWIO_PMIC_ARB_OBS2_CHNL33_RDATA1_ADDR A:0xe62109c
y.create.l HWIO_PMIC_ARB_OBS2_CHNL34_RDATA1_ADDR A:0xe62111c
y.create.l HWIO_PMIC_ARB_OBS2_CHNL35_RDATA1_ADDR A:0xe62119c
y.create.l HWIO_PMIC_ARB_OBS2_CHNL36_RDATA1_ADDR A:0xe62121c
y.create.l HWIO_PMIC_ARB_OBS2_CHNL37_RDATA1_ADDR A:0xe62129c
y.create.l HWIO_PMIC_ARB_OBS2_CHNL38_RDATA1_ADDR A:0xe62131c
y.create.l HWIO_PMIC_ARB_OBS2_CHNL39_RDATA1_ADDR A:0xe62139c
y.create.l HWIO_PMIC_ARB_OBS2_CHNL40_RDATA1_ADDR A:0xe62141c
y.create.l HWIO_PMIC_ARB_OBS2_CHNL41_RDATA1_ADDR A:0xe62149c
y.create.l HWIO_PMIC_ARB_OBS2_CHNL42_RDATA1_ADDR A:0xe62151c
y.create.l HWIO_PMIC_ARB_OBS2_CHNL43_RDATA1_ADDR A:0xe62159c
y.create.l HWIO_PMIC_ARB_OBS2_CHNL44_RDATA1_ADDR A:0xe62161c
y.create.l HWIO_PMIC_ARB_OBS2_CHNL45_RDATA1_ADDR A:0xe62169c
y.create.l HWIO_PMIC_ARB_OBS2_CHNL46_RDATA1_ADDR A:0xe62171c
y.create.l HWIO_PMIC_ARB_OBS2_CHNL47_RDATA1_ADDR A:0xe62179c
y.create.l HWIO_PMIC_ARB_OBS2_CHNL48_RDATA1_ADDR A:0xe62181c
y.create.l HWIO_PMIC_ARB_OBS2_CHNL49_RDATA1_ADDR A:0xe62189c
y.create.l HWIO_PMIC_ARB_OBS2_CHNL50_RDATA1_ADDR A:0xe62191c
y.create.l HWIO_PMIC_ARB_OBS2_CHNL51_RDATA1_ADDR A:0xe62199c
y.create.l HWIO_PMIC_ARB_OBS2_CHNL52_RDATA1_ADDR A:0xe621a1c
y.create.l HWIO_PMIC_ARB_OBS2_CHNL53_RDATA1_ADDR A:0xe621a9c
y.create.l HWIO_PMIC_ARB_OBS2_CHNL54_RDATA1_ADDR A:0xe621b1c
y.create.l HWIO_PMIC_ARB_OBS2_CHNL55_RDATA1_ADDR A:0xe621b9c
y.create.l HWIO_PMIC_ARB_OBS2_CHNL56_RDATA1_ADDR A:0xe621c1c
y.create.l HWIO_PMIC_ARB_OBS2_CHNL57_RDATA1_ADDR A:0xe621c9c
y.create.l HWIO_PMIC_ARB_OBS2_CHNL58_RDATA1_ADDR A:0xe621d1c
y.create.l HWIO_PMIC_ARB_OBS2_CHNL59_RDATA1_ADDR A:0xe621d9c
y.create.l HWIO_PMIC_ARB_OBS2_CHNL60_RDATA1_ADDR A:0xe621e1c
y.create.l HWIO_PMIC_ARB_OBS2_CHNL61_RDATA1_ADDR A:0xe621e9c
y.create.l HWIO_PMIC_ARB_OBS2_CHNL62_RDATA1_ADDR A:0xe621f1c
y.create.l HWIO_PMIC_ARB_OBS2_CHNL63_RDATA1_ADDR A:0xe621f9c
y.create.l HWIO_PMIC_ARB_OBS2_CHNL64_RDATA1_ADDR A:0xe62201c
y.create.l HWIO_PMIC_ARB_OBS2_CHNL65_RDATA1_ADDR A:0xe62209c
y.create.l HWIO_PMIC_ARB_OBS2_CHNL66_RDATA1_ADDR A:0xe62211c
y.create.l HWIO_PMIC_ARB_OBS2_CHNL67_RDATA1_ADDR A:0xe62219c
y.create.l HWIO_PMIC_ARB_OBS2_CHNL68_RDATA1_ADDR A:0xe62221c
y.create.l HWIO_PMIC_ARB_OBS2_CHNL69_RDATA1_ADDR A:0xe62229c
y.create.l HWIO_PMIC_ARB_OBS2_CHNL70_RDATA1_ADDR A:0xe62231c
y.create.l HWIO_PMIC_ARB_OBS2_CHNL71_RDATA1_ADDR A:0xe62239c
y.create.l HWIO_PMIC_ARB_OBS2_CHNL72_RDATA1_ADDR A:0xe62241c
y.create.l HWIO_PMIC_ARB_OBS2_CHNL73_RDATA1_ADDR A:0xe62249c
y.create.l HWIO_PMIC_ARB_OBS2_CHNL74_RDATA1_ADDR A:0xe62251c
y.create.l HWIO_PMIC_ARB_OBS2_CHNL75_RDATA1_ADDR A:0xe62259c
y.create.l HWIO_PMIC_ARB_OBS2_CHNL76_RDATA1_ADDR A:0xe62261c
y.create.l HWIO_PMIC_ARB_OBS2_CHNL77_RDATA1_ADDR A:0xe62269c
y.create.l HWIO_PMIC_ARB_OBS2_CHNL78_RDATA1_ADDR A:0xe62271c
y.create.l HWIO_PMIC_ARB_OBS2_CHNL79_RDATA1_ADDR A:0xe62279c
y.create.l HWIO_PMIC_ARB_OBS2_CHNL80_RDATA1_ADDR A:0xe62281c
y.create.l HWIO_PMIC_ARB_OBS2_CHNL81_RDATA1_ADDR A:0xe62289c
y.create.l HWIO_PMIC_ARB_OBS2_CHNL82_RDATA1_ADDR A:0xe62291c
y.create.l HWIO_PMIC_ARB_OBS2_CHNL83_RDATA1_ADDR A:0xe62299c
y.create.l HWIO_PMIC_ARB_OBS2_CHNL84_RDATA1_ADDR A:0xe622a1c
y.create.l HWIO_PMIC_ARB_OBS2_CHNL85_RDATA1_ADDR A:0xe622a9c
y.create.l HWIO_PMIC_ARB_OBS2_CHNL86_RDATA1_ADDR A:0xe622b1c
y.create.l HWIO_PMIC_ARB_OBS2_CHNL87_RDATA1_ADDR A:0xe622b9c
y.create.l HWIO_PMIC_ARB_OBS2_CHNL88_RDATA1_ADDR A:0xe622c1c
y.create.l HWIO_PMIC_ARB_OBS2_CHNL89_RDATA1_ADDR A:0xe622c9c
y.create.l HWIO_PMIC_ARB_OBS2_CHNL90_RDATA1_ADDR A:0xe622d1c
y.create.l HWIO_PMIC_ARB_OBS2_CHNL91_RDATA1_ADDR A:0xe622d9c
y.create.l HWIO_PMIC_ARB_OBS2_CHNL92_RDATA1_ADDR A:0xe622e1c
y.create.l HWIO_PMIC_ARB_OBS2_CHNL93_RDATA1_ADDR A:0xe622e9c
y.create.l HWIO_PMIC_ARB_OBS2_CHNL94_RDATA1_ADDR A:0xe622f1c
y.create.l HWIO_PMIC_ARB_OBS2_CHNL95_RDATA1_ADDR A:0xe622f9c
y.create.l HWIO_PMIC_ARB_OBS2_CHNL96_RDATA1_ADDR A:0xe62301c
y.create.l HWIO_PMIC_ARB_OBS2_CHNL97_RDATA1_ADDR A:0xe62309c
y.create.l HWIO_PMIC_ARB_OBS2_CHNL98_RDATA1_ADDR A:0xe62311c
y.create.l HWIO_PMIC_ARB_OBS2_CHNL99_RDATA1_ADDR A:0xe62319c
y.create.l HWIO_PMIC_ARB_OBS2_CHNL100_RDATA1_ADDR A:0xe62321c
y.create.l HWIO_PMIC_ARB_OBS2_CHNL101_RDATA1_ADDR A:0xe62329c
y.create.l HWIO_PMIC_ARB_OBS2_CHNL102_RDATA1_ADDR A:0xe62331c
y.create.l HWIO_PMIC_ARB_OBS2_CHNL103_RDATA1_ADDR A:0xe62339c
y.create.l HWIO_PMIC_ARB_OBS2_CHNL104_RDATA1_ADDR A:0xe62341c
y.create.l HWIO_PMIC_ARB_OBS2_CHNL105_RDATA1_ADDR A:0xe62349c
y.create.l HWIO_PMIC_ARB_OBS2_CHNL106_RDATA1_ADDR A:0xe62351c
y.create.l HWIO_PMIC_ARB_OBS2_CHNL107_RDATA1_ADDR A:0xe62359c
y.create.l HWIO_PMIC_ARB_OBS2_CHNL108_RDATA1_ADDR A:0xe62361c
y.create.l HWIO_PMIC_ARB_OBS2_CHNL109_RDATA1_ADDR A:0xe62369c
y.create.l HWIO_PMIC_ARB_OBS2_CHNL110_RDATA1_ADDR A:0xe62371c
y.create.l HWIO_PMIC_ARB_OBS2_CHNL111_RDATA1_ADDR A:0xe62379c
y.create.l HWIO_PMIC_ARB_OBS2_CHNL112_RDATA1_ADDR A:0xe62381c
y.create.l HWIO_PMIC_ARB_OBS2_CHNL113_RDATA1_ADDR A:0xe62389c
y.create.l HWIO_PMIC_ARB_OBS2_CHNL114_RDATA1_ADDR A:0xe62391c
y.create.l HWIO_PMIC_ARB_OBS2_CHNL115_RDATA1_ADDR A:0xe62399c
y.create.l HWIO_PMIC_ARB_OBS2_CHNL116_RDATA1_ADDR A:0xe623a1c
y.create.l HWIO_PMIC_ARB_OBS2_CHNL117_RDATA1_ADDR A:0xe623a9c
y.create.l HWIO_PMIC_ARB_OBS2_CHNL118_RDATA1_ADDR A:0xe623b1c
y.create.l HWIO_PMIC_ARB_OBS2_CHNL119_RDATA1_ADDR A:0xe623b9c
y.create.l HWIO_PMIC_ARB_OBS2_CHNL120_RDATA1_ADDR A:0xe623c1c
y.create.l HWIO_PMIC_ARB_OBS2_CHNL121_RDATA1_ADDR A:0xe623c9c
y.create.l HWIO_PMIC_ARB_OBS2_CHNL122_RDATA1_ADDR A:0xe623d1c
y.create.l HWIO_PMIC_ARB_OBS2_CHNL123_RDATA1_ADDR A:0xe623d9c
y.create.l HWIO_PMIC_ARB_OBS2_CHNL124_RDATA1_ADDR A:0xe623e1c
y.create.l HWIO_PMIC_ARB_OBS2_CHNL125_RDATA1_ADDR A:0xe623e9c
y.create.l HWIO_PMIC_ARB_OBS2_CHNL126_RDATA1_ADDR A:0xe623f1c
y.create.l HWIO_PMIC_ARB_OBS2_CHNL127_RDATA1_ADDR A:0xe623f9c
y.create.l HWIO_PMIC_ARB_OBS2_CHNL128_RDATA1_ADDR A:0xe62401c
y.create.l HWIO_PMIC_ARB_OBS2_CHNL129_RDATA1_ADDR A:0xe62409c
y.create.l HWIO_PMIC_ARB_OBS2_CHNL130_RDATA1_ADDR A:0xe62411c
y.create.l HWIO_PMIC_ARB_OBS2_CHNL131_RDATA1_ADDR A:0xe62419c
y.create.l HWIO_PMIC_ARB_OBS2_CHNL132_RDATA1_ADDR A:0xe62421c
y.create.l HWIO_PMIC_ARB_OBS2_CHNL133_RDATA1_ADDR A:0xe62429c
y.create.l HWIO_PMIC_ARB_OBS2_CHNL134_RDATA1_ADDR A:0xe62431c
y.create.l HWIO_PMIC_ARB_OBS2_CHNL135_RDATA1_ADDR A:0xe62439c
y.create.l HWIO_PMIC_ARB_OBS2_CHNL136_RDATA1_ADDR A:0xe62441c
y.create.l HWIO_PMIC_ARB_OBS2_CHNL137_RDATA1_ADDR A:0xe62449c
y.create.l HWIO_PMIC_ARB_OBS2_CHNL138_RDATA1_ADDR A:0xe62451c
y.create.l HWIO_PMIC_ARB_OBS2_CHNL139_RDATA1_ADDR A:0xe62459c
y.create.l HWIO_PMIC_ARB_OBS2_CHNL140_RDATA1_ADDR A:0xe62461c
y.create.l HWIO_PMIC_ARB_OBS2_CHNL141_RDATA1_ADDR A:0xe62469c
y.create.l HWIO_PMIC_ARB_OBS2_CHNL142_RDATA1_ADDR A:0xe62471c
y.create.l HWIO_PMIC_ARB_OBS2_CHNL143_RDATA1_ADDR A:0xe62479c
y.create.l HWIO_PMIC_ARB_OBS2_CHNL144_RDATA1_ADDR A:0xe62481c
y.create.l HWIO_PMIC_ARB_OBS2_CHNL145_RDATA1_ADDR A:0xe62489c
y.create.l HWIO_PMIC_ARB_OBS2_CHNL146_RDATA1_ADDR A:0xe62491c
y.create.l HWIO_PMIC_ARB_OBS2_CHNL147_RDATA1_ADDR A:0xe62499c
y.create.l HWIO_PMIC_ARB_OBS2_CHNL148_RDATA1_ADDR A:0xe624a1c
y.create.l HWIO_PMIC_ARB_OBS2_CHNL149_RDATA1_ADDR A:0xe624a9c
y.create.l HWIO_PMIC_ARB_OBS2_CHNL150_RDATA1_ADDR A:0xe624b1c
y.create.l HWIO_PMIC_ARB_OBS2_CHNL151_RDATA1_ADDR A:0xe624b9c
y.create.l HWIO_PMIC_ARB_OBS2_CHNL152_RDATA1_ADDR A:0xe624c1c
y.create.l HWIO_PMIC_ARB_OBS2_CHNL153_RDATA1_ADDR A:0xe624c9c
y.create.l HWIO_PMIC_ARB_OBS2_CHNL154_RDATA1_ADDR A:0xe624d1c
y.create.l HWIO_PMIC_ARB_OBS2_CHNL155_RDATA1_ADDR A:0xe624d9c
y.create.l HWIO_PMIC_ARB_OBS2_CHNL156_RDATA1_ADDR A:0xe624e1c
y.create.l HWIO_PMIC_ARB_OBS2_CHNL157_RDATA1_ADDR A:0xe624e9c
y.create.l HWIO_PMIC_ARB_OBS2_CHNL158_RDATA1_ADDR A:0xe624f1c
y.create.l HWIO_PMIC_ARB_OBS2_CHNL159_RDATA1_ADDR A:0xe624f9c
y.create.l HWIO_PMIC_ARB_OBS2_CHNL160_RDATA1_ADDR A:0xe62501c
y.create.l HWIO_PMIC_ARB_OBS2_CHNL161_RDATA1_ADDR A:0xe62509c
y.create.l HWIO_PMIC_ARB_OBS2_CHNL162_RDATA1_ADDR A:0xe62511c
y.create.l HWIO_PMIC_ARB_OBS2_CHNL163_RDATA1_ADDR A:0xe62519c
y.create.l HWIO_PMIC_ARB_OBS2_CHNL164_RDATA1_ADDR A:0xe62521c
y.create.l HWIO_PMIC_ARB_OBS2_CHNL165_RDATA1_ADDR A:0xe62529c
y.create.l HWIO_PMIC_ARB_OBS2_CHNL166_RDATA1_ADDR A:0xe62531c
y.create.l HWIO_PMIC_ARB_OBS2_CHNL167_RDATA1_ADDR A:0xe62539c
y.create.l HWIO_PMIC_ARB_OBS2_CHNL168_RDATA1_ADDR A:0xe62541c
y.create.l HWIO_PMIC_ARB_OBS2_CHNL169_RDATA1_ADDR A:0xe62549c
y.create.l HWIO_PMIC_ARB_OBS2_CHNL170_RDATA1_ADDR A:0xe62551c
y.create.l HWIO_PMIC_ARB_OBS2_CHNL171_RDATA1_ADDR A:0xe62559c
y.create.l HWIO_PMIC_ARB_OBS2_CHNL172_RDATA1_ADDR A:0xe62561c
y.create.l HWIO_PMIC_ARB_OBS2_CHNL173_RDATA1_ADDR A:0xe62569c
y.create.l HWIO_PMIC_ARB_OBS2_CHNL174_RDATA1_ADDR A:0xe62571c
y.create.l HWIO_PMIC_ARB_OBS2_CHNL175_RDATA1_ADDR A:0xe62579c
y.create.l HWIO_PMIC_ARB_OBS2_CHNL176_RDATA1_ADDR A:0xe62581c
y.create.l HWIO_PMIC_ARB_OBS2_CHNL177_RDATA1_ADDR A:0xe62589c
y.create.l HWIO_PMIC_ARB_OBS2_CHNL178_RDATA1_ADDR A:0xe62591c
y.create.l HWIO_PMIC_ARB_OBS2_CHNL179_RDATA1_ADDR A:0xe62599c
y.create.l HWIO_PMIC_ARB_OBS2_CHNL180_RDATA1_ADDR A:0xe625a1c
y.create.l HWIO_PMIC_ARB_OBS2_CHNL181_RDATA1_ADDR A:0xe625a9c
y.create.l HWIO_PMIC_ARB_OBS2_CHNL182_RDATA1_ADDR A:0xe625b1c
y.create.l HWIO_PMIC_ARB_OBS2_CHNL183_RDATA1_ADDR A:0xe625b9c
y.create.l HWIO_PMIC_ARB_OBS2_CHNL184_RDATA1_ADDR A:0xe625c1c
y.create.l HWIO_PMIC_ARB_OBS2_CHNL185_RDATA1_ADDR A:0xe625c9c
y.create.l HWIO_PMIC_ARB_OBS2_CHNL186_RDATA1_ADDR A:0xe625d1c
y.create.l HWIO_PMIC_ARB_OBS2_CHNL187_RDATA1_ADDR A:0xe625d9c
y.create.l HWIO_PMIC_ARB_OBS2_CHNL188_RDATA1_ADDR A:0xe625e1c
y.create.l HWIO_PMIC_ARB_OBS2_CHNL189_RDATA1_ADDR A:0xe625e9c
y.create.l HWIO_PMIC_ARB_OBS2_CHNL190_RDATA1_ADDR A:0xe625f1c
y.create.l HWIO_PMIC_ARB_OBS2_CHNL191_RDATA1_ADDR A:0xe625f9c
y.create.l HWIO_PMIC_ARB_OBS2_CHNL192_RDATA1_ADDR A:0xe62601c
y.create.l HWIO_PMIC_ARB_OBS2_CHNL193_RDATA1_ADDR A:0xe62609c
y.create.l HWIO_PMIC_ARB_OBS2_CHNL194_RDATA1_ADDR A:0xe62611c
y.create.l HWIO_PMIC_ARB_OBS2_CHNL195_RDATA1_ADDR A:0xe62619c
y.create.l HWIO_PMIC_ARB_OBS2_CHNL196_RDATA1_ADDR A:0xe62621c
y.create.l HWIO_PMIC_ARB_OBS2_CHNL197_RDATA1_ADDR A:0xe62629c
y.create.l HWIO_PMIC_ARB_OBS2_CHNL198_RDATA1_ADDR A:0xe62631c
y.create.l HWIO_PMIC_ARB_OBS2_CHNL199_RDATA1_ADDR A:0xe62639c
y.create.l HWIO_PMIC_ARB_OBS2_CHNL200_RDATA1_ADDR A:0xe62641c
y.create.l HWIO_PMIC_ARB_OBS2_CHNL201_RDATA1_ADDR A:0xe62649c
y.create.l HWIO_PMIC_ARB_OBS2_CHNL202_RDATA1_ADDR A:0xe62651c
y.create.l HWIO_PMIC_ARB_OBS2_CHNL203_RDATA1_ADDR A:0xe62659c
y.create.l HWIO_PMIC_ARB_OBS2_CHNL204_RDATA1_ADDR A:0xe62661c
y.create.l HWIO_PMIC_ARB_OBS2_CHNL205_RDATA1_ADDR A:0xe62669c
y.create.l HWIO_PMIC_ARB_OBS2_CHNL206_RDATA1_ADDR A:0xe62671c
y.create.l HWIO_PMIC_ARB_OBS2_CHNL207_RDATA1_ADDR A:0xe62679c
y.create.l HWIO_PMIC_ARB_OBS2_CHNL208_RDATA1_ADDR A:0xe62681c
y.create.l HWIO_PMIC_ARB_OBS2_CHNL209_RDATA1_ADDR A:0xe62689c
y.create.l HWIO_PMIC_ARB_OBS2_CHNL210_RDATA1_ADDR A:0xe62691c
y.create.l HWIO_PMIC_ARB_OBS2_CHNL211_RDATA1_ADDR A:0xe62699c
y.create.l HWIO_PMIC_ARB_OBS2_CHNL212_RDATA1_ADDR A:0xe626a1c
y.create.l HWIO_PMIC_ARB_OBS2_CHNL213_RDATA1_ADDR A:0xe626a9c
y.create.l HWIO_PMIC_ARB_OBS2_CHNL214_RDATA1_ADDR A:0xe626b1c
y.create.l HWIO_PMIC_ARB_OBS2_CHNL215_RDATA1_ADDR A:0xe626b9c
y.create.l HWIO_PMIC_ARB_OBS2_CHNL216_RDATA1_ADDR A:0xe626c1c
y.create.l HWIO_PMIC_ARB_OBS2_CHNL217_RDATA1_ADDR A:0xe626c9c
y.create.l HWIO_PMIC_ARB_OBS2_CHNL218_RDATA1_ADDR A:0xe626d1c
y.create.l HWIO_PMIC_ARB_OBS2_CHNL219_RDATA1_ADDR A:0xe626d9c
y.create.l HWIO_PMIC_ARB_OBS2_CHNL220_RDATA1_ADDR A:0xe626e1c
y.create.l HWIO_PMIC_ARB_OBS2_CHNL221_RDATA1_ADDR A:0xe626e9c
y.create.l HWIO_PMIC_ARB_OBS2_CHNL222_RDATA1_ADDR A:0xe626f1c
y.create.l HWIO_PMIC_ARB_OBS2_CHNL223_RDATA1_ADDR A:0xe626f9c
y.create.l HWIO_PMIC_ARB_OBS2_CHNL224_RDATA1_ADDR A:0xe62701c
y.create.l HWIO_PMIC_ARB_OBS2_CHNL225_RDATA1_ADDR A:0xe62709c
y.create.l HWIO_PMIC_ARB_OBS2_CHNL226_RDATA1_ADDR A:0xe62711c
y.create.l HWIO_PMIC_ARB_OBS2_CHNL227_RDATA1_ADDR A:0xe62719c
y.create.l HWIO_PMIC_ARB_OBS2_CHNL228_RDATA1_ADDR A:0xe62721c
y.create.l HWIO_PMIC_ARB_OBS2_CHNL229_RDATA1_ADDR A:0xe62729c
y.create.l HWIO_PMIC_ARB_OBS2_CHNL230_RDATA1_ADDR A:0xe62731c
y.create.l HWIO_PMIC_ARB_OBS2_CHNL231_RDATA1_ADDR A:0xe62739c
y.create.l HWIO_PMIC_ARB_OBS2_CHNL232_RDATA1_ADDR A:0xe62741c
y.create.l HWIO_PMIC_ARB_OBS2_CHNL233_RDATA1_ADDR A:0xe62749c
y.create.l HWIO_PMIC_ARB_OBS2_CHNL234_RDATA1_ADDR A:0xe62751c
y.create.l HWIO_PMIC_ARB_OBS2_CHNL235_RDATA1_ADDR A:0xe62759c
y.create.l HWIO_PMIC_ARB_OBS2_CHNL236_RDATA1_ADDR A:0xe62761c
y.create.l HWIO_PMIC_ARB_OBS2_CHNL237_RDATA1_ADDR A:0xe62769c
y.create.l HWIO_PMIC_ARB_OBS2_CHNL238_RDATA1_ADDR A:0xe62771c
y.create.l HWIO_PMIC_ARB_OBS2_CHNL239_RDATA1_ADDR A:0xe62779c
y.create.l HWIO_PMIC_ARB_OBS2_CHNL240_RDATA1_ADDR A:0xe62781c
y.create.l HWIO_PMIC_ARB_OBS2_CHNL241_RDATA1_ADDR A:0xe62789c
y.create.l HWIO_PMIC_ARB_OBS2_CHNL242_RDATA1_ADDR A:0xe62791c
y.create.l HWIO_PMIC_ARB_OBS2_CHNL243_RDATA1_ADDR A:0xe62799c
y.create.l HWIO_PMIC_ARB_OBS2_CHNL244_RDATA1_ADDR A:0xe627a1c
y.create.l HWIO_PMIC_ARB_OBS2_CHNL245_RDATA1_ADDR A:0xe627a9c
y.create.l HWIO_PMIC_ARB_OBS2_CHNL246_RDATA1_ADDR A:0xe627b1c
y.create.l HWIO_PMIC_ARB_OBS2_CHNL247_RDATA1_ADDR A:0xe627b9c
y.create.l HWIO_PMIC_ARB_OBS2_CHNL248_RDATA1_ADDR A:0xe627c1c
y.create.l HWIO_PMIC_ARB_OBS2_CHNL249_RDATA1_ADDR A:0xe627c9c
y.create.l HWIO_PMIC_ARB_OBS2_CHNL250_RDATA1_ADDR A:0xe627d1c
y.create.l HWIO_PMIC_ARB_OBS2_CHNL251_RDATA1_ADDR A:0xe627d9c
y.create.l HWIO_PMIC_ARB_OBS2_CHNL252_RDATA1_ADDR A:0xe627e1c
y.create.l HWIO_PMIC_ARB_OBS2_CHNL253_RDATA1_ADDR A:0xe627e9c
y.create.l HWIO_PMIC_ARB_OBS2_CHNL254_RDATA1_ADDR A:0xe627f1c
y.create.l HWIO_PMIC_ARB_OBS2_CHNL255_RDATA1_ADDR A:0xe627f9c
y.create.l HWIO_PMIC_ARB_OBS3_CHNL0_RDATA1_ADDR A:0xe63001c
y.create.l HWIO_PMIC_ARB_OBS3_CHNL1_RDATA1_ADDR A:0xe63009c
y.create.l HWIO_PMIC_ARB_OBS3_CHNL2_RDATA1_ADDR A:0xe63011c
y.create.l HWIO_PMIC_ARB_OBS3_CHNL3_RDATA1_ADDR A:0xe63019c
y.create.l HWIO_PMIC_ARB_OBS3_CHNL4_RDATA1_ADDR A:0xe63021c
y.create.l HWIO_PMIC_ARB_OBS3_CHNL5_RDATA1_ADDR A:0xe63029c
y.create.l HWIO_PMIC_ARB_OBS3_CHNL6_RDATA1_ADDR A:0xe63031c
y.create.l HWIO_PMIC_ARB_OBS3_CHNL7_RDATA1_ADDR A:0xe63039c
y.create.l HWIO_PMIC_ARB_OBS3_CHNL8_RDATA1_ADDR A:0xe63041c
y.create.l HWIO_PMIC_ARB_OBS3_CHNL9_RDATA1_ADDR A:0xe63049c
y.create.l HWIO_PMIC_ARB_OBS3_CHNL10_RDATA1_ADDR A:0xe63051c
y.create.l HWIO_PMIC_ARB_OBS3_CHNL11_RDATA1_ADDR A:0xe63059c
y.create.l HWIO_PMIC_ARB_OBS3_CHNL12_RDATA1_ADDR A:0xe63061c
y.create.l HWIO_PMIC_ARB_OBS3_CHNL13_RDATA1_ADDR A:0xe63069c
y.create.l HWIO_PMIC_ARB_OBS3_CHNL14_RDATA1_ADDR A:0xe63071c
y.create.l HWIO_PMIC_ARB_OBS3_CHNL15_RDATA1_ADDR A:0xe63079c
y.create.l HWIO_PMIC_ARB_OBS3_CHNL16_RDATA1_ADDR A:0xe63081c
y.create.l HWIO_PMIC_ARB_OBS3_CHNL17_RDATA1_ADDR A:0xe63089c
y.create.l HWIO_PMIC_ARB_OBS3_CHNL18_RDATA1_ADDR A:0xe63091c
y.create.l HWIO_PMIC_ARB_OBS3_CHNL19_RDATA1_ADDR A:0xe63099c
y.create.l HWIO_PMIC_ARB_OBS3_CHNL20_RDATA1_ADDR A:0xe630a1c
y.create.l HWIO_PMIC_ARB_OBS3_CHNL21_RDATA1_ADDR A:0xe630a9c
y.create.l HWIO_PMIC_ARB_OBS3_CHNL22_RDATA1_ADDR A:0xe630b1c
y.create.l HWIO_PMIC_ARB_OBS3_CHNL23_RDATA1_ADDR A:0xe630b9c
y.create.l HWIO_PMIC_ARB_OBS3_CHNL24_RDATA1_ADDR A:0xe630c1c
y.create.l HWIO_PMIC_ARB_OBS3_CHNL25_RDATA1_ADDR A:0xe630c9c
y.create.l HWIO_PMIC_ARB_OBS3_CHNL26_RDATA1_ADDR A:0xe630d1c
y.create.l HWIO_PMIC_ARB_OBS3_CHNL27_RDATA1_ADDR A:0xe630d9c
y.create.l HWIO_PMIC_ARB_OBS3_CHNL28_RDATA1_ADDR A:0xe630e1c
y.create.l HWIO_PMIC_ARB_OBS3_CHNL29_RDATA1_ADDR A:0xe630e9c
y.create.l HWIO_PMIC_ARB_OBS3_CHNL30_RDATA1_ADDR A:0xe630f1c
y.create.l HWIO_PMIC_ARB_OBS3_CHNL31_RDATA1_ADDR A:0xe630f9c
y.create.l HWIO_PMIC_ARB_OBS3_CHNL32_RDATA1_ADDR A:0xe63101c
y.create.l HWIO_PMIC_ARB_OBS3_CHNL33_RDATA1_ADDR A:0xe63109c
y.create.l HWIO_PMIC_ARB_OBS3_CHNL34_RDATA1_ADDR A:0xe63111c
y.create.l HWIO_PMIC_ARB_OBS3_CHNL35_RDATA1_ADDR A:0xe63119c
y.create.l HWIO_PMIC_ARB_OBS3_CHNL36_RDATA1_ADDR A:0xe63121c
y.create.l HWIO_PMIC_ARB_OBS3_CHNL37_RDATA1_ADDR A:0xe63129c
y.create.l HWIO_PMIC_ARB_OBS3_CHNL38_RDATA1_ADDR A:0xe63131c
y.create.l HWIO_PMIC_ARB_OBS3_CHNL39_RDATA1_ADDR A:0xe63139c
y.create.l HWIO_PMIC_ARB_OBS3_CHNL40_RDATA1_ADDR A:0xe63141c
y.create.l HWIO_PMIC_ARB_OBS3_CHNL41_RDATA1_ADDR A:0xe63149c
y.create.l HWIO_PMIC_ARB_OBS3_CHNL42_RDATA1_ADDR A:0xe63151c
y.create.l HWIO_PMIC_ARB_OBS3_CHNL43_RDATA1_ADDR A:0xe63159c
y.create.l HWIO_PMIC_ARB_OBS3_CHNL44_RDATA1_ADDR A:0xe63161c
y.create.l HWIO_PMIC_ARB_OBS3_CHNL45_RDATA1_ADDR A:0xe63169c
y.create.l HWIO_PMIC_ARB_OBS3_CHNL46_RDATA1_ADDR A:0xe63171c
y.create.l HWIO_PMIC_ARB_OBS3_CHNL47_RDATA1_ADDR A:0xe63179c
y.create.l HWIO_PMIC_ARB_OBS3_CHNL48_RDATA1_ADDR A:0xe63181c
y.create.l HWIO_PMIC_ARB_OBS3_CHNL49_RDATA1_ADDR A:0xe63189c
y.create.l HWIO_PMIC_ARB_OBS3_CHNL50_RDATA1_ADDR A:0xe63191c
y.create.l HWIO_PMIC_ARB_OBS3_CHNL51_RDATA1_ADDR A:0xe63199c
y.create.l HWIO_PMIC_ARB_OBS3_CHNL52_RDATA1_ADDR A:0xe631a1c
y.create.l HWIO_PMIC_ARB_OBS3_CHNL53_RDATA1_ADDR A:0xe631a9c
y.create.l HWIO_PMIC_ARB_OBS3_CHNL54_RDATA1_ADDR A:0xe631b1c
y.create.l HWIO_PMIC_ARB_OBS3_CHNL55_RDATA1_ADDR A:0xe631b9c
y.create.l HWIO_PMIC_ARB_OBS3_CHNL56_RDATA1_ADDR A:0xe631c1c
y.create.l HWIO_PMIC_ARB_OBS3_CHNL57_RDATA1_ADDR A:0xe631c9c
y.create.l HWIO_PMIC_ARB_OBS3_CHNL58_RDATA1_ADDR A:0xe631d1c
y.create.l HWIO_PMIC_ARB_OBS3_CHNL59_RDATA1_ADDR A:0xe631d9c
y.create.l HWIO_PMIC_ARB_OBS3_CHNL60_RDATA1_ADDR A:0xe631e1c
y.create.l HWIO_PMIC_ARB_OBS3_CHNL61_RDATA1_ADDR A:0xe631e9c
y.create.l HWIO_PMIC_ARB_OBS3_CHNL62_RDATA1_ADDR A:0xe631f1c
y.create.l HWIO_PMIC_ARB_OBS3_CHNL63_RDATA1_ADDR A:0xe631f9c
y.create.l HWIO_PMIC_ARB_OBS3_CHNL64_RDATA1_ADDR A:0xe63201c
y.create.l HWIO_PMIC_ARB_OBS3_CHNL65_RDATA1_ADDR A:0xe63209c
y.create.l HWIO_PMIC_ARB_OBS3_CHNL66_RDATA1_ADDR A:0xe63211c
y.create.l HWIO_PMIC_ARB_OBS3_CHNL67_RDATA1_ADDR A:0xe63219c
y.create.l HWIO_PMIC_ARB_OBS3_CHNL68_RDATA1_ADDR A:0xe63221c
y.create.l HWIO_PMIC_ARB_OBS3_CHNL69_RDATA1_ADDR A:0xe63229c
y.create.l HWIO_PMIC_ARB_OBS3_CHNL70_RDATA1_ADDR A:0xe63231c
y.create.l HWIO_PMIC_ARB_OBS3_CHNL71_RDATA1_ADDR A:0xe63239c
y.create.l HWIO_PMIC_ARB_OBS3_CHNL72_RDATA1_ADDR A:0xe63241c
y.create.l HWIO_PMIC_ARB_OBS3_CHNL73_RDATA1_ADDR A:0xe63249c
y.create.l HWIO_PMIC_ARB_OBS3_CHNL74_RDATA1_ADDR A:0xe63251c
y.create.l HWIO_PMIC_ARB_OBS3_CHNL75_RDATA1_ADDR A:0xe63259c
y.create.l HWIO_PMIC_ARB_OBS3_CHNL76_RDATA1_ADDR A:0xe63261c
y.create.l HWIO_PMIC_ARB_OBS3_CHNL77_RDATA1_ADDR A:0xe63269c
y.create.l HWIO_PMIC_ARB_OBS3_CHNL78_RDATA1_ADDR A:0xe63271c
y.create.l HWIO_PMIC_ARB_OBS3_CHNL79_RDATA1_ADDR A:0xe63279c
y.create.l HWIO_PMIC_ARB_OBS3_CHNL80_RDATA1_ADDR A:0xe63281c
y.create.l HWIO_PMIC_ARB_OBS3_CHNL81_RDATA1_ADDR A:0xe63289c
y.create.l HWIO_PMIC_ARB_OBS3_CHNL82_RDATA1_ADDR A:0xe63291c
y.create.l HWIO_PMIC_ARB_OBS3_CHNL83_RDATA1_ADDR A:0xe63299c
y.create.l HWIO_PMIC_ARB_OBS3_CHNL84_RDATA1_ADDR A:0xe632a1c
y.create.l HWIO_PMIC_ARB_OBS3_CHNL85_RDATA1_ADDR A:0xe632a9c
y.create.l HWIO_PMIC_ARB_OBS3_CHNL86_RDATA1_ADDR A:0xe632b1c
y.create.l HWIO_PMIC_ARB_OBS3_CHNL87_RDATA1_ADDR A:0xe632b9c
y.create.l HWIO_PMIC_ARB_OBS3_CHNL88_RDATA1_ADDR A:0xe632c1c
y.create.l HWIO_PMIC_ARB_OBS3_CHNL89_RDATA1_ADDR A:0xe632c9c
y.create.l HWIO_PMIC_ARB_OBS3_CHNL90_RDATA1_ADDR A:0xe632d1c
y.create.l HWIO_PMIC_ARB_OBS3_CHNL91_RDATA1_ADDR A:0xe632d9c
y.create.l HWIO_PMIC_ARB_OBS3_CHNL92_RDATA1_ADDR A:0xe632e1c
y.create.l HWIO_PMIC_ARB_OBS3_CHNL93_RDATA1_ADDR A:0xe632e9c
y.create.l HWIO_PMIC_ARB_OBS3_CHNL94_RDATA1_ADDR A:0xe632f1c
y.create.l HWIO_PMIC_ARB_OBS3_CHNL95_RDATA1_ADDR A:0xe632f9c
y.create.l HWIO_PMIC_ARB_OBS3_CHNL96_RDATA1_ADDR A:0xe63301c
y.create.l HWIO_PMIC_ARB_OBS3_CHNL97_RDATA1_ADDR A:0xe63309c
y.create.l HWIO_PMIC_ARB_OBS3_CHNL98_RDATA1_ADDR A:0xe63311c
y.create.l HWIO_PMIC_ARB_OBS3_CHNL99_RDATA1_ADDR A:0xe63319c
y.create.l HWIO_PMIC_ARB_OBS3_CHNL100_RDATA1_ADDR A:0xe63321c
y.create.l HWIO_PMIC_ARB_OBS3_CHNL101_RDATA1_ADDR A:0xe63329c
y.create.l HWIO_PMIC_ARB_OBS3_CHNL102_RDATA1_ADDR A:0xe63331c
y.create.l HWIO_PMIC_ARB_OBS3_CHNL103_RDATA1_ADDR A:0xe63339c
y.create.l HWIO_PMIC_ARB_OBS3_CHNL104_RDATA1_ADDR A:0xe63341c
y.create.l HWIO_PMIC_ARB_OBS3_CHNL105_RDATA1_ADDR A:0xe63349c
y.create.l HWIO_PMIC_ARB_OBS3_CHNL106_RDATA1_ADDR A:0xe63351c
y.create.l HWIO_PMIC_ARB_OBS3_CHNL107_RDATA1_ADDR A:0xe63359c
y.create.l HWIO_PMIC_ARB_OBS3_CHNL108_RDATA1_ADDR A:0xe63361c
y.create.l HWIO_PMIC_ARB_OBS3_CHNL109_RDATA1_ADDR A:0xe63369c
y.create.l HWIO_PMIC_ARB_OBS3_CHNL110_RDATA1_ADDR A:0xe63371c
y.create.l HWIO_PMIC_ARB_OBS3_CHNL111_RDATA1_ADDR A:0xe63379c
y.create.l HWIO_PMIC_ARB_OBS3_CHNL112_RDATA1_ADDR A:0xe63381c
y.create.l HWIO_PMIC_ARB_OBS3_CHNL113_RDATA1_ADDR A:0xe63389c
y.create.l HWIO_PMIC_ARB_OBS3_CHNL114_RDATA1_ADDR A:0xe63391c
y.create.l HWIO_PMIC_ARB_OBS3_CHNL115_RDATA1_ADDR A:0xe63399c
y.create.l HWIO_PMIC_ARB_OBS3_CHNL116_RDATA1_ADDR A:0xe633a1c
y.create.l HWIO_PMIC_ARB_OBS3_CHNL117_RDATA1_ADDR A:0xe633a9c
y.create.l HWIO_PMIC_ARB_OBS3_CHNL118_RDATA1_ADDR A:0xe633b1c
y.create.l HWIO_PMIC_ARB_OBS3_CHNL119_RDATA1_ADDR A:0xe633b9c
y.create.l HWIO_PMIC_ARB_OBS3_CHNL120_RDATA1_ADDR A:0xe633c1c
y.create.l HWIO_PMIC_ARB_OBS3_CHNL121_RDATA1_ADDR A:0xe633c9c
y.create.l HWIO_PMIC_ARB_OBS3_CHNL122_RDATA1_ADDR A:0xe633d1c
y.create.l HWIO_PMIC_ARB_OBS3_CHNL123_RDATA1_ADDR A:0xe633d9c
y.create.l HWIO_PMIC_ARB_OBS3_CHNL124_RDATA1_ADDR A:0xe633e1c
y.create.l HWIO_PMIC_ARB_OBS3_CHNL125_RDATA1_ADDR A:0xe633e9c
y.create.l HWIO_PMIC_ARB_OBS3_CHNL126_RDATA1_ADDR A:0xe633f1c
y.create.l HWIO_PMIC_ARB_OBS3_CHNL127_RDATA1_ADDR A:0xe633f9c
y.create.l HWIO_PMIC_ARB_OBS3_CHNL128_RDATA1_ADDR A:0xe63401c
y.create.l HWIO_PMIC_ARB_OBS3_CHNL129_RDATA1_ADDR A:0xe63409c
y.create.l HWIO_PMIC_ARB_OBS3_CHNL130_RDATA1_ADDR A:0xe63411c
y.create.l HWIO_PMIC_ARB_OBS3_CHNL131_RDATA1_ADDR A:0xe63419c
y.create.l HWIO_PMIC_ARB_OBS3_CHNL132_RDATA1_ADDR A:0xe63421c
y.create.l HWIO_PMIC_ARB_OBS3_CHNL133_RDATA1_ADDR A:0xe63429c
y.create.l HWIO_PMIC_ARB_OBS3_CHNL134_RDATA1_ADDR A:0xe63431c
y.create.l HWIO_PMIC_ARB_OBS3_CHNL135_RDATA1_ADDR A:0xe63439c
y.create.l HWIO_PMIC_ARB_OBS3_CHNL136_RDATA1_ADDR A:0xe63441c
y.create.l HWIO_PMIC_ARB_OBS3_CHNL137_RDATA1_ADDR A:0xe63449c
y.create.l HWIO_PMIC_ARB_OBS3_CHNL138_RDATA1_ADDR A:0xe63451c
y.create.l HWIO_PMIC_ARB_OBS3_CHNL139_RDATA1_ADDR A:0xe63459c
y.create.l HWIO_PMIC_ARB_OBS3_CHNL140_RDATA1_ADDR A:0xe63461c
y.create.l HWIO_PMIC_ARB_OBS3_CHNL141_RDATA1_ADDR A:0xe63469c
y.create.l HWIO_PMIC_ARB_OBS3_CHNL142_RDATA1_ADDR A:0xe63471c
y.create.l HWIO_PMIC_ARB_OBS3_CHNL143_RDATA1_ADDR A:0xe63479c
y.create.l HWIO_PMIC_ARB_OBS3_CHNL144_RDATA1_ADDR A:0xe63481c
y.create.l HWIO_PMIC_ARB_OBS3_CHNL145_RDATA1_ADDR A:0xe63489c
y.create.l HWIO_PMIC_ARB_OBS3_CHNL146_RDATA1_ADDR A:0xe63491c
y.create.l HWIO_PMIC_ARB_OBS3_CHNL147_RDATA1_ADDR A:0xe63499c
y.create.l HWIO_PMIC_ARB_OBS3_CHNL148_RDATA1_ADDR A:0xe634a1c
y.create.l HWIO_PMIC_ARB_OBS3_CHNL149_RDATA1_ADDR A:0xe634a9c
y.create.l HWIO_PMIC_ARB_OBS3_CHNL150_RDATA1_ADDR A:0xe634b1c
y.create.l HWIO_PMIC_ARB_OBS3_CHNL151_RDATA1_ADDR A:0xe634b9c
y.create.l HWIO_PMIC_ARB_OBS3_CHNL152_RDATA1_ADDR A:0xe634c1c
y.create.l HWIO_PMIC_ARB_OBS3_CHNL153_RDATA1_ADDR A:0xe634c9c
y.create.l HWIO_PMIC_ARB_OBS3_CHNL154_RDATA1_ADDR A:0xe634d1c
y.create.l HWIO_PMIC_ARB_OBS3_CHNL155_RDATA1_ADDR A:0xe634d9c
y.create.l HWIO_PMIC_ARB_OBS3_CHNL156_RDATA1_ADDR A:0xe634e1c
y.create.l HWIO_PMIC_ARB_OBS3_CHNL157_RDATA1_ADDR A:0xe634e9c
y.create.l HWIO_PMIC_ARB_OBS3_CHNL158_RDATA1_ADDR A:0xe634f1c
y.create.l HWIO_PMIC_ARB_OBS3_CHNL159_RDATA1_ADDR A:0xe634f9c
y.create.l HWIO_PMIC_ARB_OBS3_CHNL160_RDATA1_ADDR A:0xe63501c
y.create.l HWIO_PMIC_ARB_OBS3_CHNL161_RDATA1_ADDR A:0xe63509c
y.create.l HWIO_PMIC_ARB_OBS3_CHNL162_RDATA1_ADDR A:0xe63511c
y.create.l HWIO_PMIC_ARB_OBS3_CHNL163_RDATA1_ADDR A:0xe63519c
y.create.l HWIO_PMIC_ARB_OBS3_CHNL164_RDATA1_ADDR A:0xe63521c
y.create.l HWIO_PMIC_ARB_OBS3_CHNL165_RDATA1_ADDR A:0xe63529c
y.create.l HWIO_PMIC_ARB_OBS3_CHNL166_RDATA1_ADDR A:0xe63531c
y.create.l HWIO_PMIC_ARB_OBS3_CHNL167_RDATA1_ADDR A:0xe63539c
y.create.l HWIO_PMIC_ARB_OBS3_CHNL168_RDATA1_ADDR A:0xe63541c
y.create.l HWIO_PMIC_ARB_OBS3_CHNL169_RDATA1_ADDR A:0xe63549c
y.create.l HWIO_PMIC_ARB_OBS3_CHNL170_RDATA1_ADDR A:0xe63551c
y.create.l HWIO_PMIC_ARB_OBS3_CHNL171_RDATA1_ADDR A:0xe63559c
y.create.l HWIO_PMIC_ARB_OBS3_CHNL172_RDATA1_ADDR A:0xe63561c
y.create.l HWIO_PMIC_ARB_OBS3_CHNL173_RDATA1_ADDR A:0xe63569c
y.create.l HWIO_PMIC_ARB_OBS3_CHNL174_RDATA1_ADDR A:0xe63571c
y.create.l HWIO_PMIC_ARB_OBS3_CHNL175_RDATA1_ADDR A:0xe63579c
y.create.l HWIO_PMIC_ARB_OBS3_CHNL176_RDATA1_ADDR A:0xe63581c
y.create.l HWIO_PMIC_ARB_OBS3_CHNL177_RDATA1_ADDR A:0xe63589c
y.create.l HWIO_PMIC_ARB_OBS3_CHNL178_RDATA1_ADDR A:0xe63591c
y.create.l HWIO_PMIC_ARB_OBS3_CHNL179_RDATA1_ADDR A:0xe63599c
y.create.l HWIO_PMIC_ARB_OBS3_CHNL180_RDATA1_ADDR A:0xe635a1c
y.create.l HWIO_PMIC_ARB_OBS3_CHNL181_RDATA1_ADDR A:0xe635a9c
y.create.l HWIO_PMIC_ARB_OBS3_CHNL182_RDATA1_ADDR A:0xe635b1c
y.create.l HWIO_PMIC_ARB_OBS3_CHNL183_RDATA1_ADDR A:0xe635b9c
y.create.l HWIO_PMIC_ARB_OBS3_CHNL184_RDATA1_ADDR A:0xe635c1c
y.create.l HWIO_PMIC_ARB_OBS3_CHNL185_RDATA1_ADDR A:0xe635c9c
y.create.l HWIO_PMIC_ARB_OBS3_CHNL186_RDATA1_ADDR A:0xe635d1c
y.create.l HWIO_PMIC_ARB_OBS3_CHNL187_RDATA1_ADDR A:0xe635d9c
y.create.l HWIO_PMIC_ARB_OBS3_CHNL188_RDATA1_ADDR A:0xe635e1c
y.create.l HWIO_PMIC_ARB_OBS3_CHNL189_RDATA1_ADDR A:0xe635e9c
y.create.l HWIO_PMIC_ARB_OBS3_CHNL190_RDATA1_ADDR A:0xe635f1c
y.create.l HWIO_PMIC_ARB_OBS3_CHNL191_RDATA1_ADDR A:0xe635f9c
y.create.l HWIO_PMIC_ARB_OBS3_CHNL192_RDATA1_ADDR A:0xe63601c
y.create.l HWIO_PMIC_ARB_OBS3_CHNL193_RDATA1_ADDR A:0xe63609c
y.create.l HWIO_PMIC_ARB_OBS3_CHNL194_RDATA1_ADDR A:0xe63611c
y.create.l HWIO_PMIC_ARB_OBS3_CHNL195_RDATA1_ADDR A:0xe63619c
y.create.l HWIO_PMIC_ARB_OBS3_CHNL196_RDATA1_ADDR A:0xe63621c
y.create.l HWIO_PMIC_ARB_OBS3_CHNL197_RDATA1_ADDR A:0xe63629c
y.create.l HWIO_PMIC_ARB_OBS3_CHNL198_RDATA1_ADDR A:0xe63631c
y.create.l HWIO_PMIC_ARB_OBS3_CHNL199_RDATA1_ADDR A:0xe63639c
y.create.l HWIO_PMIC_ARB_OBS3_CHNL200_RDATA1_ADDR A:0xe63641c
y.create.l HWIO_PMIC_ARB_OBS3_CHNL201_RDATA1_ADDR A:0xe63649c
y.create.l HWIO_PMIC_ARB_OBS3_CHNL202_RDATA1_ADDR A:0xe63651c
y.create.l HWIO_PMIC_ARB_OBS3_CHNL203_RDATA1_ADDR A:0xe63659c
y.create.l HWIO_PMIC_ARB_OBS3_CHNL204_RDATA1_ADDR A:0xe63661c
y.create.l HWIO_PMIC_ARB_OBS3_CHNL205_RDATA1_ADDR A:0xe63669c
y.create.l HWIO_PMIC_ARB_OBS3_CHNL206_RDATA1_ADDR A:0xe63671c
y.create.l HWIO_PMIC_ARB_OBS3_CHNL207_RDATA1_ADDR A:0xe63679c
y.create.l HWIO_PMIC_ARB_OBS3_CHNL208_RDATA1_ADDR A:0xe63681c
y.create.l HWIO_PMIC_ARB_OBS3_CHNL209_RDATA1_ADDR A:0xe63689c
y.create.l HWIO_PMIC_ARB_OBS3_CHNL210_RDATA1_ADDR A:0xe63691c
y.create.l HWIO_PMIC_ARB_OBS3_CHNL211_RDATA1_ADDR A:0xe63699c
y.create.l HWIO_PMIC_ARB_OBS3_CHNL212_RDATA1_ADDR A:0xe636a1c
y.create.l HWIO_PMIC_ARB_OBS3_CHNL213_RDATA1_ADDR A:0xe636a9c
y.create.l HWIO_PMIC_ARB_OBS3_CHNL214_RDATA1_ADDR A:0xe636b1c
y.create.l HWIO_PMIC_ARB_OBS3_CHNL215_RDATA1_ADDR A:0xe636b9c
y.create.l HWIO_PMIC_ARB_OBS3_CHNL216_RDATA1_ADDR A:0xe636c1c
y.create.l HWIO_PMIC_ARB_OBS3_CHNL217_RDATA1_ADDR A:0xe636c9c
y.create.l HWIO_PMIC_ARB_OBS3_CHNL218_RDATA1_ADDR A:0xe636d1c
y.create.l HWIO_PMIC_ARB_OBS3_CHNL219_RDATA1_ADDR A:0xe636d9c
y.create.l HWIO_PMIC_ARB_OBS3_CHNL220_RDATA1_ADDR A:0xe636e1c
y.create.l HWIO_PMIC_ARB_OBS3_CHNL221_RDATA1_ADDR A:0xe636e9c
y.create.l HWIO_PMIC_ARB_OBS3_CHNL222_RDATA1_ADDR A:0xe636f1c
y.create.l HWIO_PMIC_ARB_OBS3_CHNL223_RDATA1_ADDR A:0xe636f9c
y.create.l HWIO_PMIC_ARB_OBS3_CHNL224_RDATA1_ADDR A:0xe63701c
y.create.l HWIO_PMIC_ARB_OBS3_CHNL225_RDATA1_ADDR A:0xe63709c
y.create.l HWIO_PMIC_ARB_OBS3_CHNL226_RDATA1_ADDR A:0xe63711c
y.create.l HWIO_PMIC_ARB_OBS3_CHNL227_RDATA1_ADDR A:0xe63719c
y.create.l HWIO_PMIC_ARB_OBS3_CHNL228_RDATA1_ADDR A:0xe63721c
y.create.l HWIO_PMIC_ARB_OBS3_CHNL229_RDATA1_ADDR A:0xe63729c
y.create.l HWIO_PMIC_ARB_OBS3_CHNL230_RDATA1_ADDR A:0xe63731c
y.create.l HWIO_PMIC_ARB_OBS3_CHNL231_RDATA1_ADDR A:0xe63739c
y.create.l HWIO_PMIC_ARB_OBS3_CHNL232_RDATA1_ADDR A:0xe63741c
y.create.l HWIO_PMIC_ARB_OBS3_CHNL233_RDATA1_ADDR A:0xe63749c
y.create.l HWIO_PMIC_ARB_OBS3_CHNL234_RDATA1_ADDR A:0xe63751c
y.create.l HWIO_PMIC_ARB_OBS3_CHNL235_RDATA1_ADDR A:0xe63759c
y.create.l HWIO_PMIC_ARB_OBS3_CHNL236_RDATA1_ADDR A:0xe63761c
y.create.l HWIO_PMIC_ARB_OBS3_CHNL237_RDATA1_ADDR A:0xe63769c
y.create.l HWIO_PMIC_ARB_OBS3_CHNL238_RDATA1_ADDR A:0xe63771c
y.create.l HWIO_PMIC_ARB_OBS3_CHNL239_RDATA1_ADDR A:0xe63779c
y.create.l HWIO_PMIC_ARB_OBS3_CHNL240_RDATA1_ADDR A:0xe63781c
y.create.l HWIO_PMIC_ARB_OBS3_CHNL241_RDATA1_ADDR A:0xe63789c
y.create.l HWIO_PMIC_ARB_OBS3_CHNL242_RDATA1_ADDR A:0xe63791c
y.create.l HWIO_PMIC_ARB_OBS3_CHNL243_RDATA1_ADDR A:0xe63799c
y.create.l HWIO_PMIC_ARB_OBS3_CHNL244_RDATA1_ADDR A:0xe637a1c
y.create.l HWIO_PMIC_ARB_OBS3_CHNL245_RDATA1_ADDR A:0xe637a9c
y.create.l HWIO_PMIC_ARB_OBS3_CHNL246_RDATA1_ADDR A:0xe637b1c
y.create.l HWIO_PMIC_ARB_OBS3_CHNL247_RDATA1_ADDR A:0xe637b9c
y.create.l HWIO_PMIC_ARB_OBS3_CHNL248_RDATA1_ADDR A:0xe637c1c
y.create.l HWIO_PMIC_ARB_OBS3_CHNL249_RDATA1_ADDR A:0xe637c9c
y.create.l HWIO_PMIC_ARB_OBS3_CHNL250_RDATA1_ADDR A:0xe637d1c
y.create.l HWIO_PMIC_ARB_OBS3_CHNL251_RDATA1_ADDR A:0xe637d9c
y.create.l HWIO_PMIC_ARB_OBS3_CHNL252_RDATA1_ADDR A:0xe637e1c
y.create.l HWIO_PMIC_ARB_OBS3_CHNL253_RDATA1_ADDR A:0xe637e9c
y.create.l HWIO_PMIC_ARB_OBS3_CHNL254_RDATA1_ADDR A:0xe637f1c
y.create.l HWIO_PMIC_ARB_OBS3_CHNL255_RDATA1_ADDR A:0xe637f9c
y.create.l HWIO_PMIC_ARB_OBS4_CHNL0_RDATA1_ADDR A:0xe64001c
y.create.l HWIO_PMIC_ARB_OBS4_CHNL1_RDATA1_ADDR A:0xe64009c
y.create.l HWIO_PMIC_ARB_OBS4_CHNL2_RDATA1_ADDR A:0xe64011c
y.create.l HWIO_PMIC_ARB_OBS4_CHNL3_RDATA1_ADDR A:0xe64019c
y.create.l HWIO_PMIC_ARB_OBS4_CHNL4_RDATA1_ADDR A:0xe64021c
y.create.l HWIO_PMIC_ARB_OBS4_CHNL5_RDATA1_ADDR A:0xe64029c
y.create.l HWIO_PMIC_ARB_OBS4_CHNL6_RDATA1_ADDR A:0xe64031c
y.create.l HWIO_PMIC_ARB_OBS4_CHNL7_RDATA1_ADDR A:0xe64039c
y.create.l HWIO_PMIC_ARB_OBS4_CHNL8_RDATA1_ADDR A:0xe64041c
y.create.l HWIO_PMIC_ARB_OBS4_CHNL9_RDATA1_ADDR A:0xe64049c
y.create.l HWIO_PMIC_ARB_OBS4_CHNL10_RDATA1_ADDR A:0xe64051c
y.create.l HWIO_PMIC_ARB_OBS4_CHNL11_RDATA1_ADDR A:0xe64059c
y.create.l HWIO_PMIC_ARB_OBS4_CHNL12_RDATA1_ADDR A:0xe64061c
y.create.l HWIO_PMIC_ARB_OBS4_CHNL13_RDATA1_ADDR A:0xe64069c
y.create.l HWIO_PMIC_ARB_OBS4_CHNL14_RDATA1_ADDR A:0xe64071c
y.create.l HWIO_PMIC_ARB_OBS4_CHNL15_RDATA1_ADDR A:0xe64079c
y.create.l HWIO_PMIC_ARB_OBS4_CHNL16_RDATA1_ADDR A:0xe64081c
y.create.l HWIO_PMIC_ARB_OBS4_CHNL17_RDATA1_ADDR A:0xe64089c
y.create.l HWIO_PMIC_ARB_OBS4_CHNL18_RDATA1_ADDR A:0xe64091c
y.create.l HWIO_PMIC_ARB_OBS4_CHNL19_RDATA1_ADDR A:0xe64099c
y.create.l HWIO_PMIC_ARB_OBS4_CHNL20_RDATA1_ADDR A:0xe640a1c
y.create.l HWIO_PMIC_ARB_OBS4_CHNL21_RDATA1_ADDR A:0xe640a9c
y.create.l HWIO_PMIC_ARB_OBS4_CHNL22_RDATA1_ADDR A:0xe640b1c
y.create.l HWIO_PMIC_ARB_OBS4_CHNL23_RDATA1_ADDR A:0xe640b9c
y.create.l HWIO_PMIC_ARB_OBS4_CHNL24_RDATA1_ADDR A:0xe640c1c
y.create.l HWIO_PMIC_ARB_OBS4_CHNL25_RDATA1_ADDR A:0xe640c9c
y.create.l HWIO_PMIC_ARB_OBS4_CHNL26_RDATA1_ADDR A:0xe640d1c
y.create.l HWIO_PMIC_ARB_OBS4_CHNL27_RDATA1_ADDR A:0xe640d9c
y.create.l HWIO_PMIC_ARB_OBS4_CHNL28_RDATA1_ADDR A:0xe640e1c
y.create.l HWIO_PMIC_ARB_OBS4_CHNL29_RDATA1_ADDR A:0xe640e9c
y.create.l HWIO_PMIC_ARB_OBS4_CHNL30_RDATA1_ADDR A:0xe640f1c
y.create.l HWIO_PMIC_ARB_OBS4_CHNL31_RDATA1_ADDR A:0xe640f9c
y.create.l HWIO_PMIC_ARB_OBS4_CHNL32_RDATA1_ADDR A:0xe64101c
y.create.l HWIO_PMIC_ARB_OBS4_CHNL33_RDATA1_ADDR A:0xe64109c
y.create.l HWIO_PMIC_ARB_OBS4_CHNL34_RDATA1_ADDR A:0xe64111c
y.create.l HWIO_PMIC_ARB_OBS4_CHNL35_RDATA1_ADDR A:0xe64119c
y.create.l HWIO_PMIC_ARB_OBS4_CHNL36_RDATA1_ADDR A:0xe64121c
y.create.l HWIO_PMIC_ARB_OBS4_CHNL37_RDATA1_ADDR A:0xe64129c
y.create.l HWIO_PMIC_ARB_OBS4_CHNL38_RDATA1_ADDR A:0xe64131c
y.create.l HWIO_PMIC_ARB_OBS4_CHNL39_RDATA1_ADDR A:0xe64139c
y.create.l HWIO_PMIC_ARB_OBS4_CHNL40_RDATA1_ADDR A:0xe64141c
y.create.l HWIO_PMIC_ARB_OBS4_CHNL41_RDATA1_ADDR A:0xe64149c
y.create.l HWIO_PMIC_ARB_OBS4_CHNL42_RDATA1_ADDR A:0xe64151c
y.create.l HWIO_PMIC_ARB_OBS4_CHNL43_RDATA1_ADDR A:0xe64159c
y.create.l HWIO_PMIC_ARB_OBS4_CHNL44_RDATA1_ADDR A:0xe64161c
y.create.l HWIO_PMIC_ARB_OBS4_CHNL45_RDATA1_ADDR A:0xe64169c
y.create.l HWIO_PMIC_ARB_OBS4_CHNL46_RDATA1_ADDR A:0xe64171c
y.create.l HWIO_PMIC_ARB_OBS4_CHNL47_RDATA1_ADDR A:0xe64179c
y.create.l HWIO_PMIC_ARB_OBS4_CHNL48_RDATA1_ADDR A:0xe64181c
y.create.l HWIO_PMIC_ARB_OBS4_CHNL49_RDATA1_ADDR A:0xe64189c
y.create.l HWIO_PMIC_ARB_OBS4_CHNL50_RDATA1_ADDR A:0xe64191c
y.create.l HWIO_PMIC_ARB_OBS4_CHNL51_RDATA1_ADDR A:0xe64199c
y.create.l HWIO_PMIC_ARB_OBS4_CHNL52_RDATA1_ADDR A:0xe641a1c
y.create.l HWIO_PMIC_ARB_OBS4_CHNL53_RDATA1_ADDR A:0xe641a9c
y.create.l HWIO_PMIC_ARB_OBS4_CHNL54_RDATA1_ADDR A:0xe641b1c
y.create.l HWIO_PMIC_ARB_OBS4_CHNL55_RDATA1_ADDR A:0xe641b9c
y.create.l HWIO_PMIC_ARB_OBS4_CHNL56_RDATA1_ADDR A:0xe641c1c
y.create.l HWIO_PMIC_ARB_OBS4_CHNL57_RDATA1_ADDR A:0xe641c9c
y.create.l HWIO_PMIC_ARB_OBS4_CHNL58_RDATA1_ADDR A:0xe641d1c
y.create.l HWIO_PMIC_ARB_OBS4_CHNL59_RDATA1_ADDR A:0xe641d9c
y.create.l HWIO_PMIC_ARB_OBS4_CHNL60_RDATA1_ADDR A:0xe641e1c
y.create.l HWIO_PMIC_ARB_OBS4_CHNL61_RDATA1_ADDR A:0xe641e9c
y.create.l HWIO_PMIC_ARB_OBS4_CHNL62_RDATA1_ADDR A:0xe641f1c
y.create.l HWIO_PMIC_ARB_OBS4_CHNL63_RDATA1_ADDR A:0xe641f9c
y.create.l HWIO_PMIC_ARB_OBS4_CHNL64_RDATA1_ADDR A:0xe64201c
y.create.l HWIO_PMIC_ARB_OBS4_CHNL65_RDATA1_ADDR A:0xe64209c
y.create.l HWIO_PMIC_ARB_OBS4_CHNL66_RDATA1_ADDR A:0xe64211c
y.create.l HWIO_PMIC_ARB_OBS4_CHNL67_RDATA1_ADDR A:0xe64219c
y.create.l HWIO_PMIC_ARB_OBS4_CHNL68_RDATA1_ADDR A:0xe64221c
y.create.l HWIO_PMIC_ARB_OBS4_CHNL69_RDATA1_ADDR A:0xe64229c
y.create.l HWIO_PMIC_ARB_OBS4_CHNL70_RDATA1_ADDR A:0xe64231c
y.create.l HWIO_PMIC_ARB_OBS4_CHNL71_RDATA1_ADDR A:0xe64239c
y.create.l HWIO_PMIC_ARB_OBS4_CHNL72_RDATA1_ADDR A:0xe64241c
y.create.l HWIO_PMIC_ARB_OBS4_CHNL73_RDATA1_ADDR A:0xe64249c
y.create.l HWIO_PMIC_ARB_OBS4_CHNL74_RDATA1_ADDR A:0xe64251c
y.create.l HWIO_PMIC_ARB_OBS4_CHNL75_RDATA1_ADDR A:0xe64259c
y.create.l HWIO_PMIC_ARB_OBS4_CHNL76_RDATA1_ADDR A:0xe64261c
y.create.l HWIO_PMIC_ARB_OBS4_CHNL77_RDATA1_ADDR A:0xe64269c
y.create.l HWIO_PMIC_ARB_OBS4_CHNL78_RDATA1_ADDR A:0xe64271c
y.create.l HWIO_PMIC_ARB_OBS4_CHNL79_RDATA1_ADDR A:0xe64279c
y.create.l HWIO_PMIC_ARB_OBS4_CHNL80_RDATA1_ADDR A:0xe64281c
y.create.l HWIO_PMIC_ARB_OBS4_CHNL81_RDATA1_ADDR A:0xe64289c
y.create.l HWIO_PMIC_ARB_OBS4_CHNL82_RDATA1_ADDR A:0xe64291c
y.create.l HWIO_PMIC_ARB_OBS4_CHNL83_RDATA1_ADDR A:0xe64299c
y.create.l HWIO_PMIC_ARB_OBS4_CHNL84_RDATA1_ADDR A:0xe642a1c
y.create.l HWIO_PMIC_ARB_OBS4_CHNL85_RDATA1_ADDR A:0xe642a9c
y.create.l HWIO_PMIC_ARB_OBS4_CHNL86_RDATA1_ADDR A:0xe642b1c
y.create.l HWIO_PMIC_ARB_OBS4_CHNL87_RDATA1_ADDR A:0xe642b9c
y.create.l HWIO_PMIC_ARB_OBS4_CHNL88_RDATA1_ADDR A:0xe642c1c
y.create.l HWIO_PMIC_ARB_OBS4_CHNL89_RDATA1_ADDR A:0xe642c9c
y.create.l HWIO_PMIC_ARB_OBS4_CHNL90_RDATA1_ADDR A:0xe642d1c
y.create.l HWIO_PMIC_ARB_OBS4_CHNL91_RDATA1_ADDR A:0xe642d9c
y.create.l HWIO_PMIC_ARB_OBS4_CHNL92_RDATA1_ADDR A:0xe642e1c
y.create.l HWIO_PMIC_ARB_OBS4_CHNL93_RDATA1_ADDR A:0xe642e9c
y.create.l HWIO_PMIC_ARB_OBS4_CHNL94_RDATA1_ADDR A:0xe642f1c
y.create.l HWIO_PMIC_ARB_OBS4_CHNL95_RDATA1_ADDR A:0xe642f9c
y.create.l HWIO_PMIC_ARB_OBS4_CHNL96_RDATA1_ADDR A:0xe64301c
y.create.l HWIO_PMIC_ARB_OBS4_CHNL97_RDATA1_ADDR A:0xe64309c
y.create.l HWIO_PMIC_ARB_OBS4_CHNL98_RDATA1_ADDR A:0xe64311c
y.create.l HWIO_PMIC_ARB_OBS4_CHNL99_RDATA1_ADDR A:0xe64319c
y.create.l HWIO_PMIC_ARB_OBS4_CHNL100_RDATA1_ADDR A:0xe64321c
y.create.l HWIO_PMIC_ARB_OBS4_CHNL101_RDATA1_ADDR A:0xe64329c
y.create.l HWIO_PMIC_ARB_OBS4_CHNL102_RDATA1_ADDR A:0xe64331c
y.create.l HWIO_PMIC_ARB_OBS4_CHNL103_RDATA1_ADDR A:0xe64339c
y.create.l HWIO_PMIC_ARB_OBS4_CHNL104_RDATA1_ADDR A:0xe64341c
y.create.l HWIO_PMIC_ARB_OBS4_CHNL105_RDATA1_ADDR A:0xe64349c
y.create.l HWIO_PMIC_ARB_OBS4_CHNL106_RDATA1_ADDR A:0xe64351c
y.create.l HWIO_PMIC_ARB_OBS4_CHNL107_RDATA1_ADDR A:0xe64359c
y.create.l HWIO_PMIC_ARB_OBS4_CHNL108_RDATA1_ADDR A:0xe64361c
y.create.l HWIO_PMIC_ARB_OBS4_CHNL109_RDATA1_ADDR A:0xe64369c
y.create.l HWIO_PMIC_ARB_OBS4_CHNL110_RDATA1_ADDR A:0xe64371c
y.create.l HWIO_PMIC_ARB_OBS4_CHNL111_RDATA1_ADDR A:0xe64379c
y.create.l HWIO_PMIC_ARB_OBS4_CHNL112_RDATA1_ADDR A:0xe64381c
y.create.l HWIO_PMIC_ARB_OBS4_CHNL113_RDATA1_ADDR A:0xe64389c
y.create.l HWIO_PMIC_ARB_OBS4_CHNL114_RDATA1_ADDR A:0xe64391c
y.create.l HWIO_PMIC_ARB_OBS4_CHNL115_RDATA1_ADDR A:0xe64399c
y.create.l HWIO_PMIC_ARB_OBS4_CHNL116_RDATA1_ADDR A:0xe643a1c
y.create.l HWIO_PMIC_ARB_OBS4_CHNL117_RDATA1_ADDR A:0xe643a9c
y.create.l HWIO_PMIC_ARB_OBS4_CHNL118_RDATA1_ADDR A:0xe643b1c
y.create.l HWIO_PMIC_ARB_OBS4_CHNL119_RDATA1_ADDR A:0xe643b9c
y.create.l HWIO_PMIC_ARB_OBS4_CHNL120_RDATA1_ADDR A:0xe643c1c
y.create.l HWIO_PMIC_ARB_OBS4_CHNL121_RDATA1_ADDR A:0xe643c9c
y.create.l HWIO_PMIC_ARB_OBS4_CHNL122_RDATA1_ADDR A:0xe643d1c
y.create.l HWIO_PMIC_ARB_OBS4_CHNL123_RDATA1_ADDR A:0xe643d9c
y.create.l HWIO_PMIC_ARB_OBS4_CHNL124_RDATA1_ADDR A:0xe643e1c
y.create.l HWIO_PMIC_ARB_OBS4_CHNL125_RDATA1_ADDR A:0xe643e9c
y.create.l HWIO_PMIC_ARB_OBS4_CHNL126_RDATA1_ADDR A:0xe643f1c
y.create.l HWIO_PMIC_ARB_OBS4_CHNL127_RDATA1_ADDR A:0xe643f9c
y.create.l HWIO_PMIC_ARB_OBS4_CHNL128_RDATA1_ADDR A:0xe64401c
y.create.l HWIO_PMIC_ARB_OBS4_CHNL129_RDATA1_ADDR A:0xe64409c
y.create.l HWIO_PMIC_ARB_OBS4_CHNL130_RDATA1_ADDR A:0xe64411c
y.create.l HWIO_PMIC_ARB_OBS4_CHNL131_RDATA1_ADDR A:0xe64419c
y.create.l HWIO_PMIC_ARB_OBS4_CHNL132_RDATA1_ADDR A:0xe64421c
y.create.l HWIO_PMIC_ARB_OBS4_CHNL133_RDATA1_ADDR A:0xe64429c
y.create.l HWIO_PMIC_ARB_OBS4_CHNL134_RDATA1_ADDR A:0xe64431c
y.create.l HWIO_PMIC_ARB_OBS4_CHNL135_RDATA1_ADDR A:0xe64439c
y.create.l HWIO_PMIC_ARB_OBS4_CHNL136_RDATA1_ADDR A:0xe64441c
y.create.l HWIO_PMIC_ARB_OBS4_CHNL137_RDATA1_ADDR A:0xe64449c
y.create.l HWIO_PMIC_ARB_OBS4_CHNL138_RDATA1_ADDR A:0xe64451c
y.create.l HWIO_PMIC_ARB_OBS4_CHNL139_RDATA1_ADDR A:0xe64459c
y.create.l HWIO_PMIC_ARB_OBS4_CHNL140_RDATA1_ADDR A:0xe64461c
y.create.l HWIO_PMIC_ARB_OBS4_CHNL141_RDATA1_ADDR A:0xe64469c
y.create.l HWIO_PMIC_ARB_OBS4_CHNL142_RDATA1_ADDR A:0xe64471c
y.create.l HWIO_PMIC_ARB_OBS4_CHNL143_RDATA1_ADDR A:0xe64479c
y.create.l HWIO_PMIC_ARB_OBS4_CHNL144_RDATA1_ADDR A:0xe64481c
y.create.l HWIO_PMIC_ARB_OBS4_CHNL145_RDATA1_ADDR A:0xe64489c
y.create.l HWIO_PMIC_ARB_OBS4_CHNL146_RDATA1_ADDR A:0xe64491c
y.create.l HWIO_PMIC_ARB_OBS4_CHNL147_RDATA1_ADDR A:0xe64499c
y.create.l HWIO_PMIC_ARB_OBS4_CHNL148_RDATA1_ADDR A:0xe644a1c
y.create.l HWIO_PMIC_ARB_OBS4_CHNL149_RDATA1_ADDR A:0xe644a9c
y.create.l HWIO_PMIC_ARB_OBS4_CHNL150_RDATA1_ADDR A:0xe644b1c
y.create.l HWIO_PMIC_ARB_OBS4_CHNL151_RDATA1_ADDR A:0xe644b9c
y.create.l HWIO_PMIC_ARB_OBS4_CHNL152_RDATA1_ADDR A:0xe644c1c
y.create.l HWIO_PMIC_ARB_OBS4_CHNL153_RDATA1_ADDR A:0xe644c9c
y.create.l HWIO_PMIC_ARB_OBS4_CHNL154_RDATA1_ADDR A:0xe644d1c
y.create.l HWIO_PMIC_ARB_OBS4_CHNL155_RDATA1_ADDR A:0xe644d9c
y.create.l HWIO_PMIC_ARB_OBS4_CHNL156_RDATA1_ADDR A:0xe644e1c
y.create.l HWIO_PMIC_ARB_OBS4_CHNL157_RDATA1_ADDR A:0xe644e9c
y.create.l HWIO_PMIC_ARB_OBS4_CHNL158_RDATA1_ADDR A:0xe644f1c
y.create.l HWIO_PMIC_ARB_OBS4_CHNL159_RDATA1_ADDR A:0xe644f9c
y.create.l HWIO_PMIC_ARB_OBS4_CHNL160_RDATA1_ADDR A:0xe64501c
y.create.l HWIO_PMIC_ARB_OBS4_CHNL161_RDATA1_ADDR A:0xe64509c
y.create.l HWIO_PMIC_ARB_OBS4_CHNL162_RDATA1_ADDR A:0xe64511c
y.create.l HWIO_PMIC_ARB_OBS4_CHNL163_RDATA1_ADDR A:0xe64519c
y.create.l HWIO_PMIC_ARB_OBS4_CHNL164_RDATA1_ADDR A:0xe64521c
y.create.l HWIO_PMIC_ARB_OBS4_CHNL165_RDATA1_ADDR A:0xe64529c
y.create.l HWIO_PMIC_ARB_OBS4_CHNL166_RDATA1_ADDR A:0xe64531c
y.create.l HWIO_PMIC_ARB_OBS4_CHNL167_RDATA1_ADDR A:0xe64539c
y.create.l HWIO_PMIC_ARB_OBS4_CHNL168_RDATA1_ADDR A:0xe64541c
y.create.l HWIO_PMIC_ARB_OBS4_CHNL169_RDATA1_ADDR A:0xe64549c
y.create.l HWIO_PMIC_ARB_OBS4_CHNL170_RDATA1_ADDR A:0xe64551c
y.create.l HWIO_PMIC_ARB_OBS4_CHNL171_RDATA1_ADDR A:0xe64559c
y.create.l HWIO_PMIC_ARB_OBS4_CHNL172_RDATA1_ADDR A:0xe64561c
y.create.l HWIO_PMIC_ARB_OBS4_CHNL173_RDATA1_ADDR A:0xe64569c
y.create.l HWIO_PMIC_ARB_OBS4_CHNL174_RDATA1_ADDR A:0xe64571c
y.create.l HWIO_PMIC_ARB_OBS4_CHNL175_RDATA1_ADDR A:0xe64579c
y.create.l HWIO_PMIC_ARB_OBS4_CHNL176_RDATA1_ADDR A:0xe64581c
y.create.l HWIO_PMIC_ARB_OBS4_CHNL177_RDATA1_ADDR A:0xe64589c
y.create.l HWIO_PMIC_ARB_OBS4_CHNL178_RDATA1_ADDR A:0xe64591c
y.create.l HWIO_PMIC_ARB_OBS4_CHNL179_RDATA1_ADDR A:0xe64599c
y.create.l HWIO_PMIC_ARB_OBS4_CHNL180_RDATA1_ADDR A:0xe645a1c
y.create.l HWIO_PMIC_ARB_OBS4_CHNL181_RDATA1_ADDR A:0xe645a9c
y.create.l HWIO_PMIC_ARB_OBS4_CHNL182_RDATA1_ADDR A:0xe645b1c
y.create.l HWIO_PMIC_ARB_OBS4_CHNL183_RDATA1_ADDR A:0xe645b9c
y.create.l HWIO_PMIC_ARB_OBS4_CHNL184_RDATA1_ADDR A:0xe645c1c
y.create.l HWIO_PMIC_ARB_OBS4_CHNL185_RDATA1_ADDR A:0xe645c9c
y.create.l HWIO_PMIC_ARB_OBS4_CHNL186_RDATA1_ADDR A:0xe645d1c
y.create.l HWIO_PMIC_ARB_OBS4_CHNL187_RDATA1_ADDR A:0xe645d9c
y.create.l HWIO_PMIC_ARB_OBS4_CHNL188_RDATA1_ADDR A:0xe645e1c
y.create.l HWIO_PMIC_ARB_OBS4_CHNL189_RDATA1_ADDR A:0xe645e9c
y.create.l HWIO_PMIC_ARB_OBS4_CHNL190_RDATA1_ADDR A:0xe645f1c
y.create.l HWIO_PMIC_ARB_OBS4_CHNL191_RDATA1_ADDR A:0xe645f9c
y.create.l HWIO_PMIC_ARB_OBS4_CHNL192_RDATA1_ADDR A:0xe64601c
y.create.l HWIO_PMIC_ARB_OBS4_CHNL193_RDATA1_ADDR A:0xe64609c
y.create.l HWIO_PMIC_ARB_OBS4_CHNL194_RDATA1_ADDR A:0xe64611c
y.create.l HWIO_PMIC_ARB_OBS4_CHNL195_RDATA1_ADDR A:0xe64619c
y.create.l HWIO_PMIC_ARB_OBS4_CHNL196_RDATA1_ADDR A:0xe64621c
y.create.l HWIO_PMIC_ARB_OBS4_CHNL197_RDATA1_ADDR A:0xe64629c
y.create.l HWIO_PMIC_ARB_OBS4_CHNL198_RDATA1_ADDR A:0xe64631c
y.create.l HWIO_PMIC_ARB_OBS4_CHNL199_RDATA1_ADDR A:0xe64639c
y.create.l HWIO_PMIC_ARB_OBS4_CHNL200_RDATA1_ADDR A:0xe64641c
y.create.l HWIO_PMIC_ARB_OBS4_CHNL201_RDATA1_ADDR A:0xe64649c
y.create.l HWIO_PMIC_ARB_OBS4_CHNL202_RDATA1_ADDR A:0xe64651c
y.create.l HWIO_PMIC_ARB_OBS4_CHNL203_RDATA1_ADDR A:0xe64659c
y.create.l HWIO_PMIC_ARB_OBS4_CHNL204_RDATA1_ADDR A:0xe64661c
y.create.l HWIO_PMIC_ARB_OBS4_CHNL205_RDATA1_ADDR A:0xe64669c
y.create.l HWIO_PMIC_ARB_OBS4_CHNL206_RDATA1_ADDR A:0xe64671c
y.create.l HWIO_PMIC_ARB_OBS4_CHNL207_RDATA1_ADDR A:0xe64679c
y.create.l HWIO_PMIC_ARB_OBS4_CHNL208_RDATA1_ADDR A:0xe64681c
y.create.l HWIO_PMIC_ARB_OBS4_CHNL209_RDATA1_ADDR A:0xe64689c
y.create.l HWIO_PMIC_ARB_OBS4_CHNL210_RDATA1_ADDR A:0xe64691c
y.create.l HWIO_PMIC_ARB_OBS4_CHNL211_RDATA1_ADDR A:0xe64699c
y.create.l HWIO_PMIC_ARB_OBS4_CHNL212_RDATA1_ADDR A:0xe646a1c
y.create.l HWIO_PMIC_ARB_OBS4_CHNL213_RDATA1_ADDR A:0xe646a9c
y.create.l HWIO_PMIC_ARB_OBS4_CHNL214_RDATA1_ADDR A:0xe646b1c
y.create.l HWIO_PMIC_ARB_OBS4_CHNL215_RDATA1_ADDR A:0xe646b9c
y.create.l HWIO_PMIC_ARB_OBS4_CHNL216_RDATA1_ADDR A:0xe646c1c
y.create.l HWIO_PMIC_ARB_OBS4_CHNL217_RDATA1_ADDR A:0xe646c9c
y.create.l HWIO_PMIC_ARB_OBS4_CHNL218_RDATA1_ADDR A:0xe646d1c
y.create.l HWIO_PMIC_ARB_OBS4_CHNL219_RDATA1_ADDR A:0xe646d9c
y.create.l HWIO_PMIC_ARB_OBS4_CHNL220_RDATA1_ADDR A:0xe646e1c
y.create.l HWIO_PMIC_ARB_OBS4_CHNL221_RDATA1_ADDR A:0xe646e9c
y.create.l HWIO_PMIC_ARB_OBS4_CHNL222_RDATA1_ADDR A:0xe646f1c
y.create.l HWIO_PMIC_ARB_OBS4_CHNL223_RDATA1_ADDR A:0xe646f9c
y.create.l HWIO_PMIC_ARB_OBS4_CHNL224_RDATA1_ADDR A:0xe64701c
y.create.l HWIO_PMIC_ARB_OBS4_CHNL225_RDATA1_ADDR A:0xe64709c
y.create.l HWIO_PMIC_ARB_OBS4_CHNL226_RDATA1_ADDR A:0xe64711c
y.create.l HWIO_PMIC_ARB_OBS4_CHNL227_RDATA1_ADDR A:0xe64719c
y.create.l HWIO_PMIC_ARB_OBS4_CHNL228_RDATA1_ADDR A:0xe64721c
y.create.l HWIO_PMIC_ARB_OBS4_CHNL229_RDATA1_ADDR A:0xe64729c
y.create.l HWIO_PMIC_ARB_OBS4_CHNL230_RDATA1_ADDR A:0xe64731c
y.create.l HWIO_PMIC_ARB_OBS4_CHNL231_RDATA1_ADDR A:0xe64739c
y.create.l HWIO_PMIC_ARB_OBS4_CHNL232_RDATA1_ADDR A:0xe64741c
y.create.l HWIO_PMIC_ARB_OBS4_CHNL233_RDATA1_ADDR A:0xe64749c
y.create.l HWIO_PMIC_ARB_OBS4_CHNL234_RDATA1_ADDR A:0xe64751c
y.create.l HWIO_PMIC_ARB_OBS4_CHNL235_RDATA1_ADDR A:0xe64759c
y.create.l HWIO_PMIC_ARB_OBS4_CHNL236_RDATA1_ADDR A:0xe64761c
y.create.l HWIO_PMIC_ARB_OBS4_CHNL237_RDATA1_ADDR A:0xe64769c
y.create.l HWIO_PMIC_ARB_OBS4_CHNL238_RDATA1_ADDR A:0xe64771c
y.create.l HWIO_PMIC_ARB_OBS4_CHNL239_RDATA1_ADDR A:0xe64779c
y.create.l HWIO_PMIC_ARB_OBS4_CHNL240_RDATA1_ADDR A:0xe64781c
y.create.l HWIO_PMIC_ARB_OBS4_CHNL241_RDATA1_ADDR A:0xe64789c
y.create.l HWIO_PMIC_ARB_OBS4_CHNL242_RDATA1_ADDR A:0xe64791c
y.create.l HWIO_PMIC_ARB_OBS4_CHNL243_RDATA1_ADDR A:0xe64799c
y.create.l HWIO_PMIC_ARB_OBS4_CHNL244_RDATA1_ADDR A:0xe647a1c
y.create.l HWIO_PMIC_ARB_OBS4_CHNL245_RDATA1_ADDR A:0xe647a9c
y.create.l HWIO_PMIC_ARB_OBS4_CHNL246_RDATA1_ADDR A:0xe647b1c
y.create.l HWIO_PMIC_ARB_OBS4_CHNL247_RDATA1_ADDR A:0xe647b9c
y.create.l HWIO_PMIC_ARB_OBS4_CHNL248_RDATA1_ADDR A:0xe647c1c
y.create.l HWIO_PMIC_ARB_OBS4_CHNL249_RDATA1_ADDR A:0xe647c9c
y.create.l HWIO_PMIC_ARB_OBS4_CHNL250_RDATA1_ADDR A:0xe647d1c
y.create.l HWIO_PMIC_ARB_OBS4_CHNL251_RDATA1_ADDR A:0xe647d9c
y.create.l HWIO_PMIC_ARB_OBS4_CHNL252_RDATA1_ADDR A:0xe647e1c
y.create.l HWIO_PMIC_ARB_OBS4_CHNL253_RDATA1_ADDR A:0xe647e9c
y.create.l HWIO_PMIC_ARB_OBS4_CHNL254_RDATA1_ADDR A:0xe647f1c
y.create.l HWIO_PMIC_ARB_OBS4_CHNL255_RDATA1_ADDR A:0xe647f9c
y.create.l HWIO_PMIC_ARB_OBS0_ACCESS0_ADDR A:0xc450000
y.create.l HWIO_PMIC_ARB_OBS0_ACCESS1_ADDR A:0xc450004
y.create.l HWIO_PMIC_ARB_OBS0_ACCESS2_ADDR A:0xc450008
y.create.l HWIO_PMIC_ARB_OBS0_ACCESS3_ADDR A:0xc45000c
y.create.l HWIO_PMIC_ARB_OBS0_ACCESS4_ADDR A:0xc450010
y.create.l HWIO_PMIC_ARB_OBS0_ACCESS5_ADDR A:0xc450014
y.create.l HWIO_PMIC_ARB_OBS0_ACCESS6_ADDR A:0xc450018
y.create.l HWIO_PMIC_ARB_OBS0_ACCESS7_ADDR A:0xc45001c
y.create.l HWIO_PMIC_ARB_OBS0_ACCESS8_ADDR A:0xc450020
y.create.l HWIO_PMIC_ARB_OBS0_ACCESS9_ADDR A:0xc450024
y.create.l HWIO_PMIC_ARB_OBS0_ACCESS10_ADDR A:0xc450028
y.create.l HWIO_PMIC_ARB_OBS0_ACCESS11_ADDR A:0xc45002c
y.create.l HWIO_PMIC_ARB_OBS0_ACCESS12_ADDR A:0xc450030
y.create.l HWIO_PMIC_ARB_OBS0_ACCESS13_ADDR A:0xc450034
y.create.l HWIO_PMIC_ARB_OBS0_ACCESS14_ADDR A:0xc450038
y.create.l HWIO_PMIC_ARB_OBS0_ACCESS15_ADDR A:0xc45003c
y.create.l HWIO_PMIC_ARB_OBS1_ACCESS0_ADDR A:0xc450040
y.create.l HWIO_PMIC_ARB_OBS1_ACCESS1_ADDR A:0xc450044
y.create.l HWIO_PMIC_ARB_OBS1_ACCESS2_ADDR A:0xc450048
y.create.l HWIO_PMIC_ARB_OBS1_ACCESS3_ADDR A:0xc45004c
y.create.l HWIO_PMIC_ARB_OBS1_ACCESS4_ADDR A:0xc450050
y.create.l HWIO_PMIC_ARB_OBS1_ACCESS5_ADDR A:0xc450054
y.create.l HWIO_PMIC_ARB_OBS1_ACCESS6_ADDR A:0xc450058
y.create.l HWIO_PMIC_ARB_OBS1_ACCESS7_ADDR A:0xc45005c
y.create.l HWIO_PMIC_ARB_OBS1_ACCESS8_ADDR A:0xc450060
y.create.l HWIO_PMIC_ARB_OBS1_ACCESS9_ADDR A:0xc450064
y.create.l HWIO_PMIC_ARB_OBS1_ACCESS10_ADDR A:0xc450068
y.create.l HWIO_PMIC_ARB_OBS1_ACCESS11_ADDR A:0xc45006c
y.create.l HWIO_PMIC_ARB_OBS1_ACCESS12_ADDR A:0xc450070
y.create.l HWIO_PMIC_ARB_OBS1_ACCESS13_ADDR A:0xc450074
y.create.l HWIO_PMIC_ARB_OBS1_ACCESS14_ADDR A:0xc450078
y.create.l HWIO_PMIC_ARB_OBS1_ACCESS15_ADDR A:0xc45007c
y.create.l HWIO_PMIC_ARB_OBS2_ACCESS0_ADDR A:0xc450080
y.create.l HWIO_PMIC_ARB_OBS2_ACCESS1_ADDR A:0xc450084
y.create.l HWIO_PMIC_ARB_OBS2_ACCESS2_ADDR A:0xc450088
y.create.l HWIO_PMIC_ARB_OBS2_ACCESS3_ADDR A:0xc45008c
y.create.l HWIO_PMIC_ARB_OBS2_ACCESS4_ADDR A:0xc450090
y.create.l HWIO_PMIC_ARB_OBS2_ACCESS5_ADDR A:0xc450094
y.create.l HWIO_PMIC_ARB_OBS2_ACCESS6_ADDR A:0xc450098
y.create.l HWIO_PMIC_ARB_OBS2_ACCESS7_ADDR A:0xc45009c
y.create.l HWIO_PMIC_ARB_OBS2_ACCESS8_ADDR A:0xc4500a0
y.create.l HWIO_PMIC_ARB_OBS2_ACCESS9_ADDR A:0xc4500a4
y.create.l HWIO_PMIC_ARB_OBS2_ACCESS10_ADDR A:0xc4500a8
y.create.l HWIO_PMIC_ARB_OBS2_ACCESS11_ADDR A:0xc4500ac
y.create.l HWIO_PMIC_ARB_OBS2_ACCESS12_ADDR A:0xc4500b0
y.create.l HWIO_PMIC_ARB_OBS2_ACCESS13_ADDR A:0xc4500b4
y.create.l HWIO_PMIC_ARB_OBS2_ACCESS14_ADDR A:0xc4500b8
y.create.l HWIO_PMIC_ARB_OBS2_ACCESS15_ADDR A:0xc4500bc
y.create.l HWIO_PMIC_ARB_OBS3_ACCESS0_ADDR A:0xc4500c0
y.create.l HWIO_PMIC_ARB_OBS3_ACCESS1_ADDR A:0xc4500c4
y.create.l HWIO_PMIC_ARB_OBS3_ACCESS2_ADDR A:0xc4500c8
y.create.l HWIO_PMIC_ARB_OBS3_ACCESS3_ADDR A:0xc4500cc
y.create.l HWIO_PMIC_ARB_OBS3_ACCESS4_ADDR A:0xc4500d0
y.create.l HWIO_PMIC_ARB_OBS3_ACCESS5_ADDR A:0xc4500d4
y.create.l HWIO_PMIC_ARB_OBS3_ACCESS6_ADDR A:0xc4500d8
y.create.l HWIO_PMIC_ARB_OBS3_ACCESS7_ADDR A:0xc4500dc
y.create.l HWIO_PMIC_ARB_OBS3_ACCESS8_ADDR A:0xc4500e0
y.create.l HWIO_PMIC_ARB_OBS3_ACCESS9_ADDR A:0xc4500e4
y.create.l HWIO_PMIC_ARB_OBS3_ACCESS10_ADDR A:0xc4500e8
y.create.l HWIO_PMIC_ARB_OBS3_ACCESS11_ADDR A:0xc4500ec
y.create.l HWIO_PMIC_ARB_OBS3_ACCESS12_ADDR A:0xc4500f0
y.create.l HWIO_PMIC_ARB_OBS3_ACCESS13_ADDR A:0xc4500f4
y.create.l HWIO_PMIC_ARB_OBS3_ACCESS14_ADDR A:0xc4500f8
y.create.l HWIO_PMIC_ARB_OBS3_ACCESS15_ADDR A:0xc4500fc
y.create.l HWIO_PMIC_ARB_OBS4_ACCESS0_ADDR A:0xc450100
y.create.l HWIO_PMIC_ARB_OBS4_ACCESS1_ADDR A:0xc450104
y.create.l HWIO_PMIC_ARB_OBS4_ACCESS2_ADDR A:0xc450108
y.create.l HWIO_PMIC_ARB_OBS4_ACCESS3_ADDR A:0xc45010c
y.create.l HWIO_PMIC_ARB_OBS4_ACCESS4_ADDR A:0xc450110
y.create.l HWIO_PMIC_ARB_OBS4_ACCESS5_ADDR A:0xc450114
y.create.l HWIO_PMIC_ARB_OBS4_ACCESS6_ADDR A:0xc450118
y.create.l HWIO_PMIC_ARB_OBS4_ACCESS7_ADDR A:0xc45011c
y.create.l HWIO_PMIC_ARB_OBS4_ACCESS8_ADDR A:0xc450120
y.create.l HWIO_PMIC_ARB_OBS4_ACCESS9_ADDR A:0xc450124
y.create.l HWIO_PMIC_ARB_OBS4_ACCESS10_ADDR A:0xc450128
y.create.l HWIO_PMIC_ARB_OBS4_ACCESS11_ADDR A:0xc45012c
y.create.l HWIO_PMIC_ARB_OBS4_ACCESS12_ADDR A:0xc450130
y.create.l HWIO_PMIC_ARB_OBS4_ACCESS13_ADDR A:0xc450134
y.create.l HWIO_PMIC_ARB_OBS4_ACCESS14_ADDR A:0xc450138
y.create.l HWIO_PMIC_ARB_OBS4_ACCESS15_ADDR A:0xc45013c
y.create.l HWIO_PMIC_ARB_OBS5_ACCESS0_ADDR A:0xc450140
y.create.l HWIO_PMIC_ARB_OBS5_ACCESS1_ADDR A:0xc450144
y.create.l HWIO_PMIC_ARB_OBS5_ACCESS2_ADDR A:0xc450148
y.create.l HWIO_PMIC_ARB_OBS5_ACCESS3_ADDR A:0xc45014c
y.create.l HWIO_PMIC_ARB_OBS5_ACCESS4_ADDR A:0xc450150
y.create.l HWIO_PMIC_ARB_OBS5_ACCESS5_ADDR A:0xc450154
y.create.l HWIO_PMIC_ARB_OBS5_ACCESS6_ADDR A:0xc450158
y.create.l HWIO_PMIC_ARB_OBS5_ACCESS7_ADDR A:0xc45015c
y.create.l HWIO_PMIC_ARB_OBS5_ACCESS8_ADDR A:0xc450160
y.create.l HWIO_PMIC_ARB_OBS5_ACCESS9_ADDR A:0xc450164
y.create.l HWIO_PMIC_ARB_OBS5_ACCESS10_ADDR A:0xc450168
y.create.l HWIO_PMIC_ARB_OBS5_ACCESS11_ADDR A:0xc45016c
y.create.l HWIO_PMIC_ARB_OBS5_ACCESS12_ADDR A:0xc450170
y.create.l HWIO_PMIC_ARB_OBS5_ACCESS13_ADDR A:0xc450174
y.create.l HWIO_PMIC_ARB_OBS5_ACCESS14_ADDR A:0xc450178
y.create.l HWIO_PMIC_ARB_OBS5_ACCESS15_ADDR A:0xc45017c
y.create.l HWIO_PMIC_ARB_OBS6_ACCESS0_ADDR A:0xc450180
y.create.l HWIO_PMIC_ARB_OBS6_ACCESS1_ADDR A:0xc450184
y.create.l HWIO_PMIC_ARB_OBS6_ACCESS2_ADDR A:0xc450188
y.create.l HWIO_PMIC_ARB_OBS6_ACCESS3_ADDR A:0xc45018c
y.create.l HWIO_PMIC_ARB_OBS6_ACCESS4_ADDR A:0xc450190
y.create.l HWIO_PMIC_ARB_OBS6_ACCESS5_ADDR A:0xc450194
y.create.l HWIO_PMIC_ARB_OBS6_ACCESS6_ADDR A:0xc450198
y.create.l HWIO_PMIC_ARB_OBS6_ACCESS7_ADDR A:0xc45019c
y.create.l HWIO_PMIC_ARB_OBS6_ACCESS8_ADDR A:0xc4501a0
y.create.l HWIO_PMIC_ARB_OBS6_ACCESS9_ADDR A:0xc4501a4
y.create.l HWIO_PMIC_ARB_OBS6_ACCESS10_ADDR A:0xc4501a8
y.create.l HWIO_PMIC_ARB_OBS6_ACCESS11_ADDR A:0xc4501ac
y.create.l HWIO_PMIC_ARB_OBS6_ACCESS12_ADDR A:0xc4501b0
y.create.l HWIO_PMIC_ARB_OBS6_ACCESS13_ADDR A:0xc4501b4
y.create.l HWIO_PMIC_ARB_OBS6_ACCESS14_ADDR A:0xc4501b8
y.create.l HWIO_PMIC_ARB_OBS6_ACCESS15_ADDR A:0xc4501bc
y.create.l HWIO_QDSS_PMIC_ARB_PMIC_ARB_DEBUG_SPMI_CHNL_CMD0_ADDR A:0x6b22000
y.create.l HWIO_QDSS_PMIC_ARB_PMIC_ARB_DEBUG_SPMI_CHNL_CMD1_ADDR A:0x6b22004
y.create.l HWIO_QDSS_PMIC_ARB_PMIC_ARB_DEBUG_SPMI_CHNL_CMD2_ADDR A:0x6b22008
y.create.l HWIO_QDSS_PMIC_ARB_PMIC_ARB_DEBUG_SPMI_CHNL_CMD3_ADDR A:0x6b2200c
y.create.l HWIO_QDSS_PMIC_ARB_PMIC_ARB_DEBUG_SPMI_CHNL_CONFIG_ADDR A:0x6b22010
y.create.l HWIO_QDSS_PMIC_ARB_PMIC_ARB_DEBUG_SPMI_CHNL_STATUS_ADDR A:0x6b22014
y.create.l HWIO_QDSS_PMIC_ARB_PMIC_ARB_DEBUG_SPMI_CHNL_WDATA0_ADDR A:0x6b22018
y.create.l HWIO_QDSS_PMIC_ARB_PMIC_ARB_DEBUG_SPMI_CHNL_WDATA1_ADDR A:0x6b2201c
y.create.l HWIO_QDSS_PMIC_ARB_PMIC_ARB_DEBUG_SPMI_CHNL_WDATA2_ADDR A:0x6b22020
y.create.l HWIO_QDSS_PMIC_ARB_PMIC_ARB_DEBUG_SPMI_CHNL_WDATA3_ADDR A:0x6b22024
y.create.l HWIO_QDSS_PMIC_ARB_PMIC_ARB_DEBUG_SPMI_CHNL_WDATA4_ADDR A:0x6b22028
y.create.l HWIO_QDSS_PMIC_ARB_PMIC_ARB_DEBUG_SPMI_CHNL_WDATA5_ADDR A:0x6b2202c
y.create.l HWIO_QDSS_PMIC_ARB_PMIC_ARB_DEBUG_SPMI_CHNL_WDATA6_ADDR A:0x6b22030
y.create.l HWIO_QDSS_PMIC_ARB_PMIC_ARB_DEBUG_SPMI_CHNL_WDATA7_ADDR A:0x6b22034
y.create.l HWIO_QDSS_PMIC_ARB_PMIC_ARB_DEBUG_SPMI_CHNL_RDATA0_ADDR A:0x6b22038
y.create.l HWIO_QDSS_PMIC_ARB_PMIC_ARB_DEBUG_SPMI_CHNL_RDATA1_ADDR A:0x6b2203c
y.create.l HWIO_QDSS_PMIC_ARB_PMIC_ARB_DEBUG_SPMI_CHNL_RDATA2_ADDR A:0x6b22040
y.create.l HWIO_QDSS_PMIC_ARB_PMIC_ARB_DEBUG_SPMI_CHNL_RDATA3_ADDR A:0x6b22044
y.create.l HWIO_QDSS_PMIC_ARB_PMIC_ARB_DEBUG_SPMI_CHNL_RDATA4_ADDR A:0x6b22048
y.create.l HWIO_QDSS_PMIC_ARB_PMIC_ARB_DEBUG_SPMI_CHNL_RDATA5_ADDR A:0x6b2204c
y.create.l HWIO_QDSS_PMIC_ARB_PMIC_ARB_DEBUG_SPMI_CHNL_RDATA6_ADDR A:0x6b22050
y.create.l HWIO_QDSS_PMIC_ARB_PMIC_ARB_DEBUG_SPMI_CHNL_RDATA7_ADDR A:0x6b22054
y.create.l HWIO_QDSS_PMIC_ARB_PMIC_ARB_DEBUG_SPMI_CHNL_RDATA8_ADDR A:0x6b22058
y.create.l HWIO_QDSS_PMIC_ARB_PMIC_ARB_DEBUG_SPMI_CHNL_RDATA9_ADDR A:0x6b2205c
y.create.done

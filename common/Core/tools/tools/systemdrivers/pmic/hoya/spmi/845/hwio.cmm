y.create.l HWIO_AOSS_CC_SPMI_BCR_ADDR A:0xc2a21f4
y.create.l HWIO_AOSS_CC_SPMI_CFG_AHB_CBCR_ADDR A:0xc2a21f8
y.create.l HWIO_AOSS_CC_SPMI_SER_CBCR_ADDR A:0xc2a21fc
y.create.l HWIO_AOSS_CC_SPMI_AOD_SER_CBCR_ADDR A:0xc2a2200
y.create.l HWIO_AOSS_CC_SPMI_AOD_SER_CMD_RCGR_ADDR A:0xc2a2204
y.create.l HWIO_AOSS_CC_SPMI_AOD_SER_CFG_RCGR_ADDR A:0xc2a2208
y.create.l HWIO_SPMI_GENI_CLK_CTRL_ADDR A:0xc40a000
y.create.l HWIO_SPMI_GENI_HW_VERSION_ADDR A:0xc40a004
y.create.l HWIO_SPMI_GENI_FW_REVISION_ADDR A:0xc40a008
y.create.l HWIO_SPMI_GENI_S_FW_REVISION_ADDR A:0xc40a00c
y.create.l HWIO_SPMI_GENI_FORCE_DEFAULT_REG_ADDR A:0xc40a010
y.create.l HWIO_SPMI_GENI_OUTPUT_CTRL_ADDR A:0xc40a014
y.create.l HWIO_SPMI_GENI_CGC_CTRL_ADDR A:0xc40a018
y.create.l HWIO_SPMI_GENI_CHAR_CFG_ADDR A:0xc40a01c
y.create.l HWIO_SPMI_GENI_CHAR_DATA_0_ADDR A:0xc40a020
y.create.l HWIO_SPMI_GENI_CHAR_DATA_1_ADDR A:0xc40a024
y.create.l HWIO_SPMI_GENI_CTRL_ADDR A:0xc40a028
y.create.l HWIO_SPMI_GENI_STATUS_ADDR A:0xc40a02c
y.create.l HWIO_SPMI_GENI_TEST_BUS_CTRL_ADDR A:0xc40a030
y.create.l HWIO_SPMI_GENI_SER_CLK_CFG_ADDR A:0xc40a034
y.create.l HWIO_SPMI_GENI_TX_WATERMARK_REG_ADDR A:0xc40a038
y.create.l HWIO_SPMI_GENI_RX_WATERMARK_REG_ADDR A:0xc40a03c
y.create.l HWIO_SPMI_GENI_STOP_REG_ADDR A:0xc40a040
y.create.l HWIO_SPMI_GENI_SW_COMP_REG_ADDR A:0xc40a044
y.create.l HWIO_SPMI_GENI_PROG_ROM_CTRL_REG_ADDR A:0xc40a048
y.create.l HWIO_SPMI_GENI_CFG_REG0_ADDR A:0xc40a100
y.create.l HWIO_SPMI_GENI_CFG_REG1_ADDR A:0xc40a104
y.create.l HWIO_SPMI_GENI_CFG_REG2_ADDR A:0xc40a108
y.create.l HWIO_SPMI_GENI_CFG_REG3_ADDR A:0xc40a10c
y.create.l HWIO_SPMI_GENI_CFG_REG4_ADDR A:0xc40a110
y.create.l HWIO_SPMI_GENI_CFG_REG5_ADDR A:0xc40a114
y.create.l HWIO_SPMI_GENI_CFG_REG6_ADDR A:0xc40a118
y.create.l HWIO_SPMI_GENI_CFG_REG7_ADDR A:0xc40a11c
y.create.l HWIO_SPMI_GENI_CFG_REG8_ADDR A:0xc40a120
y.create.l HWIO_SPMI_GENI_CFG_REG9_ADDR A:0xc40a124
y.create.l HWIO_SPMI_GENI_CFG_REG10_ADDR A:0xc40a128
y.create.l HWIO_SPMI_GENI_CFG_REG11_ADDR A:0xc40a12c
y.create.l HWIO_SPMI_GENI_CFG_REG12_ADDR A:0xc40a130
y.create.l HWIO_SPMI_GENI_CFG_REG13_ADDR A:0xc40a134
y.create.l HWIO_SPMI_GENI_CFG_REG14_ADDR A:0xc40a138
y.create.l HWIO_SPMI_GENI_CFG_REG15_ADDR A:0xc40a13c
y.create.l HWIO_SPMI_GENI_CFG_REG16_ADDR A:0xc40a140
y.create.l HWIO_SPMI_GENI_CFG_REG17_ADDR A:0xc40a144
y.create.l HWIO_SPMI_GENI_CFG_REG18_ADDR A:0xc40a148
y.create.l HWIO_SPMI_GENI_CFG_REG19_ADDR A:0xc40a14c
y.create.l HWIO_SPMI_GENI_CFG_REG20_ADDR A:0xc40a150
y.create.l HWIO_SPMI_GENI_CFG_REG21_ADDR A:0xc40a154
y.create.l HWIO_SPMI_GENI_CFG_REG22_ADDR A:0xc40a158
y.create.l HWIO_SPMI_GENI_CFG_REG23_ADDR A:0xc40a15c
y.create.l HWIO_SPMI_GENI_CFG_REG24_ADDR A:0xc40a160
y.create.l HWIO_SPMI_GENI_CFG_REG25_ADDR A:0xc40a164
y.create.l HWIO_SPMI_GENI_CFG_REG26_ADDR A:0xc40a168
y.create.l HWIO_SPMI_GENI_CFG_REG27_ADDR A:0xc40a16c
y.create.l HWIO_SPMI_GENI_CFG_REG28_ADDR A:0xc40a170
y.create.l HWIO_SPMI_GENI_CFG_REG29_ADDR A:0xc40a174
y.create.l HWIO_SPMI_GENI_CFG_REG30_ADDR A:0xc40a178
y.create.l HWIO_SPMI_GENI_CFG_RAM0_ADDR A:0xc40a200
y.create.l HWIO_SPMI_GENI_CFG_RAM1_ADDR A:0xc40a204
y.create.l HWIO_SPMI_GENI_CFG_RAM2_ADDR A:0xc40a208
y.create.l HWIO_SPMI_GENI_CFG_RAM3_ADDR A:0xc40a20c
y.create.l HWIO_SPMI_GENI_CFG_RAM4_ADDR A:0xc40a210
y.create.l HWIO_SPMI_GENI_CFG_RAM5_ADDR A:0xc40a214
y.create.l HWIO_SPMI_GENI_CFG_RAM6_ADDR A:0xc40a218
y.create.l HWIO_SPMI_GENI_CFG_RAM7_ADDR A:0xc40a21c
y.create.l HWIO_SPMI_GENI_CFG_RAM8_ADDR A:0xc40a220
y.create.l HWIO_SPMI_GENI_CFG_RAM9_ADDR A:0xc40a224
y.create.l HWIO_SPMI_GENI_CFG_RAM10_ADDR A:0xc40a228
y.create.l HWIO_SPMI_GENI_CFG_RAM11_ADDR A:0xc40a22c
y.create.l HWIO_SPMI_GENI_CFG_RAM12_ADDR A:0xc40a230
y.create.l HWIO_SPMI_GENI_CFG_RAM13_ADDR A:0xc40a234
y.create.l HWIO_SPMI_GENI_CFG_RAM14_ADDR A:0xc40a238
y.create.l HWIO_SPMI_GENI_CFG_RAM15_ADDR A:0xc40a23c
y.create.l HWIO_SPMI_GENI_CFG_RAM16_ADDR A:0xc40a240
y.create.l HWIO_SPMI_GENI_CFG_RAM17_ADDR A:0xc40a244
y.create.l HWIO_SPMI_GENI_CFG_RAM18_ADDR A:0xc40a248
y.create.l HWIO_SPMI_GENI_CFG_RAM19_ADDR A:0xc40a24c
y.create.l HWIO_SPMI_GENI_CFG_RAM20_ADDR A:0xc40a250
y.create.l HWIO_SPMI_GENI_CFG_RAM21_ADDR A:0xc40a254
y.create.l HWIO_SPMI_GENI_CFG_RAM22_ADDR A:0xc40a258
y.create.l HWIO_SPMI_GENI_CFG_RAM23_ADDR A:0xc40a25c
y.create.l HWIO_SPMI_GENI_CFG_RAM24_ADDR A:0xc40a260
y.create.l HWIO_SPMI_GENI_CFG_RAM25_ADDR A:0xc40a264
y.create.l HWIO_SPMI_GENI_CFG_RAM26_ADDR A:0xc40a268
y.create.l HWIO_SPMI_GENI_CFG_RAM27_ADDR A:0xc40a26c
y.create.l HWIO_SPMI_GENI_CFG_RAM28_ADDR A:0xc40a270
y.create.l HWIO_SPMI_GENI_CFG_RAM29_ADDR A:0xc40a274
y.create.l HWIO_SPMI_GENI_CFG_RAM30_ADDR A:0xc40a278
y.create.l HWIO_SPMI_GENI_CFG_RAM31_ADDR A:0xc40a27c
y.create.l HWIO_SPMI_GENI_CFG_RAM32_ADDR A:0xc40a280
y.create.l HWIO_SPMI_GENI_CFG_RAM33_ADDR A:0xc40a284
y.create.l HWIO_SPMI_GENI_CFG_RAM34_ADDR A:0xc40a288
y.create.l HWIO_SPMI_GENI_CFG_RAM35_ADDR A:0xc40a28c
y.create.l HWIO_SPMI_GENI_CFG_RAM36_ADDR A:0xc40a290
y.create.l HWIO_SPMI_GENI_CFG_RAM37_ADDR A:0xc40a294
y.create.l HWIO_SPMI_GENI_CFG_RAM38_ADDR A:0xc40a298
y.create.l HWIO_SPMI_GENI_CFG_RAM39_ADDR A:0xc40a29c
y.create.l HWIO_SPMI_GENI_CFG_RAM40_ADDR A:0xc40a2a0
y.create.l HWIO_SPMI_GENI_CFG_RAM41_ADDR A:0xc40a2a4
y.create.l HWIO_SPMI_GENI_CFG_RAM42_ADDR A:0xc40a2a8
y.create.l HWIO_SPMI_GENI_CFG_RAM43_ADDR A:0xc40a2ac
y.create.l HWIO_SPMI_GENI_CFG_RAM44_ADDR A:0xc40a2b0
y.create.l HWIO_SPMI_GENI_CFG_RAM45_ADDR A:0xc40a2b4
y.create.l HWIO_SPMI_GENI_CFG_RAM46_ADDR A:0xc40a2b8
y.create.l HWIO_SPMI_GENI_CFG_RAM47_ADDR A:0xc40a2bc
y.create.l HWIO_SPMI_GENI_CFG_RAM48_ADDR A:0xc40a2c0
y.create.l HWIO_SPMI_GENI_CFG_RAM49_ADDR A:0xc40a2c4
y.create.l HWIO_SPMI_GENI_CFG_RAM50_ADDR A:0xc40a2c8
y.create.l HWIO_SPMI_GENI_CFG_RAM51_ADDR A:0xc40a2cc
y.create.l HWIO_SPMI_GENI_CFG_RAM52_ADDR A:0xc40a2d0
y.create.l HWIO_SPMI_GENI_CFG_RAM53_ADDR A:0xc40a2d4
y.create.l HWIO_SPMI_GENI_CFG_RAM54_ADDR A:0xc40a2d8
y.create.l HWIO_SPMI_GENI_CFG_RAM55_ADDR A:0xc40a2dc
y.create.l HWIO_SPMI_GENI_CFG_RAM56_ADDR A:0xc40a2e0
y.create.l HWIO_SPMI_GENI_CFG_RAM57_ADDR A:0xc40a2e4
y.create.l HWIO_SPMI_GENI_CFG_RAM58_ADDR A:0xc40a2e8
y.create.l HWIO_SPMI_GENI_CFG_RAM59_ADDR A:0xc40a2ec
y.create.l HWIO_SPMI_GENI_CFG_RAM60_ADDR A:0xc40a2f0
y.create.l HWIO_SPMI_GENI_CFG_RAM61_ADDR A:0xc40a2f4
y.create.l HWIO_SPMI_GENI_CFG_RAM62_ADDR A:0xc40a2f8
y.create.l HWIO_SPMI_GENI_CFG_RAM63_ADDR A:0xc40a2fc
y.create.l HWIO_SPMI_GENI_CFG_RAM64_ADDR A:0xc40a300
y.create.l HWIO_SPMI_GENI_CFG_RAM65_ADDR A:0xc40a304
y.create.l HWIO_SPMI_GENI_CFG_RAM66_ADDR A:0xc40a308
y.create.l HWIO_SPMI_GENI_CFG_RAM67_ADDR A:0xc40a30c
y.create.l HWIO_SPMI_GENI_CFG_RAM68_ADDR A:0xc40a310
y.create.l HWIO_SPMI_GENI_CFG_RAM69_ADDR A:0xc40a314
y.create.l HWIO_SPMI_GENI_CFG_RAM70_ADDR A:0xc40a318
y.create.l HWIO_SPMI_GENI_CFG_RAM71_ADDR A:0xc40a31c
y.create.l HWIO_SPMI_GENI_CFG_RAM72_ADDR A:0xc40a320
y.create.l HWIO_SPMI_GENI_CFG_RAM73_ADDR A:0xc40a324
y.create.l HWIO_SPMI_GENI_CFG_RAM74_ADDR A:0xc40a328
y.create.l HWIO_SPMI_GENI_CFG_RAM75_ADDR A:0xc40a32c
y.create.l HWIO_SPMI_GENI_CFG_RAM76_ADDR A:0xc40a330
y.create.l HWIO_SPMI_GENI_CFG_RAM77_ADDR A:0xc40a334
y.create.l HWIO_SPMI_GENI_CFG_RAM78_ADDR A:0xc40a338
y.create.l HWIO_SPMI_GENI_CFG_RAM79_ADDR A:0xc40a33c
y.create.l HWIO_SPMI_GENI_CFG_RAM80_ADDR A:0xc40a340
y.create.l HWIO_SPMI_GENI_CFG_RAM81_ADDR A:0xc40a344
y.create.l HWIO_SPMI_GENI_CFG_RAM82_ADDR A:0xc40a348
y.create.l HWIO_SPMI_GENI_CFG_RAM83_ADDR A:0xc40a34c
y.create.l HWIO_SPMI_GENI_CFG_RAM84_ADDR A:0xc40a350
y.create.l HWIO_SPMI_GENI_CFG_RAM85_ADDR A:0xc40a354
y.create.l HWIO_SPMI_GENI_CFG_RAM86_ADDR A:0xc40a358
y.create.l HWIO_SPMI_GENI_CFG_RAM87_ADDR A:0xc40a35c
y.create.l HWIO_SPMI_GENI_CFG_RAM88_ADDR A:0xc40a360
y.create.l HWIO_SPMI_GENI_CFG_RAM89_ADDR A:0xc40a364
y.create.l HWIO_SPMI_GENI_CFG_RAM90_ADDR A:0xc40a368
y.create.l HWIO_SPMI_GENI_CFG_RAM91_ADDR A:0xc40a36c
y.create.l HWIO_SPMI_GENI_CFG_RAM92_ADDR A:0xc40a370
y.create.l HWIO_SPMI_GENI_CFG_RAM93_ADDR A:0xc40a374
y.create.l HWIO_SPMI_GENI_CFG_RAM94_ADDR A:0xc40a378
y.create.l HWIO_SPMI_GENI_CFG_RAM95_ADDR A:0xc40a37c
y.create.l HWIO_SPMI_GENI_CFG_RAM96_ADDR A:0xc40a380
y.create.l HWIO_SPMI_GENI_CFG_RAM97_ADDR A:0xc40a384
y.create.l HWIO_SPMI_GENI_CFG_RAM98_ADDR A:0xc40a388
y.create.l HWIO_SPMI_GENI_CFG_RAM99_ADDR A:0xc40a38c
y.create.l HWIO_SPMI_GENI_CFG_RAM100_ADDR A:0xc40a390
y.create.l HWIO_SPMI_GENI_CFG_RAM101_ADDR A:0xc40a394
y.create.l HWIO_SPMI_GENI_CFG_RAM102_ADDR A:0xc40a398
y.create.l HWIO_SPMI_GENI_CFG_RAM103_ADDR A:0xc40a39c
y.create.l HWIO_SPMI_GENI_CFG_RAM104_ADDR A:0xc40a3a0
y.create.l HWIO_SPMI_GENI_CFG_RAM105_ADDR A:0xc40a3a4
y.create.l HWIO_SPMI_GENI_CFG_RAM106_ADDR A:0xc40a3a8
y.create.l HWIO_SPMI_GENI_CFG_RAM107_ADDR A:0xc40a3ac
y.create.l HWIO_SPMI_GENI_CFG_RAM108_ADDR A:0xc40a3b0
y.create.l HWIO_SPMI_GENI_CFG_RAM109_ADDR A:0xc40a3b4
y.create.l HWIO_SPMI_GENI_CFG_RAM110_ADDR A:0xc40a3b8
y.create.l HWIO_SPMI_GENI_CFG_RAM111_ADDR A:0xc40a3bc
y.create.l HWIO_SPMI_GENI_CFG_RAM112_ADDR A:0xc40a3c0
y.create.l HWIO_SPMI_GENI_CFG_RAM113_ADDR A:0xc40a3c4
y.create.l HWIO_SPMI_GENI_CFG_RAM114_ADDR A:0xc40a3c8
y.create.l HWIO_SPMI_GENI_CFG_RAM115_ADDR A:0xc40a3cc
y.create.l HWIO_SPMI_GENI_CFG_RAM116_ADDR A:0xc40a3d0
y.create.l HWIO_SPMI_GENI_CFG_RAM117_ADDR A:0xc40a3d4
y.create.l HWIO_SPMI_GENI_CFG_RAM118_ADDR A:0xc40a3d8
y.create.l HWIO_SPMI_GENI_CFG_RAM119_ADDR A:0xc40a3dc
y.create.l HWIO_SPMI_GENI_CFG_RAM120_ADDR A:0xc40a3e0
y.create.l HWIO_SPMI_GENI_CFG_RAM121_ADDR A:0xc40a3e4
y.create.l HWIO_SPMI_GENI_CFG_RAM122_ADDR A:0xc40a3e8
y.create.l HWIO_SPMI_GENI_CFG_RAM123_ADDR A:0xc40a3ec
y.create.l HWIO_SPMI_GENI_CFG_RAM124_ADDR A:0xc40a3f0
y.create.l HWIO_SPMI_GENI_CFG_RAM125_ADDR A:0xc40a3f4
y.create.l HWIO_SPMI_GENI_CFG_RAM126_ADDR A:0xc40a3f8
y.create.l HWIO_SPMI_GENI_CFG_RAM127_ADDR A:0xc40a3fc
y.create.l HWIO_SPMI_GENI_CFG_RAM128_ADDR A:0xc40a400
y.create.l HWIO_SPMI_GENI_CFG_RAM129_ADDR A:0xc40a404
y.create.l HWIO_SPMI_GENI_CFG_RAM130_ADDR A:0xc40a408
y.create.l HWIO_SPMI_GENI_CFG_RAM131_ADDR A:0xc40a40c
y.create.l HWIO_SPMI_GENI_CFG_RAM132_ADDR A:0xc40a410
y.create.l HWIO_SPMI_GENI_CFG_RAM133_ADDR A:0xc40a414
y.create.l HWIO_SPMI_GENI_CFG_RAM134_ADDR A:0xc40a418
y.create.l HWIO_SPMI_GENI_CFG_RAM135_ADDR A:0xc40a41c
y.create.l HWIO_SPMI_GENI_CFG_RAM136_ADDR A:0xc40a420
y.create.l HWIO_SPMI_GENI_CFG_RAM137_ADDR A:0xc40a424
y.create.l HWIO_SPMI_GENI_CFG_RAM138_ADDR A:0xc40a428
y.create.l HWIO_SPMI_GENI_CFG_RAM139_ADDR A:0xc40a42c
y.create.l HWIO_SPMI_GENI_CFG_RAM140_ADDR A:0xc40a430
y.create.l HWIO_SPMI_GENI_CFG_RAM141_ADDR A:0xc40a434
y.create.l HWIO_SPMI_GENI_CFG_RAM142_ADDR A:0xc40a438
y.create.l HWIO_SPMI_GENI_CFG_RAM143_ADDR A:0xc40a43c
y.create.l HWIO_SPMI_GENI_CFG_RAM144_ADDR A:0xc40a440
y.create.l HWIO_SPMI_GENI_CFG_RAM145_ADDR A:0xc40a444
y.create.l HWIO_SPMI_GENI_CFG_RAM146_ADDR A:0xc40a448
y.create.l HWIO_SPMI_GENI_CFG_RAM147_ADDR A:0xc40a44c
y.create.l HWIO_SPMI_GENI_CFG_RAM148_ADDR A:0xc40a450
y.create.l HWIO_SPMI_GENI_CFG_RAM149_ADDR A:0xc40a454
y.create.l HWIO_SPMI_GENI_CFG_RAM150_ADDR A:0xc40a458
y.create.l HWIO_SPMI_GENI_CFG_RAM151_ADDR A:0xc40a45c
y.create.l HWIO_SPMI_GENI_CFG_RAM152_ADDR A:0xc40a460
y.create.l HWIO_SPMI_GENI_CFG_RAM153_ADDR A:0xc40a464
y.create.l HWIO_SPMI_GENI_CFG_RAM154_ADDR A:0xc40a468
y.create.l HWIO_SPMI_GENI_CFG_RAM155_ADDR A:0xc40a46c
y.create.l HWIO_SPMI_GENI_CFG_RAM156_ADDR A:0xc40a470
y.create.l HWIO_SPMI_GENI_CFG_RAM157_ADDR A:0xc40a474
y.create.l HWIO_SPMI_GENI_CFG_RAM158_ADDR A:0xc40a478
y.create.l HWIO_SPMI_GENI_CFG_RAM159_ADDR A:0xc40a47c
y.create.l HWIO_SPMI_GENI_CFG_RAM160_ADDR A:0xc40a480
y.create.l HWIO_SPMI_GENI_CFG_RAM161_ADDR A:0xc40a484
y.create.l HWIO_SPMI_GENI_CFG_RAM162_ADDR A:0xc40a488
y.create.l HWIO_SPMI_GENI_CFG_RAM163_ADDR A:0xc40a48c
y.create.l HWIO_SPMI_GENI_CFG_RAM164_ADDR A:0xc40a490
y.create.l HWIO_SPMI_GENI_CFG_RAM165_ADDR A:0xc40a494
y.create.l HWIO_SPMI_GENI_CFG_RAM166_ADDR A:0xc40a498
y.create.l HWIO_SPMI_GENI_CFG_RAM167_ADDR A:0xc40a49c
y.create.l HWIO_SPMI_GENI_CFG_RAM168_ADDR A:0xc40a4a0
y.create.l HWIO_SPMI_GENI_CFG_RAM169_ADDR A:0xc40a4a4
y.create.l HWIO_SPMI_GENI_CFG_RAM170_ADDR A:0xc40a4a8
y.create.l HWIO_SPMI_GENI_CFG_RAM171_ADDR A:0xc40a4ac
y.create.l HWIO_SPMI_GENI_CFG_RAM172_ADDR A:0xc40a4b0
y.create.l HWIO_SPMI_GENI_CFG_RAM173_ADDR A:0xc40a4b4
y.create.l HWIO_SPMI_GENI_CFG_RAM174_ADDR A:0xc40a4b8
y.create.l HWIO_SPMI_GENI_CFG_RAM175_ADDR A:0xc40a4bc
y.create.l HWIO_SPMI_GENI_CFG_RAM176_ADDR A:0xc40a4c0
y.create.l HWIO_SPMI_GENI_CFG_RAM177_ADDR A:0xc40a4c4
y.create.l HWIO_SPMI_GENI_CFG_RAM178_ADDR A:0xc40a4c8
y.create.l HWIO_SPMI_GENI_CFG_RAM179_ADDR A:0xc40a4cc
y.create.l HWIO_SPMI_GENI_CFG_RAM180_ADDR A:0xc40a4d0
y.create.l HWIO_SPMI_GENI_CFG_RAM181_ADDR A:0xc40a4d4
y.create.l HWIO_SPMI_GENI_CFG_RAM182_ADDR A:0xc40a4d8
y.create.l HWIO_SPMI_GENI_CFG_RAM183_ADDR A:0xc40a4dc
y.create.l HWIO_SPMI_GENI_CFG_RAM184_ADDR A:0xc40a4e0
y.create.l HWIO_SPMI_GENI_CFG_RAM185_ADDR A:0xc40a4e4
y.create.l HWIO_SPMI_GENI_CFG_RAM186_ADDR A:0xc40a4e8
y.create.l HWIO_SPMI_GENI_CFG_RAM187_ADDR A:0xc40a4ec
y.create.l HWIO_SPMI_GENI_CFG_RAM188_ADDR A:0xc40a4f0
y.create.l HWIO_SPMI_GENI_CFG_RAM189_ADDR A:0xc40a4f4
y.create.l HWIO_SPMI_GENI_CFG_RAM190_ADDR A:0xc40a4f8
y.create.l HWIO_SPMI_GENI_CFG_RAM191_ADDR A:0xc40a4fc
y.create.l HWIO_SPMI_GENI_CFG_RAM192_ADDR A:0xc40a500
y.create.l HWIO_SPMI_GENI_CFG_RAM193_ADDR A:0xc40a504
y.create.l HWIO_SPMI_GENI_CFG_RAM194_ADDR A:0xc40a508
y.create.l HWIO_SPMI_GENI_CFG_RAM195_ADDR A:0xc40a50c
y.create.l HWIO_SPMI_GENI_CFG_RAM196_ADDR A:0xc40a510
y.create.l HWIO_SPMI_GENI_CFG_RAM197_ADDR A:0xc40a514
y.create.l HWIO_SPMI_GENI_CFG_RAM198_ADDR A:0xc40a518
y.create.l HWIO_SPMI_GENI_CFG_RAM199_ADDR A:0xc40a51c
y.create.l HWIO_SPMI_GENI_CFG_RAM200_ADDR A:0xc40a520
y.create.l HWIO_SPMI_GENI_CFG_RAM201_ADDR A:0xc40a524
y.create.l HWIO_SPMI_GENI_CFG_RAM202_ADDR A:0xc40a528
y.create.l HWIO_SPMI_GENI_CFG_RAM203_ADDR A:0xc40a52c
y.create.l HWIO_SPMI_GENI_CFG_RAM204_ADDR A:0xc40a530
y.create.l HWIO_SPMI_GENI_CFG_RAM205_ADDR A:0xc40a534
y.create.l HWIO_SPMI_GENI_CFG_RAM206_ADDR A:0xc40a538
y.create.l HWIO_SPMI_GENI_CFG_RAM207_ADDR A:0xc40a53c
y.create.l HWIO_SPMI_GENI_CFG_RAM208_ADDR A:0xc40a540
y.create.l HWIO_SPMI_GENI_CFG_RAM209_ADDR A:0xc40a544
y.create.l HWIO_SPMI_GENI_CFG_RAM210_ADDR A:0xc40a548
y.create.l HWIO_SPMI_GENI_CFG_RAM211_ADDR A:0xc40a54c
y.create.l HWIO_SPMI_GENI_CFG_RAM212_ADDR A:0xc40a550
y.create.l HWIO_SPMI_GENI_CFG_RAM213_ADDR A:0xc40a554
y.create.l HWIO_SPMI_GENI_CFG_RAM214_ADDR A:0xc40a558
y.create.l HWIO_SPMI_GENI_CFG_RAM215_ADDR A:0xc40a55c
y.create.l HWIO_SPMI_GENI_CFG_RAM216_ADDR A:0xc40a560
y.create.l HWIO_SPMI_GENI_CFG_RAM217_ADDR A:0xc40a564
y.create.l HWIO_SPMI_GENI_CFG_RAM218_ADDR A:0xc40a568
y.create.l HWIO_SPMI_GENI_CFG_RAM219_ADDR A:0xc40a56c
y.create.l HWIO_SPMI_GENI_CFG_RAM220_ADDR A:0xc40a570
y.create.l HWIO_SPMI_GENI_CFG_RAM221_ADDR A:0xc40a574
y.create.l HWIO_SPMI_GENI_CFG_RAM222_ADDR A:0xc40a578
y.create.l HWIO_SPMI_GENI_CFG_RAM223_ADDR A:0xc40a57c
y.create.l HWIO_SPMI_GENI_CFG_RAM224_ADDR A:0xc40a580
y.create.l HWIO_SPMI_GENI_CFG_RAM225_ADDR A:0xc40a584
y.create.l HWIO_SPMI_GENI_CFG_RAM226_ADDR A:0xc40a588
y.create.l HWIO_SPMI_GENI_CFG_RAM227_ADDR A:0xc40a58c
y.create.l HWIO_SPMI_GENI_CFG_RAM228_ADDR A:0xc40a590
y.create.l HWIO_SPMI_GENI_CFG_RAM229_ADDR A:0xc40a594
y.create.l HWIO_SPMI_GENI_CFG_RAM230_ADDR A:0xc40a598
y.create.l HWIO_SPMI_GENI_CFG_RAM231_ADDR A:0xc40a59c
y.create.l HWIO_SPMI_GENI_CFG_RAM232_ADDR A:0xc40a5a0
y.create.l HWIO_SPMI_GENI_CFG_RAM233_ADDR A:0xc40a5a4
y.create.l HWIO_SPMI_GENI_CFG_RAM234_ADDR A:0xc40a5a8
y.create.l HWIO_SPMI_GENI_CFG_RAM235_ADDR A:0xc40a5ac
y.create.l HWIO_SPMI_GENI_CFG_RAM236_ADDR A:0xc40a5b0
y.create.l HWIO_SPMI_GENI_CFG_RAM237_ADDR A:0xc40a5b4
y.create.l HWIO_SPMI_GENI_CFG_RAM238_ADDR A:0xc40a5b8
y.create.l HWIO_SPMI_GENI_CFG_RAM239_ADDR A:0xc40a5bc
y.create.l HWIO_SPMI_GENI_CFG_RAM240_ADDR A:0xc40a5c0
y.create.l HWIO_SPMI_GENI_CFG_RAM241_ADDR A:0xc40a5c4
y.create.l HWIO_SPMI_GENI_CFG_RAM242_ADDR A:0xc40a5c8
y.create.l HWIO_SPMI_GENI_CFG_RAM243_ADDR A:0xc40a5cc
y.create.l HWIO_SPMI_GENI_CFG_RAM244_ADDR A:0xc40a5d0
y.create.l HWIO_SPMI_GENI_CFG_RAM245_ADDR A:0xc40a5d4
y.create.l HWIO_SPMI_GENI_CFG_RAM246_ADDR A:0xc40a5d8
y.create.l HWIO_SPMI_GENI_CFG_RAM247_ADDR A:0xc40a5dc
y.create.l HWIO_SPMI_GENI_CFG_RAM248_ADDR A:0xc40a5e0
y.create.l HWIO_SPMI_GENI_CFG_RAM249_ADDR A:0xc40a5e4
y.create.l HWIO_SPMI_GENI_CFG_RAM250_ADDR A:0xc40a5e8
y.create.l HWIO_SPMI_GENI_CFG_RAM251_ADDR A:0xc40a5ec
y.create.l HWIO_SPMI_GENI_CFG_RAM252_ADDR A:0xc40a5f0
y.create.l HWIO_SPMI_GENI_CFG_RAM253_ADDR A:0xc40a5f4
y.create.l HWIO_SPMI_GENI_CFG_RAM254_ADDR A:0xc40a5f8
y.create.l HWIO_SPMI_GENI_CFG_RAM255_ADDR A:0xc40a5fc
y.create.l HWIO_SPMI_PERIPH0_2OWNER_TABLE_REG_ADDR A:0xc40a700
y.create.l HWIO_SPMI_PERIPH1_2OWNER_TABLE_REG_ADDR A:0xc40a704
y.create.l HWIO_SPMI_PERIPH2_2OWNER_TABLE_REG_ADDR A:0xc40a708
y.create.l HWIO_SPMI_PERIPH3_2OWNER_TABLE_REG_ADDR A:0xc40a70c
y.create.l HWIO_SPMI_PERIPH4_2OWNER_TABLE_REG_ADDR A:0xc40a710
y.create.l HWIO_SPMI_PERIPH5_2OWNER_TABLE_REG_ADDR A:0xc40a714
y.create.l HWIO_SPMI_PERIPH6_2OWNER_TABLE_REG_ADDR A:0xc40a718
y.create.l HWIO_SPMI_PERIPH7_2OWNER_TABLE_REG_ADDR A:0xc40a71c
y.create.l HWIO_SPMI_PERIPH8_2OWNER_TABLE_REG_ADDR A:0xc40a720
y.create.l HWIO_SPMI_PERIPH9_2OWNER_TABLE_REG_ADDR A:0xc40a724
y.create.l HWIO_SPMI_PERIPH10_2OWNER_TABLE_REG_ADDR A:0xc40a728
y.create.l HWIO_SPMI_PERIPH11_2OWNER_TABLE_REG_ADDR A:0xc40a72c
y.create.l HWIO_SPMI_PERIPH12_2OWNER_TABLE_REG_ADDR A:0xc40a730
y.create.l HWIO_SPMI_PERIPH13_2OWNER_TABLE_REG_ADDR A:0xc40a734
y.create.l HWIO_SPMI_PERIPH14_2OWNER_TABLE_REG_ADDR A:0xc40a738
y.create.l HWIO_SPMI_PERIPH15_2OWNER_TABLE_REG_ADDR A:0xc40a73c
y.create.l HWIO_SPMI_PERIPH16_2OWNER_TABLE_REG_ADDR A:0xc40a740
y.create.l HWIO_SPMI_PERIPH17_2OWNER_TABLE_REG_ADDR A:0xc40a744
y.create.l HWIO_SPMI_PERIPH18_2OWNER_TABLE_REG_ADDR A:0xc40a748
y.create.l HWIO_SPMI_PERIPH19_2OWNER_TABLE_REG_ADDR A:0xc40a74c
y.create.l HWIO_SPMI_PERIPH20_2OWNER_TABLE_REG_ADDR A:0xc40a750
y.create.l HWIO_SPMI_PERIPH21_2OWNER_TABLE_REG_ADDR A:0xc40a754
y.create.l HWIO_SPMI_PERIPH22_2OWNER_TABLE_REG_ADDR A:0xc40a758
y.create.l HWIO_SPMI_PERIPH23_2OWNER_TABLE_REG_ADDR A:0xc40a75c
y.create.l HWIO_SPMI_PERIPH24_2OWNER_TABLE_REG_ADDR A:0xc40a760
y.create.l HWIO_SPMI_PERIPH25_2OWNER_TABLE_REG_ADDR A:0xc40a764
y.create.l HWIO_SPMI_PERIPH26_2OWNER_TABLE_REG_ADDR A:0xc40a768
y.create.l HWIO_SPMI_PERIPH27_2OWNER_TABLE_REG_ADDR A:0xc40a76c
y.create.l HWIO_SPMI_PERIPH28_2OWNER_TABLE_REG_ADDR A:0xc40a770
y.create.l HWIO_SPMI_PERIPH29_2OWNER_TABLE_REG_ADDR A:0xc40a774
y.create.l HWIO_SPMI_PERIPH30_2OWNER_TABLE_REG_ADDR A:0xc40a778
y.create.l HWIO_SPMI_PERIPH31_2OWNER_TABLE_REG_ADDR A:0xc40a77c
y.create.l HWIO_SPMI_PERIPH32_2OWNER_TABLE_REG_ADDR A:0xc40a780
y.create.l HWIO_SPMI_PERIPH33_2OWNER_TABLE_REG_ADDR A:0xc40a784
y.create.l HWIO_SPMI_PERIPH34_2OWNER_TABLE_REG_ADDR A:0xc40a788
y.create.l HWIO_SPMI_PERIPH35_2OWNER_TABLE_REG_ADDR A:0xc40a78c
y.create.l HWIO_SPMI_PERIPH36_2OWNER_TABLE_REG_ADDR A:0xc40a790
y.create.l HWIO_SPMI_PERIPH37_2OWNER_TABLE_REG_ADDR A:0xc40a794
y.create.l HWIO_SPMI_PERIPH38_2OWNER_TABLE_REG_ADDR A:0xc40a798
y.create.l HWIO_SPMI_PERIPH39_2OWNER_TABLE_REG_ADDR A:0xc40a79c
y.create.l HWIO_SPMI_PERIPH40_2OWNER_TABLE_REG_ADDR A:0xc40a7a0
y.create.l HWIO_SPMI_PERIPH41_2OWNER_TABLE_REG_ADDR A:0xc40a7a4
y.create.l HWIO_SPMI_PERIPH42_2OWNER_TABLE_REG_ADDR A:0xc40a7a8
y.create.l HWIO_SPMI_PERIPH43_2OWNER_TABLE_REG_ADDR A:0xc40a7ac
y.create.l HWIO_SPMI_PERIPH44_2OWNER_TABLE_REG_ADDR A:0xc40a7b0
y.create.l HWIO_SPMI_PERIPH45_2OWNER_TABLE_REG_ADDR A:0xc40a7b4
y.create.l HWIO_SPMI_PERIPH46_2OWNER_TABLE_REG_ADDR A:0xc40a7b8
y.create.l HWIO_SPMI_PERIPH47_2OWNER_TABLE_REG_ADDR A:0xc40a7bc
y.create.l HWIO_SPMI_PERIPH48_2OWNER_TABLE_REG_ADDR A:0xc40a7c0
y.create.l HWIO_SPMI_PERIPH49_2OWNER_TABLE_REG_ADDR A:0xc40a7c4
y.create.l HWIO_SPMI_PERIPH50_2OWNER_TABLE_REG_ADDR A:0xc40a7c8
y.create.l HWIO_SPMI_PERIPH51_2OWNER_TABLE_REG_ADDR A:0xc40a7cc
y.create.l HWIO_SPMI_PERIPH52_2OWNER_TABLE_REG_ADDR A:0xc40a7d0
y.create.l HWIO_SPMI_PERIPH53_2OWNER_TABLE_REG_ADDR A:0xc40a7d4
y.create.l HWIO_SPMI_PERIPH54_2OWNER_TABLE_REG_ADDR A:0xc40a7d8
y.create.l HWIO_SPMI_PERIPH55_2OWNER_TABLE_REG_ADDR A:0xc40a7dc
y.create.l HWIO_SPMI_PERIPH56_2OWNER_TABLE_REG_ADDR A:0xc40a7e0
y.create.l HWIO_SPMI_PERIPH57_2OWNER_TABLE_REG_ADDR A:0xc40a7e4
y.create.l HWIO_SPMI_PERIPH58_2OWNER_TABLE_REG_ADDR A:0xc40a7e8
y.create.l HWIO_SPMI_PERIPH59_2OWNER_TABLE_REG_ADDR A:0xc40a7ec
y.create.l HWIO_SPMI_PERIPH60_2OWNER_TABLE_REG_ADDR A:0xc40a7f0
y.create.l HWIO_SPMI_PERIPH61_2OWNER_TABLE_REG_ADDR A:0xc40a7f4
y.create.l HWIO_SPMI_PERIPH62_2OWNER_TABLE_REG_ADDR A:0xc40a7f8
y.create.l HWIO_SPMI_PERIPH63_2OWNER_TABLE_REG_ADDR A:0xc40a7fc
y.create.l HWIO_SPMI_PERIPH64_2OWNER_TABLE_REG_ADDR A:0xc40a800
y.create.l HWIO_SPMI_PERIPH65_2OWNER_TABLE_REG_ADDR A:0xc40a804
y.create.l HWIO_SPMI_PERIPH66_2OWNER_TABLE_REG_ADDR A:0xc40a808
y.create.l HWIO_SPMI_PERIPH67_2OWNER_TABLE_REG_ADDR A:0xc40a80c
y.create.l HWIO_SPMI_PERIPH68_2OWNER_TABLE_REG_ADDR A:0xc40a810
y.create.l HWIO_SPMI_PERIPH69_2OWNER_TABLE_REG_ADDR A:0xc40a814
y.create.l HWIO_SPMI_PERIPH70_2OWNER_TABLE_REG_ADDR A:0xc40a818
y.create.l HWIO_SPMI_PERIPH71_2OWNER_TABLE_REG_ADDR A:0xc40a81c
y.create.l HWIO_SPMI_PERIPH72_2OWNER_TABLE_REG_ADDR A:0xc40a820
y.create.l HWIO_SPMI_PERIPH73_2OWNER_TABLE_REG_ADDR A:0xc40a824
y.create.l HWIO_SPMI_PERIPH74_2OWNER_TABLE_REG_ADDR A:0xc40a828
y.create.l HWIO_SPMI_PERIPH75_2OWNER_TABLE_REG_ADDR A:0xc40a82c
y.create.l HWIO_SPMI_PERIPH76_2OWNER_TABLE_REG_ADDR A:0xc40a830
y.create.l HWIO_SPMI_PERIPH77_2OWNER_TABLE_REG_ADDR A:0xc40a834
y.create.l HWIO_SPMI_PERIPH78_2OWNER_TABLE_REG_ADDR A:0xc40a838
y.create.l HWIO_SPMI_PERIPH79_2OWNER_TABLE_REG_ADDR A:0xc40a83c
y.create.l HWIO_SPMI_PERIPH80_2OWNER_TABLE_REG_ADDR A:0xc40a840
y.create.l HWIO_SPMI_PERIPH81_2OWNER_TABLE_REG_ADDR A:0xc40a844
y.create.l HWIO_SPMI_PERIPH82_2OWNER_TABLE_REG_ADDR A:0xc40a848
y.create.l HWIO_SPMI_PERIPH83_2OWNER_TABLE_REG_ADDR A:0xc40a84c
y.create.l HWIO_SPMI_PERIPH84_2OWNER_TABLE_REG_ADDR A:0xc40a850
y.create.l HWIO_SPMI_PERIPH85_2OWNER_TABLE_REG_ADDR A:0xc40a854
y.create.l HWIO_SPMI_PERIPH86_2OWNER_TABLE_REG_ADDR A:0xc40a858
y.create.l HWIO_SPMI_PERIPH87_2OWNER_TABLE_REG_ADDR A:0xc40a85c
y.create.l HWIO_SPMI_PERIPH88_2OWNER_TABLE_REG_ADDR A:0xc40a860
y.create.l HWIO_SPMI_PERIPH89_2OWNER_TABLE_REG_ADDR A:0xc40a864
y.create.l HWIO_SPMI_PERIPH90_2OWNER_TABLE_REG_ADDR A:0xc40a868
y.create.l HWIO_SPMI_PERIPH91_2OWNER_TABLE_REG_ADDR A:0xc40a86c
y.create.l HWIO_SPMI_PERIPH92_2OWNER_TABLE_REG_ADDR A:0xc40a870
y.create.l HWIO_SPMI_PERIPH93_2OWNER_TABLE_REG_ADDR A:0xc40a874
y.create.l HWIO_SPMI_PERIPH94_2OWNER_TABLE_REG_ADDR A:0xc40a878
y.create.l HWIO_SPMI_PERIPH95_2OWNER_TABLE_REG_ADDR A:0xc40a87c
y.create.l HWIO_SPMI_PERIPH96_2OWNER_TABLE_REG_ADDR A:0xc40a880
y.create.l HWIO_SPMI_PERIPH97_2OWNER_TABLE_REG_ADDR A:0xc40a884
y.create.l HWIO_SPMI_PERIPH98_2OWNER_TABLE_REG_ADDR A:0xc40a888
y.create.l HWIO_SPMI_PERIPH99_2OWNER_TABLE_REG_ADDR A:0xc40a88c
y.create.l HWIO_SPMI_PERIPH100_2OWNER_TABLE_REG_ADDR A:0xc40a890
y.create.l HWIO_SPMI_PERIPH101_2OWNER_TABLE_REG_ADDR A:0xc40a894
y.create.l HWIO_SPMI_PERIPH102_2OWNER_TABLE_REG_ADDR A:0xc40a898
y.create.l HWIO_SPMI_PERIPH103_2OWNER_TABLE_REG_ADDR A:0xc40a89c
y.create.l HWIO_SPMI_PERIPH104_2OWNER_TABLE_REG_ADDR A:0xc40a8a0
y.create.l HWIO_SPMI_PERIPH105_2OWNER_TABLE_REG_ADDR A:0xc40a8a4
y.create.l HWIO_SPMI_PERIPH106_2OWNER_TABLE_REG_ADDR A:0xc40a8a8
y.create.l HWIO_SPMI_PERIPH107_2OWNER_TABLE_REG_ADDR A:0xc40a8ac
y.create.l HWIO_SPMI_PERIPH108_2OWNER_TABLE_REG_ADDR A:0xc40a8b0
y.create.l HWIO_SPMI_PERIPH109_2OWNER_TABLE_REG_ADDR A:0xc40a8b4
y.create.l HWIO_SPMI_PERIPH110_2OWNER_TABLE_REG_ADDR A:0xc40a8b8
y.create.l HWIO_SPMI_PERIPH111_2OWNER_TABLE_REG_ADDR A:0xc40a8bc
y.create.l HWIO_SPMI_PERIPH112_2OWNER_TABLE_REG_ADDR A:0xc40a8c0
y.create.l HWIO_SPMI_PERIPH113_2OWNER_TABLE_REG_ADDR A:0xc40a8c4
y.create.l HWIO_SPMI_PERIPH114_2OWNER_TABLE_REG_ADDR A:0xc40a8c8
y.create.l HWIO_SPMI_PERIPH115_2OWNER_TABLE_REG_ADDR A:0xc40a8cc
y.create.l HWIO_SPMI_PERIPH116_2OWNER_TABLE_REG_ADDR A:0xc40a8d0
y.create.l HWIO_SPMI_PERIPH117_2OWNER_TABLE_REG_ADDR A:0xc40a8d4
y.create.l HWIO_SPMI_PERIPH118_2OWNER_TABLE_REG_ADDR A:0xc40a8d8
y.create.l HWIO_SPMI_PERIPH119_2OWNER_TABLE_REG_ADDR A:0xc40a8dc
y.create.l HWIO_SPMI_PERIPH120_2OWNER_TABLE_REG_ADDR A:0xc40a8e0
y.create.l HWIO_SPMI_PERIPH121_2OWNER_TABLE_REG_ADDR A:0xc40a8e4
y.create.l HWIO_SPMI_PERIPH122_2OWNER_TABLE_REG_ADDR A:0xc40a8e8
y.create.l HWIO_SPMI_PERIPH123_2OWNER_TABLE_REG_ADDR A:0xc40a8ec
y.create.l HWIO_SPMI_PERIPH124_2OWNER_TABLE_REG_ADDR A:0xc40a8f0
y.create.l HWIO_SPMI_PERIPH125_2OWNER_TABLE_REG_ADDR A:0xc40a8f4
y.create.l HWIO_SPMI_PERIPH126_2OWNER_TABLE_REG_ADDR A:0xc40a8f8
y.create.l HWIO_SPMI_PERIPH127_2OWNER_TABLE_REG_ADDR A:0xc40a8fc
y.create.l HWIO_SPMI_PERIPH128_2OWNER_TABLE_REG_ADDR A:0xc40a900
y.create.l HWIO_SPMI_PERIPH129_2OWNER_TABLE_REG_ADDR A:0xc40a904
y.create.l HWIO_SPMI_PERIPH130_2OWNER_TABLE_REG_ADDR A:0xc40a908
y.create.l HWIO_SPMI_PERIPH131_2OWNER_TABLE_REG_ADDR A:0xc40a90c
y.create.l HWIO_SPMI_PERIPH132_2OWNER_TABLE_REG_ADDR A:0xc40a910
y.create.l HWIO_SPMI_PERIPH133_2OWNER_TABLE_REG_ADDR A:0xc40a914
y.create.l HWIO_SPMI_PERIPH134_2OWNER_TABLE_REG_ADDR A:0xc40a918
y.create.l HWIO_SPMI_PERIPH135_2OWNER_TABLE_REG_ADDR A:0xc40a91c
y.create.l HWIO_SPMI_PERIPH136_2OWNER_TABLE_REG_ADDR A:0xc40a920
y.create.l HWIO_SPMI_PERIPH137_2OWNER_TABLE_REG_ADDR A:0xc40a924
y.create.l HWIO_SPMI_PERIPH138_2OWNER_TABLE_REG_ADDR A:0xc40a928
y.create.l HWIO_SPMI_PERIPH139_2OWNER_TABLE_REG_ADDR A:0xc40a92c
y.create.l HWIO_SPMI_PERIPH140_2OWNER_TABLE_REG_ADDR A:0xc40a930
y.create.l HWIO_SPMI_PERIPH141_2OWNER_TABLE_REG_ADDR A:0xc40a934
y.create.l HWIO_SPMI_PERIPH142_2OWNER_TABLE_REG_ADDR A:0xc40a938
y.create.l HWIO_SPMI_PERIPH143_2OWNER_TABLE_REG_ADDR A:0xc40a93c
y.create.l HWIO_SPMI_PERIPH144_2OWNER_TABLE_REG_ADDR A:0xc40a940
y.create.l HWIO_SPMI_PERIPH145_2OWNER_TABLE_REG_ADDR A:0xc40a944
y.create.l HWIO_SPMI_PERIPH146_2OWNER_TABLE_REG_ADDR A:0xc40a948
y.create.l HWIO_SPMI_PERIPH147_2OWNER_TABLE_REG_ADDR A:0xc40a94c
y.create.l HWIO_SPMI_PERIPH148_2OWNER_TABLE_REG_ADDR A:0xc40a950
y.create.l HWIO_SPMI_PERIPH149_2OWNER_TABLE_REG_ADDR A:0xc40a954
y.create.l HWIO_SPMI_PERIPH150_2OWNER_TABLE_REG_ADDR A:0xc40a958
y.create.l HWIO_SPMI_PERIPH151_2OWNER_TABLE_REG_ADDR A:0xc40a95c
y.create.l HWIO_SPMI_PERIPH152_2OWNER_TABLE_REG_ADDR A:0xc40a960
y.create.l HWIO_SPMI_PERIPH153_2OWNER_TABLE_REG_ADDR A:0xc40a964
y.create.l HWIO_SPMI_PERIPH154_2OWNER_TABLE_REG_ADDR A:0xc40a968
y.create.l HWIO_SPMI_PERIPH155_2OWNER_TABLE_REG_ADDR A:0xc40a96c
y.create.l HWIO_SPMI_PERIPH156_2OWNER_TABLE_REG_ADDR A:0xc40a970
y.create.l HWIO_SPMI_PERIPH157_2OWNER_TABLE_REG_ADDR A:0xc40a974
y.create.l HWIO_SPMI_PERIPH158_2OWNER_TABLE_REG_ADDR A:0xc40a978
y.create.l HWIO_SPMI_PERIPH159_2OWNER_TABLE_REG_ADDR A:0xc40a97c
y.create.l HWIO_SPMI_PERIPH160_2OWNER_TABLE_REG_ADDR A:0xc40a980
y.create.l HWIO_SPMI_PERIPH161_2OWNER_TABLE_REG_ADDR A:0xc40a984
y.create.l HWIO_SPMI_PERIPH162_2OWNER_TABLE_REG_ADDR A:0xc40a988
y.create.l HWIO_SPMI_PERIPH163_2OWNER_TABLE_REG_ADDR A:0xc40a98c
y.create.l HWIO_SPMI_PERIPH164_2OWNER_TABLE_REG_ADDR A:0xc40a990
y.create.l HWIO_SPMI_PERIPH165_2OWNER_TABLE_REG_ADDR A:0xc40a994
y.create.l HWIO_SPMI_PERIPH166_2OWNER_TABLE_REG_ADDR A:0xc40a998
y.create.l HWIO_SPMI_PERIPH167_2OWNER_TABLE_REG_ADDR A:0xc40a99c
y.create.l HWIO_SPMI_PERIPH168_2OWNER_TABLE_REG_ADDR A:0xc40a9a0
y.create.l HWIO_SPMI_PERIPH169_2OWNER_TABLE_REG_ADDR A:0xc40a9a4
y.create.l HWIO_SPMI_PERIPH170_2OWNER_TABLE_REG_ADDR A:0xc40a9a8
y.create.l HWIO_SPMI_PERIPH171_2OWNER_TABLE_REG_ADDR A:0xc40a9ac
y.create.l HWIO_SPMI_PERIPH172_2OWNER_TABLE_REG_ADDR A:0xc40a9b0
y.create.l HWIO_SPMI_PERIPH173_2OWNER_TABLE_REG_ADDR A:0xc40a9b4
y.create.l HWIO_SPMI_PERIPH174_2OWNER_TABLE_REG_ADDR A:0xc40a9b8
y.create.l HWIO_SPMI_PERIPH175_2OWNER_TABLE_REG_ADDR A:0xc40a9bc
y.create.l HWIO_SPMI_PERIPH176_2OWNER_TABLE_REG_ADDR A:0xc40a9c0
y.create.l HWIO_SPMI_PERIPH177_2OWNER_TABLE_REG_ADDR A:0xc40a9c4
y.create.l HWIO_SPMI_PERIPH178_2OWNER_TABLE_REG_ADDR A:0xc40a9c8
y.create.l HWIO_SPMI_PERIPH179_2OWNER_TABLE_REG_ADDR A:0xc40a9cc
y.create.l HWIO_SPMI_PERIPH180_2OWNER_TABLE_REG_ADDR A:0xc40a9d0
y.create.l HWIO_SPMI_PERIPH181_2OWNER_TABLE_REG_ADDR A:0xc40a9d4
y.create.l HWIO_SPMI_PERIPH182_2OWNER_TABLE_REG_ADDR A:0xc40a9d8
y.create.l HWIO_SPMI_PERIPH183_2OWNER_TABLE_REG_ADDR A:0xc40a9dc
y.create.l HWIO_SPMI_PERIPH184_2OWNER_TABLE_REG_ADDR A:0xc40a9e0
y.create.l HWIO_SPMI_PERIPH185_2OWNER_TABLE_REG_ADDR A:0xc40a9e4
y.create.l HWIO_SPMI_PERIPH186_2OWNER_TABLE_REG_ADDR A:0xc40a9e8
y.create.l HWIO_SPMI_PERIPH187_2OWNER_TABLE_REG_ADDR A:0xc40a9ec
y.create.l HWIO_SPMI_PERIPH188_2OWNER_TABLE_REG_ADDR A:0xc40a9f0
y.create.l HWIO_SPMI_PERIPH189_2OWNER_TABLE_REG_ADDR A:0xc40a9f4
y.create.l HWIO_SPMI_PERIPH190_2OWNER_TABLE_REG_ADDR A:0xc40a9f8
y.create.l HWIO_SPMI_PERIPH191_2OWNER_TABLE_REG_ADDR A:0xc40a9fc
y.create.l HWIO_SPMI_PERIPH192_2OWNER_TABLE_REG_ADDR A:0xc40aa00
y.create.l HWIO_SPMI_PERIPH193_2OWNER_TABLE_REG_ADDR A:0xc40aa04
y.create.l HWIO_SPMI_PERIPH194_2OWNER_TABLE_REG_ADDR A:0xc40aa08
y.create.l HWIO_SPMI_PERIPH195_2OWNER_TABLE_REG_ADDR A:0xc40aa0c
y.create.l HWIO_SPMI_PERIPH196_2OWNER_TABLE_REG_ADDR A:0xc40aa10
y.create.l HWIO_SPMI_PERIPH197_2OWNER_TABLE_REG_ADDR A:0xc40aa14
y.create.l HWIO_SPMI_PERIPH198_2OWNER_TABLE_REG_ADDR A:0xc40aa18
y.create.l HWIO_SPMI_PERIPH199_2OWNER_TABLE_REG_ADDR A:0xc40aa1c
y.create.l HWIO_SPMI_PERIPH200_2OWNER_TABLE_REG_ADDR A:0xc40aa20
y.create.l HWIO_SPMI_PERIPH201_2OWNER_TABLE_REG_ADDR A:0xc40aa24
y.create.l HWIO_SPMI_PERIPH202_2OWNER_TABLE_REG_ADDR A:0xc40aa28
y.create.l HWIO_SPMI_PERIPH203_2OWNER_TABLE_REG_ADDR A:0xc40aa2c
y.create.l HWIO_SPMI_PERIPH204_2OWNER_TABLE_REG_ADDR A:0xc40aa30
y.create.l HWIO_SPMI_PERIPH205_2OWNER_TABLE_REG_ADDR A:0xc40aa34
y.create.l HWIO_SPMI_PERIPH206_2OWNER_TABLE_REG_ADDR A:0xc40aa38
y.create.l HWIO_SPMI_PERIPH207_2OWNER_TABLE_REG_ADDR A:0xc40aa3c
y.create.l HWIO_SPMI_PERIPH208_2OWNER_TABLE_REG_ADDR A:0xc40aa40
y.create.l HWIO_SPMI_PERIPH209_2OWNER_TABLE_REG_ADDR A:0xc40aa44
y.create.l HWIO_SPMI_PERIPH210_2OWNER_TABLE_REG_ADDR A:0xc40aa48
y.create.l HWIO_SPMI_PERIPH211_2OWNER_TABLE_REG_ADDR A:0xc40aa4c
y.create.l HWIO_SPMI_PERIPH212_2OWNER_TABLE_REG_ADDR A:0xc40aa50
y.create.l HWIO_SPMI_PERIPH213_2OWNER_TABLE_REG_ADDR A:0xc40aa54
y.create.l HWIO_SPMI_PERIPH214_2OWNER_TABLE_REG_ADDR A:0xc40aa58
y.create.l HWIO_SPMI_PERIPH215_2OWNER_TABLE_REG_ADDR A:0xc40aa5c
y.create.l HWIO_SPMI_PERIPH216_2OWNER_TABLE_REG_ADDR A:0xc40aa60
y.create.l HWIO_SPMI_PERIPH217_2OWNER_TABLE_REG_ADDR A:0xc40aa64
y.create.l HWIO_SPMI_PERIPH218_2OWNER_TABLE_REG_ADDR A:0xc40aa68
y.create.l HWIO_SPMI_PERIPH219_2OWNER_TABLE_REG_ADDR A:0xc40aa6c
y.create.l HWIO_SPMI_PERIPH220_2OWNER_TABLE_REG_ADDR A:0xc40aa70
y.create.l HWIO_SPMI_PERIPH221_2OWNER_TABLE_REG_ADDR A:0xc40aa74
y.create.l HWIO_SPMI_PERIPH222_2OWNER_TABLE_REG_ADDR A:0xc40aa78
y.create.l HWIO_SPMI_PERIPH223_2OWNER_TABLE_REG_ADDR A:0xc40aa7c
y.create.l HWIO_SPMI_PERIPH224_2OWNER_TABLE_REG_ADDR A:0xc40aa80
y.create.l HWIO_SPMI_PERIPH225_2OWNER_TABLE_REG_ADDR A:0xc40aa84
y.create.l HWIO_SPMI_PERIPH226_2OWNER_TABLE_REG_ADDR A:0xc40aa88
y.create.l HWIO_SPMI_PERIPH227_2OWNER_TABLE_REG_ADDR A:0xc40aa8c
y.create.l HWIO_SPMI_PERIPH228_2OWNER_TABLE_REG_ADDR A:0xc40aa90
y.create.l HWIO_SPMI_PERIPH229_2OWNER_TABLE_REG_ADDR A:0xc40aa94
y.create.l HWIO_SPMI_PERIPH230_2OWNER_TABLE_REG_ADDR A:0xc40aa98
y.create.l HWIO_SPMI_PERIPH231_2OWNER_TABLE_REG_ADDR A:0xc40aa9c
y.create.l HWIO_SPMI_PERIPH232_2OWNER_TABLE_REG_ADDR A:0xc40aaa0
y.create.l HWIO_SPMI_PERIPH233_2OWNER_TABLE_REG_ADDR A:0xc40aaa4
y.create.l HWIO_SPMI_PERIPH234_2OWNER_TABLE_REG_ADDR A:0xc40aaa8
y.create.l HWIO_SPMI_PERIPH235_2OWNER_TABLE_REG_ADDR A:0xc40aaac
y.create.l HWIO_SPMI_PERIPH236_2OWNER_TABLE_REG_ADDR A:0xc40aab0
y.create.l HWIO_SPMI_PERIPH237_2OWNER_TABLE_REG_ADDR A:0xc40aab4
y.create.l HWIO_SPMI_PERIPH238_2OWNER_TABLE_REG_ADDR A:0xc40aab8
y.create.l HWIO_SPMI_PERIPH239_2OWNER_TABLE_REG_ADDR A:0xc40aabc
y.create.l HWIO_SPMI_PERIPH240_2OWNER_TABLE_REG_ADDR A:0xc40aac0
y.create.l HWIO_SPMI_PERIPH241_2OWNER_TABLE_REG_ADDR A:0xc40aac4
y.create.l HWIO_SPMI_PERIPH242_2OWNER_TABLE_REG_ADDR A:0xc40aac8
y.create.l HWIO_SPMI_PERIPH243_2OWNER_TABLE_REG_ADDR A:0xc40aacc
y.create.l HWIO_SPMI_PERIPH244_2OWNER_TABLE_REG_ADDR A:0xc40aad0
y.create.l HWIO_SPMI_PERIPH245_2OWNER_TABLE_REG_ADDR A:0xc40aad4
y.create.l HWIO_SPMI_PERIPH246_2OWNER_TABLE_REG_ADDR A:0xc40aad8
y.create.l HWIO_SPMI_PERIPH247_2OWNER_TABLE_REG_ADDR A:0xc40aadc
y.create.l HWIO_SPMI_PERIPH248_2OWNER_TABLE_REG_ADDR A:0xc40aae0
y.create.l HWIO_SPMI_PERIPH249_2OWNER_TABLE_REG_ADDR A:0xc40aae4
y.create.l HWIO_SPMI_PERIPH250_2OWNER_TABLE_REG_ADDR A:0xc40aae8
y.create.l HWIO_SPMI_PERIPH251_2OWNER_TABLE_REG_ADDR A:0xc40aaec
y.create.l HWIO_SPMI_PERIPH252_2OWNER_TABLE_REG_ADDR A:0xc40aaf0
y.create.l HWIO_SPMI_PERIPH253_2OWNER_TABLE_REG_ADDR A:0xc40aaf4
y.create.l HWIO_SPMI_PERIPH254_2OWNER_TABLE_REG_ADDR A:0xc40aaf8
y.create.l HWIO_SPMI_PERIPH255_2OWNER_TABLE_REG_ADDR A:0xc40aafc
y.create.l HWIO_SPMI_PERIPH256_2OWNER_TABLE_REG_ADDR A:0xc40ab00
y.create.l HWIO_SPMI_PERIPH257_2OWNER_TABLE_REG_ADDR A:0xc40ab04
y.create.l HWIO_SPMI_PERIPH258_2OWNER_TABLE_REG_ADDR A:0xc40ab08
y.create.l HWIO_SPMI_PERIPH259_2OWNER_TABLE_REG_ADDR A:0xc40ab0c
y.create.l HWIO_SPMI_PERIPH260_2OWNER_TABLE_REG_ADDR A:0xc40ab10
y.create.l HWIO_SPMI_PERIPH261_2OWNER_TABLE_REG_ADDR A:0xc40ab14
y.create.l HWIO_SPMI_PERIPH262_2OWNER_TABLE_REG_ADDR A:0xc40ab18
y.create.l HWIO_SPMI_PERIPH263_2OWNER_TABLE_REG_ADDR A:0xc40ab1c
y.create.l HWIO_SPMI_PERIPH264_2OWNER_TABLE_REG_ADDR A:0xc40ab20
y.create.l HWIO_SPMI_PERIPH265_2OWNER_TABLE_REG_ADDR A:0xc40ab24
y.create.l HWIO_SPMI_PERIPH266_2OWNER_TABLE_REG_ADDR A:0xc40ab28
y.create.l HWIO_SPMI_PERIPH267_2OWNER_TABLE_REG_ADDR A:0xc40ab2c
y.create.l HWIO_SPMI_PERIPH268_2OWNER_TABLE_REG_ADDR A:0xc40ab30
y.create.l HWIO_SPMI_PERIPH269_2OWNER_TABLE_REG_ADDR A:0xc40ab34
y.create.l HWIO_SPMI_PERIPH270_2OWNER_TABLE_REG_ADDR A:0xc40ab38
y.create.l HWIO_SPMI_PERIPH271_2OWNER_TABLE_REG_ADDR A:0xc40ab3c
y.create.l HWIO_SPMI_PERIPH272_2OWNER_TABLE_REG_ADDR A:0xc40ab40
y.create.l HWIO_SPMI_PERIPH273_2OWNER_TABLE_REG_ADDR A:0xc40ab44
y.create.l HWIO_SPMI_PERIPH274_2OWNER_TABLE_REG_ADDR A:0xc40ab48
y.create.l HWIO_SPMI_PERIPH275_2OWNER_TABLE_REG_ADDR A:0xc40ab4c
y.create.l HWIO_SPMI_PERIPH276_2OWNER_TABLE_REG_ADDR A:0xc40ab50
y.create.l HWIO_SPMI_PERIPH277_2OWNER_TABLE_REG_ADDR A:0xc40ab54
y.create.l HWIO_SPMI_PERIPH278_2OWNER_TABLE_REG_ADDR A:0xc40ab58
y.create.l HWIO_SPMI_PERIPH279_2OWNER_TABLE_REG_ADDR A:0xc40ab5c
y.create.l HWIO_SPMI_PERIPH280_2OWNER_TABLE_REG_ADDR A:0xc40ab60
y.create.l HWIO_SPMI_PERIPH281_2OWNER_TABLE_REG_ADDR A:0xc40ab64
y.create.l HWIO_SPMI_PERIPH282_2OWNER_TABLE_REG_ADDR A:0xc40ab68
y.create.l HWIO_SPMI_PERIPH283_2OWNER_TABLE_REG_ADDR A:0xc40ab6c
y.create.l HWIO_SPMI_PERIPH284_2OWNER_TABLE_REG_ADDR A:0xc40ab70
y.create.l HWIO_SPMI_PERIPH285_2OWNER_TABLE_REG_ADDR A:0xc40ab74
y.create.l HWIO_SPMI_PERIPH286_2OWNER_TABLE_REG_ADDR A:0xc40ab78
y.create.l HWIO_SPMI_PERIPH287_2OWNER_TABLE_REG_ADDR A:0xc40ab7c
y.create.l HWIO_SPMI_PERIPH288_2OWNER_TABLE_REG_ADDR A:0xc40ab80
y.create.l HWIO_SPMI_PERIPH289_2OWNER_TABLE_REG_ADDR A:0xc40ab84
y.create.l HWIO_SPMI_PERIPH290_2OWNER_TABLE_REG_ADDR A:0xc40ab88
y.create.l HWIO_SPMI_PERIPH291_2OWNER_TABLE_REG_ADDR A:0xc40ab8c
y.create.l HWIO_SPMI_PERIPH292_2OWNER_TABLE_REG_ADDR A:0xc40ab90
y.create.l HWIO_SPMI_PERIPH293_2OWNER_TABLE_REG_ADDR A:0xc40ab94
y.create.l HWIO_SPMI_PERIPH294_2OWNER_TABLE_REG_ADDR A:0xc40ab98
y.create.l HWIO_SPMI_PERIPH295_2OWNER_TABLE_REG_ADDR A:0xc40ab9c
y.create.l HWIO_SPMI_PERIPH296_2OWNER_TABLE_REG_ADDR A:0xc40aba0
y.create.l HWIO_SPMI_PERIPH297_2OWNER_TABLE_REG_ADDR A:0xc40aba4
y.create.l HWIO_SPMI_PERIPH298_2OWNER_TABLE_REG_ADDR A:0xc40aba8
y.create.l HWIO_SPMI_PERIPH299_2OWNER_TABLE_REG_ADDR A:0xc40abac
y.create.l HWIO_SPMI_PERIPH300_2OWNER_TABLE_REG_ADDR A:0xc40abb0
y.create.l HWIO_SPMI_PERIPH301_2OWNER_TABLE_REG_ADDR A:0xc40abb4
y.create.l HWIO_SPMI_PERIPH302_2OWNER_TABLE_REG_ADDR A:0xc40abb8
y.create.l HWIO_SPMI_PERIPH303_2OWNER_TABLE_REG_ADDR A:0xc40abbc
y.create.l HWIO_SPMI_PERIPH304_2OWNER_TABLE_REG_ADDR A:0xc40abc0
y.create.l HWIO_SPMI_PERIPH305_2OWNER_TABLE_REG_ADDR A:0xc40abc4
y.create.l HWIO_SPMI_PERIPH306_2OWNER_TABLE_REG_ADDR A:0xc40abc8
y.create.l HWIO_SPMI_PERIPH307_2OWNER_TABLE_REG_ADDR A:0xc40abcc
y.create.l HWIO_SPMI_PERIPH308_2OWNER_TABLE_REG_ADDR A:0xc40abd0
y.create.l HWIO_SPMI_PERIPH309_2OWNER_TABLE_REG_ADDR A:0xc40abd4
y.create.l HWIO_SPMI_PERIPH310_2OWNER_TABLE_REG_ADDR A:0xc40abd8
y.create.l HWIO_SPMI_PERIPH311_2OWNER_TABLE_REG_ADDR A:0xc40abdc
y.create.l HWIO_SPMI_PERIPH312_2OWNER_TABLE_REG_ADDR A:0xc40abe0
y.create.l HWIO_SPMI_PERIPH313_2OWNER_TABLE_REG_ADDR A:0xc40abe4
y.create.l HWIO_SPMI_PERIPH314_2OWNER_TABLE_REG_ADDR A:0xc40abe8
y.create.l HWIO_SPMI_PERIPH315_2OWNER_TABLE_REG_ADDR A:0xc40abec
y.create.l HWIO_SPMI_PERIPH316_2OWNER_TABLE_REG_ADDR A:0xc40abf0
y.create.l HWIO_SPMI_PERIPH317_2OWNER_TABLE_REG_ADDR A:0xc40abf4
y.create.l HWIO_SPMI_PERIPH318_2OWNER_TABLE_REG_ADDR A:0xc40abf8
y.create.l HWIO_SPMI_PERIPH319_2OWNER_TABLE_REG_ADDR A:0xc40abfc
y.create.l HWIO_SPMI_PERIPH320_2OWNER_TABLE_REG_ADDR A:0xc40ac00
y.create.l HWIO_SPMI_PERIPH321_2OWNER_TABLE_REG_ADDR A:0xc40ac04
y.create.l HWIO_SPMI_PERIPH322_2OWNER_TABLE_REG_ADDR A:0xc40ac08
y.create.l HWIO_SPMI_PERIPH323_2OWNER_TABLE_REG_ADDR A:0xc40ac0c
y.create.l HWIO_SPMI_PERIPH324_2OWNER_TABLE_REG_ADDR A:0xc40ac10
y.create.l HWIO_SPMI_PERIPH325_2OWNER_TABLE_REG_ADDR A:0xc40ac14
y.create.l HWIO_SPMI_PERIPH326_2OWNER_TABLE_REG_ADDR A:0xc40ac18
y.create.l HWIO_SPMI_PERIPH327_2OWNER_TABLE_REG_ADDR A:0xc40ac1c
y.create.l HWIO_SPMI_PERIPH328_2OWNER_TABLE_REG_ADDR A:0xc40ac20
y.create.l HWIO_SPMI_PERIPH329_2OWNER_TABLE_REG_ADDR A:0xc40ac24
y.create.l HWIO_SPMI_PERIPH330_2OWNER_TABLE_REG_ADDR A:0xc40ac28
y.create.l HWIO_SPMI_PERIPH331_2OWNER_TABLE_REG_ADDR A:0xc40ac2c
y.create.l HWIO_SPMI_PERIPH332_2OWNER_TABLE_REG_ADDR A:0xc40ac30
y.create.l HWIO_SPMI_PERIPH333_2OWNER_TABLE_REG_ADDR A:0xc40ac34
y.create.l HWIO_SPMI_PERIPH334_2OWNER_TABLE_REG_ADDR A:0xc40ac38
y.create.l HWIO_SPMI_PERIPH335_2OWNER_TABLE_REG_ADDR A:0xc40ac3c
y.create.l HWIO_SPMI_PERIPH336_2OWNER_TABLE_REG_ADDR A:0xc40ac40
y.create.l HWIO_SPMI_PERIPH337_2OWNER_TABLE_REG_ADDR A:0xc40ac44
y.create.l HWIO_SPMI_PERIPH338_2OWNER_TABLE_REG_ADDR A:0xc40ac48
y.create.l HWIO_SPMI_PERIPH339_2OWNER_TABLE_REG_ADDR A:0xc40ac4c
y.create.l HWIO_SPMI_PERIPH340_2OWNER_TABLE_REG_ADDR A:0xc40ac50
y.create.l HWIO_SPMI_PERIPH341_2OWNER_TABLE_REG_ADDR A:0xc40ac54
y.create.l HWIO_SPMI_PERIPH342_2OWNER_TABLE_REG_ADDR A:0xc40ac58
y.create.l HWIO_SPMI_PERIPH343_2OWNER_TABLE_REG_ADDR A:0xc40ac5c
y.create.l HWIO_SPMI_PERIPH344_2OWNER_TABLE_REG_ADDR A:0xc40ac60
y.create.l HWIO_SPMI_PERIPH345_2OWNER_TABLE_REG_ADDR A:0xc40ac64
y.create.l HWIO_SPMI_PERIPH346_2OWNER_TABLE_REG_ADDR A:0xc40ac68
y.create.l HWIO_SPMI_PERIPH347_2OWNER_TABLE_REG_ADDR A:0xc40ac6c
y.create.l HWIO_SPMI_PERIPH348_2OWNER_TABLE_REG_ADDR A:0xc40ac70
y.create.l HWIO_SPMI_PERIPH349_2OWNER_TABLE_REG_ADDR A:0xc40ac74
y.create.l HWIO_SPMI_PERIPH350_2OWNER_TABLE_REG_ADDR A:0xc40ac78
y.create.l HWIO_SPMI_PERIPH351_2OWNER_TABLE_REG_ADDR A:0xc40ac7c
y.create.l HWIO_SPMI_PERIPH352_2OWNER_TABLE_REG_ADDR A:0xc40ac80
y.create.l HWIO_SPMI_PERIPH353_2OWNER_TABLE_REG_ADDR A:0xc40ac84
y.create.l HWIO_SPMI_PERIPH354_2OWNER_TABLE_REG_ADDR A:0xc40ac88
y.create.l HWIO_SPMI_PERIPH355_2OWNER_TABLE_REG_ADDR A:0xc40ac8c
y.create.l HWIO_SPMI_PERIPH356_2OWNER_TABLE_REG_ADDR A:0xc40ac90
y.create.l HWIO_SPMI_PERIPH357_2OWNER_TABLE_REG_ADDR A:0xc40ac94
y.create.l HWIO_SPMI_PERIPH358_2OWNER_TABLE_REG_ADDR A:0xc40ac98
y.create.l HWIO_SPMI_PERIPH359_2OWNER_TABLE_REG_ADDR A:0xc40ac9c
y.create.l HWIO_SPMI_PERIPH360_2OWNER_TABLE_REG_ADDR A:0xc40aca0
y.create.l HWIO_SPMI_PERIPH361_2OWNER_TABLE_REG_ADDR A:0xc40aca4
y.create.l HWIO_SPMI_PERIPH362_2OWNER_TABLE_REG_ADDR A:0xc40aca8
y.create.l HWIO_SPMI_PERIPH363_2OWNER_TABLE_REG_ADDR A:0xc40acac
y.create.l HWIO_SPMI_PERIPH364_2OWNER_TABLE_REG_ADDR A:0xc40acb0
y.create.l HWIO_SPMI_PERIPH365_2OWNER_TABLE_REG_ADDR A:0xc40acb4
y.create.l HWIO_SPMI_PERIPH366_2OWNER_TABLE_REG_ADDR A:0xc40acb8
y.create.l HWIO_SPMI_PERIPH367_2OWNER_TABLE_REG_ADDR A:0xc40acbc
y.create.l HWIO_SPMI_PERIPH368_2OWNER_TABLE_REG_ADDR A:0xc40acc0
y.create.l HWIO_SPMI_PERIPH369_2OWNER_TABLE_REG_ADDR A:0xc40acc4
y.create.l HWIO_SPMI_PERIPH370_2OWNER_TABLE_REG_ADDR A:0xc40acc8
y.create.l HWIO_SPMI_PERIPH371_2OWNER_TABLE_REG_ADDR A:0xc40accc
y.create.l HWIO_SPMI_PERIPH372_2OWNER_TABLE_REG_ADDR A:0xc40acd0
y.create.l HWIO_SPMI_PERIPH373_2OWNER_TABLE_REG_ADDR A:0xc40acd4
y.create.l HWIO_SPMI_PERIPH374_2OWNER_TABLE_REG_ADDR A:0xc40acd8
y.create.l HWIO_SPMI_PERIPH375_2OWNER_TABLE_REG_ADDR A:0xc40acdc
y.create.l HWIO_SPMI_PERIPH376_2OWNER_TABLE_REG_ADDR A:0xc40ace0
y.create.l HWIO_SPMI_PERIPH377_2OWNER_TABLE_REG_ADDR A:0xc40ace4
y.create.l HWIO_SPMI_PERIPH378_2OWNER_TABLE_REG_ADDR A:0xc40ace8
y.create.l HWIO_SPMI_PERIPH379_2OWNER_TABLE_REG_ADDR A:0xc40acec
y.create.l HWIO_SPMI_PERIPH380_2OWNER_TABLE_REG_ADDR A:0xc40acf0
y.create.l HWIO_SPMI_PERIPH381_2OWNER_TABLE_REG_ADDR A:0xc40acf4
y.create.l HWIO_SPMI_PERIPH382_2OWNER_TABLE_REG_ADDR A:0xc40acf8
y.create.l HWIO_SPMI_PERIPH383_2OWNER_TABLE_REG_ADDR A:0xc40acfc
y.create.l HWIO_SPMI_PERIPH384_2OWNER_TABLE_REG_ADDR A:0xc40ad00
y.create.l HWIO_SPMI_PERIPH385_2OWNER_TABLE_REG_ADDR A:0xc40ad04
y.create.l HWIO_SPMI_PERIPH386_2OWNER_TABLE_REG_ADDR A:0xc40ad08
y.create.l HWIO_SPMI_PERIPH387_2OWNER_TABLE_REG_ADDR A:0xc40ad0c
y.create.l HWIO_SPMI_PERIPH388_2OWNER_TABLE_REG_ADDR A:0xc40ad10
y.create.l HWIO_SPMI_PERIPH389_2OWNER_TABLE_REG_ADDR A:0xc40ad14
y.create.l HWIO_SPMI_PERIPH390_2OWNER_TABLE_REG_ADDR A:0xc40ad18
y.create.l HWIO_SPMI_PERIPH391_2OWNER_TABLE_REG_ADDR A:0xc40ad1c
y.create.l HWIO_SPMI_PERIPH392_2OWNER_TABLE_REG_ADDR A:0xc40ad20
y.create.l HWIO_SPMI_PERIPH393_2OWNER_TABLE_REG_ADDR A:0xc40ad24
y.create.l HWIO_SPMI_PERIPH394_2OWNER_TABLE_REG_ADDR A:0xc40ad28
y.create.l HWIO_SPMI_PERIPH395_2OWNER_TABLE_REG_ADDR A:0xc40ad2c
y.create.l HWIO_SPMI_PERIPH396_2OWNER_TABLE_REG_ADDR A:0xc40ad30
y.create.l HWIO_SPMI_PERIPH397_2OWNER_TABLE_REG_ADDR A:0xc40ad34
y.create.l HWIO_SPMI_PERIPH398_2OWNER_TABLE_REG_ADDR A:0xc40ad38
y.create.l HWIO_SPMI_PERIPH399_2OWNER_TABLE_REG_ADDR A:0xc40ad3c
y.create.l HWIO_SPMI_PERIPH400_2OWNER_TABLE_REG_ADDR A:0xc40ad40
y.create.l HWIO_SPMI_PERIPH401_2OWNER_TABLE_REG_ADDR A:0xc40ad44
y.create.l HWIO_SPMI_PERIPH402_2OWNER_TABLE_REG_ADDR A:0xc40ad48
y.create.l HWIO_SPMI_PERIPH403_2OWNER_TABLE_REG_ADDR A:0xc40ad4c
y.create.l HWIO_SPMI_PERIPH404_2OWNER_TABLE_REG_ADDR A:0xc40ad50
y.create.l HWIO_SPMI_PERIPH405_2OWNER_TABLE_REG_ADDR A:0xc40ad54
y.create.l HWIO_SPMI_PERIPH406_2OWNER_TABLE_REG_ADDR A:0xc40ad58
y.create.l HWIO_SPMI_PERIPH407_2OWNER_TABLE_REG_ADDR A:0xc40ad5c
y.create.l HWIO_SPMI_PERIPH408_2OWNER_TABLE_REG_ADDR A:0xc40ad60
y.create.l HWIO_SPMI_PERIPH409_2OWNER_TABLE_REG_ADDR A:0xc40ad64
y.create.l HWIO_SPMI_PERIPH410_2OWNER_TABLE_REG_ADDR A:0xc40ad68
y.create.l HWIO_SPMI_PERIPH411_2OWNER_TABLE_REG_ADDR A:0xc40ad6c
y.create.l HWIO_SPMI_PERIPH412_2OWNER_TABLE_REG_ADDR A:0xc40ad70
y.create.l HWIO_SPMI_PERIPH413_2OWNER_TABLE_REG_ADDR A:0xc40ad74
y.create.l HWIO_SPMI_PERIPH414_2OWNER_TABLE_REG_ADDR A:0xc40ad78
y.create.l HWIO_SPMI_PERIPH415_2OWNER_TABLE_REG_ADDR A:0xc40ad7c
y.create.l HWIO_SPMI_PERIPH416_2OWNER_TABLE_REG_ADDR A:0xc40ad80
y.create.l HWIO_SPMI_PERIPH417_2OWNER_TABLE_REG_ADDR A:0xc40ad84
y.create.l HWIO_SPMI_PERIPH418_2OWNER_TABLE_REG_ADDR A:0xc40ad88
y.create.l HWIO_SPMI_PERIPH419_2OWNER_TABLE_REG_ADDR A:0xc40ad8c
y.create.l HWIO_SPMI_PERIPH420_2OWNER_TABLE_REG_ADDR A:0xc40ad90
y.create.l HWIO_SPMI_PERIPH421_2OWNER_TABLE_REG_ADDR A:0xc40ad94
y.create.l HWIO_SPMI_PERIPH422_2OWNER_TABLE_REG_ADDR A:0xc40ad98
y.create.l HWIO_SPMI_PERIPH423_2OWNER_TABLE_REG_ADDR A:0xc40ad9c
y.create.l HWIO_SPMI_PERIPH424_2OWNER_TABLE_REG_ADDR A:0xc40ada0
y.create.l HWIO_SPMI_PERIPH425_2OWNER_TABLE_REG_ADDR A:0xc40ada4
y.create.l HWIO_SPMI_PERIPH426_2OWNER_TABLE_REG_ADDR A:0xc40ada8
y.create.l HWIO_SPMI_PERIPH427_2OWNER_TABLE_REG_ADDR A:0xc40adac
y.create.l HWIO_SPMI_PERIPH428_2OWNER_TABLE_REG_ADDR A:0xc40adb0
y.create.l HWIO_SPMI_PERIPH429_2OWNER_TABLE_REG_ADDR A:0xc40adb4
y.create.l HWIO_SPMI_PERIPH430_2OWNER_TABLE_REG_ADDR A:0xc40adb8
y.create.l HWIO_SPMI_PERIPH431_2OWNER_TABLE_REG_ADDR A:0xc40adbc
y.create.l HWIO_SPMI_PERIPH432_2OWNER_TABLE_REG_ADDR A:0xc40adc0
y.create.l HWIO_SPMI_PERIPH433_2OWNER_TABLE_REG_ADDR A:0xc40adc4
y.create.l HWIO_SPMI_PERIPH434_2OWNER_TABLE_REG_ADDR A:0xc40adc8
y.create.l HWIO_SPMI_PERIPH435_2OWNER_TABLE_REG_ADDR A:0xc40adcc
y.create.l HWIO_SPMI_PERIPH436_2OWNER_TABLE_REG_ADDR A:0xc40add0
y.create.l HWIO_SPMI_PERIPH437_2OWNER_TABLE_REG_ADDR A:0xc40add4
y.create.l HWIO_SPMI_PERIPH438_2OWNER_TABLE_REG_ADDR A:0xc40add8
y.create.l HWIO_SPMI_PERIPH439_2OWNER_TABLE_REG_ADDR A:0xc40addc
y.create.l HWIO_SPMI_PERIPH440_2OWNER_TABLE_REG_ADDR A:0xc40ade0
y.create.l HWIO_SPMI_PERIPH441_2OWNER_TABLE_REG_ADDR A:0xc40ade4
y.create.l HWIO_SPMI_PERIPH442_2OWNER_TABLE_REG_ADDR A:0xc40ade8
y.create.l HWIO_SPMI_PERIPH443_2OWNER_TABLE_REG_ADDR A:0xc40adec
y.create.l HWIO_SPMI_PERIPH444_2OWNER_TABLE_REG_ADDR A:0xc40adf0
y.create.l HWIO_SPMI_PERIPH445_2OWNER_TABLE_REG_ADDR A:0xc40adf4
y.create.l HWIO_SPMI_PERIPH446_2OWNER_TABLE_REG_ADDR A:0xc40adf8
y.create.l HWIO_SPMI_PERIPH447_2OWNER_TABLE_REG_ADDR A:0xc40adfc
y.create.l HWIO_SPMI_PERIPH448_2OWNER_TABLE_REG_ADDR A:0xc40ae00
y.create.l HWIO_SPMI_PERIPH449_2OWNER_TABLE_REG_ADDR A:0xc40ae04
y.create.l HWIO_SPMI_PERIPH450_2OWNER_TABLE_REG_ADDR A:0xc40ae08
y.create.l HWIO_SPMI_PERIPH451_2OWNER_TABLE_REG_ADDR A:0xc40ae0c
y.create.l HWIO_SPMI_PERIPH452_2OWNER_TABLE_REG_ADDR A:0xc40ae10
y.create.l HWIO_SPMI_PERIPH453_2OWNER_TABLE_REG_ADDR A:0xc40ae14
y.create.l HWIO_SPMI_PERIPH454_2OWNER_TABLE_REG_ADDR A:0xc40ae18
y.create.l HWIO_SPMI_PERIPH455_2OWNER_TABLE_REG_ADDR A:0xc40ae1c
y.create.l HWIO_SPMI_PERIPH456_2OWNER_TABLE_REG_ADDR A:0xc40ae20
y.create.l HWIO_SPMI_PERIPH457_2OWNER_TABLE_REG_ADDR A:0xc40ae24
y.create.l HWIO_SPMI_PERIPH458_2OWNER_TABLE_REG_ADDR A:0xc40ae28
y.create.l HWIO_SPMI_PERIPH459_2OWNER_TABLE_REG_ADDR A:0xc40ae2c
y.create.l HWIO_SPMI_PERIPH460_2OWNER_TABLE_REG_ADDR A:0xc40ae30
y.create.l HWIO_SPMI_PERIPH461_2OWNER_TABLE_REG_ADDR A:0xc40ae34
y.create.l HWIO_SPMI_PERIPH462_2OWNER_TABLE_REG_ADDR A:0xc40ae38
y.create.l HWIO_SPMI_PERIPH463_2OWNER_TABLE_REG_ADDR A:0xc40ae3c
y.create.l HWIO_SPMI_PERIPH464_2OWNER_TABLE_REG_ADDR A:0xc40ae40
y.create.l HWIO_SPMI_PERIPH465_2OWNER_TABLE_REG_ADDR A:0xc40ae44
y.create.l HWIO_SPMI_PERIPH466_2OWNER_TABLE_REG_ADDR A:0xc40ae48
y.create.l HWIO_SPMI_PERIPH467_2OWNER_TABLE_REG_ADDR A:0xc40ae4c
y.create.l HWIO_SPMI_PERIPH468_2OWNER_TABLE_REG_ADDR A:0xc40ae50
y.create.l HWIO_SPMI_PERIPH469_2OWNER_TABLE_REG_ADDR A:0xc40ae54
y.create.l HWIO_SPMI_PERIPH470_2OWNER_TABLE_REG_ADDR A:0xc40ae58
y.create.l HWIO_SPMI_PERIPH471_2OWNER_TABLE_REG_ADDR A:0xc40ae5c
y.create.l HWIO_SPMI_PERIPH472_2OWNER_TABLE_REG_ADDR A:0xc40ae60
y.create.l HWIO_SPMI_PERIPH473_2OWNER_TABLE_REG_ADDR A:0xc40ae64
y.create.l HWIO_SPMI_PERIPH474_2OWNER_TABLE_REG_ADDR A:0xc40ae68
y.create.l HWIO_SPMI_PERIPH475_2OWNER_TABLE_REG_ADDR A:0xc40ae6c
y.create.l HWIO_SPMI_PERIPH476_2OWNER_TABLE_REG_ADDR A:0xc40ae70
y.create.l HWIO_SPMI_PERIPH477_2OWNER_TABLE_REG_ADDR A:0xc40ae74
y.create.l HWIO_SPMI_PERIPH478_2OWNER_TABLE_REG_ADDR A:0xc40ae78
y.create.l HWIO_SPMI_PERIPH479_2OWNER_TABLE_REG_ADDR A:0xc40ae7c
y.create.l HWIO_SPMI_PERIPH480_2OWNER_TABLE_REG_ADDR A:0xc40ae80
y.create.l HWIO_SPMI_PERIPH481_2OWNER_TABLE_REG_ADDR A:0xc40ae84
y.create.l HWIO_SPMI_PERIPH482_2OWNER_TABLE_REG_ADDR A:0xc40ae88
y.create.l HWIO_SPMI_PERIPH483_2OWNER_TABLE_REG_ADDR A:0xc40ae8c
y.create.l HWIO_SPMI_PERIPH484_2OWNER_TABLE_REG_ADDR A:0xc40ae90
y.create.l HWIO_SPMI_PERIPH485_2OWNER_TABLE_REG_ADDR A:0xc40ae94
y.create.l HWIO_SPMI_PERIPH486_2OWNER_TABLE_REG_ADDR A:0xc40ae98
y.create.l HWIO_SPMI_PERIPH487_2OWNER_TABLE_REG_ADDR A:0xc40ae9c
y.create.l HWIO_SPMI_PERIPH488_2OWNER_TABLE_REG_ADDR A:0xc40aea0
y.create.l HWIO_SPMI_PERIPH489_2OWNER_TABLE_REG_ADDR A:0xc40aea4
y.create.l HWIO_SPMI_PERIPH490_2OWNER_TABLE_REG_ADDR A:0xc40aea8
y.create.l HWIO_SPMI_PERIPH491_2OWNER_TABLE_REG_ADDR A:0xc40aeac
y.create.l HWIO_SPMI_PERIPH492_2OWNER_TABLE_REG_ADDR A:0xc40aeb0
y.create.l HWIO_SPMI_PERIPH493_2OWNER_TABLE_REG_ADDR A:0xc40aeb4
y.create.l HWIO_SPMI_PERIPH494_2OWNER_TABLE_REG_ADDR A:0xc40aeb8
y.create.l HWIO_SPMI_PERIPH495_2OWNER_TABLE_REG_ADDR A:0xc40aebc
y.create.l HWIO_SPMI_PERIPH496_2OWNER_TABLE_REG_ADDR A:0xc40aec0
y.create.l HWIO_SPMI_PERIPH497_2OWNER_TABLE_REG_ADDR A:0xc40aec4
y.create.l HWIO_SPMI_PERIPH498_2OWNER_TABLE_REG_ADDR A:0xc40aec8
y.create.l HWIO_SPMI_PERIPH499_2OWNER_TABLE_REG_ADDR A:0xc40aecc
y.create.l HWIO_SPMI_PERIPH500_2OWNER_TABLE_REG_ADDR A:0xc40aed0
y.create.l HWIO_SPMI_PERIPH501_2OWNER_TABLE_REG_ADDR A:0xc40aed4
y.create.l HWIO_SPMI_PERIPH502_2OWNER_TABLE_REG_ADDR A:0xc40aed8
y.create.l HWIO_SPMI_PERIPH503_2OWNER_TABLE_REG_ADDR A:0xc40aedc
y.create.l HWIO_SPMI_PERIPH504_2OWNER_TABLE_REG_ADDR A:0xc40aee0
y.create.l HWIO_SPMI_PERIPH505_2OWNER_TABLE_REG_ADDR A:0xc40aee4
y.create.l HWIO_SPMI_PERIPH506_2OWNER_TABLE_REG_ADDR A:0xc40aee8
y.create.l HWIO_SPMI_PERIPH507_2OWNER_TABLE_REG_ADDR A:0xc40aeec
y.create.l HWIO_SPMI_PERIPH508_2OWNER_TABLE_REG_ADDR A:0xc40aef0
y.create.l HWIO_SPMI_PERIPH509_2OWNER_TABLE_REG_ADDR A:0xc40aef4
y.create.l HWIO_SPMI_PERIPH510_2OWNER_TABLE_REG_ADDR A:0xc40aef8
y.create.l HWIO_SPMI_PERIPH511_2OWNER_TABLE_REG_ADDR A:0xc40aefc
y.create.l HWIO_SPMI_MID_REG_ADDR A:0xc40af00
y.create.l HWIO_SPMI_CFG_REG_ADDR A:0xc40af04
y.create.l HWIO_SPMI_SEC_DISABLE_REG_ADDR A:0xc40af08
y.create.l HWIO_SPMI_HW_VERSION_ADDR A:0xc40af0c
y.create.l HWIO_SPMI_CGC_CTRL_ADDR A:0xc40af10
y.create.l HWIO_SPMI_MWB_ENABLE_REG_ADDR A:0xc40af14
y.create.l HWIO_SPMI_CHAR_CFG_ADDR A:0xc40af40
y.create.l HWIO_SPMI_CHAR_DATA_0_ADDR A:0xc40af44
y.create.l HWIO_SPMI_CHAR_DATA_1_ADDR A:0xc40af48
y.create.l HWIO_SPMI_CMPR_EN_REG_ADDR A:0xc40af54
y.create.l HWIO_SPMI_PIC_RCS_VIOCTL_ADDR A:0xc40af58
y.create.l HWIO_SPMI_PIC_RCS_VIOCTL_N_ADDR A:0xc40af5c
y.create.l HWIO_SPMI_PROTOCOL_IRQ_STATUS_ADDR A:0xc410000
y.create.l HWIO_SPMI_PROTOCOL_IRQ_ENABLE_ADDR A:0xc410004
y.create.l HWIO_SPMI_PROTOCOL_IRQ_CLEAR_ADDR A:0xc410008
y.create.l HWIO_SPMI_PROTOCOL_IRQ_EN_SET_ADDR A:0xc41000c
y.create.l HWIO_SPMI_PROTOCOL_IRQ_EN_CLEAR_ADDR A:0xc410010
y.create.l HWIO_SPMI_TEST_BUS_CTRL_ADDR A:0xc420000
y.create.l HWIO_SPMI_HW_SW_EVENTS_CTRL_ADDR A:0xc420004
y.create.l HWIO_SPMI_HW_SW_EVENTS_BITWISE_REG0_ADDR A:0xc420008
y.create.l HWIO_SPMI_HW_SW_EVENTS_BITWISE_REG1_ADDR A:0xc42000c
y.create.l HWIO_SPMI_HW_SW_EVENTS_BITWISE_REG2_ADDR A:0xc420010
y.create.l HWIO_SPMI_HW_SW_EVENTS_BITWISE_REG3_ADDR A:0xc420014
y.create.l HWIO_SPMI_HW_SW_EVENTS_BITWISE_REG4_ADDR A:0xc420018
y.create.l HWIO_SPMI_HW_SW_EVENTS_BITWISE_REG5_ADDR A:0xc42001c
y.create.l HWIO_SPMI_HW_SW_EVENTS_BITWISE_REG6_ADDR A:0xc420020
y.create.l HWIO_SPMI_HW_SW_EVENTS_BITWISE_REG7_ADDR A:0xc420024
y.create.l HWIO_SPMI_DEBUG_REG_ADDR A:0xc420028
y.create.l HWIO_SPMI_PIC_OWNER0_ACC_STATUS0_ADDR A:0xe700000
y.create.l HWIO_SPMI_PIC_OWNER0_ACC_STATUS1_ADDR A:0xe700004
y.create.l HWIO_SPMI_PIC_OWNER0_ACC_STATUS2_ADDR A:0xe700008
y.create.l HWIO_SPMI_PIC_OWNER0_ACC_STATUS3_ADDR A:0xe70000c
y.create.l HWIO_SPMI_PIC_OWNER0_ACC_STATUS4_ADDR A:0xe700010
y.create.l HWIO_SPMI_PIC_OWNER0_ACC_STATUS5_ADDR A:0xe700014
y.create.l HWIO_SPMI_PIC_OWNER0_ACC_STATUS6_ADDR A:0xe700018
y.create.l HWIO_SPMI_PIC_OWNER0_ACC_STATUS7_ADDR A:0xe70001c
y.create.l HWIO_SPMI_PIC_OWNER0_ACC_STATUS8_ADDR A:0xe700020
y.create.l HWIO_SPMI_PIC_OWNER0_ACC_STATUS9_ADDR A:0xe700024
y.create.l HWIO_SPMI_PIC_OWNER0_ACC_STATUS10_ADDR A:0xe700028
y.create.l HWIO_SPMI_PIC_OWNER0_ACC_STATUS11_ADDR A:0xe70002c
y.create.l HWIO_SPMI_PIC_OWNER0_ACC_STATUS12_ADDR A:0xe700030
y.create.l HWIO_SPMI_PIC_OWNER0_ACC_STATUS13_ADDR A:0xe700034
y.create.l HWIO_SPMI_PIC_OWNER0_ACC_STATUS14_ADDR A:0xe700038
y.create.l HWIO_SPMI_PIC_OWNER0_ACC_STATUS15_ADDR A:0xe70003c
y.create.l HWIO_SPMI_PIC_OWNER1_ACC_STATUS0_ADDR A:0xe710000
y.create.l HWIO_SPMI_PIC_OWNER1_ACC_STATUS1_ADDR A:0xe710004
y.create.l HWIO_SPMI_PIC_OWNER1_ACC_STATUS2_ADDR A:0xe710008
y.create.l HWIO_SPMI_PIC_OWNER1_ACC_STATUS3_ADDR A:0xe71000c
y.create.l HWIO_SPMI_PIC_OWNER1_ACC_STATUS4_ADDR A:0xe710010
y.create.l HWIO_SPMI_PIC_OWNER1_ACC_STATUS5_ADDR A:0xe710014
y.create.l HWIO_SPMI_PIC_OWNER1_ACC_STATUS6_ADDR A:0xe710018
y.create.l HWIO_SPMI_PIC_OWNER1_ACC_STATUS7_ADDR A:0xe71001c
y.create.l HWIO_SPMI_PIC_OWNER1_ACC_STATUS8_ADDR A:0xe710020
y.create.l HWIO_SPMI_PIC_OWNER1_ACC_STATUS9_ADDR A:0xe710024
y.create.l HWIO_SPMI_PIC_OWNER1_ACC_STATUS10_ADDR A:0xe710028
y.create.l HWIO_SPMI_PIC_OWNER1_ACC_STATUS11_ADDR A:0xe71002c
y.create.l HWIO_SPMI_PIC_OWNER1_ACC_STATUS12_ADDR A:0xe710030
y.create.l HWIO_SPMI_PIC_OWNER1_ACC_STATUS13_ADDR A:0xe710034
y.create.l HWIO_SPMI_PIC_OWNER1_ACC_STATUS14_ADDR A:0xe710038
y.create.l HWIO_SPMI_PIC_OWNER1_ACC_STATUS15_ADDR A:0xe71003c
y.create.l HWIO_SPMI_PIC_OWNER2_ACC_STATUS0_ADDR A:0xe720000
y.create.l HWIO_SPMI_PIC_OWNER2_ACC_STATUS1_ADDR A:0xe720004
y.create.l HWIO_SPMI_PIC_OWNER2_ACC_STATUS2_ADDR A:0xe720008
y.create.l HWIO_SPMI_PIC_OWNER2_ACC_STATUS3_ADDR A:0xe72000c
y.create.l HWIO_SPMI_PIC_OWNER2_ACC_STATUS4_ADDR A:0xe720010
y.create.l HWIO_SPMI_PIC_OWNER2_ACC_STATUS5_ADDR A:0xe720014
y.create.l HWIO_SPMI_PIC_OWNER2_ACC_STATUS6_ADDR A:0xe720018
y.create.l HWIO_SPMI_PIC_OWNER2_ACC_STATUS7_ADDR A:0xe72001c
y.create.l HWIO_SPMI_PIC_OWNER2_ACC_STATUS8_ADDR A:0xe720020
y.create.l HWIO_SPMI_PIC_OWNER2_ACC_STATUS9_ADDR A:0xe720024
y.create.l HWIO_SPMI_PIC_OWNER2_ACC_STATUS10_ADDR A:0xe720028
y.create.l HWIO_SPMI_PIC_OWNER2_ACC_STATUS11_ADDR A:0xe72002c
y.create.l HWIO_SPMI_PIC_OWNER2_ACC_STATUS12_ADDR A:0xe720030
y.create.l HWIO_SPMI_PIC_OWNER2_ACC_STATUS13_ADDR A:0xe720034
y.create.l HWIO_SPMI_PIC_OWNER2_ACC_STATUS14_ADDR A:0xe720038
y.create.l HWIO_SPMI_PIC_OWNER2_ACC_STATUS15_ADDR A:0xe72003c
y.create.l HWIO_SPMI_PIC_OWNER3_ACC_STATUS0_ADDR A:0xe730000
y.create.l HWIO_SPMI_PIC_OWNER3_ACC_STATUS1_ADDR A:0xe730004
y.create.l HWIO_SPMI_PIC_OWNER3_ACC_STATUS2_ADDR A:0xe730008
y.create.l HWIO_SPMI_PIC_OWNER3_ACC_STATUS3_ADDR A:0xe73000c
y.create.l HWIO_SPMI_PIC_OWNER3_ACC_STATUS4_ADDR A:0xe730010
y.create.l HWIO_SPMI_PIC_OWNER3_ACC_STATUS5_ADDR A:0xe730014
y.create.l HWIO_SPMI_PIC_OWNER3_ACC_STATUS6_ADDR A:0xe730018
y.create.l HWIO_SPMI_PIC_OWNER3_ACC_STATUS7_ADDR A:0xe73001c
y.create.l HWIO_SPMI_PIC_OWNER3_ACC_STATUS8_ADDR A:0xe730020
y.create.l HWIO_SPMI_PIC_OWNER3_ACC_STATUS9_ADDR A:0xe730024
y.create.l HWIO_SPMI_PIC_OWNER3_ACC_STATUS10_ADDR A:0xe730028
y.create.l HWIO_SPMI_PIC_OWNER3_ACC_STATUS11_ADDR A:0xe73002c
y.create.l HWIO_SPMI_PIC_OWNER3_ACC_STATUS12_ADDR A:0xe730030
y.create.l HWIO_SPMI_PIC_OWNER3_ACC_STATUS13_ADDR A:0xe730034
y.create.l HWIO_SPMI_PIC_OWNER3_ACC_STATUS14_ADDR A:0xe730038
y.create.l HWIO_SPMI_PIC_OWNER3_ACC_STATUS15_ADDR A:0xe73003c
y.create.l HWIO_SPMI_PIC_OWNER4_ACC_STATUS0_ADDR A:0xe740000
y.create.l HWIO_SPMI_PIC_OWNER4_ACC_STATUS1_ADDR A:0xe740004
y.create.l HWIO_SPMI_PIC_OWNER4_ACC_STATUS2_ADDR A:0xe740008
y.create.l HWIO_SPMI_PIC_OWNER4_ACC_STATUS3_ADDR A:0xe74000c
y.create.l HWIO_SPMI_PIC_OWNER4_ACC_STATUS4_ADDR A:0xe740010
y.create.l HWIO_SPMI_PIC_OWNER4_ACC_STATUS5_ADDR A:0xe740014
y.create.l HWIO_SPMI_PIC_OWNER4_ACC_STATUS6_ADDR A:0xe740018
y.create.l HWIO_SPMI_PIC_OWNER4_ACC_STATUS7_ADDR A:0xe74001c
y.create.l HWIO_SPMI_PIC_OWNER4_ACC_STATUS8_ADDR A:0xe740020
y.create.l HWIO_SPMI_PIC_OWNER4_ACC_STATUS9_ADDR A:0xe740024
y.create.l HWIO_SPMI_PIC_OWNER4_ACC_STATUS10_ADDR A:0xe740028
y.create.l HWIO_SPMI_PIC_OWNER4_ACC_STATUS11_ADDR A:0xe74002c
y.create.l HWIO_SPMI_PIC_OWNER4_ACC_STATUS12_ADDR A:0xe740030
y.create.l HWIO_SPMI_PIC_OWNER4_ACC_STATUS13_ADDR A:0xe740034
y.create.l HWIO_SPMI_PIC_OWNER4_ACC_STATUS14_ADDR A:0xe740038
y.create.l HWIO_SPMI_PIC_OWNER4_ACC_STATUS15_ADDR A:0xe74003c
y.create.l HWIO_SPMI_PIC_OWNER5_ACC_STATUS0_ADDR A:0xe750000
y.create.l HWIO_SPMI_PIC_OWNER5_ACC_STATUS1_ADDR A:0xe750004
y.create.l HWIO_SPMI_PIC_OWNER5_ACC_STATUS2_ADDR A:0xe750008
y.create.l HWIO_SPMI_PIC_OWNER5_ACC_STATUS3_ADDR A:0xe75000c
y.create.l HWIO_SPMI_PIC_OWNER5_ACC_STATUS4_ADDR A:0xe750010
y.create.l HWIO_SPMI_PIC_OWNER5_ACC_STATUS5_ADDR A:0xe750014
y.create.l HWIO_SPMI_PIC_OWNER5_ACC_STATUS6_ADDR A:0xe750018
y.create.l HWIO_SPMI_PIC_OWNER5_ACC_STATUS7_ADDR A:0xe75001c
y.create.l HWIO_SPMI_PIC_OWNER5_ACC_STATUS8_ADDR A:0xe750020
y.create.l HWIO_SPMI_PIC_OWNER5_ACC_STATUS9_ADDR A:0xe750024
y.create.l HWIO_SPMI_PIC_OWNER5_ACC_STATUS10_ADDR A:0xe750028
y.create.l HWIO_SPMI_PIC_OWNER5_ACC_STATUS11_ADDR A:0xe75002c
y.create.l HWIO_SPMI_PIC_OWNER5_ACC_STATUS12_ADDR A:0xe750030
y.create.l HWIO_SPMI_PIC_OWNER5_ACC_STATUS13_ADDR A:0xe750034
y.create.l HWIO_SPMI_PIC_OWNER5_ACC_STATUS14_ADDR A:0xe750038
y.create.l HWIO_SPMI_PIC_OWNER5_ACC_STATUS15_ADDR A:0xe75003c
y.create.l HWIO_SPMI_PIC_OWNER6_ACC_STATUS0_ADDR A:0xe760000
y.create.l HWIO_SPMI_PIC_OWNER6_ACC_STATUS1_ADDR A:0xe760004
y.create.l HWIO_SPMI_PIC_OWNER6_ACC_STATUS2_ADDR A:0xe760008
y.create.l HWIO_SPMI_PIC_OWNER6_ACC_STATUS3_ADDR A:0xe76000c
y.create.l HWIO_SPMI_PIC_OWNER6_ACC_STATUS4_ADDR A:0xe760010
y.create.l HWIO_SPMI_PIC_OWNER6_ACC_STATUS5_ADDR A:0xe760014
y.create.l HWIO_SPMI_PIC_OWNER6_ACC_STATUS6_ADDR A:0xe760018
y.create.l HWIO_SPMI_PIC_OWNER6_ACC_STATUS7_ADDR A:0xe76001c
y.create.l HWIO_SPMI_PIC_OWNER6_ACC_STATUS8_ADDR A:0xe760020
y.create.l HWIO_SPMI_PIC_OWNER6_ACC_STATUS9_ADDR A:0xe760024
y.create.l HWIO_SPMI_PIC_OWNER6_ACC_STATUS10_ADDR A:0xe760028
y.create.l HWIO_SPMI_PIC_OWNER6_ACC_STATUS11_ADDR A:0xe76002c
y.create.l HWIO_SPMI_PIC_OWNER6_ACC_STATUS12_ADDR A:0xe760030
y.create.l HWIO_SPMI_PIC_OWNER6_ACC_STATUS13_ADDR A:0xe760034
y.create.l HWIO_SPMI_PIC_OWNER6_ACC_STATUS14_ADDR A:0xe760038
y.create.l HWIO_SPMI_PIC_OWNER6_ACC_STATUS15_ADDR A:0xe76003c
y.create.l HWIO_SPMI_PIC_OWNER7_ACC_STATUS0_ADDR A:0xe770000
y.create.l HWIO_SPMI_PIC_OWNER7_ACC_STATUS1_ADDR A:0xe770004
y.create.l HWIO_SPMI_PIC_OWNER7_ACC_STATUS2_ADDR A:0xe770008
y.create.l HWIO_SPMI_PIC_OWNER7_ACC_STATUS3_ADDR A:0xe77000c
y.create.l HWIO_SPMI_PIC_OWNER7_ACC_STATUS4_ADDR A:0xe770010
y.create.l HWIO_SPMI_PIC_OWNER7_ACC_STATUS5_ADDR A:0xe770014
y.create.l HWIO_SPMI_PIC_OWNER7_ACC_STATUS6_ADDR A:0xe770018
y.create.l HWIO_SPMI_PIC_OWNER7_ACC_STATUS7_ADDR A:0xe77001c
y.create.l HWIO_SPMI_PIC_OWNER7_ACC_STATUS8_ADDR A:0xe770020
y.create.l HWIO_SPMI_PIC_OWNER7_ACC_STATUS9_ADDR A:0xe770024
y.create.l HWIO_SPMI_PIC_OWNER7_ACC_STATUS10_ADDR A:0xe770028
y.create.l HWIO_SPMI_PIC_OWNER7_ACC_STATUS11_ADDR A:0xe77002c
y.create.l HWIO_SPMI_PIC_OWNER7_ACC_STATUS12_ADDR A:0xe770030
y.create.l HWIO_SPMI_PIC_OWNER7_ACC_STATUS13_ADDR A:0xe770034
y.create.l HWIO_SPMI_PIC_OWNER7_ACC_STATUS14_ADDR A:0xe770038
y.create.l HWIO_SPMI_PIC_OWNER7_ACC_STATUS15_ADDR A:0xe77003c
y.create.l HWIO_SPMI_PIC_OWNER8_ACC_STATUS0_ADDR A:0xe780000
y.create.l HWIO_SPMI_PIC_OWNER8_ACC_STATUS1_ADDR A:0xe780004
y.create.l HWIO_SPMI_PIC_OWNER8_ACC_STATUS2_ADDR A:0xe780008
y.create.l HWIO_SPMI_PIC_OWNER8_ACC_STATUS3_ADDR A:0xe78000c
y.create.l HWIO_SPMI_PIC_OWNER8_ACC_STATUS4_ADDR A:0xe780010
y.create.l HWIO_SPMI_PIC_OWNER8_ACC_STATUS5_ADDR A:0xe780014
y.create.l HWIO_SPMI_PIC_OWNER8_ACC_STATUS6_ADDR A:0xe780018
y.create.l HWIO_SPMI_PIC_OWNER8_ACC_STATUS7_ADDR A:0xe78001c
y.create.l HWIO_SPMI_PIC_OWNER8_ACC_STATUS8_ADDR A:0xe780020
y.create.l HWIO_SPMI_PIC_OWNER8_ACC_STATUS9_ADDR A:0xe780024
y.create.l HWIO_SPMI_PIC_OWNER8_ACC_STATUS10_ADDR A:0xe780028
y.create.l HWIO_SPMI_PIC_OWNER8_ACC_STATUS11_ADDR A:0xe78002c
y.create.l HWIO_SPMI_PIC_OWNER8_ACC_STATUS12_ADDR A:0xe780030
y.create.l HWIO_SPMI_PIC_OWNER8_ACC_STATUS13_ADDR A:0xe780034
y.create.l HWIO_SPMI_PIC_OWNER8_ACC_STATUS14_ADDR A:0xe780038
y.create.l HWIO_SPMI_PIC_OWNER8_ACC_STATUS15_ADDR A:0xe78003c
y.create.l HWIO_SPMI_PIC_OWNER9_ACC_STATUS0_ADDR A:0xe790000
y.create.l HWIO_SPMI_PIC_OWNER9_ACC_STATUS1_ADDR A:0xe790004
y.create.l HWIO_SPMI_PIC_OWNER9_ACC_STATUS2_ADDR A:0xe790008
y.create.l HWIO_SPMI_PIC_OWNER9_ACC_STATUS3_ADDR A:0xe79000c
y.create.l HWIO_SPMI_PIC_OWNER9_ACC_STATUS4_ADDR A:0xe790010
y.create.l HWIO_SPMI_PIC_OWNER9_ACC_STATUS5_ADDR A:0xe790014
y.create.l HWIO_SPMI_PIC_OWNER9_ACC_STATUS6_ADDR A:0xe790018
y.create.l HWIO_SPMI_PIC_OWNER9_ACC_STATUS7_ADDR A:0xe79001c
y.create.l HWIO_SPMI_PIC_OWNER9_ACC_STATUS8_ADDR A:0xe790020
y.create.l HWIO_SPMI_PIC_OWNER9_ACC_STATUS9_ADDR A:0xe790024
y.create.l HWIO_SPMI_PIC_OWNER9_ACC_STATUS10_ADDR A:0xe790028
y.create.l HWIO_SPMI_PIC_OWNER9_ACC_STATUS11_ADDR A:0xe79002c
y.create.l HWIO_SPMI_PIC_OWNER9_ACC_STATUS12_ADDR A:0xe790030
y.create.l HWIO_SPMI_PIC_OWNER9_ACC_STATUS13_ADDR A:0xe790034
y.create.l HWIO_SPMI_PIC_OWNER9_ACC_STATUS14_ADDR A:0xe790038
y.create.l HWIO_SPMI_PIC_OWNER9_ACC_STATUS15_ADDR A:0xe79003c
y.create.l HWIO_PMIC_MGPI_TRIG_CONFIG0_ADDR A:0xc462000
y.create.l HWIO_PMIC_MGPI_TRIG_CONFIG1_ADDR A:0xc462008
y.create.l HWIO_PMIC_MGPI_TRIG_CONFIG2_ADDR A:0xc462010
y.create.l HWIO_PMIC_MGPI_TRIG_CONFIG3_ADDR A:0xc462018
y.create.l HWIO_PMIC_MGPI_TRIG_CONFIG_EN0_ADDR A:0xc462004
y.create.l HWIO_PMIC_MGPI_TRIG_CONFIG_EN1_ADDR A:0xc46200c
y.create.l HWIO_PMIC_MGPI_TRIG_CONFIG_EN2_ADDR A:0xc462014
y.create.l HWIO_PMIC_MGPI_TRIG_CONFIG_EN3_ADDR A:0xc46201c
y.create.l HWIO_PMIC_MGPI_MASTER_CSR_ADDR A:0xc462100
y.create.l HWIO_PMIC_MGPI_HW_VERSION_ADDR A:0xc462104
y.create.l HWIO_PMIC_MGPI_TRIG_STATUS0_ADDR A:0xc470000
y.create.l HWIO_PMIC_MGPI_TRIG_STATUS1_ADDR A:0xc480000
y.create.l HWIO_PMIC_MGPI_TRIG_STATUS2_ADDR A:0xc490000
y.create.l HWIO_PMIC_MGPI_TRIG_STATUS3_ADDR A:0xc4a0000
y.create.l HWIO_PMIC_ARB_HW_VERSION_ADDR A:0xc440000
y.create.l HWIO_PMIC_ARB_FEATURES_ADDR A:0xc440004
y.create.l HWIO_PMIC_ARB_MISC_CONFIG_ADDR A:0xc440010
y.create.l HWIO_PMIC_ARB_PRIORITIES0_ADDR A:0xc440100
y.create.l HWIO_PMIC_ARB_PRIORITIES1_ADDR A:0xc440104
y.create.l HWIO_PMIC_ARB_PRIORITIES2_ADDR A:0xc440108
y.create.l HWIO_PMIC_ARB_PRIORITIES3_ADDR A:0xc44010c
y.create.l HWIO_PMIC_ARB_PRIORITIES4_ADDR A:0xc440110
y.create.l HWIO_PMIC_ARB_PRIORITIES5_ADDR A:0xc440114
y.create.l HWIO_PMIC_ARB_PRIORITIES6_ADDR A:0xc440118
y.create.l HWIO_PMIC_ARB_PRIORITIES7_ADDR A:0xc44011c
y.create.l HWIO_PMIC_ARB_PRIORITIES8_ADDR A:0xc440120
y.create.l HWIO_PMIC_ARB_PRIORITIES9_ADDR A:0xc440124
y.create.l HWIO_PMIC_ARB_PVC_INTF_CTL_ADDR A:0xc440200
y.create.l HWIO_PMIC_ARB_PVC_INTF_STATUS_ADDR A:0xc440204
y.create.l HWIO_PMIC_ARB_PVC_PORT0_CTL_ADDR A:0xc440208
y.create.l HWIO_PMIC_ARB_PVC_PORT1_CTL_ADDR A:0xc44020c
y.create.l HWIO_PMIC_ARB_PVC_PORT2_CTL_ADDR A:0xc440210
y.create.l HWIO_PMIC_ARB_PVC_PORT3_CTL_ADDR A:0xc440214
y.create.l HWIO_PMIC_ARB_PVC_PORT4_CTL_ADDR A:0xc440218
y.create.l HWIO_PMIC_ARB_PVC_PORT5_CTL_ADDR A:0xc44021c
y.create.l HWIO_PMIC_ARB_PVC_PORT6_CTL_ADDR A:0xc440220
y.create.l HWIO_PMIC_ARB_PVC_PORT0_STATUS_ADDR A:0xc440288
y.create.l HWIO_PMIC_ARB_PVC_PORT1_STATUS_ADDR A:0xc44028c
y.create.l HWIO_PMIC_ARB_PVC_PORT2_STATUS_ADDR A:0xc440290
y.create.l HWIO_PMIC_ARB_PVC_PORT3_STATUS_ADDR A:0xc440294
y.create.l HWIO_PMIC_ARB_PVC_PORT4_STATUS_ADDR A:0xc440298
y.create.l HWIO_PMIC_ARB_PVC_PORT5_STATUS_ADDR A:0xc44029c
y.create.l HWIO_PMIC_ARB_PVC_PORT6_STATUS_ADDR A:0xc4402a0
y.create.l HWIO_PMIC_ARB_PVC0_ADDR0_ADDR A:0xc440400
y.create.l HWIO_PMIC_ARB_PVC0_ADDR1_ADDR A:0xc440404
y.create.l HWIO_PMIC_ARB_PVC0_ADDR2_ADDR A:0xc440408
y.create.l HWIO_PMIC_ARB_PVC0_ADDR3_ADDR A:0xc44040c
y.create.l HWIO_PMIC_ARB_PVC1_ADDR0_ADDR A:0xc440420
y.create.l HWIO_PMIC_ARB_PVC1_ADDR1_ADDR A:0xc440424
y.create.l HWIO_PMIC_ARB_PVC1_ADDR2_ADDR A:0xc440428
y.create.l HWIO_PMIC_ARB_PVC1_ADDR3_ADDR A:0xc44042c
y.create.l HWIO_PMIC_ARB_PVC2_ADDR0_ADDR A:0xc440440
y.create.l HWIO_PMIC_ARB_PVC2_ADDR1_ADDR A:0xc440444
y.create.l HWIO_PMIC_ARB_PVC2_ADDR2_ADDR A:0xc440448
y.create.l HWIO_PMIC_ARB_PVC2_ADDR3_ADDR A:0xc44044c
y.create.l HWIO_PMIC_ARB_PVC3_ADDR0_ADDR A:0xc440460
y.create.l HWIO_PMIC_ARB_PVC3_ADDR1_ADDR A:0xc440464
y.create.l HWIO_PMIC_ARB_PVC3_ADDR2_ADDR A:0xc440468
y.create.l HWIO_PMIC_ARB_PVC3_ADDR3_ADDR A:0xc44046c
y.create.l HWIO_PMIC_ARB_PVC4_ADDR0_ADDR A:0xc440480
y.create.l HWIO_PMIC_ARB_PVC4_ADDR1_ADDR A:0xc440484
y.create.l HWIO_PMIC_ARB_PVC4_ADDR2_ADDR A:0xc440488
y.create.l HWIO_PMIC_ARB_PVC4_ADDR3_ADDR A:0xc44048c
y.create.l HWIO_PMIC_ARB_PVC5_ADDR0_ADDR A:0xc4404a0
y.create.l HWIO_PMIC_ARB_PVC5_ADDR1_ADDR A:0xc4404a4
y.create.l HWIO_PMIC_ARB_PVC5_ADDR2_ADDR A:0xc4404a8
y.create.l HWIO_PMIC_ARB_PVC5_ADDR3_ADDR A:0xc4404ac
y.create.l HWIO_PMIC_ARB_PVC6_ADDR0_ADDR A:0xc4404c0
y.create.l HWIO_PMIC_ARB_PVC6_ADDR1_ADDR A:0xc4404c4
y.create.l HWIO_PMIC_ARB_PVC6_ADDR2_ADDR A:0xc4404c8
y.create.l HWIO_PMIC_ARB_PVC6_ADDR3_ADDR A:0xc4404cc
y.create.l HWIO_PMIC_ARB_REG_ADDR0_ADDR A:0xc440900
y.create.l HWIO_PMIC_ARB_REG_ADDR1_ADDR A:0xc440904
y.create.l HWIO_PMIC_ARB_REG_ADDR2_ADDR A:0xc440908
y.create.l HWIO_PMIC_ARB_REG_ADDR3_ADDR A:0xc44090c
y.create.l HWIO_PMIC_ARB_REG_ADDR4_ADDR A:0xc440910
y.create.l HWIO_PMIC_ARB_REG_ADDR5_ADDR A:0xc440914
y.create.l HWIO_PMIC_ARB_REG_ADDR6_ADDR A:0xc440918
y.create.l HWIO_PMIC_ARB_REG_ADDR7_ADDR A:0xc44091c
y.create.l HWIO_PMIC_ARB_REG_ADDR8_ADDR A:0xc440920
y.create.l HWIO_PMIC_ARB_REG_ADDR9_ADDR A:0xc440924
y.create.l HWIO_PMIC_ARB_REG_ADDR10_ADDR A:0xc440928
y.create.l HWIO_PMIC_ARB_REG_ADDR11_ADDR A:0xc44092c
y.create.l HWIO_PMIC_ARB_REG_ADDR12_ADDR A:0xc440930
y.create.l HWIO_PMIC_ARB_REG_ADDR13_ADDR A:0xc440934
y.create.l HWIO_PMIC_ARB_REG_ADDR14_ADDR A:0xc440938
y.create.l HWIO_PMIC_ARB_REG_ADDR15_ADDR A:0xc44093c
y.create.l HWIO_PMIC_ARB_REG_ADDR16_ADDR A:0xc440940
y.create.l HWIO_PMIC_ARB_REG_ADDR17_ADDR A:0xc440944
y.create.l HWIO_PMIC_ARB_REG_ADDR18_ADDR A:0xc440948
y.create.l HWIO_PMIC_ARB_REG_ADDR19_ADDR A:0xc44094c
y.create.l HWIO_PMIC_ARB_REG_ADDR20_ADDR A:0xc440950
y.create.l HWIO_PMIC_ARB_REG_ADDR21_ADDR A:0xc440954
y.create.l HWIO_PMIC_ARB_REG_ADDR22_ADDR A:0xc440958
y.create.l HWIO_PMIC_ARB_REG_ADDR23_ADDR A:0xc44095c
y.create.l HWIO_PMIC_ARB_REG_ADDR24_ADDR A:0xc440960
y.create.l HWIO_PMIC_ARB_REG_ADDR25_ADDR A:0xc440964
y.create.l HWIO_PMIC_ARB_REG_ADDR26_ADDR A:0xc440968
y.create.l HWIO_PMIC_ARB_REG_ADDR27_ADDR A:0xc44096c
y.create.l HWIO_PMIC_ARB_REG_ADDR28_ADDR A:0xc440970
y.create.l HWIO_PMIC_ARB_REG_ADDR29_ADDR A:0xc440974
y.create.l HWIO_PMIC_ARB_REG_ADDR30_ADDR A:0xc440978
y.create.l HWIO_PMIC_ARB_REG_ADDR31_ADDR A:0xc44097c
y.create.l HWIO_PMIC_ARB_REG_ADDR32_ADDR A:0xc440980
y.create.l HWIO_PMIC_ARB_REG_ADDR33_ADDR A:0xc440984
y.create.l HWIO_PMIC_ARB_REG_ADDR34_ADDR A:0xc440988
y.create.l HWIO_PMIC_ARB_REG_ADDR35_ADDR A:0xc44098c
y.create.l HWIO_PMIC_ARB_REG_ADDR36_ADDR A:0xc440990
y.create.l HWIO_PMIC_ARB_REG_ADDR37_ADDR A:0xc440994
y.create.l HWIO_PMIC_ARB_REG_ADDR38_ADDR A:0xc440998
y.create.l HWIO_PMIC_ARB_REG_ADDR39_ADDR A:0xc44099c
y.create.l HWIO_PMIC_ARB_REG_ADDR40_ADDR A:0xc4409a0
y.create.l HWIO_PMIC_ARB_REG_ADDR41_ADDR A:0xc4409a4
y.create.l HWIO_PMIC_ARB_REG_ADDR42_ADDR A:0xc4409a8
y.create.l HWIO_PMIC_ARB_REG_ADDR43_ADDR A:0xc4409ac
y.create.l HWIO_PMIC_ARB_REG_ADDR44_ADDR A:0xc4409b0
y.create.l HWIO_PMIC_ARB_REG_ADDR45_ADDR A:0xc4409b4
y.create.l HWIO_PMIC_ARB_REG_ADDR46_ADDR A:0xc4409b8
y.create.l HWIO_PMIC_ARB_REG_ADDR47_ADDR A:0xc4409bc
y.create.l HWIO_PMIC_ARB_REG_ADDR48_ADDR A:0xc4409c0
y.create.l HWIO_PMIC_ARB_REG_ADDR49_ADDR A:0xc4409c4
y.create.l HWIO_PMIC_ARB_REG_ADDR50_ADDR A:0xc4409c8
y.create.l HWIO_PMIC_ARB_REG_ADDR51_ADDR A:0xc4409cc
y.create.l HWIO_PMIC_ARB_REG_ADDR52_ADDR A:0xc4409d0
y.create.l HWIO_PMIC_ARB_REG_ADDR53_ADDR A:0xc4409d4
y.create.l HWIO_PMIC_ARB_REG_ADDR54_ADDR A:0xc4409d8
y.create.l HWIO_PMIC_ARB_REG_ADDR55_ADDR A:0xc4409dc
y.create.l HWIO_PMIC_ARB_REG_ADDR56_ADDR A:0xc4409e0
y.create.l HWIO_PMIC_ARB_REG_ADDR57_ADDR A:0xc4409e4
y.create.l HWIO_PMIC_ARB_REG_ADDR58_ADDR A:0xc4409e8
y.create.l HWIO_PMIC_ARB_REG_ADDR59_ADDR A:0xc4409ec
y.create.l HWIO_PMIC_ARB_REG_ADDR60_ADDR A:0xc4409f0
y.create.l HWIO_PMIC_ARB_REG_ADDR61_ADDR A:0xc4409f4
y.create.l HWIO_PMIC_ARB_REG_ADDR62_ADDR A:0xc4409f8
y.create.l HWIO_PMIC_ARB_REG_ADDR63_ADDR A:0xc4409fc
y.create.l HWIO_PMIC_ARB_REG_ADDR64_ADDR A:0xc440a00
y.create.l HWIO_PMIC_ARB_REG_ADDR65_ADDR A:0xc440a04
y.create.l HWIO_PMIC_ARB_REG_ADDR66_ADDR A:0xc440a08
y.create.l HWIO_PMIC_ARB_REG_ADDR67_ADDR A:0xc440a0c
y.create.l HWIO_PMIC_ARB_REG_ADDR68_ADDR A:0xc440a10
y.create.l HWIO_PMIC_ARB_REG_ADDR69_ADDR A:0xc440a14
y.create.l HWIO_PMIC_ARB_REG_ADDR70_ADDR A:0xc440a18
y.create.l HWIO_PMIC_ARB_REG_ADDR71_ADDR A:0xc440a1c
y.create.l HWIO_PMIC_ARB_REG_ADDR72_ADDR A:0xc440a20
y.create.l HWIO_PMIC_ARB_REG_ADDR73_ADDR A:0xc440a24
y.create.l HWIO_PMIC_ARB_REG_ADDR74_ADDR A:0xc440a28
y.create.l HWIO_PMIC_ARB_REG_ADDR75_ADDR A:0xc440a2c
y.create.l HWIO_PMIC_ARB_REG_ADDR76_ADDR A:0xc440a30
y.create.l HWIO_PMIC_ARB_REG_ADDR77_ADDR A:0xc440a34
y.create.l HWIO_PMIC_ARB_REG_ADDR78_ADDR A:0xc440a38
y.create.l HWIO_PMIC_ARB_REG_ADDR79_ADDR A:0xc440a3c
y.create.l HWIO_PMIC_ARB_REG_ADDR80_ADDR A:0xc440a40
y.create.l HWIO_PMIC_ARB_REG_ADDR81_ADDR A:0xc440a44
y.create.l HWIO_PMIC_ARB_REG_ADDR82_ADDR A:0xc440a48
y.create.l HWIO_PMIC_ARB_REG_ADDR83_ADDR A:0xc440a4c
y.create.l HWIO_PMIC_ARB_REG_ADDR84_ADDR A:0xc440a50
y.create.l HWIO_PMIC_ARB_REG_ADDR85_ADDR A:0xc440a54
y.create.l HWIO_PMIC_ARB_REG_ADDR86_ADDR A:0xc440a58
y.create.l HWIO_PMIC_ARB_REG_ADDR87_ADDR A:0xc440a5c
y.create.l HWIO_PMIC_ARB_REG_ADDR88_ADDR A:0xc440a60
y.create.l HWIO_PMIC_ARB_REG_ADDR89_ADDR A:0xc440a64
y.create.l HWIO_PMIC_ARB_REG_ADDR90_ADDR A:0xc440a68
y.create.l HWIO_PMIC_ARB_REG_ADDR91_ADDR A:0xc440a6c
y.create.l HWIO_PMIC_ARB_REG_ADDR92_ADDR A:0xc440a70
y.create.l HWIO_PMIC_ARB_REG_ADDR93_ADDR A:0xc440a74
y.create.l HWIO_PMIC_ARB_REG_ADDR94_ADDR A:0xc440a78
y.create.l HWIO_PMIC_ARB_REG_ADDR95_ADDR A:0xc440a7c
y.create.l HWIO_PMIC_ARB_REG_ADDR96_ADDR A:0xc440a80
y.create.l HWIO_PMIC_ARB_REG_ADDR97_ADDR A:0xc440a84
y.create.l HWIO_PMIC_ARB_REG_ADDR98_ADDR A:0xc440a88
y.create.l HWIO_PMIC_ARB_REG_ADDR99_ADDR A:0xc440a8c
y.create.l HWIO_PMIC_ARB_REG_ADDR100_ADDR A:0xc440a90
y.create.l HWIO_PMIC_ARB_REG_ADDR101_ADDR A:0xc440a94
y.create.l HWIO_PMIC_ARB_REG_ADDR102_ADDR A:0xc440a98
y.create.l HWIO_PMIC_ARB_REG_ADDR103_ADDR A:0xc440a9c
y.create.l HWIO_PMIC_ARB_REG_ADDR104_ADDR A:0xc440aa0
y.create.l HWIO_PMIC_ARB_REG_ADDR105_ADDR A:0xc440aa4
y.create.l HWIO_PMIC_ARB_REG_ADDR106_ADDR A:0xc440aa8
y.create.l HWIO_PMIC_ARB_REG_ADDR107_ADDR A:0xc440aac
y.create.l HWIO_PMIC_ARB_REG_ADDR108_ADDR A:0xc440ab0
y.create.l HWIO_PMIC_ARB_REG_ADDR109_ADDR A:0xc440ab4
y.create.l HWIO_PMIC_ARB_REG_ADDR110_ADDR A:0xc440ab8
y.create.l HWIO_PMIC_ARB_REG_ADDR111_ADDR A:0xc440abc
y.create.l HWIO_PMIC_ARB_REG_ADDR112_ADDR A:0xc440ac0
y.create.l HWIO_PMIC_ARB_REG_ADDR113_ADDR A:0xc440ac4
y.create.l HWIO_PMIC_ARB_REG_ADDR114_ADDR A:0xc440ac8
y.create.l HWIO_PMIC_ARB_REG_ADDR115_ADDR A:0xc440acc
y.create.l HWIO_PMIC_ARB_REG_ADDR116_ADDR A:0xc440ad0
y.create.l HWIO_PMIC_ARB_REG_ADDR117_ADDR A:0xc440ad4
y.create.l HWIO_PMIC_ARB_REG_ADDR118_ADDR A:0xc440ad8
y.create.l HWIO_PMIC_ARB_REG_ADDR119_ADDR A:0xc440adc
y.create.l HWIO_PMIC_ARB_REG_ADDR120_ADDR A:0xc440ae0
y.create.l HWIO_PMIC_ARB_REG_ADDR121_ADDR A:0xc440ae4
y.create.l HWIO_PMIC_ARB_REG_ADDR122_ADDR A:0xc440ae8
y.create.l HWIO_PMIC_ARB_REG_ADDR123_ADDR A:0xc440aec
y.create.l HWIO_PMIC_ARB_REG_ADDR124_ADDR A:0xc440af0
y.create.l HWIO_PMIC_ARB_REG_ADDR125_ADDR A:0xc440af4
y.create.l HWIO_PMIC_ARB_REG_ADDR126_ADDR A:0xc440af8
y.create.l HWIO_PMIC_ARB_REG_ADDR127_ADDR A:0xc440afc
y.create.l HWIO_PMIC_ARB_REG_ADDR128_ADDR A:0xc440b00
y.create.l HWIO_PMIC_ARB_REG_ADDR129_ADDR A:0xc440b04
y.create.l HWIO_PMIC_ARB_REG_ADDR130_ADDR A:0xc440b08
y.create.l HWIO_PMIC_ARB_REG_ADDR131_ADDR A:0xc440b0c
y.create.l HWIO_PMIC_ARB_REG_ADDR132_ADDR A:0xc440b10
y.create.l HWIO_PMIC_ARB_REG_ADDR133_ADDR A:0xc440b14
y.create.l HWIO_PMIC_ARB_REG_ADDR134_ADDR A:0xc440b18
y.create.l HWIO_PMIC_ARB_REG_ADDR135_ADDR A:0xc440b1c
y.create.l HWIO_PMIC_ARB_REG_ADDR136_ADDR A:0xc440b20
y.create.l HWIO_PMIC_ARB_REG_ADDR137_ADDR A:0xc440b24
y.create.l HWIO_PMIC_ARB_REG_ADDR138_ADDR A:0xc440b28
y.create.l HWIO_PMIC_ARB_REG_ADDR139_ADDR A:0xc440b2c
y.create.l HWIO_PMIC_ARB_REG_ADDR140_ADDR A:0xc440b30
y.create.l HWIO_PMIC_ARB_REG_ADDR141_ADDR A:0xc440b34
y.create.l HWIO_PMIC_ARB_REG_ADDR142_ADDR A:0xc440b38
y.create.l HWIO_PMIC_ARB_REG_ADDR143_ADDR A:0xc440b3c
y.create.l HWIO_PMIC_ARB_REG_ADDR144_ADDR A:0xc440b40
y.create.l HWIO_PMIC_ARB_REG_ADDR145_ADDR A:0xc440b44
y.create.l HWIO_PMIC_ARB_REG_ADDR146_ADDR A:0xc440b48
y.create.l HWIO_PMIC_ARB_REG_ADDR147_ADDR A:0xc440b4c
y.create.l HWIO_PMIC_ARB_REG_ADDR148_ADDR A:0xc440b50
y.create.l HWIO_PMIC_ARB_REG_ADDR149_ADDR A:0xc440b54
y.create.l HWIO_PMIC_ARB_REG_ADDR150_ADDR A:0xc440b58
y.create.l HWIO_PMIC_ARB_REG_ADDR151_ADDR A:0xc440b5c
y.create.l HWIO_PMIC_ARB_REG_ADDR152_ADDR A:0xc440b60
y.create.l HWIO_PMIC_ARB_REG_ADDR153_ADDR A:0xc440b64
y.create.l HWIO_PMIC_ARB_REG_ADDR154_ADDR A:0xc440b68
y.create.l HWIO_PMIC_ARB_REG_ADDR155_ADDR A:0xc440b6c
y.create.l HWIO_PMIC_ARB_REG_ADDR156_ADDR A:0xc440b70
y.create.l HWIO_PMIC_ARB_REG_ADDR157_ADDR A:0xc440b74
y.create.l HWIO_PMIC_ARB_REG_ADDR158_ADDR A:0xc440b78
y.create.l HWIO_PMIC_ARB_REG_ADDR159_ADDR A:0xc440b7c
y.create.l HWIO_PMIC_ARB_REG_ADDR160_ADDR A:0xc440b80
y.create.l HWIO_PMIC_ARB_REG_ADDR161_ADDR A:0xc440b84
y.create.l HWIO_PMIC_ARB_REG_ADDR162_ADDR A:0xc440b88
y.create.l HWIO_PMIC_ARB_REG_ADDR163_ADDR A:0xc440b8c
y.create.l HWIO_PMIC_ARB_REG_ADDR164_ADDR A:0xc440b90
y.create.l HWIO_PMIC_ARB_REG_ADDR165_ADDR A:0xc440b94
y.create.l HWIO_PMIC_ARB_REG_ADDR166_ADDR A:0xc440b98
y.create.l HWIO_PMIC_ARB_REG_ADDR167_ADDR A:0xc440b9c
y.create.l HWIO_PMIC_ARB_REG_ADDR168_ADDR A:0xc440ba0
y.create.l HWIO_PMIC_ARB_REG_ADDR169_ADDR A:0xc440ba4
y.create.l HWIO_PMIC_ARB_REG_ADDR170_ADDR A:0xc440ba8
y.create.l HWIO_PMIC_ARB_REG_ADDR171_ADDR A:0xc440bac
y.create.l HWIO_PMIC_ARB_REG_ADDR172_ADDR A:0xc440bb0
y.create.l HWIO_PMIC_ARB_REG_ADDR173_ADDR A:0xc440bb4
y.create.l HWIO_PMIC_ARB_REG_ADDR174_ADDR A:0xc440bb8
y.create.l HWIO_PMIC_ARB_REG_ADDR175_ADDR A:0xc440bbc
y.create.l HWIO_PMIC_ARB_REG_ADDR176_ADDR A:0xc440bc0
y.create.l HWIO_PMIC_ARB_REG_ADDR177_ADDR A:0xc440bc4
y.create.l HWIO_PMIC_ARB_REG_ADDR178_ADDR A:0xc440bc8
y.create.l HWIO_PMIC_ARB_REG_ADDR179_ADDR A:0xc440bcc
y.create.l HWIO_PMIC_ARB_REG_ADDR180_ADDR A:0xc440bd0
y.create.l HWIO_PMIC_ARB_REG_ADDR181_ADDR A:0xc440bd4
y.create.l HWIO_PMIC_ARB_REG_ADDR182_ADDR A:0xc440bd8
y.create.l HWIO_PMIC_ARB_REG_ADDR183_ADDR A:0xc440bdc
y.create.l HWIO_PMIC_ARB_REG_ADDR184_ADDR A:0xc440be0
y.create.l HWIO_PMIC_ARB_REG_ADDR185_ADDR A:0xc440be4
y.create.l HWIO_PMIC_ARB_REG_ADDR186_ADDR A:0xc440be8
y.create.l HWIO_PMIC_ARB_REG_ADDR187_ADDR A:0xc440bec
y.create.l HWIO_PMIC_ARB_REG_ADDR188_ADDR A:0xc440bf0
y.create.l HWIO_PMIC_ARB_REG_ADDR189_ADDR A:0xc440bf4
y.create.l HWIO_PMIC_ARB_REG_ADDR190_ADDR A:0xc440bf8
y.create.l HWIO_PMIC_ARB_REG_ADDR191_ADDR A:0xc440bfc
y.create.l HWIO_PMIC_ARB_REG_ADDR192_ADDR A:0xc440c00
y.create.l HWIO_PMIC_ARB_REG_ADDR193_ADDR A:0xc440c04
y.create.l HWIO_PMIC_ARB_REG_ADDR194_ADDR A:0xc440c08
y.create.l HWIO_PMIC_ARB_REG_ADDR195_ADDR A:0xc440c0c
y.create.l HWIO_PMIC_ARB_REG_ADDR196_ADDR A:0xc440c10
y.create.l HWIO_PMIC_ARB_REG_ADDR197_ADDR A:0xc440c14
y.create.l HWIO_PMIC_ARB_REG_ADDR198_ADDR A:0xc440c18
y.create.l HWIO_PMIC_ARB_REG_ADDR199_ADDR A:0xc440c1c
y.create.l HWIO_PMIC_ARB_REG_ADDR200_ADDR A:0xc440c20
y.create.l HWIO_PMIC_ARB_REG_ADDR201_ADDR A:0xc440c24
y.create.l HWIO_PMIC_ARB_REG_ADDR202_ADDR A:0xc440c28
y.create.l HWIO_PMIC_ARB_REG_ADDR203_ADDR A:0xc440c2c
y.create.l HWIO_PMIC_ARB_REG_ADDR204_ADDR A:0xc440c30
y.create.l HWIO_PMIC_ARB_REG_ADDR205_ADDR A:0xc440c34
y.create.l HWIO_PMIC_ARB_REG_ADDR206_ADDR A:0xc440c38
y.create.l HWIO_PMIC_ARB_REG_ADDR207_ADDR A:0xc440c3c
y.create.l HWIO_PMIC_ARB_REG_ADDR208_ADDR A:0xc440c40
y.create.l HWIO_PMIC_ARB_REG_ADDR209_ADDR A:0xc440c44
y.create.l HWIO_PMIC_ARB_REG_ADDR210_ADDR A:0xc440c48
y.create.l HWIO_PMIC_ARB_REG_ADDR211_ADDR A:0xc440c4c
y.create.l HWIO_PMIC_ARB_REG_ADDR212_ADDR A:0xc440c50
y.create.l HWIO_PMIC_ARB_REG_ADDR213_ADDR A:0xc440c54
y.create.l HWIO_PMIC_ARB_REG_ADDR214_ADDR A:0xc440c58
y.create.l HWIO_PMIC_ARB_REG_ADDR215_ADDR A:0xc440c5c
y.create.l HWIO_PMIC_ARB_REG_ADDR216_ADDR A:0xc440c60
y.create.l HWIO_PMIC_ARB_REG_ADDR217_ADDR A:0xc440c64
y.create.l HWIO_PMIC_ARB_REG_ADDR218_ADDR A:0xc440c68
y.create.l HWIO_PMIC_ARB_REG_ADDR219_ADDR A:0xc440c6c
y.create.l HWIO_PMIC_ARB_REG_ADDR220_ADDR A:0xc440c70
y.create.l HWIO_PMIC_ARB_REG_ADDR221_ADDR A:0xc440c74
y.create.l HWIO_PMIC_ARB_REG_ADDR222_ADDR A:0xc440c78
y.create.l HWIO_PMIC_ARB_REG_ADDR223_ADDR A:0xc440c7c
y.create.l HWIO_PMIC_ARB_REG_ADDR224_ADDR A:0xc440c80
y.create.l HWIO_PMIC_ARB_REG_ADDR225_ADDR A:0xc440c84
y.create.l HWIO_PMIC_ARB_REG_ADDR226_ADDR A:0xc440c88
y.create.l HWIO_PMIC_ARB_REG_ADDR227_ADDR A:0xc440c8c
y.create.l HWIO_PMIC_ARB_REG_ADDR228_ADDR A:0xc440c90
y.create.l HWIO_PMIC_ARB_REG_ADDR229_ADDR A:0xc440c94
y.create.l HWIO_PMIC_ARB_REG_ADDR230_ADDR A:0xc440c98
y.create.l HWIO_PMIC_ARB_REG_ADDR231_ADDR A:0xc440c9c
y.create.l HWIO_PMIC_ARB_REG_ADDR232_ADDR A:0xc440ca0
y.create.l HWIO_PMIC_ARB_REG_ADDR233_ADDR A:0xc440ca4
y.create.l HWIO_PMIC_ARB_REG_ADDR234_ADDR A:0xc440ca8
y.create.l HWIO_PMIC_ARB_REG_ADDR235_ADDR A:0xc440cac
y.create.l HWIO_PMIC_ARB_REG_ADDR236_ADDR A:0xc440cb0
y.create.l HWIO_PMIC_ARB_REG_ADDR237_ADDR A:0xc440cb4
y.create.l HWIO_PMIC_ARB_REG_ADDR238_ADDR A:0xc440cb8
y.create.l HWIO_PMIC_ARB_REG_ADDR239_ADDR A:0xc440cbc
y.create.l HWIO_PMIC_ARB_REG_ADDR240_ADDR A:0xc440cc0
y.create.l HWIO_PMIC_ARB_REG_ADDR241_ADDR A:0xc440cc4
y.create.l HWIO_PMIC_ARB_REG_ADDR242_ADDR A:0xc440cc8
y.create.l HWIO_PMIC_ARB_REG_ADDR243_ADDR A:0xc440ccc
y.create.l HWIO_PMIC_ARB_REG_ADDR244_ADDR A:0xc440cd0
y.create.l HWIO_PMIC_ARB_REG_ADDR245_ADDR A:0xc440cd4
y.create.l HWIO_PMIC_ARB_REG_ADDR246_ADDR A:0xc440cd8
y.create.l HWIO_PMIC_ARB_REG_ADDR247_ADDR A:0xc440cdc
y.create.l HWIO_PMIC_ARB_REG_ADDR248_ADDR A:0xc440ce0
y.create.l HWIO_PMIC_ARB_REG_ADDR249_ADDR A:0xc440ce4
y.create.l HWIO_PMIC_ARB_REG_ADDR250_ADDR A:0xc440ce8
y.create.l HWIO_PMIC_ARB_REG_ADDR251_ADDR A:0xc440cec
y.create.l HWIO_PMIC_ARB_REG_ADDR252_ADDR A:0xc440cf0
y.create.l HWIO_PMIC_ARB_REG_ADDR253_ADDR A:0xc440cf4
y.create.l HWIO_PMIC_ARB_REG_ADDR254_ADDR A:0xc440cf8
y.create.l HWIO_PMIC_ARB_REG_ADDR255_ADDR A:0xc440cfc
y.create.l HWIO_PMIC_ARB_REG_ADDR256_ADDR A:0xc440d00
y.create.l HWIO_PMIC_ARB_REG_ADDR257_ADDR A:0xc440d04
y.create.l HWIO_PMIC_ARB_REG_ADDR258_ADDR A:0xc440d08
y.create.l HWIO_PMIC_ARB_REG_ADDR259_ADDR A:0xc440d0c
y.create.l HWIO_PMIC_ARB_REG_ADDR260_ADDR A:0xc440d10
y.create.l HWIO_PMIC_ARB_REG_ADDR261_ADDR A:0xc440d14
y.create.l HWIO_PMIC_ARB_REG_ADDR262_ADDR A:0xc440d18
y.create.l HWIO_PMIC_ARB_REG_ADDR263_ADDR A:0xc440d1c
y.create.l HWIO_PMIC_ARB_REG_ADDR264_ADDR A:0xc440d20
y.create.l HWIO_PMIC_ARB_REG_ADDR265_ADDR A:0xc440d24
y.create.l HWIO_PMIC_ARB_REG_ADDR266_ADDR A:0xc440d28
y.create.l HWIO_PMIC_ARB_REG_ADDR267_ADDR A:0xc440d2c
y.create.l HWIO_PMIC_ARB_REG_ADDR268_ADDR A:0xc440d30
y.create.l HWIO_PMIC_ARB_REG_ADDR269_ADDR A:0xc440d34
y.create.l HWIO_PMIC_ARB_REG_ADDR270_ADDR A:0xc440d38
y.create.l HWIO_PMIC_ARB_REG_ADDR271_ADDR A:0xc440d3c
y.create.l HWIO_PMIC_ARB_REG_ADDR272_ADDR A:0xc440d40
y.create.l HWIO_PMIC_ARB_REG_ADDR273_ADDR A:0xc440d44
y.create.l HWIO_PMIC_ARB_REG_ADDR274_ADDR A:0xc440d48
y.create.l HWIO_PMIC_ARB_REG_ADDR275_ADDR A:0xc440d4c
y.create.l HWIO_PMIC_ARB_REG_ADDR276_ADDR A:0xc440d50
y.create.l HWIO_PMIC_ARB_REG_ADDR277_ADDR A:0xc440d54
y.create.l HWIO_PMIC_ARB_REG_ADDR278_ADDR A:0xc440d58
y.create.l HWIO_PMIC_ARB_REG_ADDR279_ADDR A:0xc440d5c
y.create.l HWIO_PMIC_ARB_REG_ADDR280_ADDR A:0xc440d60
y.create.l HWIO_PMIC_ARB_REG_ADDR281_ADDR A:0xc440d64
y.create.l HWIO_PMIC_ARB_REG_ADDR282_ADDR A:0xc440d68
y.create.l HWIO_PMIC_ARB_REG_ADDR283_ADDR A:0xc440d6c
y.create.l HWIO_PMIC_ARB_REG_ADDR284_ADDR A:0xc440d70
y.create.l HWIO_PMIC_ARB_REG_ADDR285_ADDR A:0xc440d74
y.create.l HWIO_PMIC_ARB_REG_ADDR286_ADDR A:0xc440d78
y.create.l HWIO_PMIC_ARB_REG_ADDR287_ADDR A:0xc440d7c
y.create.l HWIO_PMIC_ARB_REG_ADDR288_ADDR A:0xc440d80
y.create.l HWIO_PMIC_ARB_REG_ADDR289_ADDR A:0xc440d84
y.create.l HWIO_PMIC_ARB_REG_ADDR290_ADDR A:0xc440d88
y.create.l HWIO_PMIC_ARB_REG_ADDR291_ADDR A:0xc440d8c
y.create.l HWIO_PMIC_ARB_REG_ADDR292_ADDR A:0xc440d90
y.create.l HWIO_PMIC_ARB_REG_ADDR293_ADDR A:0xc440d94
y.create.l HWIO_PMIC_ARB_REG_ADDR294_ADDR A:0xc440d98
y.create.l HWIO_PMIC_ARB_REG_ADDR295_ADDR A:0xc440d9c
y.create.l HWIO_PMIC_ARB_REG_ADDR296_ADDR A:0xc440da0
y.create.l HWIO_PMIC_ARB_REG_ADDR297_ADDR A:0xc440da4
y.create.l HWIO_PMIC_ARB_REG_ADDR298_ADDR A:0xc440da8
y.create.l HWIO_PMIC_ARB_REG_ADDR299_ADDR A:0xc440dac
y.create.l HWIO_PMIC_ARB_REG_ADDR300_ADDR A:0xc440db0
y.create.l HWIO_PMIC_ARB_REG_ADDR301_ADDR A:0xc440db4
y.create.l HWIO_PMIC_ARB_REG_ADDR302_ADDR A:0xc440db8
y.create.l HWIO_PMIC_ARB_REG_ADDR303_ADDR A:0xc440dbc
y.create.l HWIO_PMIC_ARB_REG_ADDR304_ADDR A:0xc440dc0
y.create.l HWIO_PMIC_ARB_REG_ADDR305_ADDR A:0xc440dc4
y.create.l HWIO_PMIC_ARB_REG_ADDR306_ADDR A:0xc440dc8
y.create.l HWIO_PMIC_ARB_REG_ADDR307_ADDR A:0xc440dcc
y.create.l HWIO_PMIC_ARB_REG_ADDR308_ADDR A:0xc440dd0
y.create.l HWIO_PMIC_ARB_REG_ADDR309_ADDR A:0xc440dd4
y.create.l HWIO_PMIC_ARB_REG_ADDR310_ADDR A:0xc440dd8
y.create.l HWIO_PMIC_ARB_REG_ADDR311_ADDR A:0xc440ddc
y.create.l HWIO_PMIC_ARB_REG_ADDR312_ADDR A:0xc440de0
y.create.l HWIO_PMIC_ARB_REG_ADDR313_ADDR A:0xc440de4
y.create.l HWIO_PMIC_ARB_REG_ADDR314_ADDR A:0xc440de8
y.create.l HWIO_PMIC_ARB_REG_ADDR315_ADDR A:0xc440dec
y.create.l HWIO_PMIC_ARB_REG_ADDR316_ADDR A:0xc440df0
y.create.l HWIO_PMIC_ARB_REG_ADDR317_ADDR A:0xc440df4
y.create.l HWIO_PMIC_ARB_REG_ADDR318_ADDR A:0xc440df8
y.create.l HWIO_PMIC_ARB_REG_ADDR319_ADDR A:0xc440dfc
y.create.l HWIO_PMIC_ARB_REG_ADDR320_ADDR A:0xc440e00
y.create.l HWIO_PMIC_ARB_REG_ADDR321_ADDR A:0xc440e04
y.create.l HWIO_PMIC_ARB_REG_ADDR322_ADDR A:0xc440e08
y.create.l HWIO_PMIC_ARB_REG_ADDR323_ADDR A:0xc440e0c
y.create.l HWIO_PMIC_ARB_REG_ADDR324_ADDR A:0xc440e10
y.create.l HWIO_PMIC_ARB_REG_ADDR325_ADDR A:0xc440e14
y.create.l HWIO_PMIC_ARB_REG_ADDR326_ADDR A:0xc440e18
y.create.l HWIO_PMIC_ARB_REG_ADDR327_ADDR A:0xc440e1c
y.create.l HWIO_PMIC_ARB_REG_ADDR328_ADDR A:0xc440e20
y.create.l HWIO_PMIC_ARB_REG_ADDR329_ADDR A:0xc440e24
y.create.l HWIO_PMIC_ARB_REG_ADDR330_ADDR A:0xc440e28
y.create.l HWIO_PMIC_ARB_REG_ADDR331_ADDR A:0xc440e2c
y.create.l HWIO_PMIC_ARB_REG_ADDR332_ADDR A:0xc440e30
y.create.l HWIO_PMIC_ARB_REG_ADDR333_ADDR A:0xc440e34
y.create.l HWIO_PMIC_ARB_REG_ADDR334_ADDR A:0xc440e38
y.create.l HWIO_PMIC_ARB_REG_ADDR335_ADDR A:0xc440e3c
y.create.l HWIO_PMIC_ARB_REG_ADDR336_ADDR A:0xc440e40
y.create.l HWIO_PMIC_ARB_REG_ADDR337_ADDR A:0xc440e44
y.create.l HWIO_PMIC_ARB_REG_ADDR338_ADDR A:0xc440e48
y.create.l HWIO_PMIC_ARB_REG_ADDR339_ADDR A:0xc440e4c
y.create.l HWIO_PMIC_ARB_REG_ADDR340_ADDR A:0xc440e50
y.create.l HWIO_PMIC_ARB_REG_ADDR341_ADDR A:0xc440e54
y.create.l HWIO_PMIC_ARB_REG_ADDR342_ADDR A:0xc440e58
y.create.l HWIO_PMIC_ARB_REG_ADDR343_ADDR A:0xc440e5c
y.create.l HWIO_PMIC_ARB_REG_ADDR344_ADDR A:0xc440e60
y.create.l HWIO_PMIC_ARB_REG_ADDR345_ADDR A:0xc440e64
y.create.l HWIO_PMIC_ARB_REG_ADDR346_ADDR A:0xc440e68
y.create.l HWIO_PMIC_ARB_REG_ADDR347_ADDR A:0xc440e6c
y.create.l HWIO_PMIC_ARB_REG_ADDR348_ADDR A:0xc440e70
y.create.l HWIO_PMIC_ARB_REG_ADDR349_ADDR A:0xc440e74
y.create.l HWIO_PMIC_ARB_REG_ADDR350_ADDR A:0xc440e78
y.create.l HWIO_PMIC_ARB_REG_ADDR351_ADDR A:0xc440e7c
y.create.l HWIO_PMIC_ARB_REG_ADDR352_ADDR A:0xc440e80
y.create.l HWIO_PMIC_ARB_REG_ADDR353_ADDR A:0xc440e84
y.create.l HWIO_PMIC_ARB_REG_ADDR354_ADDR A:0xc440e88
y.create.l HWIO_PMIC_ARB_REG_ADDR355_ADDR A:0xc440e8c
y.create.l HWIO_PMIC_ARB_REG_ADDR356_ADDR A:0xc440e90
y.create.l HWIO_PMIC_ARB_REG_ADDR357_ADDR A:0xc440e94
y.create.l HWIO_PMIC_ARB_REG_ADDR358_ADDR A:0xc440e98
y.create.l HWIO_PMIC_ARB_REG_ADDR359_ADDR A:0xc440e9c
y.create.l HWIO_PMIC_ARB_REG_ADDR360_ADDR A:0xc440ea0
y.create.l HWIO_PMIC_ARB_REG_ADDR361_ADDR A:0xc440ea4
y.create.l HWIO_PMIC_ARB_REG_ADDR362_ADDR A:0xc440ea8
y.create.l HWIO_PMIC_ARB_REG_ADDR363_ADDR A:0xc440eac
y.create.l HWIO_PMIC_ARB_REG_ADDR364_ADDR A:0xc440eb0
y.create.l HWIO_PMIC_ARB_REG_ADDR365_ADDR A:0xc440eb4
y.create.l HWIO_PMIC_ARB_REG_ADDR366_ADDR A:0xc440eb8
y.create.l HWIO_PMIC_ARB_REG_ADDR367_ADDR A:0xc440ebc
y.create.l HWIO_PMIC_ARB_REG_ADDR368_ADDR A:0xc440ec0
y.create.l HWIO_PMIC_ARB_REG_ADDR369_ADDR A:0xc440ec4
y.create.l HWIO_PMIC_ARB_REG_ADDR370_ADDR A:0xc440ec8
y.create.l HWIO_PMIC_ARB_REG_ADDR371_ADDR A:0xc440ecc
y.create.l HWIO_PMIC_ARB_REG_ADDR372_ADDR A:0xc440ed0
y.create.l HWIO_PMIC_ARB_REG_ADDR373_ADDR A:0xc440ed4
y.create.l HWIO_PMIC_ARB_REG_ADDR374_ADDR A:0xc440ed8
y.create.l HWIO_PMIC_ARB_REG_ADDR375_ADDR A:0xc440edc
y.create.l HWIO_PMIC_ARB_REG_ADDR376_ADDR A:0xc440ee0
y.create.l HWIO_PMIC_ARB_REG_ADDR377_ADDR A:0xc440ee4
y.create.l HWIO_PMIC_ARB_REG_ADDR378_ADDR A:0xc440ee8
y.create.l HWIO_PMIC_ARB_REG_ADDR379_ADDR A:0xc440eec
y.create.l HWIO_PMIC_ARB_REG_ADDR380_ADDR A:0xc440ef0
y.create.l HWIO_PMIC_ARB_REG_ADDR381_ADDR A:0xc440ef4
y.create.l HWIO_PMIC_ARB_REG_ADDR382_ADDR A:0xc440ef8
y.create.l HWIO_PMIC_ARB_REG_ADDR383_ADDR A:0xc440efc
y.create.l HWIO_PMIC_ARB_REG_ADDR384_ADDR A:0xc440f00
y.create.l HWIO_PMIC_ARB_REG_ADDR385_ADDR A:0xc440f04
y.create.l HWIO_PMIC_ARB_REG_ADDR386_ADDR A:0xc440f08
y.create.l HWIO_PMIC_ARB_REG_ADDR387_ADDR A:0xc440f0c
y.create.l HWIO_PMIC_ARB_REG_ADDR388_ADDR A:0xc440f10
y.create.l HWIO_PMIC_ARB_REG_ADDR389_ADDR A:0xc440f14
y.create.l HWIO_PMIC_ARB_REG_ADDR390_ADDR A:0xc440f18
y.create.l HWIO_PMIC_ARB_REG_ADDR391_ADDR A:0xc440f1c
y.create.l HWIO_PMIC_ARB_REG_ADDR392_ADDR A:0xc440f20
y.create.l HWIO_PMIC_ARB_REG_ADDR393_ADDR A:0xc440f24
y.create.l HWIO_PMIC_ARB_REG_ADDR394_ADDR A:0xc440f28
y.create.l HWIO_PMIC_ARB_REG_ADDR395_ADDR A:0xc440f2c
y.create.l HWIO_PMIC_ARB_REG_ADDR396_ADDR A:0xc440f30
y.create.l HWIO_PMIC_ARB_REG_ADDR397_ADDR A:0xc440f34
y.create.l HWIO_PMIC_ARB_REG_ADDR398_ADDR A:0xc440f38
y.create.l HWIO_PMIC_ARB_REG_ADDR399_ADDR A:0xc440f3c
y.create.l HWIO_PMIC_ARB_REG_ADDR400_ADDR A:0xc440f40
y.create.l HWIO_PMIC_ARB_REG_ADDR401_ADDR A:0xc440f44
y.create.l HWIO_PMIC_ARB_REG_ADDR402_ADDR A:0xc440f48
y.create.l HWIO_PMIC_ARB_REG_ADDR403_ADDR A:0xc440f4c
y.create.l HWIO_PMIC_ARB_REG_ADDR404_ADDR A:0xc440f50
y.create.l HWIO_PMIC_ARB_REG_ADDR405_ADDR A:0xc440f54
y.create.l HWIO_PMIC_ARB_REG_ADDR406_ADDR A:0xc440f58
y.create.l HWIO_PMIC_ARB_REG_ADDR407_ADDR A:0xc440f5c
y.create.l HWIO_PMIC_ARB_REG_ADDR408_ADDR A:0xc440f60
y.create.l HWIO_PMIC_ARB_REG_ADDR409_ADDR A:0xc440f64
y.create.l HWIO_PMIC_ARB_REG_ADDR410_ADDR A:0xc440f68
y.create.l HWIO_PMIC_ARB_REG_ADDR411_ADDR A:0xc440f6c
y.create.l HWIO_PMIC_ARB_REG_ADDR412_ADDR A:0xc440f70
y.create.l HWIO_PMIC_ARB_REG_ADDR413_ADDR A:0xc440f74
y.create.l HWIO_PMIC_ARB_REG_ADDR414_ADDR A:0xc440f78
y.create.l HWIO_PMIC_ARB_REG_ADDR415_ADDR A:0xc440f7c
y.create.l HWIO_PMIC_ARB_REG_ADDR416_ADDR A:0xc440f80
y.create.l HWIO_PMIC_ARB_REG_ADDR417_ADDR A:0xc440f84
y.create.l HWIO_PMIC_ARB_REG_ADDR418_ADDR A:0xc440f88
y.create.l HWIO_PMIC_ARB_REG_ADDR419_ADDR A:0xc440f8c
y.create.l HWIO_PMIC_ARB_REG_ADDR420_ADDR A:0xc440f90
y.create.l HWIO_PMIC_ARB_REG_ADDR421_ADDR A:0xc440f94
y.create.l HWIO_PMIC_ARB_REG_ADDR422_ADDR A:0xc440f98
y.create.l HWIO_PMIC_ARB_REG_ADDR423_ADDR A:0xc440f9c
y.create.l HWIO_PMIC_ARB_REG_ADDR424_ADDR A:0xc440fa0
y.create.l HWIO_PMIC_ARB_REG_ADDR425_ADDR A:0xc440fa4
y.create.l HWIO_PMIC_ARB_REG_ADDR426_ADDR A:0xc440fa8
y.create.l HWIO_PMIC_ARB_REG_ADDR427_ADDR A:0xc440fac
y.create.l HWIO_PMIC_ARB_REG_ADDR428_ADDR A:0xc440fb0
y.create.l HWIO_PMIC_ARB_REG_ADDR429_ADDR A:0xc440fb4
y.create.l HWIO_PMIC_ARB_REG_ADDR430_ADDR A:0xc440fb8
y.create.l HWIO_PMIC_ARB_REG_ADDR431_ADDR A:0xc440fbc
y.create.l HWIO_PMIC_ARB_REG_ADDR432_ADDR A:0xc440fc0
y.create.l HWIO_PMIC_ARB_REG_ADDR433_ADDR A:0xc440fc4
y.create.l HWIO_PMIC_ARB_REG_ADDR434_ADDR A:0xc440fc8
y.create.l HWIO_PMIC_ARB_REG_ADDR435_ADDR A:0xc440fcc
y.create.l HWIO_PMIC_ARB_REG_ADDR436_ADDR A:0xc440fd0
y.create.l HWIO_PMIC_ARB_REG_ADDR437_ADDR A:0xc440fd4
y.create.l HWIO_PMIC_ARB_REG_ADDR438_ADDR A:0xc440fd8
y.create.l HWIO_PMIC_ARB_REG_ADDR439_ADDR A:0xc440fdc
y.create.l HWIO_PMIC_ARB_REG_ADDR440_ADDR A:0xc440fe0
y.create.l HWIO_PMIC_ARB_REG_ADDR441_ADDR A:0xc440fe4
y.create.l HWIO_PMIC_ARB_REG_ADDR442_ADDR A:0xc440fe8
y.create.l HWIO_PMIC_ARB_REG_ADDR443_ADDR A:0xc440fec
y.create.l HWIO_PMIC_ARB_REG_ADDR444_ADDR A:0xc440ff0
y.create.l HWIO_PMIC_ARB_REG_ADDR445_ADDR A:0xc440ff4
y.create.l HWIO_PMIC_ARB_REG_ADDR446_ADDR A:0xc440ff8
y.create.l HWIO_PMIC_ARB_REG_ADDR447_ADDR A:0xc440ffc
y.create.l HWIO_PMIC_ARB_REG_ADDR448_ADDR A:0xc441000
y.create.l HWIO_PMIC_ARB_REG_ADDR449_ADDR A:0xc441004
y.create.l HWIO_PMIC_ARB_REG_ADDR450_ADDR A:0xc441008
y.create.l HWIO_PMIC_ARB_REG_ADDR451_ADDR A:0xc44100c
y.create.l HWIO_PMIC_ARB_REG_ADDR452_ADDR A:0xc441010
y.create.l HWIO_PMIC_ARB_REG_ADDR453_ADDR A:0xc441014
y.create.l HWIO_PMIC_ARB_REG_ADDR454_ADDR A:0xc441018
y.create.l HWIO_PMIC_ARB_REG_ADDR455_ADDR A:0xc44101c
y.create.l HWIO_PMIC_ARB_REG_ADDR456_ADDR A:0xc441020
y.create.l HWIO_PMIC_ARB_REG_ADDR457_ADDR A:0xc441024
y.create.l HWIO_PMIC_ARB_REG_ADDR458_ADDR A:0xc441028
y.create.l HWIO_PMIC_ARB_REG_ADDR459_ADDR A:0xc44102c
y.create.l HWIO_PMIC_ARB_REG_ADDR460_ADDR A:0xc441030
y.create.l HWIO_PMIC_ARB_REG_ADDR461_ADDR A:0xc441034
y.create.l HWIO_PMIC_ARB_REG_ADDR462_ADDR A:0xc441038
y.create.l HWIO_PMIC_ARB_REG_ADDR463_ADDR A:0xc44103c
y.create.l HWIO_PMIC_ARB_REG_ADDR464_ADDR A:0xc441040
y.create.l HWIO_PMIC_ARB_REG_ADDR465_ADDR A:0xc441044
y.create.l HWIO_PMIC_ARB_REG_ADDR466_ADDR A:0xc441048
y.create.l HWIO_PMIC_ARB_REG_ADDR467_ADDR A:0xc44104c
y.create.l HWIO_PMIC_ARB_REG_ADDR468_ADDR A:0xc441050
y.create.l HWIO_PMIC_ARB_REG_ADDR469_ADDR A:0xc441054
y.create.l HWIO_PMIC_ARB_REG_ADDR470_ADDR A:0xc441058
y.create.l HWIO_PMIC_ARB_REG_ADDR471_ADDR A:0xc44105c
y.create.l HWIO_PMIC_ARB_REG_ADDR472_ADDR A:0xc441060
y.create.l HWIO_PMIC_ARB_REG_ADDR473_ADDR A:0xc441064
y.create.l HWIO_PMIC_ARB_REG_ADDR474_ADDR A:0xc441068
y.create.l HWIO_PMIC_ARB_REG_ADDR475_ADDR A:0xc44106c
y.create.l HWIO_PMIC_ARB_REG_ADDR476_ADDR A:0xc441070
y.create.l HWIO_PMIC_ARB_REG_ADDR477_ADDR A:0xc441074
y.create.l HWIO_PMIC_ARB_REG_ADDR478_ADDR A:0xc441078
y.create.l HWIO_PMIC_ARB_REG_ADDR479_ADDR A:0xc44107c
y.create.l HWIO_PMIC_ARB_REG_ADDR480_ADDR A:0xc441080
y.create.l HWIO_PMIC_ARB_REG_ADDR481_ADDR A:0xc441084
y.create.l HWIO_PMIC_ARB_REG_ADDR482_ADDR A:0xc441088
y.create.l HWIO_PMIC_ARB_REG_ADDR483_ADDR A:0xc44108c
y.create.l HWIO_PMIC_ARB_REG_ADDR484_ADDR A:0xc441090
y.create.l HWIO_PMIC_ARB_REG_ADDR485_ADDR A:0xc441094
y.create.l HWIO_PMIC_ARB_REG_ADDR486_ADDR A:0xc441098
y.create.l HWIO_PMIC_ARB_REG_ADDR487_ADDR A:0xc44109c
y.create.l HWIO_PMIC_ARB_REG_ADDR488_ADDR A:0xc4410a0
y.create.l HWIO_PMIC_ARB_REG_ADDR489_ADDR A:0xc4410a4
y.create.l HWIO_PMIC_ARB_REG_ADDR490_ADDR A:0xc4410a8
y.create.l HWIO_PMIC_ARB_REG_ADDR491_ADDR A:0xc4410ac
y.create.l HWIO_PMIC_ARB_REG_ADDR492_ADDR A:0xc4410b0
y.create.l HWIO_PMIC_ARB_REG_ADDR493_ADDR A:0xc4410b4
y.create.l HWIO_PMIC_ARB_REG_ADDR494_ADDR A:0xc4410b8
y.create.l HWIO_PMIC_ARB_REG_ADDR495_ADDR A:0xc4410bc
y.create.l HWIO_PMIC_ARB_REG_ADDR496_ADDR A:0xc4410c0
y.create.l HWIO_PMIC_ARB_REG_ADDR497_ADDR A:0xc4410c4
y.create.l HWIO_PMIC_ARB_REG_ADDR498_ADDR A:0xc4410c8
y.create.l HWIO_PMIC_ARB_REG_ADDR499_ADDR A:0xc4410cc
y.create.l HWIO_PMIC_ARB_REG_ADDR500_ADDR A:0xc4410d0
y.create.l HWIO_PMIC_ARB_REG_ADDR501_ADDR A:0xc4410d4
y.create.l HWIO_PMIC_ARB_REG_ADDR502_ADDR A:0xc4410d8
y.create.l HWIO_PMIC_ARB_REG_ADDR503_ADDR A:0xc4410dc
y.create.l HWIO_PMIC_ARB_REG_ADDR504_ADDR A:0xc4410e0
y.create.l HWIO_PMIC_ARB_REG_ADDR505_ADDR A:0xc4410e4
y.create.l HWIO_PMIC_ARB_REG_ADDR506_ADDR A:0xc4410e8
y.create.l HWIO_PMIC_ARB_REG_ADDR507_ADDR A:0xc4410ec
y.create.l HWIO_PMIC_ARB_REG_ADDR508_ADDR A:0xc4410f0
y.create.l HWIO_PMIC_ARB_REG_ADDR509_ADDR A:0xc4410f4
y.create.l HWIO_PMIC_ARB_REG_ADDR510_ADDR A:0xc4410f8
y.create.l HWIO_PMIC_ARB_REG_ADDR511_ADDR A:0xc4410fc
y.create.l HWIO_PMIC_ARB_VRM_S_INTF_CTL_ADDR A:0xc442200
y.create.l HWIO_PMIC_ARB_VRM_S_INTF_STATUS_ADDR A:0xc442204
y.create.l HWIO_PMIC_ARB_VRM_S_PORT_CTL_ADDR A:0xc442208
y.create.l HWIO_PMIC_ARB_VRM_S_PORT_STATUS_ADDR A:0xc44220c
y.create.l HWIO_PMIC_ARB_VRM_S_ADDR0_ADDR A:0xc442300
y.create.l HWIO_PMIC_ARB_VRM_S_ADDR1_ADDR A:0xc442304
y.create.l HWIO_PMIC_ARB_VRM_S_ADDR2_ADDR A:0xc442308
y.create.l HWIO_PMIC_ARB_VRM_S_ADDR3_ADDR A:0xc44230c
y.create.l HWIO_PMIC_ARB_VRM_S_ADDR4_ADDR A:0xc442310
y.create.l HWIO_PMIC_ARB_VRM_S_ADDR5_ADDR A:0xc442314
y.create.l HWIO_PMIC_ARB_VRM_S_ADDR6_ADDR A:0xc442318
y.create.l HWIO_PMIC_ARB_VRM_S_ADDR7_ADDR A:0xc44231c
y.create.l HWIO_PMIC_ARB_VRM_S_ADDR8_ADDR A:0xc442320
y.create.l HWIO_PMIC_ARB_VRM_S_ADDR9_ADDR A:0xc442324
y.create.l HWIO_PMIC_ARB_VRM_S_ADDR10_ADDR A:0xc442328
y.create.l HWIO_PMIC_ARB_VRM_S_ADDR11_ADDR A:0xc44232c
y.create.l HWIO_PMIC_ARB_VRM_S_ADDR12_ADDR A:0xc442330
y.create.l HWIO_PMIC_ARB_VRM_S_ADDR13_ADDR A:0xc442334
y.create.l HWIO_PMIC_ARB_VRM_S_ADDR14_ADDR A:0xc442338
y.create.l HWIO_PMIC_ARB_VRM_S_ADDR15_ADDR A:0xc44233c
y.create.l HWIO_PMIC_ARB_VRM_S_ADDR16_ADDR A:0xc442340
y.create.l HWIO_PMIC_ARB_VRM_S_ADDR17_ADDR A:0xc442344
y.create.l HWIO_PMIC_ARB_VRM_S_ADDR18_ADDR A:0xc442348
y.create.l HWIO_PMIC_ARB_VRM_S_ADDR19_ADDR A:0xc44234c
y.create.l HWIO_PMIC_ARB_VRM_S_ADDR20_ADDR A:0xc442350
y.create.l HWIO_PMIC_ARB_VRM_S_ADDR21_ADDR A:0xc442354
y.create.l HWIO_PMIC_ARB_VRM_S_ADDR22_ADDR A:0xc442358
y.create.l HWIO_PMIC_ARB_VRM_S_ADDR23_ADDR A:0xc44235c
y.create.l HWIO_PMIC_ARB_VRM_S_ADDR24_ADDR A:0xc442360
y.create.l HWIO_PMIC_ARB_VRM_S_ADDR25_ADDR A:0xc442364
y.create.l HWIO_PMIC_ARB_VRM_S_ADDR26_ADDR A:0xc442368
y.create.l HWIO_PMIC_ARB_VRM_S_ADDR27_ADDR A:0xc44236c
y.create.l HWIO_PMIC_ARB_VRM_S_ADDR28_ADDR A:0xc442370
y.create.l HWIO_PMIC_ARB_VRM_S_ADDR29_ADDR A:0xc442374
y.create.l HWIO_PMIC_ARB_VRM_S_ADDR30_ADDR A:0xc442378
y.create.l HWIO_PMIC_ARB_VRM_S_ADDR31_ADDR A:0xc44237c
y.create.l HWIO_PMIC_ARB_VRM_S_ADDR32_ADDR A:0xc442380
y.create.l HWIO_PMIC_ARB_VRM_S_ADDR33_ADDR A:0xc442384
y.create.l HWIO_PMIC_ARB_VRM_S_ADDR34_ADDR A:0xc442388
y.create.l HWIO_PMIC_ARB_VRM_S_ADDR35_ADDR A:0xc44238c
y.create.l HWIO_PMIC_ARB_VRM_S_ADDR36_ADDR A:0xc442390
y.create.l HWIO_PMIC_ARB_VRM_S_ADDR37_ADDR A:0xc442394
y.create.l HWIO_PMIC_ARB_VRM_S_ADDR38_ADDR A:0xc442398
y.create.l HWIO_PMIC_ARB_VRM_S_ADDR39_ADDR A:0xc44239c
y.create.l HWIO_PMIC_ARB_VRM_S_ADDR40_ADDR A:0xc4423a0
y.create.l HWIO_PMIC_ARB_VRM_S_ADDR41_ADDR A:0xc4423a4
y.create.l HWIO_PMIC_ARB_VRM_S_ADDR42_ADDR A:0xc4423a8
y.create.l HWIO_PMIC_ARB_VRM_S_ADDR43_ADDR A:0xc4423ac
y.create.l HWIO_PMIC_ARB_VRM_S_ADDR44_ADDR A:0xc4423b0
y.create.l HWIO_PMIC_ARB_VRM_S_ADDR45_ADDR A:0xc4423b4
y.create.l HWIO_PMIC_ARB_VRM_S_ADDR46_ADDR A:0xc4423b8
y.create.l HWIO_PMIC_ARB_VRM_S_ADDR47_ADDR A:0xc4423bc
y.create.l HWIO_PMIC_ARB_VRM_S_ADDR48_ADDR A:0xc4423c0
y.create.l HWIO_PMIC_ARB_VRM_S_ADDR49_ADDR A:0xc4423c4
y.create.l HWIO_PMIC_ARB_VRM_S_ADDR50_ADDR A:0xc4423c8
y.create.l HWIO_PMIC_ARB_VRM_S_ADDR51_ADDR A:0xc4423cc
y.create.l HWIO_PMIC_ARB_VRM_S_ADDR52_ADDR A:0xc4423d0
y.create.l HWIO_PMIC_ARB_VRM_S_ADDR53_ADDR A:0xc4423d4
y.create.l HWIO_PMIC_ARB_VRM_S_ADDR54_ADDR A:0xc4423d8
y.create.l HWIO_PMIC_ARB_VRM_S_ADDR55_ADDR A:0xc4423dc
y.create.l HWIO_PMIC_ARB_VRM_S_ADDR56_ADDR A:0xc4423e0
y.create.l HWIO_PMIC_ARB_VRM_S_ADDR57_ADDR A:0xc4423e4
y.create.l HWIO_PMIC_ARB_VRM_S_ADDR58_ADDR A:0xc4423e8
y.create.l HWIO_PMIC_ARB_VRM_S_ADDR59_ADDR A:0xc4423ec
y.create.l HWIO_PMIC_ARB_VRM_S_ADDR60_ADDR A:0xc4423f0
y.create.l HWIO_PMIC_ARB_VRM_S_ADDR61_ADDR A:0xc4423f4
y.create.l HWIO_PMIC_ARB_VRM_S_ADDR62_ADDR A:0xc4423f8
y.create.l HWIO_PMIC_ARB_VRM_S_ADDR63_ADDR A:0xc4423fc
y.create.l HWIO_PMIC_ARB_VRM_S_ADDR64_ADDR A:0xc442400
y.create.l HWIO_PMIC_ARB_VRM_S_ADDR65_ADDR A:0xc442404
y.create.l HWIO_PMIC_ARB_VRM_S_ADDR66_ADDR A:0xc442408
y.create.l HWIO_PMIC_ARB_VRM_S_ADDR67_ADDR A:0xc44240c
y.create.l HWIO_PMIC_ARB_VRM_S_ADDR68_ADDR A:0xc442410
y.create.l HWIO_PMIC_ARB_VRM_S_ADDR69_ADDR A:0xc442414
y.create.l HWIO_PMIC_ARB_VRM_S_ADDR70_ADDR A:0xc442418
y.create.l HWIO_PMIC_ARB_VRM_S_ADDR71_ADDR A:0xc44241c
y.create.l HWIO_PMIC_ARB_VRM_S_ADDR72_ADDR A:0xc442420
y.create.l HWIO_PMIC_ARB_VRM_S_ADDR73_ADDR A:0xc442424
y.create.l HWIO_PMIC_ARB_VRM_S_ADDR74_ADDR A:0xc442428
y.create.l HWIO_PMIC_ARB_VRM_S_ADDR75_ADDR A:0xc44242c
y.create.l HWIO_PMIC_ARB_VRM_S_ADDR76_ADDR A:0xc442430
y.create.l HWIO_PMIC_ARB_VRM_S_ADDR77_ADDR A:0xc442434
y.create.l HWIO_PMIC_ARB_VRM_S_ADDR78_ADDR A:0xc442438
y.create.l HWIO_PMIC_ARB_VRM_S_ADDR79_ADDR A:0xc44243c
y.create.l HWIO_PMIC_ARB_VRM_S_ADDR80_ADDR A:0xc442440
y.create.l HWIO_PMIC_ARB_VRM_S_ADDR81_ADDR A:0xc442444
y.create.l HWIO_PMIC_ARB_VRM_S_ADDR82_ADDR A:0xc442448
y.create.l HWIO_PMIC_ARB_VRM_S_ADDR83_ADDR A:0xc44244c
y.create.l HWIO_PMIC_ARB_VRM_S_ADDR84_ADDR A:0xc442450
y.create.l HWIO_PMIC_ARB_VRM_S_ADDR85_ADDR A:0xc442454
y.create.l HWIO_PMIC_ARB_VRM_S_ADDR86_ADDR A:0xc442458
y.create.l HWIO_PMIC_ARB_VRM_S_ADDR87_ADDR A:0xc44245c
y.create.l HWIO_PMIC_ARB_VRM_S_ADDR88_ADDR A:0xc442460
y.create.l HWIO_PMIC_ARB_VRM_S_ADDR89_ADDR A:0xc442464
y.create.l HWIO_PMIC_ARB_VRM_S_ADDR90_ADDR A:0xc442468
y.create.l HWIO_PMIC_ARB_VRM_S_ADDR91_ADDR A:0xc44246c
y.create.l HWIO_PMIC_ARB_VRM_S_ADDR92_ADDR A:0xc442470
y.create.l HWIO_PMIC_ARB_VRM_S_ADDR93_ADDR A:0xc442474
y.create.l HWIO_PMIC_ARB_VRM_S_ADDR94_ADDR A:0xc442478
y.create.l HWIO_PMIC_ARB_VRM_S_ADDR95_ADDR A:0xc44247c
y.create.l HWIO_PMIC_ARB_VRM_S_ADDR96_ADDR A:0xc442480
y.create.l HWIO_PMIC_ARB_VRM_S_ADDR97_ADDR A:0xc442484
y.create.l HWIO_PMIC_ARB_VRM_S_ADDR98_ADDR A:0xc442488
y.create.l HWIO_PMIC_ARB_VRM_S_ADDR99_ADDR A:0xc44248c
y.create.l HWIO_PMIC_ARB_VRM_S_ADDR100_ADDR A:0xc442490
y.create.l HWIO_PMIC_ARB_VRM_S_ADDR101_ADDR A:0xc442494
y.create.l HWIO_PMIC_ARB_VRM_S_ADDR102_ADDR A:0xc442498
y.create.l HWIO_PMIC_ARB_VRM_S_ADDR103_ADDR A:0xc44249c
y.create.l HWIO_PMIC_ARB_VRM_S_ADDR104_ADDR A:0xc4424a0
y.create.l HWIO_PMIC_ARB_VRM_S_ADDR105_ADDR A:0xc4424a4
y.create.l HWIO_PMIC_ARB_VRM_S_ADDR106_ADDR A:0xc4424a8
y.create.l HWIO_PMIC_ARB_VRM_S_ADDR107_ADDR A:0xc4424ac
y.create.l HWIO_PMIC_ARB_VRM_S_ADDR108_ADDR A:0xc4424b0
y.create.l HWIO_PMIC_ARB_VRM_S_ADDR109_ADDR A:0xc4424b4
y.create.l HWIO_PMIC_ARB_VRM_S_ADDR110_ADDR A:0xc4424b8
y.create.l HWIO_PMIC_ARB_VRM_S_ADDR111_ADDR A:0xc4424bc
y.create.l HWIO_PMIC_ARB_VRM_S_ADDR112_ADDR A:0xc4424c0
y.create.l HWIO_PMIC_ARB_VRM_S_ADDR113_ADDR A:0xc4424c4
y.create.l HWIO_PMIC_ARB_VRM_S_ADDR114_ADDR A:0xc4424c8
y.create.l HWIO_PMIC_ARB_VRM_S_ADDR115_ADDR A:0xc4424cc
y.create.l HWIO_PMIC_ARB_VRM_S_ADDR116_ADDR A:0xc4424d0
y.create.l HWIO_PMIC_ARB_VRM_S_ADDR117_ADDR A:0xc4424d4
y.create.l HWIO_PMIC_ARB_VRM_S_ADDR118_ADDR A:0xc4424d8
y.create.l HWIO_PMIC_ARB_VRM_S_ADDR119_ADDR A:0xc4424dc
y.create.l HWIO_PMIC_ARB_VRM_S_ADDR120_ADDR A:0xc4424e0
y.create.l HWIO_PMIC_ARB_VRM_S_ADDR121_ADDR A:0xc4424e4
y.create.l HWIO_PMIC_ARB_VRM_S_ADDR122_ADDR A:0xc4424e8
y.create.l HWIO_PMIC_ARB_VRM_S_ADDR123_ADDR A:0xc4424ec
y.create.l HWIO_PMIC_ARB_VRM_S_ADDR124_ADDR A:0xc4424f0
y.create.l HWIO_PMIC_ARB_VRM_S_ADDR125_ADDR A:0xc4424f4
y.create.l HWIO_PMIC_ARB_VRM_S_ADDR126_ADDR A:0xc4424f8
y.create.l HWIO_PMIC_ARB_VRM_S_ADDR127_ADDR A:0xc4424fc
y.create.l HWIO_PMIC_ARB_VRM_S_ADDR128_ADDR A:0xc442500
y.create.l HWIO_PMIC_ARB_VRM_S_ADDR129_ADDR A:0xc442504
y.create.l HWIO_PMIC_ARB_VRM_S_ADDR130_ADDR A:0xc442508
y.create.l HWIO_PMIC_ARB_VRM_S_ADDR131_ADDR A:0xc44250c
y.create.l HWIO_PMIC_ARB_VRM_S_ADDR132_ADDR A:0xc442510
y.create.l HWIO_PMIC_ARB_VRM_S_ADDR133_ADDR A:0xc442514
y.create.l HWIO_PMIC_ARB_VRM_S_ADDR134_ADDR A:0xc442518
y.create.l HWIO_PMIC_ARB_VRM_S_ADDR135_ADDR A:0xc44251c
y.create.l HWIO_PMIC_ARB_VRM_S_ADDR136_ADDR A:0xc442520
y.create.l HWIO_PMIC_ARB_VRM_S_ADDR137_ADDR A:0xc442524
y.create.l HWIO_PMIC_ARB_VRM_S_ADDR138_ADDR A:0xc442528
y.create.l HWIO_PMIC_ARB_VRM_S_ADDR139_ADDR A:0xc44252c
y.create.l HWIO_PMIC_ARB_VRM_S_ADDR140_ADDR A:0xc442530
y.create.l HWIO_PMIC_ARB_VRM_S_ADDR141_ADDR A:0xc442534
y.create.l HWIO_PMIC_ARB_VRM_S_ADDR142_ADDR A:0xc442538
y.create.l HWIO_PMIC_ARB_VRM_S_ADDR143_ADDR A:0xc44253c
y.create.l HWIO_PMIC_ARB_VRM_S_ADDR144_ADDR A:0xc442540
y.create.l HWIO_PMIC_ARB_VRM_S_ADDR145_ADDR A:0xc442544
y.create.l HWIO_PMIC_ARB_VRM_S_ADDR146_ADDR A:0xc442548
y.create.l HWIO_PMIC_ARB_VRM_S_ADDR147_ADDR A:0xc44254c
y.create.l HWIO_PMIC_ARB_VRM_S_ADDR148_ADDR A:0xc442550
y.create.l HWIO_PMIC_ARB_VRM_S_ADDR149_ADDR A:0xc442554
y.create.l HWIO_PMIC_ARB_VRM_S_ADDR150_ADDR A:0xc442558
y.create.l HWIO_PMIC_ARB_VRM_S_ADDR151_ADDR A:0xc44255c
y.create.l HWIO_PMIC_ARB_VRM_S_ADDR152_ADDR A:0xc442560
y.create.l HWIO_PMIC_ARB_VRM_S_ADDR153_ADDR A:0xc442564
y.create.l HWIO_PMIC_ARB_VRM_S_ADDR154_ADDR A:0xc442568
y.create.l HWIO_PMIC_ARB_VRM_S_ADDR155_ADDR A:0xc44256c
y.create.l HWIO_PMIC_ARB_VRM_S_ADDR156_ADDR A:0xc442570
y.create.l HWIO_PMIC_ARB_VRM_S_ADDR157_ADDR A:0xc442574
y.create.l HWIO_PMIC_ARB_VRM_S_ADDR158_ADDR A:0xc442578
y.create.l HWIO_PMIC_ARB_VRM_S_ADDR159_ADDR A:0xc44257c
y.create.l HWIO_PMIC_ARB_VRM_S_ADDR160_ADDR A:0xc442580
y.create.l HWIO_PMIC_ARB_VRM_S_ADDR161_ADDR A:0xc442584
y.create.l HWIO_PMIC_ARB_VRM_S_ADDR162_ADDR A:0xc442588
y.create.l HWIO_PMIC_ARB_VRM_S_ADDR163_ADDR A:0xc44258c
y.create.l HWIO_PMIC_ARB_VRM_S_ADDR164_ADDR A:0xc442590
y.create.l HWIO_PMIC_ARB_VRM_S_ADDR165_ADDR A:0xc442594
y.create.l HWIO_PMIC_ARB_VRM_S_ADDR166_ADDR A:0xc442598
y.create.l HWIO_PMIC_ARB_VRM_S_ADDR167_ADDR A:0xc44259c
y.create.l HWIO_PMIC_ARB_VRM_S_ADDR168_ADDR A:0xc4425a0
y.create.l HWIO_PMIC_ARB_VRM_S_ADDR169_ADDR A:0xc4425a4
y.create.l HWIO_PMIC_ARB_VRM_S_ADDR170_ADDR A:0xc4425a8
y.create.l HWIO_PMIC_ARB_VRM_S_ADDR171_ADDR A:0xc4425ac
y.create.l HWIO_PMIC_ARB_VRM_S_ADDR172_ADDR A:0xc4425b0
y.create.l HWIO_PMIC_ARB_VRM_S_ADDR173_ADDR A:0xc4425b4
y.create.l HWIO_PMIC_ARB_VRM_S_ADDR174_ADDR A:0xc4425b8
y.create.l HWIO_PMIC_ARB_VRM_S_ADDR175_ADDR A:0xc4425bc
y.create.l HWIO_PMIC_ARB_VRM_S_ADDR176_ADDR A:0xc4425c0
y.create.l HWIO_PMIC_ARB_VRM_S_ADDR177_ADDR A:0xc4425c4
y.create.l HWIO_PMIC_ARB_VRM_S_ADDR178_ADDR A:0xc4425c8
y.create.l HWIO_PMIC_ARB_VRM_S_ADDR179_ADDR A:0xc4425cc
y.create.l HWIO_PMIC_ARB_VRM_S_ADDR180_ADDR A:0xc4425d0
y.create.l HWIO_PMIC_ARB_VRM_S_ADDR181_ADDR A:0xc4425d4
y.create.l HWIO_PMIC_ARB_VRM_S_ADDR182_ADDR A:0xc4425d8
y.create.l HWIO_PMIC_ARB_VRM_S_ADDR183_ADDR A:0xc4425dc
y.create.l HWIO_PMIC_ARB_VRM_S_ADDR184_ADDR A:0xc4425e0
y.create.l HWIO_PMIC_ARB_VRM_S_ADDR185_ADDR A:0xc4425e4
y.create.l HWIO_PMIC_ARB_VRM_S_ADDR186_ADDR A:0xc4425e8
y.create.l HWIO_PMIC_ARB_VRM_S_ADDR187_ADDR A:0xc4425ec
y.create.l HWIO_PMIC_ARB_VRM_S_ADDR188_ADDR A:0xc4425f0
y.create.l HWIO_PMIC_ARB_VRM_S_ADDR189_ADDR A:0xc4425f4
y.create.l HWIO_PMIC_ARB_VRM_S_ADDR190_ADDR A:0xc4425f8
y.create.l HWIO_PMIC_ARB_VRM_S_ADDR191_ADDR A:0xc4425fc
y.create.l HWIO_PMIC_ARB_VRM_S_ADDR192_ADDR A:0xc442600
y.create.l HWIO_PMIC_ARB_VRM_S_ADDR193_ADDR A:0xc442604
y.create.l HWIO_PMIC_ARB_VRM_S_ADDR194_ADDR A:0xc442608
y.create.l HWIO_PMIC_ARB_VRM_S_ADDR195_ADDR A:0xc44260c
y.create.l HWIO_PMIC_ARB_VRM_S_ADDR196_ADDR A:0xc442610
y.create.l HWIO_PMIC_ARB_VRM_S_ADDR197_ADDR A:0xc442614
y.create.l HWIO_PMIC_ARB_VRM_S_ADDR198_ADDR A:0xc442618
y.create.l HWIO_PMIC_ARB_VRM_S_ADDR199_ADDR A:0xc44261c
y.create.l HWIO_PMIC_ARB_VRM_S_ADDR200_ADDR A:0xc442620
y.create.l HWIO_PMIC_ARB_VRM_S_ADDR201_ADDR A:0xc442624
y.create.l HWIO_PMIC_ARB_VRM_S_ADDR202_ADDR A:0xc442628
y.create.l HWIO_PMIC_ARB_VRM_S_ADDR203_ADDR A:0xc44262c
y.create.l HWIO_PMIC_ARB_VRM_S_ADDR204_ADDR A:0xc442630
y.create.l HWIO_PMIC_ARB_VRM_S_ADDR205_ADDR A:0xc442634
y.create.l HWIO_PMIC_ARB_VRM_S_ADDR206_ADDR A:0xc442638
y.create.l HWIO_PMIC_ARB_VRM_S_ADDR207_ADDR A:0xc44263c
y.create.l HWIO_PMIC_ARB_VRM_S_ADDR208_ADDR A:0xc442640
y.create.l HWIO_PMIC_ARB_VRM_S_ADDR209_ADDR A:0xc442644
y.create.l HWIO_PMIC_ARB_VRM_S_ADDR210_ADDR A:0xc442648
y.create.l HWIO_PMIC_ARB_VRM_S_ADDR211_ADDR A:0xc44264c
y.create.l HWIO_PMIC_ARB_VRM_S_ADDR212_ADDR A:0xc442650
y.create.l HWIO_PMIC_ARB_VRM_S_ADDR213_ADDR A:0xc442654
y.create.l HWIO_PMIC_ARB_VRM_S_ADDR214_ADDR A:0xc442658
y.create.l HWIO_PMIC_ARB_VRM_S_ADDR215_ADDR A:0xc44265c
y.create.l HWIO_PMIC_ARB_VRM_S_ADDR216_ADDR A:0xc442660
y.create.l HWIO_PMIC_ARB_VRM_S_ADDR217_ADDR A:0xc442664
y.create.l HWIO_PMIC_ARB_VRM_S_ADDR218_ADDR A:0xc442668
y.create.l HWIO_PMIC_ARB_VRM_S_ADDR219_ADDR A:0xc44266c
y.create.l HWIO_PMIC_ARB_VRM_S_ADDR220_ADDR A:0xc442670
y.create.l HWIO_PMIC_ARB_VRM_S_ADDR221_ADDR A:0xc442674
y.create.l HWIO_PMIC_ARB_VRM_S_ADDR222_ADDR A:0xc442678
y.create.l HWIO_PMIC_ARB_VRM_S_ADDR223_ADDR A:0xc44267c
y.create.l HWIO_PMIC_ARB_VRM_S_ADDR224_ADDR A:0xc442680
y.create.l HWIO_PMIC_ARB_VRM_S_ADDR225_ADDR A:0xc442684
y.create.l HWIO_PMIC_ARB_VRM_S_ADDR226_ADDR A:0xc442688
y.create.l HWIO_PMIC_ARB_VRM_S_ADDR227_ADDR A:0xc44268c
y.create.l HWIO_PMIC_ARB_VRM_S_ADDR228_ADDR A:0xc442690
y.create.l HWIO_PMIC_ARB_VRM_S_ADDR229_ADDR A:0xc442694
y.create.l HWIO_PMIC_ARB_VRM_S_ADDR230_ADDR A:0xc442698
y.create.l HWIO_PMIC_ARB_VRM_S_ADDR231_ADDR A:0xc44269c
y.create.l HWIO_PMIC_ARB_VRM_S_ADDR232_ADDR A:0xc4426a0
y.create.l HWIO_PMIC_ARB_VRM_S_ADDR233_ADDR A:0xc4426a4
y.create.l HWIO_PMIC_ARB_VRM_S_ADDR234_ADDR A:0xc4426a8
y.create.l HWIO_PMIC_ARB_VRM_S_ADDR235_ADDR A:0xc4426ac
y.create.l HWIO_PMIC_ARB_VRM_S_ADDR236_ADDR A:0xc4426b0
y.create.l HWIO_PMIC_ARB_VRM_S_ADDR237_ADDR A:0xc4426b4
y.create.l HWIO_PMIC_ARB_VRM_S_ADDR238_ADDR A:0xc4426b8
y.create.l HWIO_PMIC_ARB_VRM_S_ADDR239_ADDR A:0xc4426bc
y.create.l HWIO_PMIC_ARB_VRM_S_ADDR240_ADDR A:0xc4426c0
y.create.l HWIO_PMIC_ARB_VRM_S_ADDR241_ADDR A:0xc4426c4
y.create.l HWIO_PMIC_ARB_VRM_S_ADDR242_ADDR A:0xc4426c8
y.create.l HWIO_PMIC_ARB_VRM_S_ADDR243_ADDR A:0xc4426cc
y.create.l HWIO_PMIC_ARB_VRM_S_ADDR244_ADDR A:0xc4426d0
y.create.l HWIO_PMIC_ARB_VRM_S_ADDR245_ADDR A:0xc4426d4
y.create.l HWIO_PMIC_ARB_VRM_S_ADDR246_ADDR A:0xc4426d8
y.create.l HWIO_PMIC_ARB_VRM_S_ADDR247_ADDR A:0xc4426dc
y.create.l HWIO_PMIC_ARB_VRM_S_ADDR248_ADDR A:0xc4426e0
y.create.l HWIO_PMIC_ARB_VRM_S_ADDR249_ADDR A:0xc4426e4
y.create.l HWIO_PMIC_ARB_VRM_S_ADDR250_ADDR A:0xc4426e8
y.create.l HWIO_PMIC_ARB_VRM_S_ADDR251_ADDR A:0xc4426ec
y.create.l HWIO_PMIC_ARB_VRM_S_ADDR252_ADDR A:0xc4426f0
y.create.l HWIO_PMIC_ARB_VRM_S_ADDR253_ADDR A:0xc4426f4
y.create.l HWIO_PMIC_ARB_VRM_S_ADDR254_ADDR A:0xc4426f8
y.create.l HWIO_PMIC_ARB_VRM_S_ADDR255_ADDR A:0xc4426fc
y.create.l HWIO_PMIC_ARB_CHNL0_CMD_ADDR A:0xc600000
y.create.l HWIO_PMIC_ARB_CHNL1_CMD_ADDR A:0xc610000
y.create.l HWIO_PMIC_ARB_CHNL2_CMD_ADDR A:0xc620000
y.create.l HWIO_PMIC_ARB_CHNL3_CMD_ADDR A:0xc630000
y.create.l HWIO_PMIC_ARB_CHNL4_CMD_ADDR A:0xc640000
y.create.l HWIO_PMIC_ARB_CHNL5_CMD_ADDR A:0xc650000
y.create.l HWIO_PMIC_ARB_CHNL6_CMD_ADDR A:0xc660000
y.create.l HWIO_PMIC_ARB_CHNL7_CMD_ADDR A:0xc670000
y.create.l HWIO_PMIC_ARB_CHNL8_CMD_ADDR A:0xc680000
y.create.l HWIO_PMIC_ARB_CHNL9_CMD_ADDR A:0xc690000
y.create.l HWIO_PMIC_ARB_CHNL10_CMD_ADDR A:0xc6a0000
y.create.l HWIO_PMIC_ARB_CHNL11_CMD_ADDR A:0xc6b0000
y.create.l HWIO_PMIC_ARB_CHNL12_CMD_ADDR A:0xc6c0000
y.create.l HWIO_PMIC_ARB_CHNL13_CMD_ADDR A:0xc6d0000
y.create.l HWIO_PMIC_ARB_CHNL14_CMD_ADDR A:0xc6e0000
y.create.l HWIO_PMIC_ARB_CHNL15_CMD_ADDR A:0xc6f0000
y.create.l HWIO_PMIC_ARB_CHNL16_CMD_ADDR A:0xc700000
y.create.l HWIO_PMIC_ARB_CHNL17_CMD_ADDR A:0xc710000
y.create.l HWIO_PMIC_ARB_CHNL18_CMD_ADDR A:0xc720000
y.create.l HWIO_PMIC_ARB_CHNL19_CMD_ADDR A:0xc730000
y.create.l HWIO_PMIC_ARB_CHNL20_CMD_ADDR A:0xc740000
y.create.l HWIO_PMIC_ARB_CHNL21_CMD_ADDR A:0xc750000
y.create.l HWIO_PMIC_ARB_CHNL22_CMD_ADDR A:0xc760000
y.create.l HWIO_PMIC_ARB_CHNL23_CMD_ADDR A:0xc770000
y.create.l HWIO_PMIC_ARB_CHNL24_CMD_ADDR A:0xc780000
y.create.l HWIO_PMIC_ARB_CHNL25_CMD_ADDR A:0xc790000
y.create.l HWIO_PMIC_ARB_CHNL26_CMD_ADDR A:0xc7a0000
y.create.l HWIO_PMIC_ARB_CHNL27_CMD_ADDR A:0xc7b0000
y.create.l HWIO_PMIC_ARB_CHNL28_CMD_ADDR A:0xc7c0000
y.create.l HWIO_PMIC_ARB_CHNL29_CMD_ADDR A:0xc7d0000
y.create.l HWIO_PMIC_ARB_CHNL30_CMD_ADDR A:0xc7e0000
y.create.l HWIO_PMIC_ARB_CHNL31_CMD_ADDR A:0xc7f0000
y.create.l HWIO_PMIC_ARB_CHNL32_CMD_ADDR A:0xc800000
y.create.l HWIO_PMIC_ARB_CHNL33_CMD_ADDR A:0xc810000
y.create.l HWIO_PMIC_ARB_CHNL34_CMD_ADDR A:0xc820000
y.create.l HWIO_PMIC_ARB_CHNL35_CMD_ADDR A:0xc830000
y.create.l HWIO_PMIC_ARB_CHNL36_CMD_ADDR A:0xc840000
y.create.l HWIO_PMIC_ARB_CHNL37_CMD_ADDR A:0xc850000
y.create.l HWIO_PMIC_ARB_CHNL38_CMD_ADDR A:0xc860000
y.create.l HWIO_PMIC_ARB_CHNL39_CMD_ADDR A:0xc870000
y.create.l HWIO_PMIC_ARB_CHNL40_CMD_ADDR A:0xc880000
y.create.l HWIO_PMIC_ARB_CHNL41_CMD_ADDR A:0xc890000
y.create.l HWIO_PMIC_ARB_CHNL42_CMD_ADDR A:0xc8a0000
y.create.l HWIO_PMIC_ARB_CHNL43_CMD_ADDR A:0xc8b0000
y.create.l HWIO_PMIC_ARB_CHNL44_CMD_ADDR A:0xc8c0000
y.create.l HWIO_PMIC_ARB_CHNL45_CMD_ADDR A:0xc8d0000
y.create.l HWIO_PMIC_ARB_CHNL46_CMD_ADDR A:0xc8e0000
y.create.l HWIO_PMIC_ARB_CHNL47_CMD_ADDR A:0xc8f0000
y.create.l HWIO_PMIC_ARB_CHNL48_CMD_ADDR A:0xc900000
y.create.l HWIO_PMIC_ARB_CHNL49_CMD_ADDR A:0xc910000
y.create.l HWIO_PMIC_ARB_CHNL50_CMD_ADDR A:0xc920000
y.create.l HWIO_PMIC_ARB_CHNL51_CMD_ADDR A:0xc930000
y.create.l HWIO_PMIC_ARB_CHNL52_CMD_ADDR A:0xc940000
y.create.l HWIO_PMIC_ARB_CHNL53_CMD_ADDR A:0xc950000
y.create.l HWIO_PMIC_ARB_CHNL54_CMD_ADDR A:0xc960000
y.create.l HWIO_PMIC_ARB_CHNL55_CMD_ADDR A:0xc970000
y.create.l HWIO_PMIC_ARB_CHNL56_CMD_ADDR A:0xc980000
y.create.l HWIO_PMIC_ARB_CHNL57_CMD_ADDR A:0xc990000
y.create.l HWIO_PMIC_ARB_CHNL58_CMD_ADDR A:0xc9a0000
y.create.l HWIO_PMIC_ARB_CHNL59_CMD_ADDR A:0xc9b0000
y.create.l HWIO_PMIC_ARB_CHNL60_CMD_ADDR A:0xc9c0000
y.create.l HWIO_PMIC_ARB_CHNL61_CMD_ADDR A:0xc9d0000
y.create.l HWIO_PMIC_ARB_CHNL62_CMD_ADDR A:0xc9e0000
y.create.l HWIO_PMIC_ARB_CHNL63_CMD_ADDR A:0xc9f0000
y.create.l HWIO_PMIC_ARB_CHNL64_CMD_ADDR A:0xca00000
y.create.l HWIO_PMIC_ARB_CHNL65_CMD_ADDR A:0xca10000
y.create.l HWIO_PMIC_ARB_CHNL66_CMD_ADDR A:0xca20000
y.create.l HWIO_PMIC_ARB_CHNL67_CMD_ADDR A:0xca30000
y.create.l HWIO_PMIC_ARB_CHNL68_CMD_ADDR A:0xca40000
y.create.l HWIO_PMIC_ARB_CHNL69_CMD_ADDR A:0xca50000
y.create.l HWIO_PMIC_ARB_CHNL70_CMD_ADDR A:0xca60000
y.create.l HWIO_PMIC_ARB_CHNL71_CMD_ADDR A:0xca70000
y.create.l HWIO_PMIC_ARB_CHNL72_CMD_ADDR A:0xca80000
y.create.l HWIO_PMIC_ARB_CHNL73_CMD_ADDR A:0xca90000
y.create.l HWIO_PMIC_ARB_CHNL74_CMD_ADDR A:0xcaa0000
y.create.l HWIO_PMIC_ARB_CHNL75_CMD_ADDR A:0xcab0000
y.create.l HWIO_PMIC_ARB_CHNL76_CMD_ADDR A:0xcac0000
y.create.l HWIO_PMIC_ARB_CHNL77_CMD_ADDR A:0xcad0000
y.create.l HWIO_PMIC_ARB_CHNL78_CMD_ADDR A:0xcae0000
y.create.l HWIO_PMIC_ARB_CHNL79_CMD_ADDR A:0xcaf0000
y.create.l HWIO_PMIC_ARB_CHNL80_CMD_ADDR A:0xcb00000
y.create.l HWIO_PMIC_ARB_CHNL81_CMD_ADDR A:0xcb10000
y.create.l HWIO_PMIC_ARB_CHNL82_CMD_ADDR A:0xcb20000
y.create.l HWIO_PMIC_ARB_CHNL83_CMD_ADDR A:0xcb30000
y.create.l HWIO_PMIC_ARB_CHNL84_CMD_ADDR A:0xcb40000
y.create.l HWIO_PMIC_ARB_CHNL85_CMD_ADDR A:0xcb50000
y.create.l HWIO_PMIC_ARB_CHNL86_CMD_ADDR A:0xcb60000
y.create.l HWIO_PMIC_ARB_CHNL87_CMD_ADDR A:0xcb70000
y.create.l HWIO_PMIC_ARB_CHNL88_CMD_ADDR A:0xcb80000
y.create.l HWIO_PMIC_ARB_CHNL89_CMD_ADDR A:0xcb90000
y.create.l HWIO_PMIC_ARB_CHNL90_CMD_ADDR A:0xcba0000
y.create.l HWIO_PMIC_ARB_CHNL91_CMD_ADDR A:0xcbb0000
y.create.l HWIO_PMIC_ARB_CHNL92_CMD_ADDR A:0xcbc0000
y.create.l HWIO_PMIC_ARB_CHNL93_CMD_ADDR A:0xcbd0000
y.create.l HWIO_PMIC_ARB_CHNL94_CMD_ADDR A:0xcbe0000
y.create.l HWIO_PMIC_ARB_CHNL95_CMD_ADDR A:0xcbf0000
y.create.l HWIO_PMIC_ARB_CHNL96_CMD_ADDR A:0xcc00000
y.create.l HWIO_PMIC_ARB_CHNL97_CMD_ADDR A:0xcc10000
y.create.l HWIO_PMIC_ARB_CHNL98_CMD_ADDR A:0xcc20000
y.create.l HWIO_PMIC_ARB_CHNL99_CMD_ADDR A:0xcc30000
y.create.l HWIO_PMIC_ARB_CHNL100_CMD_ADDR A:0xcc40000
y.create.l HWIO_PMIC_ARB_CHNL101_CMD_ADDR A:0xcc50000
y.create.l HWIO_PMIC_ARB_CHNL102_CMD_ADDR A:0xcc60000
y.create.l HWIO_PMIC_ARB_CHNL103_CMD_ADDR A:0xcc70000
y.create.l HWIO_PMIC_ARB_CHNL104_CMD_ADDR A:0xcc80000
y.create.l HWIO_PMIC_ARB_CHNL105_CMD_ADDR A:0xcc90000
y.create.l HWIO_PMIC_ARB_CHNL106_CMD_ADDR A:0xcca0000
y.create.l HWIO_PMIC_ARB_CHNL107_CMD_ADDR A:0xccb0000
y.create.l HWIO_PMIC_ARB_CHNL108_CMD_ADDR A:0xccc0000
y.create.l HWIO_PMIC_ARB_CHNL109_CMD_ADDR A:0xccd0000
y.create.l HWIO_PMIC_ARB_CHNL110_CMD_ADDR A:0xcce0000
y.create.l HWIO_PMIC_ARB_CHNL111_CMD_ADDR A:0xccf0000
y.create.l HWIO_PMIC_ARB_CHNL112_CMD_ADDR A:0xcd00000
y.create.l HWIO_PMIC_ARB_CHNL113_CMD_ADDR A:0xcd10000
y.create.l HWIO_PMIC_ARB_CHNL114_CMD_ADDR A:0xcd20000
y.create.l HWIO_PMIC_ARB_CHNL115_CMD_ADDR A:0xcd30000
y.create.l HWIO_PMIC_ARB_CHNL116_CMD_ADDR A:0xcd40000
y.create.l HWIO_PMIC_ARB_CHNL117_CMD_ADDR A:0xcd50000
y.create.l HWIO_PMIC_ARB_CHNL118_CMD_ADDR A:0xcd60000
y.create.l HWIO_PMIC_ARB_CHNL119_CMD_ADDR A:0xcd70000
y.create.l HWIO_PMIC_ARB_CHNL120_CMD_ADDR A:0xcd80000
y.create.l HWIO_PMIC_ARB_CHNL121_CMD_ADDR A:0xcd90000
y.create.l HWIO_PMIC_ARB_CHNL122_CMD_ADDR A:0xcda0000
y.create.l HWIO_PMIC_ARB_CHNL123_CMD_ADDR A:0xcdb0000
y.create.l HWIO_PMIC_ARB_CHNL124_CMD_ADDR A:0xcdc0000
y.create.l HWIO_PMIC_ARB_CHNL125_CMD_ADDR A:0xcdd0000
y.create.l HWIO_PMIC_ARB_CHNL126_CMD_ADDR A:0xcde0000
y.create.l HWIO_PMIC_ARB_CHNL127_CMD_ADDR A:0xcdf0000
y.create.l HWIO_PMIC_ARB_CHNL128_CMD_ADDR A:0xce00000
y.create.l HWIO_PMIC_ARB_CHNL129_CMD_ADDR A:0xce10000
y.create.l HWIO_PMIC_ARB_CHNL130_CMD_ADDR A:0xce20000
y.create.l HWIO_PMIC_ARB_CHNL131_CMD_ADDR A:0xce30000
y.create.l HWIO_PMIC_ARB_CHNL132_CMD_ADDR A:0xce40000
y.create.l HWIO_PMIC_ARB_CHNL133_CMD_ADDR A:0xce50000
y.create.l HWIO_PMIC_ARB_CHNL134_CMD_ADDR A:0xce60000
y.create.l HWIO_PMIC_ARB_CHNL135_CMD_ADDR A:0xce70000
y.create.l HWIO_PMIC_ARB_CHNL136_CMD_ADDR A:0xce80000
y.create.l HWIO_PMIC_ARB_CHNL137_CMD_ADDR A:0xce90000
y.create.l HWIO_PMIC_ARB_CHNL138_CMD_ADDR A:0xcea0000
y.create.l HWIO_PMIC_ARB_CHNL139_CMD_ADDR A:0xceb0000
y.create.l HWIO_PMIC_ARB_CHNL140_CMD_ADDR A:0xcec0000
y.create.l HWIO_PMIC_ARB_CHNL141_CMD_ADDR A:0xced0000
y.create.l HWIO_PMIC_ARB_CHNL142_CMD_ADDR A:0xcee0000
y.create.l HWIO_PMIC_ARB_CHNL143_CMD_ADDR A:0xcef0000
y.create.l HWIO_PMIC_ARB_CHNL144_CMD_ADDR A:0xcf00000
y.create.l HWIO_PMIC_ARB_CHNL145_CMD_ADDR A:0xcf10000
y.create.l HWIO_PMIC_ARB_CHNL146_CMD_ADDR A:0xcf20000
y.create.l HWIO_PMIC_ARB_CHNL147_CMD_ADDR A:0xcf30000
y.create.l HWIO_PMIC_ARB_CHNL148_CMD_ADDR A:0xcf40000
y.create.l HWIO_PMIC_ARB_CHNL149_CMD_ADDR A:0xcf50000
y.create.l HWIO_PMIC_ARB_CHNL150_CMD_ADDR A:0xcf60000
y.create.l HWIO_PMIC_ARB_CHNL151_CMD_ADDR A:0xcf70000
y.create.l HWIO_PMIC_ARB_CHNL152_CMD_ADDR A:0xcf80000
y.create.l HWIO_PMIC_ARB_CHNL153_CMD_ADDR A:0xcf90000
y.create.l HWIO_PMIC_ARB_CHNL154_CMD_ADDR A:0xcfa0000
y.create.l HWIO_PMIC_ARB_CHNL155_CMD_ADDR A:0xcfb0000
y.create.l HWIO_PMIC_ARB_CHNL156_CMD_ADDR A:0xcfc0000
y.create.l HWIO_PMIC_ARB_CHNL157_CMD_ADDR A:0xcfd0000
y.create.l HWIO_PMIC_ARB_CHNL158_CMD_ADDR A:0xcfe0000
y.create.l HWIO_PMIC_ARB_CHNL159_CMD_ADDR A:0xcff0000
y.create.l HWIO_PMIC_ARB_CHNL160_CMD_ADDR A:0xd000000
y.create.l HWIO_PMIC_ARB_CHNL161_CMD_ADDR A:0xd010000
y.create.l HWIO_PMIC_ARB_CHNL162_CMD_ADDR A:0xd020000
y.create.l HWIO_PMIC_ARB_CHNL163_CMD_ADDR A:0xd030000
y.create.l HWIO_PMIC_ARB_CHNL164_CMD_ADDR A:0xd040000
y.create.l HWIO_PMIC_ARB_CHNL165_CMD_ADDR A:0xd050000
y.create.l HWIO_PMIC_ARB_CHNL166_CMD_ADDR A:0xd060000
y.create.l HWIO_PMIC_ARB_CHNL167_CMD_ADDR A:0xd070000
y.create.l HWIO_PMIC_ARB_CHNL168_CMD_ADDR A:0xd080000
y.create.l HWIO_PMIC_ARB_CHNL169_CMD_ADDR A:0xd090000
y.create.l HWIO_PMIC_ARB_CHNL170_CMD_ADDR A:0xd0a0000
y.create.l HWIO_PMIC_ARB_CHNL171_CMD_ADDR A:0xd0b0000
y.create.l HWIO_PMIC_ARB_CHNL172_CMD_ADDR A:0xd0c0000
y.create.l HWIO_PMIC_ARB_CHNL173_CMD_ADDR A:0xd0d0000
y.create.l HWIO_PMIC_ARB_CHNL174_CMD_ADDR A:0xd0e0000
y.create.l HWIO_PMIC_ARB_CHNL175_CMD_ADDR A:0xd0f0000
y.create.l HWIO_PMIC_ARB_CHNL176_CMD_ADDR A:0xd100000
y.create.l HWIO_PMIC_ARB_CHNL177_CMD_ADDR A:0xd110000
y.create.l HWIO_PMIC_ARB_CHNL178_CMD_ADDR A:0xd120000
y.create.l HWIO_PMIC_ARB_CHNL179_CMD_ADDR A:0xd130000
y.create.l HWIO_PMIC_ARB_CHNL180_CMD_ADDR A:0xd140000
y.create.l HWIO_PMIC_ARB_CHNL181_CMD_ADDR A:0xd150000
y.create.l HWIO_PMIC_ARB_CHNL182_CMD_ADDR A:0xd160000
y.create.l HWIO_PMIC_ARB_CHNL183_CMD_ADDR A:0xd170000
y.create.l HWIO_PMIC_ARB_CHNL184_CMD_ADDR A:0xd180000
y.create.l HWIO_PMIC_ARB_CHNL185_CMD_ADDR A:0xd190000
y.create.l HWIO_PMIC_ARB_CHNL186_CMD_ADDR A:0xd1a0000
y.create.l HWIO_PMIC_ARB_CHNL187_CMD_ADDR A:0xd1b0000
y.create.l HWIO_PMIC_ARB_CHNL188_CMD_ADDR A:0xd1c0000
y.create.l HWIO_PMIC_ARB_CHNL189_CMD_ADDR A:0xd1d0000
y.create.l HWIO_PMIC_ARB_CHNL190_CMD_ADDR A:0xd1e0000
y.create.l HWIO_PMIC_ARB_CHNL191_CMD_ADDR A:0xd1f0000
y.create.l HWIO_PMIC_ARB_CHNL192_CMD_ADDR A:0xd200000
y.create.l HWIO_PMIC_ARB_CHNL193_CMD_ADDR A:0xd210000
y.create.l HWIO_PMIC_ARB_CHNL194_CMD_ADDR A:0xd220000
y.create.l HWIO_PMIC_ARB_CHNL195_CMD_ADDR A:0xd230000
y.create.l HWIO_PMIC_ARB_CHNL196_CMD_ADDR A:0xd240000
y.create.l HWIO_PMIC_ARB_CHNL197_CMD_ADDR A:0xd250000
y.create.l HWIO_PMIC_ARB_CHNL198_CMD_ADDR A:0xd260000
y.create.l HWIO_PMIC_ARB_CHNL199_CMD_ADDR A:0xd270000
y.create.l HWIO_PMIC_ARB_CHNL200_CMD_ADDR A:0xd280000
y.create.l HWIO_PMIC_ARB_CHNL201_CMD_ADDR A:0xd290000
y.create.l HWIO_PMIC_ARB_CHNL202_CMD_ADDR A:0xd2a0000
y.create.l HWIO_PMIC_ARB_CHNL203_CMD_ADDR A:0xd2b0000
y.create.l HWIO_PMIC_ARB_CHNL204_CMD_ADDR A:0xd2c0000
y.create.l HWIO_PMIC_ARB_CHNL205_CMD_ADDR A:0xd2d0000
y.create.l HWIO_PMIC_ARB_CHNL206_CMD_ADDR A:0xd2e0000
y.create.l HWIO_PMIC_ARB_CHNL207_CMD_ADDR A:0xd2f0000
y.create.l HWIO_PMIC_ARB_CHNL208_CMD_ADDR A:0xd300000
y.create.l HWIO_PMIC_ARB_CHNL209_CMD_ADDR A:0xd310000
y.create.l HWIO_PMIC_ARB_CHNL210_CMD_ADDR A:0xd320000
y.create.l HWIO_PMIC_ARB_CHNL211_CMD_ADDR A:0xd330000
y.create.l HWIO_PMIC_ARB_CHNL212_CMD_ADDR A:0xd340000
y.create.l HWIO_PMIC_ARB_CHNL213_CMD_ADDR A:0xd350000
y.create.l HWIO_PMIC_ARB_CHNL214_CMD_ADDR A:0xd360000
y.create.l HWIO_PMIC_ARB_CHNL215_CMD_ADDR A:0xd370000
y.create.l HWIO_PMIC_ARB_CHNL216_CMD_ADDR A:0xd380000
y.create.l HWIO_PMIC_ARB_CHNL217_CMD_ADDR A:0xd390000
y.create.l HWIO_PMIC_ARB_CHNL218_CMD_ADDR A:0xd3a0000
y.create.l HWIO_PMIC_ARB_CHNL219_CMD_ADDR A:0xd3b0000
y.create.l HWIO_PMIC_ARB_CHNL220_CMD_ADDR A:0xd3c0000
y.create.l HWIO_PMIC_ARB_CHNL221_CMD_ADDR A:0xd3d0000
y.create.l HWIO_PMIC_ARB_CHNL222_CMD_ADDR A:0xd3e0000
y.create.l HWIO_PMIC_ARB_CHNL223_CMD_ADDR A:0xd3f0000
y.create.l HWIO_PMIC_ARB_CHNL224_CMD_ADDR A:0xd400000
y.create.l HWIO_PMIC_ARB_CHNL225_CMD_ADDR A:0xd410000
y.create.l HWIO_PMIC_ARB_CHNL226_CMD_ADDR A:0xd420000
y.create.l HWIO_PMIC_ARB_CHNL227_CMD_ADDR A:0xd430000
y.create.l HWIO_PMIC_ARB_CHNL228_CMD_ADDR A:0xd440000
y.create.l HWIO_PMIC_ARB_CHNL229_CMD_ADDR A:0xd450000
y.create.l HWIO_PMIC_ARB_CHNL230_CMD_ADDR A:0xd460000
y.create.l HWIO_PMIC_ARB_CHNL231_CMD_ADDR A:0xd470000
y.create.l HWIO_PMIC_ARB_CHNL232_CMD_ADDR A:0xd480000
y.create.l HWIO_PMIC_ARB_CHNL233_CMD_ADDR A:0xd490000
y.create.l HWIO_PMIC_ARB_CHNL234_CMD_ADDR A:0xd4a0000
y.create.l HWIO_PMIC_ARB_CHNL235_CMD_ADDR A:0xd4b0000
y.create.l HWIO_PMIC_ARB_CHNL236_CMD_ADDR A:0xd4c0000
y.create.l HWIO_PMIC_ARB_CHNL237_CMD_ADDR A:0xd4d0000
y.create.l HWIO_PMIC_ARB_CHNL238_CMD_ADDR A:0xd4e0000
y.create.l HWIO_PMIC_ARB_CHNL239_CMD_ADDR A:0xd4f0000
y.create.l HWIO_PMIC_ARB_CHNL240_CMD_ADDR A:0xd500000
y.create.l HWIO_PMIC_ARB_CHNL241_CMD_ADDR A:0xd510000
y.create.l HWIO_PMIC_ARB_CHNL242_CMD_ADDR A:0xd520000
y.create.l HWIO_PMIC_ARB_CHNL243_CMD_ADDR A:0xd530000
y.create.l HWIO_PMIC_ARB_CHNL244_CMD_ADDR A:0xd540000
y.create.l HWIO_PMIC_ARB_CHNL245_CMD_ADDR A:0xd550000
y.create.l HWIO_PMIC_ARB_CHNL246_CMD_ADDR A:0xd560000
y.create.l HWIO_PMIC_ARB_CHNL247_CMD_ADDR A:0xd570000
y.create.l HWIO_PMIC_ARB_CHNL248_CMD_ADDR A:0xd580000
y.create.l HWIO_PMIC_ARB_CHNL249_CMD_ADDR A:0xd590000
y.create.l HWIO_PMIC_ARB_CHNL250_CMD_ADDR A:0xd5a0000
y.create.l HWIO_PMIC_ARB_CHNL251_CMD_ADDR A:0xd5b0000
y.create.l HWIO_PMIC_ARB_CHNL252_CMD_ADDR A:0xd5c0000
y.create.l HWIO_PMIC_ARB_CHNL253_CMD_ADDR A:0xd5d0000
y.create.l HWIO_PMIC_ARB_CHNL254_CMD_ADDR A:0xd5e0000
y.create.l HWIO_PMIC_ARB_CHNL255_CMD_ADDR A:0xd5f0000
y.create.l HWIO_PMIC_ARB_CHNL256_CMD_ADDR A:0xd600000
y.create.l HWIO_PMIC_ARB_CHNL257_CMD_ADDR A:0xd610000
y.create.l HWIO_PMIC_ARB_CHNL258_CMD_ADDR A:0xd620000
y.create.l HWIO_PMIC_ARB_CHNL259_CMD_ADDR A:0xd630000
y.create.l HWIO_PMIC_ARB_CHNL260_CMD_ADDR A:0xd640000
y.create.l HWIO_PMIC_ARB_CHNL261_CMD_ADDR A:0xd650000
y.create.l HWIO_PMIC_ARB_CHNL262_CMD_ADDR A:0xd660000
y.create.l HWIO_PMIC_ARB_CHNL263_CMD_ADDR A:0xd670000
y.create.l HWIO_PMIC_ARB_CHNL264_CMD_ADDR A:0xd680000
y.create.l HWIO_PMIC_ARB_CHNL265_CMD_ADDR A:0xd690000
y.create.l HWIO_PMIC_ARB_CHNL266_CMD_ADDR A:0xd6a0000
y.create.l HWIO_PMIC_ARB_CHNL267_CMD_ADDR A:0xd6b0000
y.create.l HWIO_PMIC_ARB_CHNL268_CMD_ADDR A:0xd6c0000
y.create.l HWIO_PMIC_ARB_CHNL269_CMD_ADDR A:0xd6d0000
y.create.l HWIO_PMIC_ARB_CHNL270_CMD_ADDR A:0xd6e0000
y.create.l HWIO_PMIC_ARB_CHNL271_CMD_ADDR A:0xd6f0000
y.create.l HWIO_PMIC_ARB_CHNL272_CMD_ADDR A:0xd700000
y.create.l HWIO_PMIC_ARB_CHNL273_CMD_ADDR A:0xd710000
y.create.l HWIO_PMIC_ARB_CHNL274_CMD_ADDR A:0xd720000
y.create.l HWIO_PMIC_ARB_CHNL275_CMD_ADDR A:0xd730000
y.create.l HWIO_PMIC_ARB_CHNL276_CMD_ADDR A:0xd740000
y.create.l HWIO_PMIC_ARB_CHNL277_CMD_ADDR A:0xd750000
y.create.l HWIO_PMIC_ARB_CHNL278_CMD_ADDR A:0xd760000
y.create.l HWIO_PMIC_ARB_CHNL279_CMD_ADDR A:0xd770000
y.create.l HWIO_PMIC_ARB_CHNL280_CMD_ADDR A:0xd780000
y.create.l HWIO_PMIC_ARB_CHNL281_CMD_ADDR A:0xd790000
y.create.l HWIO_PMIC_ARB_CHNL282_CMD_ADDR A:0xd7a0000
y.create.l HWIO_PMIC_ARB_CHNL283_CMD_ADDR A:0xd7b0000
y.create.l HWIO_PMIC_ARB_CHNL284_CMD_ADDR A:0xd7c0000
y.create.l HWIO_PMIC_ARB_CHNL285_CMD_ADDR A:0xd7d0000
y.create.l HWIO_PMIC_ARB_CHNL286_CMD_ADDR A:0xd7e0000
y.create.l HWIO_PMIC_ARB_CHNL287_CMD_ADDR A:0xd7f0000
y.create.l HWIO_PMIC_ARB_CHNL288_CMD_ADDR A:0xd800000
y.create.l HWIO_PMIC_ARB_CHNL289_CMD_ADDR A:0xd810000
y.create.l HWIO_PMIC_ARB_CHNL290_CMD_ADDR A:0xd820000
y.create.l HWIO_PMIC_ARB_CHNL291_CMD_ADDR A:0xd830000
y.create.l HWIO_PMIC_ARB_CHNL292_CMD_ADDR A:0xd840000
y.create.l HWIO_PMIC_ARB_CHNL293_CMD_ADDR A:0xd850000
y.create.l HWIO_PMIC_ARB_CHNL294_CMD_ADDR A:0xd860000
y.create.l HWIO_PMIC_ARB_CHNL295_CMD_ADDR A:0xd870000
y.create.l HWIO_PMIC_ARB_CHNL296_CMD_ADDR A:0xd880000
y.create.l HWIO_PMIC_ARB_CHNL297_CMD_ADDR A:0xd890000
y.create.l HWIO_PMIC_ARB_CHNL298_CMD_ADDR A:0xd8a0000
y.create.l HWIO_PMIC_ARB_CHNL299_CMD_ADDR A:0xd8b0000
y.create.l HWIO_PMIC_ARB_CHNL300_CMD_ADDR A:0xd8c0000
y.create.l HWIO_PMIC_ARB_CHNL301_CMD_ADDR A:0xd8d0000
y.create.l HWIO_PMIC_ARB_CHNL302_CMD_ADDR A:0xd8e0000
y.create.l HWIO_PMIC_ARB_CHNL303_CMD_ADDR A:0xd8f0000
y.create.l HWIO_PMIC_ARB_CHNL304_CMD_ADDR A:0xd900000
y.create.l HWIO_PMIC_ARB_CHNL305_CMD_ADDR A:0xd910000
y.create.l HWIO_PMIC_ARB_CHNL306_CMD_ADDR A:0xd920000
y.create.l HWIO_PMIC_ARB_CHNL307_CMD_ADDR A:0xd930000
y.create.l HWIO_PMIC_ARB_CHNL308_CMD_ADDR A:0xd940000
y.create.l HWIO_PMIC_ARB_CHNL309_CMD_ADDR A:0xd950000
y.create.l HWIO_PMIC_ARB_CHNL310_CMD_ADDR A:0xd960000
y.create.l HWIO_PMIC_ARB_CHNL311_CMD_ADDR A:0xd970000
y.create.l HWIO_PMIC_ARB_CHNL312_CMD_ADDR A:0xd980000
y.create.l HWIO_PMIC_ARB_CHNL313_CMD_ADDR A:0xd990000
y.create.l HWIO_PMIC_ARB_CHNL314_CMD_ADDR A:0xd9a0000
y.create.l HWIO_PMIC_ARB_CHNL315_CMD_ADDR A:0xd9b0000
y.create.l HWIO_PMIC_ARB_CHNL316_CMD_ADDR A:0xd9c0000
y.create.l HWIO_PMIC_ARB_CHNL317_CMD_ADDR A:0xd9d0000
y.create.l HWIO_PMIC_ARB_CHNL318_CMD_ADDR A:0xd9e0000
y.create.l HWIO_PMIC_ARB_CHNL319_CMD_ADDR A:0xd9f0000
y.create.l HWIO_PMIC_ARB_CHNL320_CMD_ADDR A:0xda00000
y.create.l HWIO_PMIC_ARB_CHNL321_CMD_ADDR A:0xda10000
y.create.l HWIO_PMIC_ARB_CHNL322_CMD_ADDR A:0xda20000
y.create.l HWIO_PMIC_ARB_CHNL323_CMD_ADDR A:0xda30000
y.create.l HWIO_PMIC_ARB_CHNL324_CMD_ADDR A:0xda40000
y.create.l HWIO_PMIC_ARB_CHNL325_CMD_ADDR A:0xda50000
y.create.l HWIO_PMIC_ARB_CHNL326_CMD_ADDR A:0xda60000
y.create.l HWIO_PMIC_ARB_CHNL327_CMD_ADDR A:0xda70000
y.create.l HWIO_PMIC_ARB_CHNL328_CMD_ADDR A:0xda80000
y.create.l HWIO_PMIC_ARB_CHNL329_CMD_ADDR A:0xda90000
y.create.l HWIO_PMIC_ARB_CHNL330_CMD_ADDR A:0xdaa0000
y.create.l HWIO_PMIC_ARB_CHNL331_CMD_ADDR A:0xdab0000
y.create.l HWIO_PMIC_ARB_CHNL332_CMD_ADDR A:0xdac0000
y.create.l HWIO_PMIC_ARB_CHNL333_CMD_ADDR A:0xdad0000
y.create.l HWIO_PMIC_ARB_CHNL334_CMD_ADDR A:0xdae0000
y.create.l HWIO_PMIC_ARB_CHNL335_CMD_ADDR A:0xdaf0000
y.create.l HWIO_PMIC_ARB_CHNL336_CMD_ADDR A:0xdb00000
y.create.l HWIO_PMIC_ARB_CHNL337_CMD_ADDR A:0xdb10000
y.create.l HWIO_PMIC_ARB_CHNL338_CMD_ADDR A:0xdb20000
y.create.l HWIO_PMIC_ARB_CHNL339_CMD_ADDR A:0xdb30000
y.create.l HWIO_PMIC_ARB_CHNL340_CMD_ADDR A:0xdb40000
y.create.l HWIO_PMIC_ARB_CHNL341_CMD_ADDR A:0xdb50000
y.create.l HWIO_PMIC_ARB_CHNL342_CMD_ADDR A:0xdb60000
y.create.l HWIO_PMIC_ARB_CHNL343_CMD_ADDR A:0xdb70000
y.create.l HWIO_PMIC_ARB_CHNL344_CMD_ADDR A:0xdb80000
y.create.l HWIO_PMIC_ARB_CHNL345_CMD_ADDR A:0xdb90000
y.create.l HWIO_PMIC_ARB_CHNL346_CMD_ADDR A:0xdba0000
y.create.l HWIO_PMIC_ARB_CHNL347_CMD_ADDR A:0xdbb0000
y.create.l HWIO_PMIC_ARB_CHNL348_CMD_ADDR A:0xdbc0000
y.create.l HWIO_PMIC_ARB_CHNL349_CMD_ADDR A:0xdbd0000
y.create.l HWIO_PMIC_ARB_CHNL350_CMD_ADDR A:0xdbe0000
y.create.l HWIO_PMIC_ARB_CHNL351_CMD_ADDR A:0xdbf0000
y.create.l HWIO_PMIC_ARB_CHNL352_CMD_ADDR A:0xdc00000
y.create.l HWIO_PMIC_ARB_CHNL353_CMD_ADDR A:0xdc10000
y.create.l HWIO_PMIC_ARB_CHNL354_CMD_ADDR A:0xdc20000
y.create.l HWIO_PMIC_ARB_CHNL355_CMD_ADDR A:0xdc30000
y.create.l HWIO_PMIC_ARB_CHNL356_CMD_ADDR A:0xdc40000
y.create.l HWIO_PMIC_ARB_CHNL357_CMD_ADDR A:0xdc50000
y.create.l HWIO_PMIC_ARB_CHNL358_CMD_ADDR A:0xdc60000
y.create.l HWIO_PMIC_ARB_CHNL359_CMD_ADDR A:0xdc70000
y.create.l HWIO_PMIC_ARB_CHNL360_CMD_ADDR A:0xdc80000
y.create.l HWIO_PMIC_ARB_CHNL361_CMD_ADDR A:0xdc90000
y.create.l HWIO_PMIC_ARB_CHNL362_CMD_ADDR A:0xdca0000
y.create.l HWIO_PMIC_ARB_CHNL363_CMD_ADDR A:0xdcb0000
y.create.l HWIO_PMIC_ARB_CHNL364_CMD_ADDR A:0xdcc0000
y.create.l HWIO_PMIC_ARB_CHNL365_CMD_ADDR A:0xdcd0000
y.create.l HWIO_PMIC_ARB_CHNL366_CMD_ADDR A:0xdce0000
y.create.l HWIO_PMIC_ARB_CHNL367_CMD_ADDR A:0xdcf0000
y.create.l HWIO_PMIC_ARB_CHNL368_CMD_ADDR A:0xdd00000
y.create.l HWIO_PMIC_ARB_CHNL369_CMD_ADDR A:0xdd10000
y.create.l HWIO_PMIC_ARB_CHNL370_CMD_ADDR A:0xdd20000
y.create.l HWIO_PMIC_ARB_CHNL371_CMD_ADDR A:0xdd30000
y.create.l HWIO_PMIC_ARB_CHNL372_CMD_ADDR A:0xdd40000
y.create.l HWIO_PMIC_ARB_CHNL373_CMD_ADDR A:0xdd50000
y.create.l HWIO_PMIC_ARB_CHNL374_CMD_ADDR A:0xdd60000
y.create.l HWIO_PMIC_ARB_CHNL375_CMD_ADDR A:0xdd70000
y.create.l HWIO_PMIC_ARB_CHNL376_CMD_ADDR A:0xdd80000
y.create.l HWIO_PMIC_ARB_CHNL377_CMD_ADDR A:0xdd90000
y.create.l HWIO_PMIC_ARB_CHNL378_CMD_ADDR A:0xdda0000
y.create.l HWIO_PMIC_ARB_CHNL379_CMD_ADDR A:0xddb0000
y.create.l HWIO_PMIC_ARB_CHNL380_CMD_ADDR A:0xddc0000
y.create.l HWIO_PMIC_ARB_CHNL381_CMD_ADDR A:0xddd0000
y.create.l HWIO_PMIC_ARB_CHNL382_CMD_ADDR A:0xdde0000
y.create.l HWIO_PMIC_ARB_CHNL383_CMD_ADDR A:0xddf0000
y.create.l HWIO_PMIC_ARB_CHNL384_CMD_ADDR A:0xde00000
y.create.l HWIO_PMIC_ARB_CHNL385_CMD_ADDR A:0xde10000
y.create.l HWIO_PMIC_ARB_CHNL386_CMD_ADDR A:0xde20000
y.create.l HWIO_PMIC_ARB_CHNL387_CMD_ADDR A:0xde30000
y.create.l HWIO_PMIC_ARB_CHNL388_CMD_ADDR A:0xde40000
y.create.l HWIO_PMIC_ARB_CHNL389_CMD_ADDR A:0xde50000
y.create.l HWIO_PMIC_ARB_CHNL390_CMD_ADDR A:0xde60000
y.create.l HWIO_PMIC_ARB_CHNL391_CMD_ADDR A:0xde70000
y.create.l HWIO_PMIC_ARB_CHNL392_CMD_ADDR A:0xde80000
y.create.l HWIO_PMIC_ARB_CHNL393_CMD_ADDR A:0xde90000
y.create.l HWIO_PMIC_ARB_CHNL394_CMD_ADDR A:0xdea0000
y.create.l HWIO_PMIC_ARB_CHNL395_CMD_ADDR A:0xdeb0000
y.create.l HWIO_PMIC_ARB_CHNL396_CMD_ADDR A:0xdec0000
y.create.l HWIO_PMIC_ARB_CHNL397_CMD_ADDR A:0xded0000
y.create.l HWIO_PMIC_ARB_CHNL398_CMD_ADDR A:0xdee0000
y.create.l HWIO_PMIC_ARB_CHNL399_CMD_ADDR A:0xdef0000
y.create.l HWIO_PMIC_ARB_CHNL400_CMD_ADDR A:0xdf00000
y.create.l HWIO_PMIC_ARB_CHNL401_CMD_ADDR A:0xdf10000
y.create.l HWIO_PMIC_ARB_CHNL402_CMD_ADDR A:0xdf20000
y.create.l HWIO_PMIC_ARB_CHNL403_CMD_ADDR A:0xdf30000
y.create.l HWIO_PMIC_ARB_CHNL404_CMD_ADDR A:0xdf40000
y.create.l HWIO_PMIC_ARB_CHNL405_CMD_ADDR A:0xdf50000
y.create.l HWIO_PMIC_ARB_CHNL406_CMD_ADDR A:0xdf60000
y.create.l HWIO_PMIC_ARB_CHNL407_CMD_ADDR A:0xdf70000
y.create.l HWIO_PMIC_ARB_CHNL408_CMD_ADDR A:0xdf80000
y.create.l HWIO_PMIC_ARB_CHNL409_CMD_ADDR A:0xdf90000
y.create.l HWIO_PMIC_ARB_CHNL410_CMD_ADDR A:0xdfa0000
y.create.l HWIO_PMIC_ARB_CHNL411_CMD_ADDR A:0xdfb0000
y.create.l HWIO_PMIC_ARB_CHNL412_CMD_ADDR A:0xdfc0000
y.create.l HWIO_PMIC_ARB_CHNL413_CMD_ADDR A:0xdfd0000
y.create.l HWIO_PMIC_ARB_CHNL414_CMD_ADDR A:0xdfe0000
y.create.l HWIO_PMIC_ARB_CHNL415_CMD_ADDR A:0xdff0000
y.create.l HWIO_PMIC_ARB_CHNL416_CMD_ADDR A:0xe000000
y.create.l HWIO_PMIC_ARB_CHNL417_CMD_ADDR A:0xe010000
y.create.l HWIO_PMIC_ARB_CHNL418_CMD_ADDR A:0xe020000
y.create.l HWIO_PMIC_ARB_CHNL419_CMD_ADDR A:0xe030000
y.create.l HWIO_PMIC_ARB_CHNL420_CMD_ADDR A:0xe040000
y.create.l HWIO_PMIC_ARB_CHNL421_CMD_ADDR A:0xe050000
y.create.l HWIO_PMIC_ARB_CHNL422_CMD_ADDR A:0xe060000
y.create.l HWIO_PMIC_ARB_CHNL423_CMD_ADDR A:0xe070000
y.create.l HWIO_PMIC_ARB_CHNL424_CMD_ADDR A:0xe080000
y.create.l HWIO_PMIC_ARB_CHNL425_CMD_ADDR A:0xe090000
y.create.l HWIO_PMIC_ARB_CHNL426_CMD_ADDR A:0xe0a0000
y.create.l HWIO_PMIC_ARB_CHNL427_CMD_ADDR A:0xe0b0000
y.create.l HWIO_PMIC_ARB_CHNL428_CMD_ADDR A:0xe0c0000
y.create.l HWIO_PMIC_ARB_CHNL429_CMD_ADDR A:0xe0d0000
y.create.l HWIO_PMIC_ARB_CHNL430_CMD_ADDR A:0xe0e0000
y.create.l HWIO_PMIC_ARB_CHNL431_CMD_ADDR A:0xe0f0000
y.create.l HWIO_PMIC_ARB_CHNL432_CMD_ADDR A:0xe100000
y.create.l HWIO_PMIC_ARB_CHNL433_CMD_ADDR A:0xe110000
y.create.l HWIO_PMIC_ARB_CHNL434_CMD_ADDR A:0xe120000
y.create.l HWIO_PMIC_ARB_CHNL435_CMD_ADDR A:0xe130000
y.create.l HWIO_PMIC_ARB_CHNL436_CMD_ADDR A:0xe140000
y.create.l HWIO_PMIC_ARB_CHNL437_CMD_ADDR A:0xe150000
y.create.l HWIO_PMIC_ARB_CHNL438_CMD_ADDR A:0xe160000
y.create.l HWIO_PMIC_ARB_CHNL439_CMD_ADDR A:0xe170000
y.create.l HWIO_PMIC_ARB_CHNL440_CMD_ADDR A:0xe180000
y.create.l HWIO_PMIC_ARB_CHNL441_CMD_ADDR A:0xe190000
y.create.l HWIO_PMIC_ARB_CHNL442_CMD_ADDR A:0xe1a0000
y.create.l HWIO_PMIC_ARB_CHNL443_CMD_ADDR A:0xe1b0000
y.create.l HWIO_PMIC_ARB_CHNL444_CMD_ADDR A:0xe1c0000
y.create.l HWIO_PMIC_ARB_CHNL445_CMD_ADDR A:0xe1d0000
y.create.l HWIO_PMIC_ARB_CHNL446_CMD_ADDR A:0xe1e0000
y.create.l HWIO_PMIC_ARB_CHNL447_CMD_ADDR A:0xe1f0000
y.create.l HWIO_PMIC_ARB_CHNL448_CMD_ADDR A:0xe200000
y.create.l HWIO_PMIC_ARB_CHNL449_CMD_ADDR A:0xe210000
y.create.l HWIO_PMIC_ARB_CHNL450_CMD_ADDR A:0xe220000
y.create.l HWIO_PMIC_ARB_CHNL451_CMD_ADDR A:0xe230000
y.create.l HWIO_PMIC_ARB_CHNL452_CMD_ADDR A:0xe240000
y.create.l HWIO_PMIC_ARB_CHNL453_CMD_ADDR A:0xe250000
y.create.l HWIO_PMIC_ARB_CHNL454_CMD_ADDR A:0xe260000
y.create.l HWIO_PMIC_ARB_CHNL455_CMD_ADDR A:0xe270000
y.create.l HWIO_PMIC_ARB_CHNL456_CMD_ADDR A:0xe280000
y.create.l HWIO_PMIC_ARB_CHNL457_CMD_ADDR A:0xe290000
y.create.l HWIO_PMIC_ARB_CHNL458_CMD_ADDR A:0xe2a0000
y.create.l HWIO_PMIC_ARB_CHNL459_CMD_ADDR A:0xe2b0000
y.create.l HWIO_PMIC_ARB_CHNL460_CMD_ADDR A:0xe2c0000
y.create.l HWIO_PMIC_ARB_CHNL461_CMD_ADDR A:0xe2d0000
y.create.l HWIO_PMIC_ARB_CHNL462_CMD_ADDR A:0xe2e0000
y.create.l HWIO_PMIC_ARB_CHNL463_CMD_ADDR A:0xe2f0000
y.create.l HWIO_PMIC_ARB_CHNL464_CMD_ADDR A:0xe300000
y.create.l HWIO_PMIC_ARB_CHNL465_CMD_ADDR A:0xe310000
y.create.l HWIO_PMIC_ARB_CHNL466_CMD_ADDR A:0xe320000
y.create.l HWIO_PMIC_ARB_CHNL467_CMD_ADDR A:0xe330000
y.create.l HWIO_PMIC_ARB_CHNL468_CMD_ADDR A:0xe340000
y.create.l HWIO_PMIC_ARB_CHNL469_CMD_ADDR A:0xe350000
y.create.l HWIO_PMIC_ARB_CHNL470_CMD_ADDR A:0xe360000
y.create.l HWIO_PMIC_ARB_CHNL471_CMD_ADDR A:0xe370000
y.create.l HWIO_PMIC_ARB_CHNL472_CMD_ADDR A:0xe380000
y.create.l HWIO_PMIC_ARB_CHNL473_CMD_ADDR A:0xe390000
y.create.l HWIO_PMIC_ARB_CHNL474_CMD_ADDR A:0xe3a0000
y.create.l HWIO_PMIC_ARB_CHNL475_CMD_ADDR A:0xe3b0000
y.create.l HWIO_PMIC_ARB_CHNL476_CMD_ADDR A:0xe3c0000
y.create.l HWIO_PMIC_ARB_CHNL477_CMD_ADDR A:0xe3d0000
y.create.l HWIO_PMIC_ARB_CHNL478_CMD_ADDR A:0xe3e0000
y.create.l HWIO_PMIC_ARB_CHNL479_CMD_ADDR A:0xe3f0000
y.create.l HWIO_PMIC_ARB_CHNL480_CMD_ADDR A:0xe400000
y.create.l HWIO_PMIC_ARB_CHNL481_CMD_ADDR A:0xe410000
y.create.l HWIO_PMIC_ARB_CHNL482_CMD_ADDR A:0xe420000
y.create.l HWIO_PMIC_ARB_CHNL483_CMD_ADDR A:0xe430000
y.create.l HWIO_PMIC_ARB_CHNL484_CMD_ADDR A:0xe440000
y.create.l HWIO_PMIC_ARB_CHNL485_CMD_ADDR A:0xe450000
y.create.l HWIO_PMIC_ARB_CHNL486_CMD_ADDR A:0xe460000
y.create.l HWIO_PMIC_ARB_CHNL487_CMD_ADDR A:0xe470000
y.create.l HWIO_PMIC_ARB_CHNL488_CMD_ADDR A:0xe480000
y.create.l HWIO_PMIC_ARB_CHNL489_CMD_ADDR A:0xe490000
y.create.l HWIO_PMIC_ARB_CHNL490_CMD_ADDR A:0xe4a0000
y.create.l HWIO_PMIC_ARB_CHNL491_CMD_ADDR A:0xe4b0000
y.create.l HWIO_PMIC_ARB_CHNL492_CMD_ADDR A:0xe4c0000
y.create.l HWIO_PMIC_ARB_CHNL493_CMD_ADDR A:0xe4d0000
y.create.l HWIO_PMIC_ARB_CHNL494_CMD_ADDR A:0xe4e0000
y.create.l HWIO_PMIC_ARB_CHNL495_CMD_ADDR A:0xe4f0000
y.create.l HWIO_PMIC_ARB_CHNL496_CMD_ADDR A:0xe500000
y.create.l HWIO_PMIC_ARB_CHNL497_CMD_ADDR A:0xe510000
y.create.l HWIO_PMIC_ARB_CHNL498_CMD_ADDR A:0xe520000
y.create.l HWIO_PMIC_ARB_CHNL499_CMD_ADDR A:0xe530000
y.create.l HWIO_PMIC_ARB_CHNL500_CMD_ADDR A:0xe540000
y.create.l HWIO_PMIC_ARB_CHNL501_CMD_ADDR A:0xe550000
y.create.l HWIO_PMIC_ARB_CHNL502_CMD_ADDR A:0xe560000
y.create.l HWIO_PMIC_ARB_CHNL503_CMD_ADDR A:0xe570000
y.create.l HWIO_PMIC_ARB_CHNL504_CMD_ADDR A:0xe580000
y.create.l HWIO_PMIC_ARB_CHNL505_CMD_ADDR A:0xe590000
y.create.l HWIO_PMIC_ARB_CHNL506_CMD_ADDR A:0xe5a0000
y.create.l HWIO_PMIC_ARB_CHNL507_CMD_ADDR A:0xe5b0000
y.create.l HWIO_PMIC_ARB_CHNL508_CMD_ADDR A:0xe5c0000
y.create.l HWIO_PMIC_ARB_CHNL509_CMD_ADDR A:0xe5d0000
y.create.l HWIO_PMIC_ARB_CHNL510_CMD_ADDR A:0xe5e0000
y.create.l HWIO_PMIC_ARB_CHNL511_CMD_ADDR A:0xe5f0000
y.create.l HWIO_PMIC_ARB_CHNL0_CONFIG_ADDR A:0xc600004
y.create.l HWIO_PMIC_ARB_CHNL1_CONFIG_ADDR A:0xc610004
y.create.l HWIO_PMIC_ARB_CHNL2_CONFIG_ADDR A:0xc620004
y.create.l HWIO_PMIC_ARB_CHNL3_CONFIG_ADDR A:0xc630004
y.create.l HWIO_PMIC_ARB_CHNL4_CONFIG_ADDR A:0xc640004
y.create.l HWIO_PMIC_ARB_CHNL5_CONFIG_ADDR A:0xc650004
y.create.l HWIO_PMIC_ARB_CHNL6_CONFIG_ADDR A:0xc660004
y.create.l HWIO_PMIC_ARB_CHNL7_CONFIG_ADDR A:0xc670004
y.create.l HWIO_PMIC_ARB_CHNL8_CONFIG_ADDR A:0xc680004
y.create.l HWIO_PMIC_ARB_CHNL9_CONFIG_ADDR A:0xc690004
y.create.l HWIO_PMIC_ARB_CHNL10_CONFIG_ADDR A:0xc6a0004
y.create.l HWIO_PMIC_ARB_CHNL11_CONFIG_ADDR A:0xc6b0004
y.create.l HWIO_PMIC_ARB_CHNL12_CONFIG_ADDR A:0xc6c0004
y.create.l HWIO_PMIC_ARB_CHNL13_CONFIG_ADDR A:0xc6d0004
y.create.l HWIO_PMIC_ARB_CHNL14_CONFIG_ADDR A:0xc6e0004
y.create.l HWIO_PMIC_ARB_CHNL15_CONFIG_ADDR A:0xc6f0004
y.create.l HWIO_PMIC_ARB_CHNL16_CONFIG_ADDR A:0xc700004
y.create.l HWIO_PMIC_ARB_CHNL17_CONFIG_ADDR A:0xc710004
y.create.l HWIO_PMIC_ARB_CHNL18_CONFIG_ADDR A:0xc720004
y.create.l HWIO_PMIC_ARB_CHNL19_CONFIG_ADDR A:0xc730004
y.create.l HWIO_PMIC_ARB_CHNL20_CONFIG_ADDR A:0xc740004
y.create.l HWIO_PMIC_ARB_CHNL21_CONFIG_ADDR A:0xc750004
y.create.l HWIO_PMIC_ARB_CHNL22_CONFIG_ADDR A:0xc760004
y.create.l HWIO_PMIC_ARB_CHNL23_CONFIG_ADDR A:0xc770004
y.create.l HWIO_PMIC_ARB_CHNL24_CONFIG_ADDR A:0xc780004
y.create.l HWIO_PMIC_ARB_CHNL25_CONFIG_ADDR A:0xc790004
y.create.l HWIO_PMIC_ARB_CHNL26_CONFIG_ADDR A:0xc7a0004
y.create.l HWIO_PMIC_ARB_CHNL27_CONFIG_ADDR A:0xc7b0004
y.create.l HWIO_PMIC_ARB_CHNL28_CONFIG_ADDR A:0xc7c0004
y.create.l HWIO_PMIC_ARB_CHNL29_CONFIG_ADDR A:0xc7d0004
y.create.l HWIO_PMIC_ARB_CHNL30_CONFIG_ADDR A:0xc7e0004
y.create.l HWIO_PMIC_ARB_CHNL31_CONFIG_ADDR A:0xc7f0004
y.create.l HWIO_PMIC_ARB_CHNL32_CONFIG_ADDR A:0xc800004
y.create.l HWIO_PMIC_ARB_CHNL33_CONFIG_ADDR A:0xc810004
y.create.l HWIO_PMIC_ARB_CHNL34_CONFIG_ADDR A:0xc820004
y.create.l HWIO_PMIC_ARB_CHNL35_CONFIG_ADDR A:0xc830004
y.create.l HWIO_PMIC_ARB_CHNL36_CONFIG_ADDR A:0xc840004
y.create.l HWIO_PMIC_ARB_CHNL37_CONFIG_ADDR A:0xc850004
y.create.l HWIO_PMIC_ARB_CHNL38_CONFIG_ADDR A:0xc860004
y.create.l HWIO_PMIC_ARB_CHNL39_CONFIG_ADDR A:0xc870004
y.create.l HWIO_PMIC_ARB_CHNL40_CONFIG_ADDR A:0xc880004
y.create.l HWIO_PMIC_ARB_CHNL41_CONFIG_ADDR A:0xc890004
y.create.l HWIO_PMIC_ARB_CHNL42_CONFIG_ADDR A:0xc8a0004
y.create.l HWIO_PMIC_ARB_CHNL43_CONFIG_ADDR A:0xc8b0004
y.create.l HWIO_PMIC_ARB_CHNL44_CONFIG_ADDR A:0xc8c0004
y.create.l HWIO_PMIC_ARB_CHNL45_CONFIG_ADDR A:0xc8d0004
y.create.l HWIO_PMIC_ARB_CHNL46_CONFIG_ADDR A:0xc8e0004
y.create.l HWIO_PMIC_ARB_CHNL47_CONFIG_ADDR A:0xc8f0004
y.create.l HWIO_PMIC_ARB_CHNL48_CONFIG_ADDR A:0xc900004
y.create.l HWIO_PMIC_ARB_CHNL49_CONFIG_ADDR A:0xc910004
y.create.l HWIO_PMIC_ARB_CHNL50_CONFIG_ADDR A:0xc920004
y.create.l HWIO_PMIC_ARB_CHNL51_CONFIG_ADDR A:0xc930004
y.create.l HWIO_PMIC_ARB_CHNL52_CONFIG_ADDR A:0xc940004
y.create.l HWIO_PMIC_ARB_CHNL53_CONFIG_ADDR A:0xc950004
y.create.l HWIO_PMIC_ARB_CHNL54_CONFIG_ADDR A:0xc960004
y.create.l HWIO_PMIC_ARB_CHNL55_CONFIG_ADDR A:0xc970004
y.create.l HWIO_PMIC_ARB_CHNL56_CONFIG_ADDR A:0xc980004
y.create.l HWIO_PMIC_ARB_CHNL57_CONFIG_ADDR A:0xc990004
y.create.l HWIO_PMIC_ARB_CHNL58_CONFIG_ADDR A:0xc9a0004
y.create.l HWIO_PMIC_ARB_CHNL59_CONFIG_ADDR A:0xc9b0004
y.create.l HWIO_PMIC_ARB_CHNL60_CONFIG_ADDR A:0xc9c0004
y.create.l HWIO_PMIC_ARB_CHNL61_CONFIG_ADDR A:0xc9d0004
y.create.l HWIO_PMIC_ARB_CHNL62_CONFIG_ADDR A:0xc9e0004
y.create.l HWIO_PMIC_ARB_CHNL63_CONFIG_ADDR A:0xc9f0004
y.create.l HWIO_PMIC_ARB_CHNL64_CONFIG_ADDR A:0xca00004
y.create.l HWIO_PMIC_ARB_CHNL65_CONFIG_ADDR A:0xca10004
y.create.l HWIO_PMIC_ARB_CHNL66_CONFIG_ADDR A:0xca20004
y.create.l HWIO_PMIC_ARB_CHNL67_CONFIG_ADDR A:0xca30004
y.create.l HWIO_PMIC_ARB_CHNL68_CONFIG_ADDR A:0xca40004
y.create.l HWIO_PMIC_ARB_CHNL69_CONFIG_ADDR A:0xca50004
y.create.l HWIO_PMIC_ARB_CHNL70_CONFIG_ADDR A:0xca60004
y.create.l HWIO_PMIC_ARB_CHNL71_CONFIG_ADDR A:0xca70004
y.create.l HWIO_PMIC_ARB_CHNL72_CONFIG_ADDR A:0xca80004
y.create.l HWIO_PMIC_ARB_CHNL73_CONFIG_ADDR A:0xca90004
y.create.l HWIO_PMIC_ARB_CHNL74_CONFIG_ADDR A:0xcaa0004
y.create.l HWIO_PMIC_ARB_CHNL75_CONFIG_ADDR A:0xcab0004
y.create.l HWIO_PMIC_ARB_CHNL76_CONFIG_ADDR A:0xcac0004
y.create.l HWIO_PMIC_ARB_CHNL77_CONFIG_ADDR A:0xcad0004
y.create.l HWIO_PMIC_ARB_CHNL78_CONFIG_ADDR A:0xcae0004
y.create.l HWIO_PMIC_ARB_CHNL79_CONFIG_ADDR A:0xcaf0004
y.create.l HWIO_PMIC_ARB_CHNL80_CONFIG_ADDR A:0xcb00004
y.create.l HWIO_PMIC_ARB_CHNL81_CONFIG_ADDR A:0xcb10004
y.create.l HWIO_PMIC_ARB_CHNL82_CONFIG_ADDR A:0xcb20004
y.create.l HWIO_PMIC_ARB_CHNL83_CONFIG_ADDR A:0xcb30004
y.create.l HWIO_PMIC_ARB_CHNL84_CONFIG_ADDR A:0xcb40004
y.create.l HWIO_PMIC_ARB_CHNL85_CONFIG_ADDR A:0xcb50004
y.create.l HWIO_PMIC_ARB_CHNL86_CONFIG_ADDR A:0xcb60004
y.create.l HWIO_PMIC_ARB_CHNL87_CONFIG_ADDR A:0xcb70004
y.create.l HWIO_PMIC_ARB_CHNL88_CONFIG_ADDR A:0xcb80004
y.create.l HWIO_PMIC_ARB_CHNL89_CONFIG_ADDR A:0xcb90004
y.create.l HWIO_PMIC_ARB_CHNL90_CONFIG_ADDR A:0xcba0004
y.create.l HWIO_PMIC_ARB_CHNL91_CONFIG_ADDR A:0xcbb0004
y.create.l HWIO_PMIC_ARB_CHNL92_CONFIG_ADDR A:0xcbc0004
y.create.l HWIO_PMIC_ARB_CHNL93_CONFIG_ADDR A:0xcbd0004
y.create.l HWIO_PMIC_ARB_CHNL94_CONFIG_ADDR A:0xcbe0004
y.create.l HWIO_PMIC_ARB_CHNL95_CONFIG_ADDR A:0xcbf0004
y.create.l HWIO_PMIC_ARB_CHNL96_CONFIG_ADDR A:0xcc00004
y.create.l HWIO_PMIC_ARB_CHNL97_CONFIG_ADDR A:0xcc10004
y.create.l HWIO_PMIC_ARB_CHNL98_CONFIG_ADDR A:0xcc20004
y.create.l HWIO_PMIC_ARB_CHNL99_CONFIG_ADDR A:0xcc30004
y.create.l HWIO_PMIC_ARB_CHNL100_CONFIG_ADDR A:0xcc40004
y.create.l HWIO_PMIC_ARB_CHNL101_CONFIG_ADDR A:0xcc50004
y.create.l HWIO_PMIC_ARB_CHNL102_CONFIG_ADDR A:0xcc60004
y.create.l HWIO_PMIC_ARB_CHNL103_CONFIG_ADDR A:0xcc70004
y.create.l HWIO_PMIC_ARB_CHNL104_CONFIG_ADDR A:0xcc80004
y.create.l HWIO_PMIC_ARB_CHNL105_CONFIG_ADDR A:0xcc90004
y.create.l HWIO_PMIC_ARB_CHNL106_CONFIG_ADDR A:0xcca0004
y.create.l HWIO_PMIC_ARB_CHNL107_CONFIG_ADDR A:0xccb0004
y.create.l HWIO_PMIC_ARB_CHNL108_CONFIG_ADDR A:0xccc0004
y.create.l HWIO_PMIC_ARB_CHNL109_CONFIG_ADDR A:0xccd0004
y.create.l HWIO_PMIC_ARB_CHNL110_CONFIG_ADDR A:0xcce0004
y.create.l HWIO_PMIC_ARB_CHNL111_CONFIG_ADDR A:0xccf0004
y.create.l HWIO_PMIC_ARB_CHNL112_CONFIG_ADDR A:0xcd00004
y.create.l HWIO_PMIC_ARB_CHNL113_CONFIG_ADDR A:0xcd10004
y.create.l HWIO_PMIC_ARB_CHNL114_CONFIG_ADDR A:0xcd20004
y.create.l HWIO_PMIC_ARB_CHNL115_CONFIG_ADDR A:0xcd30004
y.create.l HWIO_PMIC_ARB_CHNL116_CONFIG_ADDR A:0xcd40004
y.create.l HWIO_PMIC_ARB_CHNL117_CONFIG_ADDR A:0xcd50004
y.create.l HWIO_PMIC_ARB_CHNL118_CONFIG_ADDR A:0xcd60004
y.create.l HWIO_PMIC_ARB_CHNL119_CONFIG_ADDR A:0xcd70004
y.create.l HWIO_PMIC_ARB_CHNL120_CONFIG_ADDR A:0xcd80004
y.create.l HWIO_PMIC_ARB_CHNL121_CONFIG_ADDR A:0xcd90004
y.create.l HWIO_PMIC_ARB_CHNL122_CONFIG_ADDR A:0xcda0004
y.create.l HWIO_PMIC_ARB_CHNL123_CONFIG_ADDR A:0xcdb0004
y.create.l HWIO_PMIC_ARB_CHNL124_CONFIG_ADDR A:0xcdc0004
y.create.l HWIO_PMIC_ARB_CHNL125_CONFIG_ADDR A:0xcdd0004
y.create.l HWIO_PMIC_ARB_CHNL126_CONFIG_ADDR A:0xcde0004
y.create.l HWIO_PMIC_ARB_CHNL127_CONFIG_ADDR A:0xcdf0004
y.create.l HWIO_PMIC_ARB_CHNL128_CONFIG_ADDR A:0xce00004
y.create.l HWIO_PMIC_ARB_CHNL129_CONFIG_ADDR A:0xce10004
y.create.l HWIO_PMIC_ARB_CHNL130_CONFIG_ADDR A:0xce20004
y.create.l HWIO_PMIC_ARB_CHNL131_CONFIG_ADDR A:0xce30004
y.create.l HWIO_PMIC_ARB_CHNL132_CONFIG_ADDR A:0xce40004
y.create.l HWIO_PMIC_ARB_CHNL133_CONFIG_ADDR A:0xce50004
y.create.l HWIO_PMIC_ARB_CHNL134_CONFIG_ADDR A:0xce60004
y.create.l HWIO_PMIC_ARB_CHNL135_CONFIG_ADDR A:0xce70004
y.create.l HWIO_PMIC_ARB_CHNL136_CONFIG_ADDR A:0xce80004
y.create.l HWIO_PMIC_ARB_CHNL137_CONFIG_ADDR A:0xce90004
y.create.l HWIO_PMIC_ARB_CHNL138_CONFIG_ADDR A:0xcea0004
y.create.l HWIO_PMIC_ARB_CHNL139_CONFIG_ADDR A:0xceb0004
y.create.l HWIO_PMIC_ARB_CHNL140_CONFIG_ADDR A:0xcec0004
y.create.l HWIO_PMIC_ARB_CHNL141_CONFIG_ADDR A:0xced0004
y.create.l HWIO_PMIC_ARB_CHNL142_CONFIG_ADDR A:0xcee0004
y.create.l HWIO_PMIC_ARB_CHNL143_CONFIG_ADDR A:0xcef0004
y.create.l HWIO_PMIC_ARB_CHNL144_CONFIG_ADDR A:0xcf00004
y.create.l HWIO_PMIC_ARB_CHNL145_CONFIG_ADDR A:0xcf10004
y.create.l HWIO_PMIC_ARB_CHNL146_CONFIG_ADDR A:0xcf20004
y.create.l HWIO_PMIC_ARB_CHNL147_CONFIG_ADDR A:0xcf30004
y.create.l HWIO_PMIC_ARB_CHNL148_CONFIG_ADDR A:0xcf40004
y.create.l HWIO_PMIC_ARB_CHNL149_CONFIG_ADDR A:0xcf50004
y.create.l HWIO_PMIC_ARB_CHNL150_CONFIG_ADDR A:0xcf60004
y.create.l HWIO_PMIC_ARB_CHNL151_CONFIG_ADDR A:0xcf70004
y.create.l HWIO_PMIC_ARB_CHNL152_CONFIG_ADDR A:0xcf80004
y.create.l HWIO_PMIC_ARB_CHNL153_CONFIG_ADDR A:0xcf90004
y.create.l HWIO_PMIC_ARB_CHNL154_CONFIG_ADDR A:0xcfa0004
y.create.l HWIO_PMIC_ARB_CHNL155_CONFIG_ADDR A:0xcfb0004
y.create.l HWIO_PMIC_ARB_CHNL156_CONFIG_ADDR A:0xcfc0004
y.create.l HWIO_PMIC_ARB_CHNL157_CONFIG_ADDR A:0xcfd0004
y.create.l HWIO_PMIC_ARB_CHNL158_CONFIG_ADDR A:0xcfe0004
y.create.l HWIO_PMIC_ARB_CHNL159_CONFIG_ADDR A:0xcff0004
y.create.l HWIO_PMIC_ARB_CHNL160_CONFIG_ADDR A:0xd000004
y.create.l HWIO_PMIC_ARB_CHNL161_CONFIG_ADDR A:0xd010004
y.create.l HWIO_PMIC_ARB_CHNL162_CONFIG_ADDR A:0xd020004
y.create.l HWIO_PMIC_ARB_CHNL163_CONFIG_ADDR A:0xd030004
y.create.l HWIO_PMIC_ARB_CHNL164_CONFIG_ADDR A:0xd040004
y.create.l HWIO_PMIC_ARB_CHNL165_CONFIG_ADDR A:0xd050004
y.create.l HWIO_PMIC_ARB_CHNL166_CONFIG_ADDR A:0xd060004
y.create.l HWIO_PMIC_ARB_CHNL167_CONFIG_ADDR A:0xd070004
y.create.l HWIO_PMIC_ARB_CHNL168_CONFIG_ADDR A:0xd080004
y.create.l HWIO_PMIC_ARB_CHNL169_CONFIG_ADDR A:0xd090004
y.create.l HWIO_PMIC_ARB_CHNL170_CONFIG_ADDR A:0xd0a0004
y.create.l HWIO_PMIC_ARB_CHNL171_CONFIG_ADDR A:0xd0b0004
y.create.l HWIO_PMIC_ARB_CHNL172_CONFIG_ADDR A:0xd0c0004
y.create.l HWIO_PMIC_ARB_CHNL173_CONFIG_ADDR A:0xd0d0004
y.create.l HWIO_PMIC_ARB_CHNL174_CONFIG_ADDR A:0xd0e0004
y.create.l HWIO_PMIC_ARB_CHNL175_CONFIG_ADDR A:0xd0f0004
y.create.l HWIO_PMIC_ARB_CHNL176_CONFIG_ADDR A:0xd100004
y.create.l HWIO_PMIC_ARB_CHNL177_CONFIG_ADDR A:0xd110004
y.create.l HWIO_PMIC_ARB_CHNL178_CONFIG_ADDR A:0xd120004
y.create.l HWIO_PMIC_ARB_CHNL179_CONFIG_ADDR A:0xd130004
y.create.l HWIO_PMIC_ARB_CHNL180_CONFIG_ADDR A:0xd140004
y.create.l HWIO_PMIC_ARB_CHNL181_CONFIG_ADDR A:0xd150004
y.create.l HWIO_PMIC_ARB_CHNL182_CONFIG_ADDR A:0xd160004
y.create.l HWIO_PMIC_ARB_CHNL183_CONFIG_ADDR A:0xd170004
y.create.l HWIO_PMIC_ARB_CHNL184_CONFIG_ADDR A:0xd180004
y.create.l HWIO_PMIC_ARB_CHNL185_CONFIG_ADDR A:0xd190004
y.create.l HWIO_PMIC_ARB_CHNL186_CONFIG_ADDR A:0xd1a0004
y.create.l HWIO_PMIC_ARB_CHNL187_CONFIG_ADDR A:0xd1b0004
y.create.l HWIO_PMIC_ARB_CHNL188_CONFIG_ADDR A:0xd1c0004
y.create.l HWIO_PMIC_ARB_CHNL189_CONFIG_ADDR A:0xd1d0004
y.create.l HWIO_PMIC_ARB_CHNL190_CONFIG_ADDR A:0xd1e0004
y.create.l HWIO_PMIC_ARB_CHNL191_CONFIG_ADDR A:0xd1f0004
y.create.l HWIO_PMIC_ARB_CHNL192_CONFIG_ADDR A:0xd200004
y.create.l HWIO_PMIC_ARB_CHNL193_CONFIG_ADDR A:0xd210004
y.create.l HWIO_PMIC_ARB_CHNL194_CONFIG_ADDR A:0xd220004
y.create.l HWIO_PMIC_ARB_CHNL195_CONFIG_ADDR A:0xd230004
y.create.l HWIO_PMIC_ARB_CHNL196_CONFIG_ADDR A:0xd240004
y.create.l HWIO_PMIC_ARB_CHNL197_CONFIG_ADDR A:0xd250004
y.create.l HWIO_PMIC_ARB_CHNL198_CONFIG_ADDR A:0xd260004
y.create.l HWIO_PMIC_ARB_CHNL199_CONFIG_ADDR A:0xd270004
y.create.l HWIO_PMIC_ARB_CHNL200_CONFIG_ADDR A:0xd280004
y.create.l HWIO_PMIC_ARB_CHNL201_CONFIG_ADDR A:0xd290004
y.create.l HWIO_PMIC_ARB_CHNL202_CONFIG_ADDR A:0xd2a0004
y.create.l HWIO_PMIC_ARB_CHNL203_CONFIG_ADDR A:0xd2b0004
y.create.l HWIO_PMIC_ARB_CHNL204_CONFIG_ADDR A:0xd2c0004
y.create.l HWIO_PMIC_ARB_CHNL205_CONFIG_ADDR A:0xd2d0004
y.create.l HWIO_PMIC_ARB_CHNL206_CONFIG_ADDR A:0xd2e0004
y.create.l HWIO_PMIC_ARB_CHNL207_CONFIG_ADDR A:0xd2f0004
y.create.l HWIO_PMIC_ARB_CHNL208_CONFIG_ADDR A:0xd300004
y.create.l HWIO_PMIC_ARB_CHNL209_CONFIG_ADDR A:0xd310004
y.create.l HWIO_PMIC_ARB_CHNL210_CONFIG_ADDR A:0xd320004
y.create.l HWIO_PMIC_ARB_CHNL211_CONFIG_ADDR A:0xd330004
y.create.l HWIO_PMIC_ARB_CHNL212_CONFIG_ADDR A:0xd340004
y.create.l HWIO_PMIC_ARB_CHNL213_CONFIG_ADDR A:0xd350004
y.create.l HWIO_PMIC_ARB_CHNL214_CONFIG_ADDR A:0xd360004
y.create.l HWIO_PMIC_ARB_CHNL215_CONFIG_ADDR A:0xd370004
y.create.l HWIO_PMIC_ARB_CHNL216_CONFIG_ADDR A:0xd380004
y.create.l HWIO_PMIC_ARB_CHNL217_CONFIG_ADDR A:0xd390004
y.create.l HWIO_PMIC_ARB_CHNL218_CONFIG_ADDR A:0xd3a0004
y.create.l HWIO_PMIC_ARB_CHNL219_CONFIG_ADDR A:0xd3b0004
y.create.l HWIO_PMIC_ARB_CHNL220_CONFIG_ADDR A:0xd3c0004
y.create.l HWIO_PMIC_ARB_CHNL221_CONFIG_ADDR A:0xd3d0004
y.create.l HWIO_PMIC_ARB_CHNL222_CONFIG_ADDR A:0xd3e0004
y.create.l HWIO_PMIC_ARB_CHNL223_CONFIG_ADDR A:0xd3f0004
y.create.l HWIO_PMIC_ARB_CHNL224_CONFIG_ADDR A:0xd400004
y.create.l HWIO_PMIC_ARB_CHNL225_CONFIG_ADDR A:0xd410004
y.create.l HWIO_PMIC_ARB_CHNL226_CONFIG_ADDR A:0xd420004
y.create.l HWIO_PMIC_ARB_CHNL227_CONFIG_ADDR A:0xd430004
y.create.l HWIO_PMIC_ARB_CHNL228_CONFIG_ADDR A:0xd440004
y.create.l HWIO_PMIC_ARB_CHNL229_CONFIG_ADDR A:0xd450004
y.create.l HWIO_PMIC_ARB_CHNL230_CONFIG_ADDR A:0xd460004
y.create.l HWIO_PMIC_ARB_CHNL231_CONFIG_ADDR A:0xd470004
y.create.l HWIO_PMIC_ARB_CHNL232_CONFIG_ADDR A:0xd480004
y.create.l HWIO_PMIC_ARB_CHNL233_CONFIG_ADDR A:0xd490004
y.create.l HWIO_PMIC_ARB_CHNL234_CONFIG_ADDR A:0xd4a0004
y.create.l HWIO_PMIC_ARB_CHNL235_CONFIG_ADDR A:0xd4b0004
y.create.l HWIO_PMIC_ARB_CHNL236_CONFIG_ADDR A:0xd4c0004
y.create.l HWIO_PMIC_ARB_CHNL237_CONFIG_ADDR A:0xd4d0004
y.create.l HWIO_PMIC_ARB_CHNL238_CONFIG_ADDR A:0xd4e0004
y.create.l HWIO_PMIC_ARB_CHNL239_CONFIG_ADDR A:0xd4f0004
y.create.l HWIO_PMIC_ARB_CHNL240_CONFIG_ADDR A:0xd500004
y.create.l HWIO_PMIC_ARB_CHNL241_CONFIG_ADDR A:0xd510004
y.create.l HWIO_PMIC_ARB_CHNL242_CONFIG_ADDR A:0xd520004
y.create.l HWIO_PMIC_ARB_CHNL243_CONFIG_ADDR A:0xd530004
y.create.l HWIO_PMIC_ARB_CHNL244_CONFIG_ADDR A:0xd540004
y.create.l HWIO_PMIC_ARB_CHNL245_CONFIG_ADDR A:0xd550004
y.create.l HWIO_PMIC_ARB_CHNL246_CONFIG_ADDR A:0xd560004
y.create.l HWIO_PMIC_ARB_CHNL247_CONFIG_ADDR A:0xd570004
y.create.l HWIO_PMIC_ARB_CHNL248_CONFIG_ADDR A:0xd580004
y.create.l HWIO_PMIC_ARB_CHNL249_CONFIG_ADDR A:0xd590004
y.create.l HWIO_PMIC_ARB_CHNL250_CONFIG_ADDR A:0xd5a0004
y.create.l HWIO_PMIC_ARB_CHNL251_CONFIG_ADDR A:0xd5b0004
y.create.l HWIO_PMIC_ARB_CHNL252_CONFIG_ADDR A:0xd5c0004
y.create.l HWIO_PMIC_ARB_CHNL253_CONFIG_ADDR A:0xd5d0004
y.create.l HWIO_PMIC_ARB_CHNL254_CONFIG_ADDR A:0xd5e0004
y.create.l HWIO_PMIC_ARB_CHNL255_CONFIG_ADDR A:0xd5f0004
y.create.l HWIO_PMIC_ARB_CHNL256_CONFIG_ADDR A:0xd600004
y.create.l HWIO_PMIC_ARB_CHNL257_CONFIG_ADDR A:0xd610004
y.create.l HWIO_PMIC_ARB_CHNL258_CONFIG_ADDR A:0xd620004
y.create.l HWIO_PMIC_ARB_CHNL259_CONFIG_ADDR A:0xd630004
y.create.l HWIO_PMIC_ARB_CHNL260_CONFIG_ADDR A:0xd640004
y.create.l HWIO_PMIC_ARB_CHNL261_CONFIG_ADDR A:0xd650004
y.create.l HWIO_PMIC_ARB_CHNL262_CONFIG_ADDR A:0xd660004
y.create.l HWIO_PMIC_ARB_CHNL263_CONFIG_ADDR A:0xd670004
y.create.l HWIO_PMIC_ARB_CHNL264_CONFIG_ADDR A:0xd680004
y.create.l HWIO_PMIC_ARB_CHNL265_CONFIG_ADDR A:0xd690004
y.create.l HWIO_PMIC_ARB_CHNL266_CONFIG_ADDR A:0xd6a0004
y.create.l HWIO_PMIC_ARB_CHNL267_CONFIG_ADDR A:0xd6b0004
y.create.l HWIO_PMIC_ARB_CHNL268_CONFIG_ADDR A:0xd6c0004
y.create.l HWIO_PMIC_ARB_CHNL269_CONFIG_ADDR A:0xd6d0004
y.create.l HWIO_PMIC_ARB_CHNL270_CONFIG_ADDR A:0xd6e0004
y.create.l HWIO_PMIC_ARB_CHNL271_CONFIG_ADDR A:0xd6f0004
y.create.l HWIO_PMIC_ARB_CHNL272_CONFIG_ADDR A:0xd700004
y.create.l HWIO_PMIC_ARB_CHNL273_CONFIG_ADDR A:0xd710004
y.create.l HWIO_PMIC_ARB_CHNL274_CONFIG_ADDR A:0xd720004
y.create.l HWIO_PMIC_ARB_CHNL275_CONFIG_ADDR A:0xd730004
y.create.l HWIO_PMIC_ARB_CHNL276_CONFIG_ADDR A:0xd740004
y.create.l HWIO_PMIC_ARB_CHNL277_CONFIG_ADDR A:0xd750004
y.create.l HWIO_PMIC_ARB_CHNL278_CONFIG_ADDR A:0xd760004
y.create.l HWIO_PMIC_ARB_CHNL279_CONFIG_ADDR A:0xd770004
y.create.l HWIO_PMIC_ARB_CHNL280_CONFIG_ADDR A:0xd780004
y.create.l HWIO_PMIC_ARB_CHNL281_CONFIG_ADDR A:0xd790004
y.create.l HWIO_PMIC_ARB_CHNL282_CONFIG_ADDR A:0xd7a0004
y.create.l HWIO_PMIC_ARB_CHNL283_CONFIG_ADDR A:0xd7b0004
y.create.l HWIO_PMIC_ARB_CHNL284_CONFIG_ADDR A:0xd7c0004
y.create.l HWIO_PMIC_ARB_CHNL285_CONFIG_ADDR A:0xd7d0004
y.create.l HWIO_PMIC_ARB_CHNL286_CONFIG_ADDR A:0xd7e0004
y.create.l HWIO_PMIC_ARB_CHNL287_CONFIG_ADDR A:0xd7f0004
y.create.l HWIO_PMIC_ARB_CHNL288_CONFIG_ADDR A:0xd800004
y.create.l HWIO_PMIC_ARB_CHNL289_CONFIG_ADDR A:0xd810004
y.create.l HWIO_PMIC_ARB_CHNL290_CONFIG_ADDR A:0xd820004
y.create.l HWIO_PMIC_ARB_CHNL291_CONFIG_ADDR A:0xd830004
y.create.l HWIO_PMIC_ARB_CHNL292_CONFIG_ADDR A:0xd840004
y.create.l HWIO_PMIC_ARB_CHNL293_CONFIG_ADDR A:0xd850004
y.create.l HWIO_PMIC_ARB_CHNL294_CONFIG_ADDR A:0xd860004
y.create.l HWIO_PMIC_ARB_CHNL295_CONFIG_ADDR A:0xd870004
y.create.l HWIO_PMIC_ARB_CHNL296_CONFIG_ADDR A:0xd880004
y.create.l HWIO_PMIC_ARB_CHNL297_CONFIG_ADDR A:0xd890004
y.create.l HWIO_PMIC_ARB_CHNL298_CONFIG_ADDR A:0xd8a0004
y.create.l HWIO_PMIC_ARB_CHNL299_CONFIG_ADDR A:0xd8b0004
y.create.l HWIO_PMIC_ARB_CHNL300_CONFIG_ADDR A:0xd8c0004
y.create.l HWIO_PMIC_ARB_CHNL301_CONFIG_ADDR A:0xd8d0004
y.create.l HWIO_PMIC_ARB_CHNL302_CONFIG_ADDR A:0xd8e0004
y.create.l HWIO_PMIC_ARB_CHNL303_CONFIG_ADDR A:0xd8f0004
y.create.l HWIO_PMIC_ARB_CHNL304_CONFIG_ADDR A:0xd900004
y.create.l HWIO_PMIC_ARB_CHNL305_CONFIG_ADDR A:0xd910004
y.create.l HWIO_PMIC_ARB_CHNL306_CONFIG_ADDR A:0xd920004
y.create.l HWIO_PMIC_ARB_CHNL307_CONFIG_ADDR A:0xd930004
y.create.l HWIO_PMIC_ARB_CHNL308_CONFIG_ADDR A:0xd940004
y.create.l HWIO_PMIC_ARB_CHNL309_CONFIG_ADDR A:0xd950004
y.create.l HWIO_PMIC_ARB_CHNL310_CONFIG_ADDR A:0xd960004
y.create.l HWIO_PMIC_ARB_CHNL311_CONFIG_ADDR A:0xd970004
y.create.l HWIO_PMIC_ARB_CHNL312_CONFIG_ADDR A:0xd980004
y.create.l HWIO_PMIC_ARB_CHNL313_CONFIG_ADDR A:0xd990004
y.create.l HWIO_PMIC_ARB_CHNL314_CONFIG_ADDR A:0xd9a0004
y.create.l HWIO_PMIC_ARB_CHNL315_CONFIG_ADDR A:0xd9b0004
y.create.l HWIO_PMIC_ARB_CHNL316_CONFIG_ADDR A:0xd9c0004
y.create.l HWIO_PMIC_ARB_CHNL317_CONFIG_ADDR A:0xd9d0004
y.create.l HWIO_PMIC_ARB_CHNL318_CONFIG_ADDR A:0xd9e0004
y.create.l HWIO_PMIC_ARB_CHNL319_CONFIG_ADDR A:0xd9f0004
y.create.l HWIO_PMIC_ARB_CHNL320_CONFIG_ADDR A:0xda00004
y.create.l HWIO_PMIC_ARB_CHNL321_CONFIG_ADDR A:0xda10004
y.create.l HWIO_PMIC_ARB_CHNL322_CONFIG_ADDR A:0xda20004
y.create.l HWIO_PMIC_ARB_CHNL323_CONFIG_ADDR A:0xda30004
y.create.l HWIO_PMIC_ARB_CHNL324_CONFIG_ADDR A:0xda40004
y.create.l HWIO_PMIC_ARB_CHNL325_CONFIG_ADDR A:0xda50004
y.create.l HWIO_PMIC_ARB_CHNL326_CONFIG_ADDR A:0xda60004
y.create.l HWIO_PMIC_ARB_CHNL327_CONFIG_ADDR A:0xda70004
y.create.l HWIO_PMIC_ARB_CHNL328_CONFIG_ADDR A:0xda80004
y.create.l HWIO_PMIC_ARB_CHNL329_CONFIG_ADDR A:0xda90004
y.create.l HWIO_PMIC_ARB_CHNL330_CONFIG_ADDR A:0xdaa0004
y.create.l HWIO_PMIC_ARB_CHNL331_CONFIG_ADDR A:0xdab0004
y.create.l HWIO_PMIC_ARB_CHNL332_CONFIG_ADDR A:0xdac0004
y.create.l HWIO_PMIC_ARB_CHNL333_CONFIG_ADDR A:0xdad0004
y.create.l HWIO_PMIC_ARB_CHNL334_CONFIG_ADDR A:0xdae0004
y.create.l HWIO_PMIC_ARB_CHNL335_CONFIG_ADDR A:0xdaf0004
y.create.l HWIO_PMIC_ARB_CHNL336_CONFIG_ADDR A:0xdb00004
y.create.l HWIO_PMIC_ARB_CHNL337_CONFIG_ADDR A:0xdb10004
y.create.l HWIO_PMIC_ARB_CHNL338_CONFIG_ADDR A:0xdb20004
y.create.l HWIO_PMIC_ARB_CHNL339_CONFIG_ADDR A:0xdb30004
y.create.l HWIO_PMIC_ARB_CHNL340_CONFIG_ADDR A:0xdb40004
y.create.l HWIO_PMIC_ARB_CHNL341_CONFIG_ADDR A:0xdb50004
y.create.l HWIO_PMIC_ARB_CHNL342_CONFIG_ADDR A:0xdb60004
y.create.l HWIO_PMIC_ARB_CHNL343_CONFIG_ADDR A:0xdb70004
y.create.l HWIO_PMIC_ARB_CHNL344_CONFIG_ADDR A:0xdb80004
y.create.l HWIO_PMIC_ARB_CHNL345_CONFIG_ADDR A:0xdb90004
y.create.l HWIO_PMIC_ARB_CHNL346_CONFIG_ADDR A:0xdba0004
y.create.l HWIO_PMIC_ARB_CHNL347_CONFIG_ADDR A:0xdbb0004
y.create.l HWIO_PMIC_ARB_CHNL348_CONFIG_ADDR A:0xdbc0004
y.create.l HWIO_PMIC_ARB_CHNL349_CONFIG_ADDR A:0xdbd0004
y.create.l HWIO_PMIC_ARB_CHNL350_CONFIG_ADDR A:0xdbe0004
y.create.l HWIO_PMIC_ARB_CHNL351_CONFIG_ADDR A:0xdbf0004
y.create.l HWIO_PMIC_ARB_CHNL352_CONFIG_ADDR A:0xdc00004
y.create.l HWIO_PMIC_ARB_CHNL353_CONFIG_ADDR A:0xdc10004
y.create.l HWIO_PMIC_ARB_CHNL354_CONFIG_ADDR A:0xdc20004
y.create.l HWIO_PMIC_ARB_CHNL355_CONFIG_ADDR A:0xdc30004
y.create.l HWIO_PMIC_ARB_CHNL356_CONFIG_ADDR A:0xdc40004
y.create.l HWIO_PMIC_ARB_CHNL357_CONFIG_ADDR A:0xdc50004
y.create.l HWIO_PMIC_ARB_CHNL358_CONFIG_ADDR A:0xdc60004
y.create.l HWIO_PMIC_ARB_CHNL359_CONFIG_ADDR A:0xdc70004
y.create.l HWIO_PMIC_ARB_CHNL360_CONFIG_ADDR A:0xdc80004
y.create.l HWIO_PMIC_ARB_CHNL361_CONFIG_ADDR A:0xdc90004
y.create.l HWIO_PMIC_ARB_CHNL362_CONFIG_ADDR A:0xdca0004
y.create.l HWIO_PMIC_ARB_CHNL363_CONFIG_ADDR A:0xdcb0004
y.create.l HWIO_PMIC_ARB_CHNL364_CONFIG_ADDR A:0xdcc0004
y.create.l HWIO_PMIC_ARB_CHNL365_CONFIG_ADDR A:0xdcd0004
y.create.l HWIO_PMIC_ARB_CHNL366_CONFIG_ADDR A:0xdce0004
y.create.l HWIO_PMIC_ARB_CHNL367_CONFIG_ADDR A:0xdcf0004
y.create.l HWIO_PMIC_ARB_CHNL368_CONFIG_ADDR A:0xdd00004
y.create.l HWIO_PMIC_ARB_CHNL369_CONFIG_ADDR A:0xdd10004
y.create.l HWIO_PMIC_ARB_CHNL370_CONFIG_ADDR A:0xdd20004
y.create.l HWIO_PMIC_ARB_CHNL371_CONFIG_ADDR A:0xdd30004
y.create.l HWIO_PMIC_ARB_CHNL372_CONFIG_ADDR A:0xdd40004
y.create.l HWIO_PMIC_ARB_CHNL373_CONFIG_ADDR A:0xdd50004
y.create.l HWIO_PMIC_ARB_CHNL374_CONFIG_ADDR A:0xdd60004
y.create.l HWIO_PMIC_ARB_CHNL375_CONFIG_ADDR A:0xdd70004
y.create.l HWIO_PMIC_ARB_CHNL376_CONFIG_ADDR A:0xdd80004
y.create.l HWIO_PMIC_ARB_CHNL377_CONFIG_ADDR A:0xdd90004
y.create.l HWIO_PMIC_ARB_CHNL378_CONFIG_ADDR A:0xdda0004
y.create.l HWIO_PMIC_ARB_CHNL379_CONFIG_ADDR A:0xddb0004
y.create.l HWIO_PMIC_ARB_CHNL380_CONFIG_ADDR A:0xddc0004
y.create.l HWIO_PMIC_ARB_CHNL381_CONFIG_ADDR A:0xddd0004
y.create.l HWIO_PMIC_ARB_CHNL382_CONFIG_ADDR A:0xdde0004
y.create.l HWIO_PMIC_ARB_CHNL383_CONFIG_ADDR A:0xddf0004
y.create.l HWIO_PMIC_ARB_CHNL384_CONFIG_ADDR A:0xde00004
y.create.l HWIO_PMIC_ARB_CHNL385_CONFIG_ADDR A:0xde10004
y.create.l HWIO_PMIC_ARB_CHNL386_CONFIG_ADDR A:0xde20004
y.create.l HWIO_PMIC_ARB_CHNL387_CONFIG_ADDR A:0xde30004
y.create.l HWIO_PMIC_ARB_CHNL388_CONFIG_ADDR A:0xde40004
y.create.l HWIO_PMIC_ARB_CHNL389_CONFIG_ADDR A:0xde50004
y.create.l HWIO_PMIC_ARB_CHNL390_CONFIG_ADDR A:0xde60004
y.create.l HWIO_PMIC_ARB_CHNL391_CONFIG_ADDR A:0xde70004
y.create.l HWIO_PMIC_ARB_CHNL392_CONFIG_ADDR A:0xde80004
y.create.l HWIO_PMIC_ARB_CHNL393_CONFIG_ADDR A:0xde90004
y.create.l HWIO_PMIC_ARB_CHNL394_CONFIG_ADDR A:0xdea0004
y.create.l HWIO_PMIC_ARB_CHNL395_CONFIG_ADDR A:0xdeb0004
y.create.l HWIO_PMIC_ARB_CHNL396_CONFIG_ADDR A:0xdec0004
y.create.l HWIO_PMIC_ARB_CHNL397_CONFIG_ADDR A:0xded0004
y.create.l HWIO_PMIC_ARB_CHNL398_CONFIG_ADDR A:0xdee0004
y.create.l HWIO_PMIC_ARB_CHNL399_CONFIG_ADDR A:0xdef0004
y.create.l HWIO_PMIC_ARB_CHNL400_CONFIG_ADDR A:0xdf00004
y.create.l HWIO_PMIC_ARB_CHNL401_CONFIG_ADDR A:0xdf10004
y.create.l HWIO_PMIC_ARB_CHNL402_CONFIG_ADDR A:0xdf20004
y.create.l HWIO_PMIC_ARB_CHNL403_CONFIG_ADDR A:0xdf30004
y.create.l HWIO_PMIC_ARB_CHNL404_CONFIG_ADDR A:0xdf40004
y.create.l HWIO_PMIC_ARB_CHNL405_CONFIG_ADDR A:0xdf50004
y.create.l HWIO_PMIC_ARB_CHNL406_CONFIG_ADDR A:0xdf60004
y.create.l HWIO_PMIC_ARB_CHNL407_CONFIG_ADDR A:0xdf70004
y.create.l HWIO_PMIC_ARB_CHNL408_CONFIG_ADDR A:0xdf80004
y.create.l HWIO_PMIC_ARB_CHNL409_CONFIG_ADDR A:0xdf90004
y.create.l HWIO_PMIC_ARB_CHNL410_CONFIG_ADDR A:0xdfa0004
y.create.l HWIO_PMIC_ARB_CHNL411_CONFIG_ADDR A:0xdfb0004
y.create.l HWIO_PMIC_ARB_CHNL412_CONFIG_ADDR A:0xdfc0004
y.create.l HWIO_PMIC_ARB_CHNL413_CONFIG_ADDR A:0xdfd0004
y.create.l HWIO_PMIC_ARB_CHNL414_CONFIG_ADDR A:0xdfe0004
y.create.l HWIO_PMIC_ARB_CHNL415_CONFIG_ADDR A:0xdff0004
y.create.l HWIO_PMIC_ARB_CHNL416_CONFIG_ADDR A:0xe000004
y.create.l HWIO_PMIC_ARB_CHNL417_CONFIG_ADDR A:0xe010004
y.create.l HWIO_PMIC_ARB_CHNL418_CONFIG_ADDR A:0xe020004
y.create.l HWIO_PMIC_ARB_CHNL419_CONFIG_ADDR A:0xe030004
y.create.l HWIO_PMIC_ARB_CHNL420_CONFIG_ADDR A:0xe040004
y.create.l HWIO_PMIC_ARB_CHNL421_CONFIG_ADDR A:0xe050004
y.create.l HWIO_PMIC_ARB_CHNL422_CONFIG_ADDR A:0xe060004
y.create.l HWIO_PMIC_ARB_CHNL423_CONFIG_ADDR A:0xe070004
y.create.l HWIO_PMIC_ARB_CHNL424_CONFIG_ADDR A:0xe080004
y.create.l HWIO_PMIC_ARB_CHNL425_CONFIG_ADDR A:0xe090004
y.create.l HWIO_PMIC_ARB_CHNL426_CONFIG_ADDR A:0xe0a0004
y.create.l HWIO_PMIC_ARB_CHNL427_CONFIG_ADDR A:0xe0b0004
y.create.l HWIO_PMIC_ARB_CHNL428_CONFIG_ADDR A:0xe0c0004
y.create.l HWIO_PMIC_ARB_CHNL429_CONFIG_ADDR A:0xe0d0004
y.create.l HWIO_PMIC_ARB_CHNL430_CONFIG_ADDR A:0xe0e0004
y.create.l HWIO_PMIC_ARB_CHNL431_CONFIG_ADDR A:0xe0f0004
y.create.l HWIO_PMIC_ARB_CHNL432_CONFIG_ADDR A:0xe100004
y.create.l HWIO_PMIC_ARB_CHNL433_CONFIG_ADDR A:0xe110004
y.create.l HWIO_PMIC_ARB_CHNL434_CONFIG_ADDR A:0xe120004
y.create.l HWIO_PMIC_ARB_CHNL435_CONFIG_ADDR A:0xe130004
y.create.l HWIO_PMIC_ARB_CHNL436_CONFIG_ADDR A:0xe140004
y.create.l HWIO_PMIC_ARB_CHNL437_CONFIG_ADDR A:0xe150004
y.create.l HWIO_PMIC_ARB_CHNL438_CONFIG_ADDR A:0xe160004
y.create.l HWIO_PMIC_ARB_CHNL439_CONFIG_ADDR A:0xe170004
y.create.l HWIO_PMIC_ARB_CHNL440_CONFIG_ADDR A:0xe180004
y.create.l HWIO_PMIC_ARB_CHNL441_CONFIG_ADDR A:0xe190004
y.create.l HWIO_PMIC_ARB_CHNL442_CONFIG_ADDR A:0xe1a0004
y.create.l HWIO_PMIC_ARB_CHNL443_CONFIG_ADDR A:0xe1b0004
y.create.l HWIO_PMIC_ARB_CHNL444_CONFIG_ADDR A:0xe1c0004
y.create.l HWIO_PMIC_ARB_CHNL445_CONFIG_ADDR A:0xe1d0004
y.create.l HWIO_PMIC_ARB_CHNL446_CONFIG_ADDR A:0xe1e0004
y.create.l HWIO_PMIC_ARB_CHNL447_CONFIG_ADDR A:0xe1f0004
y.create.l HWIO_PMIC_ARB_CHNL448_CONFIG_ADDR A:0xe200004
y.create.l HWIO_PMIC_ARB_CHNL449_CONFIG_ADDR A:0xe210004
y.create.l HWIO_PMIC_ARB_CHNL450_CONFIG_ADDR A:0xe220004
y.create.l HWIO_PMIC_ARB_CHNL451_CONFIG_ADDR A:0xe230004
y.create.l HWIO_PMIC_ARB_CHNL452_CONFIG_ADDR A:0xe240004
y.create.l HWIO_PMIC_ARB_CHNL453_CONFIG_ADDR A:0xe250004
y.create.l HWIO_PMIC_ARB_CHNL454_CONFIG_ADDR A:0xe260004
y.create.l HWIO_PMIC_ARB_CHNL455_CONFIG_ADDR A:0xe270004
y.create.l HWIO_PMIC_ARB_CHNL456_CONFIG_ADDR A:0xe280004
y.create.l HWIO_PMIC_ARB_CHNL457_CONFIG_ADDR A:0xe290004
y.create.l HWIO_PMIC_ARB_CHNL458_CONFIG_ADDR A:0xe2a0004
y.create.l HWIO_PMIC_ARB_CHNL459_CONFIG_ADDR A:0xe2b0004
y.create.l HWIO_PMIC_ARB_CHNL460_CONFIG_ADDR A:0xe2c0004
y.create.l HWIO_PMIC_ARB_CHNL461_CONFIG_ADDR A:0xe2d0004
y.create.l HWIO_PMIC_ARB_CHNL462_CONFIG_ADDR A:0xe2e0004
y.create.l HWIO_PMIC_ARB_CHNL463_CONFIG_ADDR A:0xe2f0004
y.create.l HWIO_PMIC_ARB_CHNL464_CONFIG_ADDR A:0xe300004
y.create.l HWIO_PMIC_ARB_CHNL465_CONFIG_ADDR A:0xe310004
y.create.l HWIO_PMIC_ARB_CHNL466_CONFIG_ADDR A:0xe320004
y.create.l HWIO_PMIC_ARB_CHNL467_CONFIG_ADDR A:0xe330004
y.create.l HWIO_PMIC_ARB_CHNL468_CONFIG_ADDR A:0xe340004
y.create.l HWIO_PMIC_ARB_CHNL469_CONFIG_ADDR A:0xe350004
y.create.l HWIO_PMIC_ARB_CHNL470_CONFIG_ADDR A:0xe360004
y.create.l HWIO_PMIC_ARB_CHNL471_CONFIG_ADDR A:0xe370004
y.create.l HWIO_PMIC_ARB_CHNL472_CONFIG_ADDR A:0xe380004
y.create.l HWIO_PMIC_ARB_CHNL473_CONFIG_ADDR A:0xe390004
y.create.l HWIO_PMIC_ARB_CHNL474_CONFIG_ADDR A:0xe3a0004
y.create.l HWIO_PMIC_ARB_CHNL475_CONFIG_ADDR A:0xe3b0004
y.create.l HWIO_PMIC_ARB_CHNL476_CONFIG_ADDR A:0xe3c0004
y.create.l HWIO_PMIC_ARB_CHNL477_CONFIG_ADDR A:0xe3d0004
y.create.l HWIO_PMIC_ARB_CHNL478_CONFIG_ADDR A:0xe3e0004
y.create.l HWIO_PMIC_ARB_CHNL479_CONFIG_ADDR A:0xe3f0004
y.create.l HWIO_PMIC_ARB_CHNL480_CONFIG_ADDR A:0xe400004
y.create.l HWIO_PMIC_ARB_CHNL481_CONFIG_ADDR A:0xe410004
y.create.l HWIO_PMIC_ARB_CHNL482_CONFIG_ADDR A:0xe420004
y.create.l HWIO_PMIC_ARB_CHNL483_CONFIG_ADDR A:0xe430004
y.create.l HWIO_PMIC_ARB_CHNL484_CONFIG_ADDR A:0xe440004
y.create.l HWIO_PMIC_ARB_CHNL485_CONFIG_ADDR A:0xe450004
y.create.l HWIO_PMIC_ARB_CHNL486_CONFIG_ADDR A:0xe460004
y.create.l HWIO_PMIC_ARB_CHNL487_CONFIG_ADDR A:0xe470004
y.create.l HWIO_PMIC_ARB_CHNL488_CONFIG_ADDR A:0xe480004
y.create.l HWIO_PMIC_ARB_CHNL489_CONFIG_ADDR A:0xe490004
y.create.l HWIO_PMIC_ARB_CHNL490_CONFIG_ADDR A:0xe4a0004
y.create.l HWIO_PMIC_ARB_CHNL491_CONFIG_ADDR A:0xe4b0004
y.create.l HWIO_PMIC_ARB_CHNL492_CONFIG_ADDR A:0xe4c0004
y.create.l HWIO_PMIC_ARB_CHNL493_CONFIG_ADDR A:0xe4d0004
y.create.l HWIO_PMIC_ARB_CHNL494_CONFIG_ADDR A:0xe4e0004
y.create.l HWIO_PMIC_ARB_CHNL495_CONFIG_ADDR A:0xe4f0004
y.create.l HWIO_PMIC_ARB_CHNL496_CONFIG_ADDR A:0xe500004
y.create.l HWIO_PMIC_ARB_CHNL497_CONFIG_ADDR A:0xe510004
y.create.l HWIO_PMIC_ARB_CHNL498_CONFIG_ADDR A:0xe520004
y.create.l HWIO_PMIC_ARB_CHNL499_CONFIG_ADDR A:0xe530004
y.create.l HWIO_PMIC_ARB_CHNL500_CONFIG_ADDR A:0xe540004
y.create.l HWIO_PMIC_ARB_CHNL501_CONFIG_ADDR A:0xe550004
y.create.l HWIO_PMIC_ARB_CHNL502_CONFIG_ADDR A:0xe560004
y.create.l HWIO_PMIC_ARB_CHNL503_CONFIG_ADDR A:0xe570004
y.create.l HWIO_PMIC_ARB_CHNL504_CONFIG_ADDR A:0xe580004
y.create.l HWIO_PMIC_ARB_CHNL505_CONFIG_ADDR A:0xe590004
y.create.l HWIO_PMIC_ARB_CHNL506_CONFIG_ADDR A:0xe5a0004
y.create.l HWIO_PMIC_ARB_CHNL507_CONFIG_ADDR A:0xe5b0004
y.create.l HWIO_PMIC_ARB_CHNL508_CONFIG_ADDR A:0xe5c0004
y.create.l HWIO_PMIC_ARB_CHNL509_CONFIG_ADDR A:0xe5d0004
y.create.l HWIO_PMIC_ARB_CHNL510_CONFIG_ADDR A:0xe5e0004
y.create.l HWIO_PMIC_ARB_CHNL511_CONFIG_ADDR A:0xe5f0004
y.create.l HWIO_PMIC_ARB_CHNL0_STATUS_ADDR A:0xc600008
y.create.l HWIO_PMIC_ARB_CHNL1_STATUS_ADDR A:0xc610008
y.create.l HWIO_PMIC_ARB_CHNL2_STATUS_ADDR A:0xc620008
y.create.l HWIO_PMIC_ARB_CHNL3_STATUS_ADDR A:0xc630008
y.create.l HWIO_PMIC_ARB_CHNL4_STATUS_ADDR A:0xc640008
y.create.l HWIO_PMIC_ARB_CHNL5_STATUS_ADDR A:0xc650008
y.create.l HWIO_PMIC_ARB_CHNL6_STATUS_ADDR A:0xc660008
y.create.l HWIO_PMIC_ARB_CHNL7_STATUS_ADDR A:0xc670008
y.create.l HWIO_PMIC_ARB_CHNL8_STATUS_ADDR A:0xc680008
y.create.l HWIO_PMIC_ARB_CHNL9_STATUS_ADDR A:0xc690008
y.create.l HWIO_PMIC_ARB_CHNL10_STATUS_ADDR A:0xc6a0008
y.create.l HWIO_PMIC_ARB_CHNL11_STATUS_ADDR A:0xc6b0008
y.create.l HWIO_PMIC_ARB_CHNL12_STATUS_ADDR A:0xc6c0008
y.create.l HWIO_PMIC_ARB_CHNL13_STATUS_ADDR A:0xc6d0008
y.create.l HWIO_PMIC_ARB_CHNL14_STATUS_ADDR A:0xc6e0008
y.create.l HWIO_PMIC_ARB_CHNL15_STATUS_ADDR A:0xc6f0008
y.create.l HWIO_PMIC_ARB_CHNL16_STATUS_ADDR A:0xc700008
y.create.l HWIO_PMIC_ARB_CHNL17_STATUS_ADDR A:0xc710008
y.create.l HWIO_PMIC_ARB_CHNL18_STATUS_ADDR A:0xc720008
y.create.l HWIO_PMIC_ARB_CHNL19_STATUS_ADDR A:0xc730008
y.create.l HWIO_PMIC_ARB_CHNL20_STATUS_ADDR A:0xc740008
y.create.l HWIO_PMIC_ARB_CHNL21_STATUS_ADDR A:0xc750008
y.create.l HWIO_PMIC_ARB_CHNL22_STATUS_ADDR A:0xc760008
y.create.l HWIO_PMIC_ARB_CHNL23_STATUS_ADDR A:0xc770008
y.create.l HWIO_PMIC_ARB_CHNL24_STATUS_ADDR A:0xc780008
y.create.l HWIO_PMIC_ARB_CHNL25_STATUS_ADDR A:0xc790008
y.create.l HWIO_PMIC_ARB_CHNL26_STATUS_ADDR A:0xc7a0008
y.create.l HWIO_PMIC_ARB_CHNL27_STATUS_ADDR A:0xc7b0008
y.create.l HWIO_PMIC_ARB_CHNL28_STATUS_ADDR A:0xc7c0008
y.create.l HWIO_PMIC_ARB_CHNL29_STATUS_ADDR A:0xc7d0008
y.create.l HWIO_PMIC_ARB_CHNL30_STATUS_ADDR A:0xc7e0008
y.create.l HWIO_PMIC_ARB_CHNL31_STATUS_ADDR A:0xc7f0008
y.create.l HWIO_PMIC_ARB_CHNL32_STATUS_ADDR A:0xc800008
y.create.l HWIO_PMIC_ARB_CHNL33_STATUS_ADDR A:0xc810008
y.create.l HWIO_PMIC_ARB_CHNL34_STATUS_ADDR A:0xc820008
y.create.l HWIO_PMIC_ARB_CHNL35_STATUS_ADDR A:0xc830008
y.create.l HWIO_PMIC_ARB_CHNL36_STATUS_ADDR A:0xc840008
y.create.l HWIO_PMIC_ARB_CHNL37_STATUS_ADDR A:0xc850008
y.create.l HWIO_PMIC_ARB_CHNL38_STATUS_ADDR A:0xc860008
y.create.l HWIO_PMIC_ARB_CHNL39_STATUS_ADDR A:0xc870008
y.create.l HWIO_PMIC_ARB_CHNL40_STATUS_ADDR A:0xc880008
y.create.l HWIO_PMIC_ARB_CHNL41_STATUS_ADDR A:0xc890008
y.create.l HWIO_PMIC_ARB_CHNL42_STATUS_ADDR A:0xc8a0008
y.create.l HWIO_PMIC_ARB_CHNL43_STATUS_ADDR A:0xc8b0008
y.create.l HWIO_PMIC_ARB_CHNL44_STATUS_ADDR A:0xc8c0008
y.create.l HWIO_PMIC_ARB_CHNL45_STATUS_ADDR A:0xc8d0008
y.create.l HWIO_PMIC_ARB_CHNL46_STATUS_ADDR A:0xc8e0008
y.create.l HWIO_PMIC_ARB_CHNL47_STATUS_ADDR A:0xc8f0008
y.create.l HWIO_PMIC_ARB_CHNL48_STATUS_ADDR A:0xc900008
y.create.l HWIO_PMIC_ARB_CHNL49_STATUS_ADDR A:0xc910008
y.create.l HWIO_PMIC_ARB_CHNL50_STATUS_ADDR A:0xc920008
y.create.l HWIO_PMIC_ARB_CHNL51_STATUS_ADDR A:0xc930008
y.create.l HWIO_PMIC_ARB_CHNL52_STATUS_ADDR A:0xc940008
y.create.l HWIO_PMIC_ARB_CHNL53_STATUS_ADDR A:0xc950008
y.create.l HWIO_PMIC_ARB_CHNL54_STATUS_ADDR A:0xc960008
y.create.l HWIO_PMIC_ARB_CHNL55_STATUS_ADDR A:0xc970008
y.create.l HWIO_PMIC_ARB_CHNL56_STATUS_ADDR A:0xc980008
y.create.l HWIO_PMIC_ARB_CHNL57_STATUS_ADDR A:0xc990008
y.create.l HWIO_PMIC_ARB_CHNL58_STATUS_ADDR A:0xc9a0008
y.create.l HWIO_PMIC_ARB_CHNL59_STATUS_ADDR A:0xc9b0008
y.create.l HWIO_PMIC_ARB_CHNL60_STATUS_ADDR A:0xc9c0008
y.create.l HWIO_PMIC_ARB_CHNL61_STATUS_ADDR A:0xc9d0008
y.create.l HWIO_PMIC_ARB_CHNL62_STATUS_ADDR A:0xc9e0008
y.create.l HWIO_PMIC_ARB_CHNL63_STATUS_ADDR A:0xc9f0008
y.create.l HWIO_PMIC_ARB_CHNL64_STATUS_ADDR A:0xca00008
y.create.l HWIO_PMIC_ARB_CHNL65_STATUS_ADDR A:0xca10008
y.create.l HWIO_PMIC_ARB_CHNL66_STATUS_ADDR A:0xca20008
y.create.l HWIO_PMIC_ARB_CHNL67_STATUS_ADDR A:0xca30008
y.create.l HWIO_PMIC_ARB_CHNL68_STATUS_ADDR A:0xca40008
y.create.l HWIO_PMIC_ARB_CHNL69_STATUS_ADDR A:0xca50008
y.create.l HWIO_PMIC_ARB_CHNL70_STATUS_ADDR A:0xca60008
y.create.l HWIO_PMIC_ARB_CHNL71_STATUS_ADDR A:0xca70008
y.create.l HWIO_PMIC_ARB_CHNL72_STATUS_ADDR A:0xca80008
y.create.l HWIO_PMIC_ARB_CHNL73_STATUS_ADDR A:0xca90008
y.create.l HWIO_PMIC_ARB_CHNL74_STATUS_ADDR A:0xcaa0008
y.create.l HWIO_PMIC_ARB_CHNL75_STATUS_ADDR A:0xcab0008
y.create.l HWIO_PMIC_ARB_CHNL76_STATUS_ADDR A:0xcac0008
y.create.l HWIO_PMIC_ARB_CHNL77_STATUS_ADDR A:0xcad0008
y.create.l HWIO_PMIC_ARB_CHNL78_STATUS_ADDR A:0xcae0008
y.create.l HWIO_PMIC_ARB_CHNL79_STATUS_ADDR A:0xcaf0008
y.create.l HWIO_PMIC_ARB_CHNL80_STATUS_ADDR A:0xcb00008
y.create.l HWIO_PMIC_ARB_CHNL81_STATUS_ADDR A:0xcb10008
y.create.l HWIO_PMIC_ARB_CHNL82_STATUS_ADDR A:0xcb20008
y.create.l HWIO_PMIC_ARB_CHNL83_STATUS_ADDR A:0xcb30008
y.create.l HWIO_PMIC_ARB_CHNL84_STATUS_ADDR A:0xcb40008
y.create.l HWIO_PMIC_ARB_CHNL85_STATUS_ADDR A:0xcb50008
y.create.l HWIO_PMIC_ARB_CHNL86_STATUS_ADDR A:0xcb60008
y.create.l HWIO_PMIC_ARB_CHNL87_STATUS_ADDR A:0xcb70008
y.create.l HWIO_PMIC_ARB_CHNL88_STATUS_ADDR A:0xcb80008
y.create.l HWIO_PMIC_ARB_CHNL89_STATUS_ADDR A:0xcb90008
y.create.l HWIO_PMIC_ARB_CHNL90_STATUS_ADDR A:0xcba0008
y.create.l HWIO_PMIC_ARB_CHNL91_STATUS_ADDR A:0xcbb0008
y.create.l HWIO_PMIC_ARB_CHNL92_STATUS_ADDR A:0xcbc0008
y.create.l HWIO_PMIC_ARB_CHNL93_STATUS_ADDR A:0xcbd0008
y.create.l HWIO_PMIC_ARB_CHNL94_STATUS_ADDR A:0xcbe0008
y.create.l HWIO_PMIC_ARB_CHNL95_STATUS_ADDR A:0xcbf0008
y.create.l HWIO_PMIC_ARB_CHNL96_STATUS_ADDR A:0xcc00008
y.create.l HWIO_PMIC_ARB_CHNL97_STATUS_ADDR A:0xcc10008
y.create.l HWIO_PMIC_ARB_CHNL98_STATUS_ADDR A:0xcc20008
y.create.l HWIO_PMIC_ARB_CHNL99_STATUS_ADDR A:0xcc30008
y.create.l HWIO_PMIC_ARB_CHNL100_STATUS_ADDR A:0xcc40008
y.create.l HWIO_PMIC_ARB_CHNL101_STATUS_ADDR A:0xcc50008
y.create.l HWIO_PMIC_ARB_CHNL102_STATUS_ADDR A:0xcc60008
y.create.l HWIO_PMIC_ARB_CHNL103_STATUS_ADDR A:0xcc70008
y.create.l HWIO_PMIC_ARB_CHNL104_STATUS_ADDR A:0xcc80008
y.create.l HWIO_PMIC_ARB_CHNL105_STATUS_ADDR A:0xcc90008
y.create.l HWIO_PMIC_ARB_CHNL106_STATUS_ADDR A:0xcca0008
y.create.l HWIO_PMIC_ARB_CHNL107_STATUS_ADDR A:0xccb0008
y.create.l HWIO_PMIC_ARB_CHNL108_STATUS_ADDR A:0xccc0008
y.create.l HWIO_PMIC_ARB_CHNL109_STATUS_ADDR A:0xccd0008
y.create.l HWIO_PMIC_ARB_CHNL110_STATUS_ADDR A:0xcce0008
y.create.l HWIO_PMIC_ARB_CHNL111_STATUS_ADDR A:0xccf0008
y.create.l HWIO_PMIC_ARB_CHNL112_STATUS_ADDR A:0xcd00008
y.create.l HWIO_PMIC_ARB_CHNL113_STATUS_ADDR A:0xcd10008
y.create.l HWIO_PMIC_ARB_CHNL114_STATUS_ADDR A:0xcd20008
y.create.l HWIO_PMIC_ARB_CHNL115_STATUS_ADDR A:0xcd30008
y.create.l HWIO_PMIC_ARB_CHNL116_STATUS_ADDR A:0xcd40008
y.create.l HWIO_PMIC_ARB_CHNL117_STATUS_ADDR A:0xcd50008
y.create.l HWIO_PMIC_ARB_CHNL118_STATUS_ADDR A:0xcd60008
y.create.l HWIO_PMIC_ARB_CHNL119_STATUS_ADDR A:0xcd70008
y.create.l HWIO_PMIC_ARB_CHNL120_STATUS_ADDR A:0xcd80008
y.create.l HWIO_PMIC_ARB_CHNL121_STATUS_ADDR A:0xcd90008
y.create.l HWIO_PMIC_ARB_CHNL122_STATUS_ADDR A:0xcda0008
y.create.l HWIO_PMIC_ARB_CHNL123_STATUS_ADDR A:0xcdb0008
y.create.l HWIO_PMIC_ARB_CHNL124_STATUS_ADDR A:0xcdc0008
y.create.l HWIO_PMIC_ARB_CHNL125_STATUS_ADDR A:0xcdd0008
y.create.l HWIO_PMIC_ARB_CHNL126_STATUS_ADDR A:0xcde0008
y.create.l HWIO_PMIC_ARB_CHNL127_STATUS_ADDR A:0xcdf0008
y.create.l HWIO_PMIC_ARB_CHNL128_STATUS_ADDR A:0xce00008
y.create.l HWIO_PMIC_ARB_CHNL129_STATUS_ADDR A:0xce10008
y.create.l HWIO_PMIC_ARB_CHNL130_STATUS_ADDR A:0xce20008
y.create.l HWIO_PMIC_ARB_CHNL131_STATUS_ADDR A:0xce30008
y.create.l HWIO_PMIC_ARB_CHNL132_STATUS_ADDR A:0xce40008
y.create.l HWIO_PMIC_ARB_CHNL133_STATUS_ADDR A:0xce50008
y.create.l HWIO_PMIC_ARB_CHNL134_STATUS_ADDR A:0xce60008
y.create.l HWIO_PMIC_ARB_CHNL135_STATUS_ADDR A:0xce70008
y.create.l HWIO_PMIC_ARB_CHNL136_STATUS_ADDR A:0xce80008
y.create.l HWIO_PMIC_ARB_CHNL137_STATUS_ADDR A:0xce90008
y.create.l HWIO_PMIC_ARB_CHNL138_STATUS_ADDR A:0xcea0008
y.create.l HWIO_PMIC_ARB_CHNL139_STATUS_ADDR A:0xceb0008
y.create.l HWIO_PMIC_ARB_CHNL140_STATUS_ADDR A:0xcec0008
y.create.l HWIO_PMIC_ARB_CHNL141_STATUS_ADDR A:0xced0008
y.create.l HWIO_PMIC_ARB_CHNL142_STATUS_ADDR A:0xcee0008
y.create.l HWIO_PMIC_ARB_CHNL143_STATUS_ADDR A:0xcef0008
y.create.l HWIO_PMIC_ARB_CHNL144_STATUS_ADDR A:0xcf00008
y.create.l HWIO_PMIC_ARB_CHNL145_STATUS_ADDR A:0xcf10008
y.create.l HWIO_PMIC_ARB_CHNL146_STATUS_ADDR A:0xcf20008
y.create.l HWIO_PMIC_ARB_CHNL147_STATUS_ADDR A:0xcf30008
y.create.l HWIO_PMIC_ARB_CHNL148_STATUS_ADDR A:0xcf40008
y.create.l HWIO_PMIC_ARB_CHNL149_STATUS_ADDR A:0xcf50008
y.create.l HWIO_PMIC_ARB_CHNL150_STATUS_ADDR A:0xcf60008
y.create.l HWIO_PMIC_ARB_CHNL151_STATUS_ADDR A:0xcf70008
y.create.l HWIO_PMIC_ARB_CHNL152_STATUS_ADDR A:0xcf80008
y.create.l HWIO_PMIC_ARB_CHNL153_STATUS_ADDR A:0xcf90008
y.create.l HWIO_PMIC_ARB_CHNL154_STATUS_ADDR A:0xcfa0008
y.create.l HWIO_PMIC_ARB_CHNL155_STATUS_ADDR A:0xcfb0008
y.create.l HWIO_PMIC_ARB_CHNL156_STATUS_ADDR A:0xcfc0008
y.create.l HWIO_PMIC_ARB_CHNL157_STATUS_ADDR A:0xcfd0008
y.create.l HWIO_PMIC_ARB_CHNL158_STATUS_ADDR A:0xcfe0008
y.create.l HWIO_PMIC_ARB_CHNL159_STATUS_ADDR A:0xcff0008
y.create.l HWIO_PMIC_ARB_CHNL160_STATUS_ADDR A:0xd000008
y.create.l HWIO_PMIC_ARB_CHNL161_STATUS_ADDR A:0xd010008
y.create.l HWIO_PMIC_ARB_CHNL162_STATUS_ADDR A:0xd020008
y.create.l HWIO_PMIC_ARB_CHNL163_STATUS_ADDR A:0xd030008
y.create.l HWIO_PMIC_ARB_CHNL164_STATUS_ADDR A:0xd040008
y.create.l HWIO_PMIC_ARB_CHNL165_STATUS_ADDR A:0xd050008
y.create.l HWIO_PMIC_ARB_CHNL166_STATUS_ADDR A:0xd060008
y.create.l HWIO_PMIC_ARB_CHNL167_STATUS_ADDR A:0xd070008
y.create.l HWIO_PMIC_ARB_CHNL168_STATUS_ADDR A:0xd080008
y.create.l HWIO_PMIC_ARB_CHNL169_STATUS_ADDR A:0xd090008
y.create.l HWIO_PMIC_ARB_CHNL170_STATUS_ADDR A:0xd0a0008
y.create.l HWIO_PMIC_ARB_CHNL171_STATUS_ADDR A:0xd0b0008
y.create.l HWIO_PMIC_ARB_CHNL172_STATUS_ADDR A:0xd0c0008
y.create.l HWIO_PMIC_ARB_CHNL173_STATUS_ADDR A:0xd0d0008
y.create.l HWIO_PMIC_ARB_CHNL174_STATUS_ADDR A:0xd0e0008
y.create.l HWIO_PMIC_ARB_CHNL175_STATUS_ADDR A:0xd0f0008
y.create.l HWIO_PMIC_ARB_CHNL176_STATUS_ADDR A:0xd100008
y.create.l HWIO_PMIC_ARB_CHNL177_STATUS_ADDR A:0xd110008
y.create.l HWIO_PMIC_ARB_CHNL178_STATUS_ADDR A:0xd120008
y.create.l HWIO_PMIC_ARB_CHNL179_STATUS_ADDR A:0xd130008
y.create.l HWIO_PMIC_ARB_CHNL180_STATUS_ADDR A:0xd140008
y.create.l HWIO_PMIC_ARB_CHNL181_STATUS_ADDR A:0xd150008
y.create.l HWIO_PMIC_ARB_CHNL182_STATUS_ADDR A:0xd160008
y.create.l HWIO_PMIC_ARB_CHNL183_STATUS_ADDR A:0xd170008
y.create.l HWIO_PMIC_ARB_CHNL184_STATUS_ADDR A:0xd180008
y.create.l HWIO_PMIC_ARB_CHNL185_STATUS_ADDR A:0xd190008
y.create.l HWIO_PMIC_ARB_CHNL186_STATUS_ADDR A:0xd1a0008
y.create.l HWIO_PMIC_ARB_CHNL187_STATUS_ADDR A:0xd1b0008
y.create.l HWIO_PMIC_ARB_CHNL188_STATUS_ADDR A:0xd1c0008
y.create.l HWIO_PMIC_ARB_CHNL189_STATUS_ADDR A:0xd1d0008
y.create.l HWIO_PMIC_ARB_CHNL190_STATUS_ADDR A:0xd1e0008
y.create.l HWIO_PMIC_ARB_CHNL191_STATUS_ADDR A:0xd1f0008
y.create.l HWIO_PMIC_ARB_CHNL192_STATUS_ADDR A:0xd200008
y.create.l HWIO_PMIC_ARB_CHNL193_STATUS_ADDR A:0xd210008
y.create.l HWIO_PMIC_ARB_CHNL194_STATUS_ADDR A:0xd220008
y.create.l HWIO_PMIC_ARB_CHNL195_STATUS_ADDR A:0xd230008
y.create.l HWIO_PMIC_ARB_CHNL196_STATUS_ADDR A:0xd240008
y.create.l HWIO_PMIC_ARB_CHNL197_STATUS_ADDR A:0xd250008
y.create.l HWIO_PMIC_ARB_CHNL198_STATUS_ADDR A:0xd260008
y.create.l HWIO_PMIC_ARB_CHNL199_STATUS_ADDR A:0xd270008
y.create.l HWIO_PMIC_ARB_CHNL200_STATUS_ADDR A:0xd280008
y.create.l HWIO_PMIC_ARB_CHNL201_STATUS_ADDR A:0xd290008
y.create.l HWIO_PMIC_ARB_CHNL202_STATUS_ADDR A:0xd2a0008
y.create.l HWIO_PMIC_ARB_CHNL203_STATUS_ADDR A:0xd2b0008
y.create.l HWIO_PMIC_ARB_CHNL204_STATUS_ADDR A:0xd2c0008
y.create.l HWIO_PMIC_ARB_CHNL205_STATUS_ADDR A:0xd2d0008
y.create.l HWIO_PMIC_ARB_CHNL206_STATUS_ADDR A:0xd2e0008
y.create.l HWIO_PMIC_ARB_CHNL207_STATUS_ADDR A:0xd2f0008
y.create.l HWIO_PMIC_ARB_CHNL208_STATUS_ADDR A:0xd300008
y.create.l HWIO_PMIC_ARB_CHNL209_STATUS_ADDR A:0xd310008
y.create.l HWIO_PMIC_ARB_CHNL210_STATUS_ADDR A:0xd320008
y.create.l HWIO_PMIC_ARB_CHNL211_STATUS_ADDR A:0xd330008
y.create.l HWIO_PMIC_ARB_CHNL212_STATUS_ADDR A:0xd340008
y.create.l HWIO_PMIC_ARB_CHNL213_STATUS_ADDR A:0xd350008
y.create.l HWIO_PMIC_ARB_CHNL214_STATUS_ADDR A:0xd360008
y.create.l HWIO_PMIC_ARB_CHNL215_STATUS_ADDR A:0xd370008
y.create.l HWIO_PMIC_ARB_CHNL216_STATUS_ADDR A:0xd380008
y.create.l HWIO_PMIC_ARB_CHNL217_STATUS_ADDR A:0xd390008
y.create.l HWIO_PMIC_ARB_CHNL218_STATUS_ADDR A:0xd3a0008
y.create.l HWIO_PMIC_ARB_CHNL219_STATUS_ADDR A:0xd3b0008
y.create.l HWIO_PMIC_ARB_CHNL220_STATUS_ADDR A:0xd3c0008
y.create.l HWIO_PMIC_ARB_CHNL221_STATUS_ADDR A:0xd3d0008
y.create.l HWIO_PMIC_ARB_CHNL222_STATUS_ADDR A:0xd3e0008
y.create.l HWIO_PMIC_ARB_CHNL223_STATUS_ADDR A:0xd3f0008
y.create.l HWIO_PMIC_ARB_CHNL224_STATUS_ADDR A:0xd400008
y.create.l HWIO_PMIC_ARB_CHNL225_STATUS_ADDR A:0xd410008
y.create.l HWIO_PMIC_ARB_CHNL226_STATUS_ADDR A:0xd420008
y.create.l HWIO_PMIC_ARB_CHNL227_STATUS_ADDR A:0xd430008
y.create.l HWIO_PMIC_ARB_CHNL228_STATUS_ADDR A:0xd440008
y.create.l HWIO_PMIC_ARB_CHNL229_STATUS_ADDR A:0xd450008
y.create.l HWIO_PMIC_ARB_CHNL230_STATUS_ADDR A:0xd460008
y.create.l HWIO_PMIC_ARB_CHNL231_STATUS_ADDR A:0xd470008
y.create.l HWIO_PMIC_ARB_CHNL232_STATUS_ADDR A:0xd480008
y.create.l HWIO_PMIC_ARB_CHNL233_STATUS_ADDR A:0xd490008
y.create.l HWIO_PMIC_ARB_CHNL234_STATUS_ADDR A:0xd4a0008
y.create.l HWIO_PMIC_ARB_CHNL235_STATUS_ADDR A:0xd4b0008
y.create.l HWIO_PMIC_ARB_CHNL236_STATUS_ADDR A:0xd4c0008
y.create.l HWIO_PMIC_ARB_CHNL237_STATUS_ADDR A:0xd4d0008
y.create.l HWIO_PMIC_ARB_CHNL238_STATUS_ADDR A:0xd4e0008
y.create.l HWIO_PMIC_ARB_CHNL239_STATUS_ADDR A:0xd4f0008
y.create.l HWIO_PMIC_ARB_CHNL240_STATUS_ADDR A:0xd500008
y.create.l HWIO_PMIC_ARB_CHNL241_STATUS_ADDR A:0xd510008
y.create.l HWIO_PMIC_ARB_CHNL242_STATUS_ADDR A:0xd520008
y.create.l HWIO_PMIC_ARB_CHNL243_STATUS_ADDR A:0xd530008
y.create.l HWIO_PMIC_ARB_CHNL244_STATUS_ADDR A:0xd540008
y.create.l HWIO_PMIC_ARB_CHNL245_STATUS_ADDR A:0xd550008
y.create.l HWIO_PMIC_ARB_CHNL246_STATUS_ADDR A:0xd560008
y.create.l HWIO_PMIC_ARB_CHNL247_STATUS_ADDR A:0xd570008
y.create.l HWIO_PMIC_ARB_CHNL248_STATUS_ADDR A:0xd580008
y.create.l HWIO_PMIC_ARB_CHNL249_STATUS_ADDR A:0xd590008
y.create.l HWIO_PMIC_ARB_CHNL250_STATUS_ADDR A:0xd5a0008
y.create.l HWIO_PMIC_ARB_CHNL251_STATUS_ADDR A:0xd5b0008
y.create.l HWIO_PMIC_ARB_CHNL252_STATUS_ADDR A:0xd5c0008
y.create.l HWIO_PMIC_ARB_CHNL253_STATUS_ADDR A:0xd5d0008
y.create.l HWIO_PMIC_ARB_CHNL254_STATUS_ADDR A:0xd5e0008
y.create.l HWIO_PMIC_ARB_CHNL255_STATUS_ADDR A:0xd5f0008
y.create.l HWIO_PMIC_ARB_CHNL256_STATUS_ADDR A:0xd600008
y.create.l HWIO_PMIC_ARB_CHNL257_STATUS_ADDR A:0xd610008
y.create.l HWIO_PMIC_ARB_CHNL258_STATUS_ADDR A:0xd620008
y.create.l HWIO_PMIC_ARB_CHNL259_STATUS_ADDR A:0xd630008
y.create.l HWIO_PMIC_ARB_CHNL260_STATUS_ADDR A:0xd640008
y.create.l HWIO_PMIC_ARB_CHNL261_STATUS_ADDR A:0xd650008
y.create.l HWIO_PMIC_ARB_CHNL262_STATUS_ADDR A:0xd660008
y.create.l HWIO_PMIC_ARB_CHNL263_STATUS_ADDR A:0xd670008
y.create.l HWIO_PMIC_ARB_CHNL264_STATUS_ADDR A:0xd680008
y.create.l HWIO_PMIC_ARB_CHNL265_STATUS_ADDR A:0xd690008
y.create.l HWIO_PMIC_ARB_CHNL266_STATUS_ADDR A:0xd6a0008
y.create.l HWIO_PMIC_ARB_CHNL267_STATUS_ADDR A:0xd6b0008
y.create.l HWIO_PMIC_ARB_CHNL268_STATUS_ADDR A:0xd6c0008
y.create.l HWIO_PMIC_ARB_CHNL269_STATUS_ADDR A:0xd6d0008
y.create.l HWIO_PMIC_ARB_CHNL270_STATUS_ADDR A:0xd6e0008
y.create.l HWIO_PMIC_ARB_CHNL271_STATUS_ADDR A:0xd6f0008
y.create.l HWIO_PMIC_ARB_CHNL272_STATUS_ADDR A:0xd700008
y.create.l HWIO_PMIC_ARB_CHNL273_STATUS_ADDR A:0xd710008
y.create.l HWIO_PMIC_ARB_CHNL274_STATUS_ADDR A:0xd720008
y.create.l HWIO_PMIC_ARB_CHNL275_STATUS_ADDR A:0xd730008
y.create.l HWIO_PMIC_ARB_CHNL276_STATUS_ADDR A:0xd740008
y.create.l HWIO_PMIC_ARB_CHNL277_STATUS_ADDR A:0xd750008
y.create.l HWIO_PMIC_ARB_CHNL278_STATUS_ADDR A:0xd760008
y.create.l HWIO_PMIC_ARB_CHNL279_STATUS_ADDR A:0xd770008
y.create.l HWIO_PMIC_ARB_CHNL280_STATUS_ADDR A:0xd780008
y.create.l HWIO_PMIC_ARB_CHNL281_STATUS_ADDR A:0xd790008
y.create.l HWIO_PMIC_ARB_CHNL282_STATUS_ADDR A:0xd7a0008
y.create.l HWIO_PMIC_ARB_CHNL283_STATUS_ADDR A:0xd7b0008
y.create.l HWIO_PMIC_ARB_CHNL284_STATUS_ADDR A:0xd7c0008
y.create.l HWIO_PMIC_ARB_CHNL285_STATUS_ADDR A:0xd7d0008
y.create.l HWIO_PMIC_ARB_CHNL286_STATUS_ADDR A:0xd7e0008
y.create.l HWIO_PMIC_ARB_CHNL287_STATUS_ADDR A:0xd7f0008
y.create.l HWIO_PMIC_ARB_CHNL288_STATUS_ADDR A:0xd800008
y.create.l HWIO_PMIC_ARB_CHNL289_STATUS_ADDR A:0xd810008
y.create.l HWIO_PMIC_ARB_CHNL290_STATUS_ADDR A:0xd820008
y.create.l HWIO_PMIC_ARB_CHNL291_STATUS_ADDR A:0xd830008
y.create.l HWIO_PMIC_ARB_CHNL292_STATUS_ADDR A:0xd840008
y.create.l HWIO_PMIC_ARB_CHNL293_STATUS_ADDR A:0xd850008
y.create.l HWIO_PMIC_ARB_CHNL294_STATUS_ADDR A:0xd860008
y.create.l HWIO_PMIC_ARB_CHNL295_STATUS_ADDR A:0xd870008
y.create.l HWIO_PMIC_ARB_CHNL296_STATUS_ADDR A:0xd880008
y.create.l HWIO_PMIC_ARB_CHNL297_STATUS_ADDR A:0xd890008
y.create.l HWIO_PMIC_ARB_CHNL298_STATUS_ADDR A:0xd8a0008
y.create.l HWIO_PMIC_ARB_CHNL299_STATUS_ADDR A:0xd8b0008
y.create.l HWIO_PMIC_ARB_CHNL300_STATUS_ADDR A:0xd8c0008
y.create.l HWIO_PMIC_ARB_CHNL301_STATUS_ADDR A:0xd8d0008
y.create.l HWIO_PMIC_ARB_CHNL302_STATUS_ADDR A:0xd8e0008
y.create.l HWIO_PMIC_ARB_CHNL303_STATUS_ADDR A:0xd8f0008
y.create.l HWIO_PMIC_ARB_CHNL304_STATUS_ADDR A:0xd900008
y.create.l HWIO_PMIC_ARB_CHNL305_STATUS_ADDR A:0xd910008
y.create.l HWIO_PMIC_ARB_CHNL306_STATUS_ADDR A:0xd920008
y.create.l HWIO_PMIC_ARB_CHNL307_STATUS_ADDR A:0xd930008
y.create.l HWIO_PMIC_ARB_CHNL308_STATUS_ADDR A:0xd940008
y.create.l HWIO_PMIC_ARB_CHNL309_STATUS_ADDR A:0xd950008
y.create.l HWIO_PMIC_ARB_CHNL310_STATUS_ADDR A:0xd960008
y.create.l HWIO_PMIC_ARB_CHNL311_STATUS_ADDR A:0xd970008
y.create.l HWIO_PMIC_ARB_CHNL312_STATUS_ADDR A:0xd980008
y.create.l HWIO_PMIC_ARB_CHNL313_STATUS_ADDR A:0xd990008
y.create.l HWIO_PMIC_ARB_CHNL314_STATUS_ADDR A:0xd9a0008
y.create.l HWIO_PMIC_ARB_CHNL315_STATUS_ADDR A:0xd9b0008
y.create.l HWIO_PMIC_ARB_CHNL316_STATUS_ADDR A:0xd9c0008
y.create.l HWIO_PMIC_ARB_CHNL317_STATUS_ADDR A:0xd9d0008
y.create.l HWIO_PMIC_ARB_CHNL318_STATUS_ADDR A:0xd9e0008
y.create.l HWIO_PMIC_ARB_CHNL319_STATUS_ADDR A:0xd9f0008
y.create.l HWIO_PMIC_ARB_CHNL320_STATUS_ADDR A:0xda00008
y.create.l HWIO_PMIC_ARB_CHNL321_STATUS_ADDR A:0xda10008
y.create.l HWIO_PMIC_ARB_CHNL322_STATUS_ADDR A:0xda20008
y.create.l HWIO_PMIC_ARB_CHNL323_STATUS_ADDR A:0xda30008
y.create.l HWIO_PMIC_ARB_CHNL324_STATUS_ADDR A:0xda40008
y.create.l HWIO_PMIC_ARB_CHNL325_STATUS_ADDR A:0xda50008
y.create.l HWIO_PMIC_ARB_CHNL326_STATUS_ADDR A:0xda60008
y.create.l HWIO_PMIC_ARB_CHNL327_STATUS_ADDR A:0xda70008
y.create.l HWIO_PMIC_ARB_CHNL328_STATUS_ADDR A:0xda80008
y.create.l HWIO_PMIC_ARB_CHNL329_STATUS_ADDR A:0xda90008
y.create.l HWIO_PMIC_ARB_CHNL330_STATUS_ADDR A:0xdaa0008
y.create.l HWIO_PMIC_ARB_CHNL331_STATUS_ADDR A:0xdab0008
y.create.l HWIO_PMIC_ARB_CHNL332_STATUS_ADDR A:0xdac0008
y.create.l HWIO_PMIC_ARB_CHNL333_STATUS_ADDR A:0xdad0008
y.create.l HWIO_PMIC_ARB_CHNL334_STATUS_ADDR A:0xdae0008
y.create.l HWIO_PMIC_ARB_CHNL335_STATUS_ADDR A:0xdaf0008
y.create.l HWIO_PMIC_ARB_CHNL336_STATUS_ADDR A:0xdb00008
y.create.l HWIO_PMIC_ARB_CHNL337_STATUS_ADDR A:0xdb10008
y.create.l HWIO_PMIC_ARB_CHNL338_STATUS_ADDR A:0xdb20008
y.create.l HWIO_PMIC_ARB_CHNL339_STATUS_ADDR A:0xdb30008
y.create.l HWIO_PMIC_ARB_CHNL340_STATUS_ADDR A:0xdb40008
y.create.l HWIO_PMIC_ARB_CHNL341_STATUS_ADDR A:0xdb50008
y.create.l HWIO_PMIC_ARB_CHNL342_STATUS_ADDR A:0xdb60008
y.create.l HWIO_PMIC_ARB_CHNL343_STATUS_ADDR A:0xdb70008
y.create.l HWIO_PMIC_ARB_CHNL344_STATUS_ADDR A:0xdb80008
y.create.l HWIO_PMIC_ARB_CHNL345_STATUS_ADDR A:0xdb90008
y.create.l HWIO_PMIC_ARB_CHNL346_STATUS_ADDR A:0xdba0008
y.create.l HWIO_PMIC_ARB_CHNL347_STATUS_ADDR A:0xdbb0008
y.create.l HWIO_PMIC_ARB_CHNL348_STATUS_ADDR A:0xdbc0008
y.create.l HWIO_PMIC_ARB_CHNL349_STATUS_ADDR A:0xdbd0008
y.create.l HWIO_PMIC_ARB_CHNL350_STATUS_ADDR A:0xdbe0008
y.create.l HWIO_PMIC_ARB_CHNL351_STATUS_ADDR A:0xdbf0008
y.create.l HWIO_PMIC_ARB_CHNL352_STATUS_ADDR A:0xdc00008
y.create.l HWIO_PMIC_ARB_CHNL353_STATUS_ADDR A:0xdc10008
y.create.l HWIO_PMIC_ARB_CHNL354_STATUS_ADDR A:0xdc20008
y.create.l HWIO_PMIC_ARB_CHNL355_STATUS_ADDR A:0xdc30008
y.create.l HWIO_PMIC_ARB_CHNL356_STATUS_ADDR A:0xdc40008
y.create.l HWIO_PMIC_ARB_CHNL357_STATUS_ADDR A:0xdc50008
y.create.l HWIO_PMIC_ARB_CHNL358_STATUS_ADDR A:0xdc60008
y.create.l HWIO_PMIC_ARB_CHNL359_STATUS_ADDR A:0xdc70008
y.create.l HWIO_PMIC_ARB_CHNL360_STATUS_ADDR A:0xdc80008
y.create.l HWIO_PMIC_ARB_CHNL361_STATUS_ADDR A:0xdc90008
y.create.l HWIO_PMIC_ARB_CHNL362_STATUS_ADDR A:0xdca0008
y.create.l HWIO_PMIC_ARB_CHNL363_STATUS_ADDR A:0xdcb0008
y.create.l HWIO_PMIC_ARB_CHNL364_STATUS_ADDR A:0xdcc0008
y.create.l HWIO_PMIC_ARB_CHNL365_STATUS_ADDR A:0xdcd0008
y.create.l HWIO_PMIC_ARB_CHNL366_STATUS_ADDR A:0xdce0008
y.create.l HWIO_PMIC_ARB_CHNL367_STATUS_ADDR A:0xdcf0008
y.create.l HWIO_PMIC_ARB_CHNL368_STATUS_ADDR A:0xdd00008
y.create.l HWIO_PMIC_ARB_CHNL369_STATUS_ADDR A:0xdd10008
y.create.l HWIO_PMIC_ARB_CHNL370_STATUS_ADDR A:0xdd20008
y.create.l HWIO_PMIC_ARB_CHNL371_STATUS_ADDR A:0xdd30008
y.create.l HWIO_PMIC_ARB_CHNL372_STATUS_ADDR A:0xdd40008
y.create.l HWIO_PMIC_ARB_CHNL373_STATUS_ADDR A:0xdd50008
y.create.l HWIO_PMIC_ARB_CHNL374_STATUS_ADDR A:0xdd60008
y.create.l HWIO_PMIC_ARB_CHNL375_STATUS_ADDR A:0xdd70008
y.create.l HWIO_PMIC_ARB_CHNL376_STATUS_ADDR A:0xdd80008
y.create.l HWIO_PMIC_ARB_CHNL377_STATUS_ADDR A:0xdd90008
y.create.l HWIO_PMIC_ARB_CHNL378_STATUS_ADDR A:0xdda0008
y.create.l HWIO_PMIC_ARB_CHNL379_STATUS_ADDR A:0xddb0008
y.create.l HWIO_PMIC_ARB_CHNL380_STATUS_ADDR A:0xddc0008
y.create.l HWIO_PMIC_ARB_CHNL381_STATUS_ADDR A:0xddd0008
y.create.l HWIO_PMIC_ARB_CHNL382_STATUS_ADDR A:0xdde0008
y.create.l HWIO_PMIC_ARB_CHNL383_STATUS_ADDR A:0xddf0008
y.create.l HWIO_PMIC_ARB_CHNL384_STATUS_ADDR A:0xde00008
y.create.l HWIO_PMIC_ARB_CHNL385_STATUS_ADDR A:0xde10008
y.create.l HWIO_PMIC_ARB_CHNL386_STATUS_ADDR A:0xde20008
y.create.l HWIO_PMIC_ARB_CHNL387_STATUS_ADDR A:0xde30008
y.create.l HWIO_PMIC_ARB_CHNL388_STATUS_ADDR A:0xde40008
y.create.l HWIO_PMIC_ARB_CHNL389_STATUS_ADDR A:0xde50008
y.create.l HWIO_PMIC_ARB_CHNL390_STATUS_ADDR A:0xde60008
y.create.l HWIO_PMIC_ARB_CHNL391_STATUS_ADDR A:0xde70008
y.create.l HWIO_PMIC_ARB_CHNL392_STATUS_ADDR A:0xde80008
y.create.l HWIO_PMIC_ARB_CHNL393_STATUS_ADDR A:0xde90008
y.create.l HWIO_PMIC_ARB_CHNL394_STATUS_ADDR A:0xdea0008
y.create.l HWIO_PMIC_ARB_CHNL395_STATUS_ADDR A:0xdeb0008
y.create.l HWIO_PMIC_ARB_CHNL396_STATUS_ADDR A:0xdec0008
y.create.l HWIO_PMIC_ARB_CHNL397_STATUS_ADDR A:0xded0008
y.create.l HWIO_PMIC_ARB_CHNL398_STATUS_ADDR A:0xdee0008
y.create.l HWIO_PMIC_ARB_CHNL399_STATUS_ADDR A:0xdef0008
y.create.l HWIO_PMIC_ARB_CHNL400_STATUS_ADDR A:0xdf00008
y.create.l HWIO_PMIC_ARB_CHNL401_STATUS_ADDR A:0xdf10008
y.create.l HWIO_PMIC_ARB_CHNL402_STATUS_ADDR A:0xdf20008
y.create.l HWIO_PMIC_ARB_CHNL403_STATUS_ADDR A:0xdf30008
y.create.l HWIO_PMIC_ARB_CHNL404_STATUS_ADDR A:0xdf40008
y.create.l HWIO_PMIC_ARB_CHNL405_STATUS_ADDR A:0xdf50008
y.create.l HWIO_PMIC_ARB_CHNL406_STATUS_ADDR A:0xdf60008
y.create.l HWIO_PMIC_ARB_CHNL407_STATUS_ADDR A:0xdf70008
y.create.l HWIO_PMIC_ARB_CHNL408_STATUS_ADDR A:0xdf80008
y.create.l HWIO_PMIC_ARB_CHNL409_STATUS_ADDR A:0xdf90008
y.create.l HWIO_PMIC_ARB_CHNL410_STATUS_ADDR A:0xdfa0008
y.create.l HWIO_PMIC_ARB_CHNL411_STATUS_ADDR A:0xdfb0008
y.create.l HWIO_PMIC_ARB_CHNL412_STATUS_ADDR A:0xdfc0008
y.create.l HWIO_PMIC_ARB_CHNL413_STATUS_ADDR A:0xdfd0008
y.create.l HWIO_PMIC_ARB_CHNL414_STATUS_ADDR A:0xdfe0008
y.create.l HWIO_PMIC_ARB_CHNL415_STATUS_ADDR A:0xdff0008
y.create.l HWIO_PMIC_ARB_CHNL416_STATUS_ADDR A:0xe000008
y.create.l HWIO_PMIC_ARB_CHNL417_STATUS_ADDR A:0xe010008
y.create.l HWIO_PMIC_ARB_CHNL418_STATUS_ADDR A:0xe020008
y.create.l HWIO_PMIC_ARB_CHNL419_STATUS_ADDR A:0xe030008
y.create.l HWIO_PMIC_ARB_CHNL420_STATUS_ADDR A:0xe040008
y.create.l HWIO_PMIC_ARB_CHNL421_STATUS_ADDR A:0xe050008
y.create.l HWIO_PMIC_ARB_CHNL422_STATUS_ADDR A:0xe060008
y.create.l HWIO_PMIC_ARB_CHNL423_STATUS_ADDR A:0xe070008
y.create.l HWIO_PMIC_ARB_CHNL424_STATUS_ADDR A:0xe080008
y.create.l HWIO_PMIC_ARB_CHNL425_STATUS_ADDR A:0xe090008
y.create.l HWIO_PMIC_ARB_CHNL426_STATUS_ADDR A:0xe0a0008
y.create.l HWIO_PMIC_ARB_CHNL427_STATUS_ADDR A:0xe0b0008
y.create.l HWIO_PMIC_ARB_CHNL428_STATUS_ADDR A:0xe0c0008
y.create.l HWIO_PMIC_ARB_CHNL429_STATUS_ADDR A:0xe0d0008
y.create.l HWIO_PMIC_ARB_CHNL430_STATUS_ADDR A:0xe0e0008
y.create.l HWIO_PMIC_ARB_CHNL431_STATUS_ADDR A:0xe0f0008
y.create.l HWIO_PMIC_ARB_CHNL432_STATUS_ADDR A:0xe100008
y.create.l HWIO_PMIC_ARB_CHNL433_STATUS_ADDR A:0xe110008
y.create.l HWIO_PMIC_ARB_CHNL434_STATUS_ADDR A:0xe120008
y.create.l HWIO_PMIC_ARB_CHNL435_STATUS_ADDR A:0xe130008
y.create.l HWIO_PMIC_ARB_CHNL436_STATUS_ADDR A:0xe140008
y.create.l HWIO_PMIC_ARB_CHNL437_STATUS_ADDR A:0xe150008
y.create.l HWIO_PMIC_ARB_CHNL438_STATUS_ADDR A:0xe160008
y.create.l HWIO_PMIC_ARB_CHNL439_STATUS_ADDR A:0xe170008
y.create.l HWIO_PMIC_ARB_CHNL440_STATUS_ADDR A:0xe180008
y.create.l HWIO_PMIC_ARB_CHNL441_STATUS_ADDR A:0xe190008
y.create.l HWIO_PMIC_ARB_CHNL442_STATUS_ADDR A:0xe1a0008
y.create.l HWIO_PMIC_ARB_CHNL443_STATUS_ADDR A:0xe1b0008
y.create.l HWIO_PMIC_ARB_CHNL444_STATUS_ADDR A:0xe1c0008
y.create.l HWIO_PMIC_ARB_CHNL445_STATUS_ADDR A:0xe1d0008
y.create.l HWIO_PMIC_ARB_CHNL446_STATUS_ADDR A:0xe1e0008
y.create.l HWIO_PMIC_ARB_CHNL447_STATUS_ADDR A:0xe1f0008
y.create.l HWIO_PMIC_ARB_CHNL448_STATUS_ADDR A:0xe200008
y.create.l HWIO_PMIC_ARB_CHNL449_STATUS_ADDR A:0xe210008
y.create.l HWIO_PMIC_ARB_CHNL450_STATUS_ADDR A:0xe220008
y.create.l HWIO_PMIC_ARB_CHNL451_STATUS_ADDR A:0xe230008
y.create.l HWIO_PMIC_ARB_CHNL452_STATUS_ADDR A:0xe240008
y.create.l HWIO_PMIC_ARB_CHNL453_STATUS_ADDR A:0xe250008
y.create.l HWIO_PMIC_ARB_CHNL454_STATUS_ADDR A:0xe260008
y.create.l HWIO_PMIC_ARB_CHNL455_STATUS_ADDR A:0xe270008
y.create.l HWIO_PMIC_ARB_CHNL456_STATUS_ADDR A:0xe280008
y.create.l HWIO_PMIC_ARB_CHNL457_STATUS_ADDR A:0xe290008
y.create.l HWIO_PMIC_ARB_CHNL458_STATUS_ADDR A:0xe2a0008
y.create.l HWIO_PMIC_ARB_CHNL459_STATUS_ADDR A:0xe2b0008
y.create.l HWIO_PMIC_ARB_CHNL460_STATUS_ADDR A:0xe2c0008
y.create.l HWIO_PMIC_ARB_CHNL461_STATUS_ADDR A:0xe2d0008
y.create.l HWIO_PMIC_ARB_CHNL462_STATUS_ADDR A:0xe2e0008
y.create.l HWIO_PMIC_ARB_CHNL463_STATUS_ADDR A:0xe2f0008
y.create.l HWIO_PMIC_ARB_CHNL464_STATUS_ADDR A:0xe300008
y.create.l HWIO_PMIC_ARB_CHNL465_STATUS_ADDR A:0xe310008
y.create.l HWIO_PMIC_ARB_CHNL466_STATUS_ADDR A:0xe320008
y.create.l HWIO_PMIC_ARB_CHNL467_STATUS_ADDR A:0xe330008
y.create.l HWIO_PMIC_ARB_CHNL468_STATUS_ADDR A:0xe340008
y.create.l HWIO_PMIC_ARB_CHNL469_STATUS_ADDR A:0xe350008
y.create.l HWIO_PMIC_ARB_CHNL470_STATUS_ADDR A:0xe360008
y.create.l HWIO_PMIC_ARB_CHNL471_STATUS_ADDR A:0xe370008
y.create.l HWIO_PMIC_ARB_CHNL472_STATUS_ADDR A:0xe380008
y.create.l HWIO_PMIC_ARB_CHNL473_STATUS_ADDR A:0xe390008
y.create.l HWIO_PMIC_ARB_CHNL474_STATUS_ADDR A:0xe3a0008
y.create.l HWIO_PMIC_ARB_CHNL475_STATUS_ADDR A:0xe3b0008
y.create.l HWIO_PMIC_ARB_CHNL476_STATUS_ADDR A:0xe3c0008
y.create.l HWIO_PMIC_ARB_CHNL477_STATUS_ADDR A:0xe3d0008
y.create.l HWIO_PMIC_ARB_CHNL478_STATUS_ADDR A:0xe3e0008
y.create.l HWIO_PMIC_ARB_CHNL479_STATUS_ADDR A:0xe3f0008
y.create.l HWIO_PMIC_ARB_CHNL480_STATUS_ADDR A:0xe400008
y.create.l HWIO_PMIC_ARB_CHNL481_STATUS_ADDR A:0xe410008
y.create.l HWIO_PMIC_ARB_CHNL482_STATUS_ADDR A:0xe420008
y.create.l HWIO_PMIC_ARB_CHNL483_STATUS_ADDR A:0xe430008
y.create.l HWIO_PMIC_ARB_CHNL484_STATUS_ADDR A:0xe440008
y.create.l HWIO_PMIC_ARB_CHNL485_STATUS_ADDR A:0xe450008
y.create.l HWIO_PMIC_ARB_CHNL486_STATUS_ADDR A:0xe460008
y.create.l HWIO_PMIC_ARB_CHNL487_STATUS_ADDR A:0xe470008
y.create.l HWIO_PMIC_ARB_CHNL488_STATUS_ADDR A:0xe480008
y.create.l HWIO_PMIC_ARB_CHNL489_STATUS_ADDR A:0xe490008
y.create.l HWIO_PMIC_ARB_CHNL490_STATUS_ADDR A:0xe4a0008
y.create.l HWIO_PMIC_ARB_CHNL491_STATUS_ADDR A:0xe4b0008
y.create.l HWIO_PMIC_ARB_CHNL492_STATUS_ADDR A:0xe4c0008
y.create.l HWIO_PMIC_ARB_CHNL493_STATUS_ADDR A:0xe4d0008
y.create.l HWIO_PMIC_ARB_CHNL494_STATUS_ADDR A:0xe4e0008
y.create.l HWIO_PMIC_ARB_CHNL495_STATUS_ADDR A:0xe4f0008
y.create.l HWIO_PMIC_ARB_CHNL496_STATUS_ADDR A:0xe500008
y.create.l HWIO_PMIC_ARB_CHNL497_STATUS_ADDR A:0xe510008
y.create.l HWIO_PMIC_ARB_CHNL498_STATUS_ADDR A:0xe520008
y.create.l HWIO_PMIC_ARB_CHNL499_STATUS_ADDR A:0xe530008
y.create.l HWIO_PMIC_ARB_CHNL500_STATUS_ADDR A:0xe540008
y.create.l HWIO_PMIC_ARB_CHNL501_STATUS_ADDR A:0xe550008
y.create.l HWIO_PMIC_ARB_CHNL502_STATUS_ADDR A:0xe560008
y.create.l HWIO_PMIC_ARB_CHNL503_STATUS_ADDR A:0xe570008
y.create.l HWIO_PMIC_ARB_CHNL504_STATUS_ADDR A:0xe580008
y.create.l HWIO_PMIC_ARB_CHNL505_STATUS_ADDR A:0xe590008
y.create.l HWIO_PMIC_ARB_CHNL506_STATUS_ADDR A:0xe5a0008
y.create.l HWIO_PMIC_ARB_CHNL507_STATUS_ADDR A:0xe5b0008
y.create.l HWIO_PMIC_ARB_CHNL508_STATUS_ADDR A:0xe5c0008
y.create.l HWIO_PMIC_ARB_CHNL509_STATUS_ADDR A:0xe5d0008
y.create.l HWIO_PMIC_ARB_CHNL510_STATUS_ADDR A:0xe5e0008
y.create.l HWIO_PMIC_ARB_CHNL511_STATUS_ADDR A:0xe5f0008
y.create.l HWIO_PMIC_ARB_CHNL0_WDATA0_ADDR A:0xc600010
y.create.l HWIO_PMIC_ARB_CHNL1_WDATA0_ADDR A:0xc610010
y.create.l HWIO_PMIC_ARB_CHNL2_WDATA0_ADDR A:0xc620010
y.create.l HWIO_PMIC_ARB_CHNL3_WDATA0_ADDR A:0xc630010
y.create.l HWIO_PMIC_ARB_CHNL4_WDATA0_ADDR A:0xc640010
y.create.l HWIO_PMIC_ARB_CHNL5_WDATA0_ADDR A:0xc650010
y.create.l HWIO_PMIC_ARB_CHNL6_WDATA0_ADDR A:0xc660010
y.create.l HWIO_PMIC_ARB_CHNL7_WDATA0_ADDR A:0xc670010
y.create.l HWIO_PMIC_ARB_CHNL8_WDATA0_ADDR A:0xc680010
y.create.l HWIO_PMIC_ARB_CHNL9_WDATA0_ADDR A:0xc690010
y.create.l HWIO_PMIC_ARB_CHNL10_WDATA0_ADDR A:0xc6a0010
y.create.l HWIO_PMIC_ARB_CHNL11_WDATA0_ADDR A:0xc6b0010
y.create.l HWIO_PMIC_ARB_CHNL12_WDATA0_ADDR A:0xc6c0010
y.create.l HWIO_PMIC_ARB_CHNL13_WDATA0_ADDR A:0xc6d0010
y.create.l HWIO_PMIC_ARB_CHNL14_WDATA0_ADDR A:0xc6e0010
y.create.l HWIO_PMIC_ARB_CHNL15_WDATA0_ADDR A:0xc6f0010
y.create.l HWIO_PMIC_ARB_CHNL16_WDATA0_ADDR A:0xc700010
y.create.l HWIO_PMIC_ARB_CHNL17_WDATA0_ADDR A:0xc710010
y.create.l HWIO_PMIC_ARB_CHNL18_WDATA0_ADDR A:0xc720010
y.create.l HWIO_PMIC_ARB_CHNL19_WDATA0_ADDR A:0xc730010
y.create.l HWIO_PMIC_ARB_CHNL20_WDATA0_ADDR A:0xc740010
y.create.l HWIO_PMIC_ARB_CHNL21_WDATA0_ADDR A:0xc750010
y.create.l HWIO_PMIC_ARB_CHNL22_WDATA0_ADDR A:0xc760010
y.create.l HWIO_PMIC_ARB_CHNL23_WDATA0_ADDR A:0xc770010
y.create.l HWIO_PMIC_ARB_CHNL24_WDATA0_ADDR A:0xc780010
y.create.l HWIO_PMIC_ARB_CHNL25_WDATA0_ADDR A:0xc790010
y.create.l HWIO_PMIC_ARB_CHNL26_WDATA0_ADDR A:0xc7a0010
y.create.l HWIO_PMIC_ARB_CHNL27_WDATA0_ADDR A:0xc7b0010
y.create.l HWIO_PMIC_ARB_CHNL28_WDATA0_ADDR A:0xc7c0010
y.create.l HWIO_PMIC_ARB_CHNL29_WDATA0_ADDR A:0xc7d0010
y.create.l HWIO_PMIC_ARB_CHNL30_WDATA0_ADDR A:0xc7e0010
y.create.l HWIO_PMIC_ARB_CHNL31_WDATA0_ADDR A:0xc7f0010
y.create.l HWIO_PMIC_ARB_CHNL32_WDATA0_ADDR A:0xc800010
y.create.l HWIO_PMIC_ARB_CHNL33_WDATA0_ADDR A:0xc810010
y.create.l HWIO_PMIC_ARB_CHNL34_WDATA0_ADDR A:0xc820010
y.create.l HWIO_PMIC_ARB_CHNL35_WDATA0_ADDR A:0xc830010
y.create.l HWIO_PMIC_ARB_CHNL36_WDATA0_ADDR A:0xc840010
y.create.l HWIO_PMIC_ARB_CHNL37_WDATA0_ADDR A:0xc850010
y.create.l HWIO_PMIC_ARB_CHNL38_WDATA0_ADDR A:0xc860010
y.create.l HWIO_PMIC_ARB_CHNL39_WDATA0_ADDR A:0xc870010
y.create.l HWIO_PMIC_ARB_CHNL40_WDATA0_ADDR A:0xc880010
y.create.l HWIO_PMIC_ARB_CHNL41_WDATA0_ADDR A:0xc890010
y.create.l HWIO_PMIC_ARB_CHNL42_WDATA0_ADDR A:0xc8a0010
y.create.l HWIO_PMIC_ARB_CHNL43_WDATA0_ADDR A:0xc8b0010
y.create.l HWIO_PMIC_ARB_CHNL44_WDATA0_ADDR A:0xc8c0010
y.create.l HWIO_PMIC_ARB_CHNL45_WDATA0_ADDR A:0xc8d0010
y.create.l HWIO_PMIC_ARB_CHNL46_WDATA0_ADDR A:0xc8e0010
y.create.l HWIO_PMIC_ARB_CHNL47_WDATA0_ADDR A:0xc8f0010
y.create.l HWIO_PMIC_ARB_CHNL48_WDATA0_ADDR A:0xc900010
y.create.l HWIO_PMIC_ARB_CHNL49_WDATA0_ADDR A:0xc910010
y.create.l HWIO_PMIC_ARB_CHNL50_WDATA0_ADDR A:0xc920010
y.create.l HWIO_PMIC_ARB_CHNL51_WDATA0_ADDR A:0xc930010
y.create.l HWIO_PMIC_ARB_CHNL52_WDATA0_ADDR A:0xc940010
y.create.l HWIO_PMIC_ARB_CHNL53_WDATA0_ADDR A:0xc950010
y.create.l HWIO_PMIC_ARB_CHNL54_WDATA0_ADDR A:0xc960010
y.create.l HWIO_PMIC_ARB_CHNL55_WDATA0_ADDR A:0xc970010
y.create.l HWIO_PMIC_ARB_CHNL56_WDATA0_ADDR A:0xc980010
y.create.l HWIO_PMIC_ARB_CHNL57_WDATA0_ADDR A:0xc990010
y.create.l HWIO_PMIC_ARB_CHNL58_WDATA0_ADDR A:0xc9a0010
y.create.l HWIO_PMIC_ARB_CHNL59_WDATA0_ADDR A:0xc9b0010
y.create.l HWIO_PMIC_ARB_CHNL60_WDATA0_ADDR A:0xc9c0010
y.create.l HWIO_PMIC_ARB_CHNL61_WDATA0_ADDR A:0xc9d0010
y.create.l HWIO_PMIC_ARB_CHNL62_WDATA0_ADDR A:0xc9e0010
y.create.l HWIO_PMIC_ARB_CHNL63_WDATA0_ADDR A:0xc9f0010
y.create.l HWIO_PMIC_ARB_CHNL64_WDATA0_ADDR A:0xca00010
y.create.l HWIO_PMIC_ARB_CHNL65_WDATA0_ADDR A:0xca10010
y.create.l HWIO_PMIC_ARB_CHNL66_WDATA0_ADDR A:0xca20010
y.create.l HWIO_PMIC_ARB_CHNL67_WDATA0_ADDR A:0xca30010
y.create.l HWIO_PMIC_ARB_CHNL68_WDATA0_ADDR A:0xca40010
y.create.l HWIO_PMIC_ARB_CHNL69_WDATA0_ADDR A:0xca50010
y.create.l HWIO_PMIC_ARB_CHNL70_WDATA0_ADDR A:0xca60010
y.create.l HWIO_PMIC_ARB_CHNL71_WDATA0_ADDR A:0xca70010
y.create.l HWIO_PMIC_ARB_CHNL72_WDATA0_ADDR A:0xca80010
y.create.l HWIO_PMIC_ARB_CHNL73_WDATA0_ADDR A:0xca90010
y.create.l HWIO_PMIC_ARB_CHNL74_WDATA0_ADDR A:0xcaa0010
y.create.l HWIO_PMIC_ARB_CHNL75_WDATA0_ADDR A:0xcab0010
y.create.l HWIO_PMIC_ARB_CHNL76_WDATA0_ADDR A:0xcac0010
y.create.l HWIO_PMIC_ARB_CHNL77_WDATA0_ADDR A:0xcad0010
y.create.l HWIO_PMIC_ARB_CHNL78_WDATA0_ADDR A:0xcae0010
y.create.l HWIO_PMIC_ARB_CHNL79_WDATA0_ADDR A:0xcaf0010
y.create.l HWIO_PMIC_ARB_CHNL80_WDATA0_ADDR A:0xcb00010
y.create.l HWIO_PMIC_ARB_CHNL81_WDATA0_ADDR A:0xcb10010
y.create.l HWIO_PMIC_ARB_CHNL82_WDATA0_ADDR A:0xcb20010
y.create.l HWIO_PMIC_ARB_CHNL83_WDATA0_ADDR A:0xcb30010
y.create.l HWIO_PMIC_ARB_CHNL84_WDATA0_ADDR A:0xcb40010
y.create.l HWIO_PMIC_ARB_CHNL85_WDATA0_ADDR A:0xcb50010
y.create.l HWIO_PMIC_ARB_CHNL86_WDATA0_ADDR A:0xcb60010
y.create.l HWIO_PMIC_ARB_CHNL87_WDATA0_ADDR A:0xcb70010
y.create.l HWIO_PMIC_ARB_CHNL88_WDATA0_ADDR A:0xcb80010
y.create.l HWIO_PMIC_ARB_CHNL89_WDATA0_ADDR A:0xcb90010
y.create.l HWIO_PMIC_ARB_CHNL90_WDATA0_ADDR A:0xcba0010
y.create.l HWIO_PMIC_ARB_CHNL91_WDATA0_ADDR A:0xcbb0010
y.create.l HWIO_PMIC_ARB_CHNL92_WDATA0_ADDR A:0xcbc0010
y.create.l HWIO_PMIC_ARB_CHNL93_WDATA0_ADDR A:0xcbd0010
y.create.l HWIO_PMIC_ARB_CHNL94_WDATA0_ADDR A:0xcbe0010
y.create.l HWIO_PMIC_ARB_CHNL95_WDATA0_ADDR A:0xcbf0010
y.create.l HWIO_PMIC_ARB_CHNL96_WDATA0_ADDR A:0xcc00010
y.create.l HWIO_PMIC_ARB_CHNL97_WDATA0_ADDR A:0xcc10010
y.create.l HWIO_PMIC_ARB_CHNL98_WDATA0_ADDR A:0xcc20010
y.create.l HWIO_PMIC_ARB_CHNL99_WDATA0_ADDR A:0xcc30010
y.create.l HWIO_PMIC_ARB_CHNL100_WDATA0_ADDR A:0xcc40010
y.create.l HWIO_PMIC_ARB_CHNL101_WDATA0_ADDR A:0xcc50010
y.create.l HWIO_PMIC_ARB_CHNL102_WDATA0_ADDR A:0xcc60010
y.create.l HWIO_PMIC_ARB_CHNL103_WDATA0_ADDR A:0xcc70010
y.create.l HWIO_PMIC_ARB_CHNL104_WDATA0_ADDR A:0xcc80010
y.create.l HWIO_PMIC_ARB_CHNL105_WDATA0_ADDR A:0xcc90010
y.create.l HWIO_PMIC_ARB_CHNL106_WDATA0_ADDR A:0xcca0010
y.create.l HWIO_PMIC_ARB_CHNL107_WDATA0_ADDR A:0xccb0010
y.create.l HWIO_PMIC_ARB_CHNL108_WDATA0_ADDR A:0xccc0010
y.create.l HWIO_PMIC_ARB_CHNL109_WDATA0_ADDR A:0xccd0010
y.create.l HWIO_PMIC_ARB_CHNL110_WDATA0_ADDR A:0xcce0010
y.create.l HWIO_PMIC_ARB_CHNL111_WDATA0_ADDR A:0xccf0010
y.create.l HWIO_PMIC_ARB_CHNL112_WDATA0_ADDR A:0xcd00010
y.create.l HWIO_PMIC_ARB_CHNL113_WDATA0_ADDR A:0xcd10010
y.create.l HWIO_PMIC_ARB_CHNL114_WDATA0_ADDR A:0xcd20010
y.create.l HWIO_PMIC_ARB_CHNL115_WDATA0_ADDR A:0xcd30010
y.create.l HWIO_PMIC_ARB_CHNL116_WDATA0_ADDR A:0xcd40010
y.create.l HWIO_PMIC_ARB_CHNL117_WDATA0_ADDR A:0xcd50010
y.create.l HWIO_PMIC_ARB_CHNL118_WDATA0_ADDR A:0xcd60010
y.create.l HWIO_PMIC_ARB_CHNL119_WDATA0_ADDR A:0xcd70010
y.create.l HWIO_PMIC_ARB_CHNL120_WDATA0_ADDR A:0xcd80010
y.create.l HWIO_PMIC_ARB_CHNL121_WDATA0_ADDR A:0xcd90010
y.create.l HWIO_PMIC_ARB_CHNL122_WDATA0_ADDR A:0xcda0010
y.create.l HWIO_PMIC_ARB_CHNL123_WDATA0_ADDR A:0xcdb0010
y.create.l HWIO_PMIC_ARB_CHNL124_WDATA0_ADDR A:0xcdc0010
y.create.l HWIO_PMIC_ARB_CHNL125_WDATA0_ADDR A:0xcdd0010
y.create.l HWIO_PMIC_ARB_CHNL126_WDATA0_ADDR A:0xcde0010
y.create.l HWIO_PMIC_ARB_CHNL127_WDATA0_ADDR A:0xcdf0010
y.create.l HWIO_PMIC_ARB_CHNL128_WDATA0_ADDR A:0xce00010
y.create.l HWIO_PMIC_ARB_CHNL129_WDATA0_ADDR A:0xce10010
y.create.l HWIO_PMIC_ARB_CHNL130_WDATA0_ADDR A:0xce20010
y.create.l HWIO_PMIC_ARB_CHNL131_WDATA0_ADDR A:0xce30010
y.create.l HWIO_PMIC_ARB_CHNL132_WDATA0_ADDR A:0xce40010
y.create.l HWIO_PMIC_ARB_CHNL133_WDATA0_ADDR A:0xce50010
y.create.l HWIO_PMIC_ARB_CHNL134_WDATA0_ADDR A:0xce60010
y.create.l HWIO_PMIC_ARB_CHNL135_WDATA0_ADDR A:0xce70010
y.create.l HWIO_PMIC_ARB_CHNL136_WDATA0_ADDR A:0xce80010
y.create.l HWIO_PMIC_ARB_CHNL137_WDATA0_ADDR A:0xce90010
y.create.l HWIO_PMIC_ARB_CHNL138_WDATA0_ADDR A:0xcea0010
y.create.l HWIO_PMIC_ARB_CHNL139_WDATA0_ADDR A:0xceb0010
y.create.l HWIO_PMIC_ARB_CHNL140_WDATA0_ADDR A:0xcec0010
y.create.l HWIO_PMIC_ARB_CHNL141_WDATA0_ADDR A:0xced0010
y.create.l HWIO_PMIC_ARB_CHNL142_WDATA0_ADDR A:0xcee0010
y.create.l HWIO_PMIC_ARB_CHNL143_WDATA0_ADDR A:0xcef0010
y.create.l HWIO_PMIC_ARB_CHNL144_WDATA0_ADDR A:0xcf00010
y.create.l HWIO_PMIC_ARB_CHNL145_WDATA0_ADDR A:0xcf10010
y.create.l HWIO_PMIC_ARB_CHNL146_WDATA0_ADDR A:0xcf20010
y.create.l HWIO_PMIC_ARB_CHNL147_WDATA0_ADDR A:0xcf30010
y.create.l HWIO_PMIC_ARB_CHNL148_WDATA0_ADDR A:0xcf40010
y.create.l HWIO_PMIC_ARB_CHNL149_WDATA0_ADDR A:0xcf50010
y.create.l HWIO_PMIC_ARB_CHNL150_WDATA0_ADDR A:0xcf60010
y.create.l HWIO_PMIC_ARB_CHNL151_WDATA0_ADDR A:0xcf70010
y.create.l HWIO_PMIC_ARB_CHNL152_WDATA0_ADDR A:0xcf80010
y.create.l HWIO_PMIC_ARB_CHNL153_WDATA0_ADDR A:0xcf90010
y.create.l HWIO_PMIC_ARB_CHNL154_WDATA0_ADDR A:0xcfa0010
y.create.l HWIO_PMIC_ARB_CHNL155_WDATA0_ADDR A:0xcfb0010
y.create.l HWIO_PMIC_ARB_CHNL156_WDATA0_ADDR A:0xcfc0010
y.create.l HWIO_PMIC_ARB_CHNL157_WDATA0_ADDR A:0xcfd0010
y.create.l HWIO_PMIC_ARB_CHNL158_WDATA0_ADDR A:0xcfe0010
y.create.l HWIO_PMIC_ARB_CHNL159_WDATA0_ADDR A:0xcff0010
y.create.l HWIO_PMIC_ARB_CHNL160_WDATA0_ADDR A:0xd000010
y.create.l HWIO_PMIC_ARB_CHNL161_WDATA0_ADDR A:0xd010010
y.create.l HWIO_PMIC_ARB_CHNL162_WDATA0_ADDR A:0xd020010
y.create.l HWIO_PMIC_ARB_CHNL163_WDATA0_ADDR A:0xd030010
y.create.l HWIO_PMIC_ARB_CHNL164_WDATA0_ADDR A:0xd040010
y.create.l HWIO_PMIC_ARB_CHNL165_WDATA0_ADDR A:0xd050010
y.create.l HWIO_PMIC_ARB_CHNL166_WDATA0_ADDR A:0xd060010
y.create.l HWIO_PMIC_ARB_CHNL167_WDATA0_ADDR A:0xd070010
y.create.l HWIO_PMIC_ARB_CHNL168_WDATA0_ADDR A:0xd080010
y.create.l HWIO_PMIC_ARB_CHNL169_WDATA0_ADDR A:0xd090010
y.create.l HWIO_PMIC_ARB_CHNL170_WDATA0_ADDR A:0xd0a0010
y.create.l HWIO_PMIC_ARB_CHNL171_WDATA0_ADDR A:0xd0b0010
y.create.l HWIO_PMIC_ARB_CHNL172_WDATA0_ADDR A:0xd0c0010
y.create.l HWIO_PMIC_ARB_CHNL173_WDATA0_ADDR A:0xd0d0010
y.create.l HWIO_PMIC_ARB_CHNL174_WDATA0_ADDR A:0xd0e0010
y.create.l HWIO_PMIC_ARB_CHNL175_WDATA0_ADDR A:0xd0f0010
y.create.l HWIO_PMIC_ARB_CHNL176_WDATA0_ADDR A:0xd100010
y.create.l HWIO_PMIC_ARB_CHNL177_WDATA0_ADDR A:0xd110010
y.create.l HWIO_PMIC_ARB_CHNL178_WDATA0_ADDR A:0xd120010
y.create.l HWIO_PMIC_ARB_CHNL179_WDATA0_ADDR A:0xd130010
y.create.l HWIO_PMIC_ARB_CHNL180_WDATA0_ADDR A:0xd140010
y.create.l HWIO_PMIC_ARB_CHNL181_WDATA0_ADDR A:0xd150010
y.create.l HWIO_PMIC_ARB_CHNL182_WDATA0_ADDR A:0xd160010
y.create.l HWIO_PMIC_ARB_CHNL183_WDATA0_ADDR A:0xd170010
y.create.l HWIO_PMIC_ARB_CHNL184_WDATA0_ADDR A:0xd180010
y.create.l HWIO_PMIC_ARB_CHNL185_WDATA0_ADDR A:0xd190010
y.create.l HWIO_PMIC_ARB_CHNL186_WDATA0_ADDR A:0xd1a0010
y.create.l HWIO_PMIC_ARB_CHNL187_WDATA0_ADDR A:0xd1b0010
y.create.l HWIO_PMIC_ARB_CHNL188_WDATA0_ADDR A:0xd1c0010
y.create.l HWIO_PMIC_ARB_CHNL189_WDATA0_ADDR A:0xd1d0010
y.create.l HWIO_PMIC_ARB_CHNL190_WDATA0_ADDR A:0xd1e0010
y.create.l HWIO_PMIC_ARB_CHNL191_WDATA0_ADDR A:0xd1f0010
y.create.l HWIO_PMIC_ARB_CHNL192_WDATA0_ADDR A:0xd200010
y.create.l HWIO_PMIC_ARB_CHNL193_WDATA0_ADDR A:0xd210010
y.create.l HWIO_PMIC_ARB_CHNL194_WDATA0_ADDR A:0xd220010
y.create.l HWIO_PMIC_ARB_CHNL195_WDATA0_ADDR A:0xd230010
y.create.l HWIO_PMIC_ARB_CHNL196_WDATA0_ADDR A:0xd240010
y.create.l HWIO_PMIC_ARB_CHNL197_WDATA0_ADDR A:0xd250010
y.create.l HWIO_PMIC_ARB_CHNL198_WDATA0_ADDR A:0xd260010
y.create.l HWIO_PMIC_ARB_CHNL199_WDATA0_ADDR A:0xd270010
y.create.l HWIO_PMIC_ARB_CHNL200_WDATA0_ADDR A:0xd280010
y.create.l HWIO_PMIC_ARB_CHNL201_WDATA0_ADDR A:0xd290010
y.create.l HWIO_PMIC_ARB_CHNL202_WDATA0_ADDR A:0xd2a0010
y.create.l HWIO_PMIC_ARB_CHNL203_WDATA0_ADDR A:0xd2b0010
y.create.l HWIO_PMIC_ARB_CHNL204_WDATA0_ADDR A:0xd2c0010
y.create.l HWIO_PMIC_ARB_CHNL205_WDATA0_ADDR A:0xd2d0010
y.create.l HWIO_PMIC_ARB_CHNL206_WDATA0_ADDR A:0xd2e0010
y.create.l HWIO_PMIC_ARB_CHNL207_WDATA0_ADDR A:0xd2f0010
y.create.l HWIO_PMIC_ARB_CHNL208_WDATA0_ADDR A:0xd300010
y.create.l HWIO_PMIC_ARB_CHNL209_WDATA0_ADDR A:0xd310010
y.create.l HWIO_PMIC_ARB_CHNL210_WDATA0_ADDR A:0xd320010
y.create.l HWIO_PMIC_ARB_CHNL211_WDATA0_ADDR A:0xd330010
y.create.l HWIO_PMIC_ARB_CHNL212_WDATA0_ADDR A:0xd340010
y.create.l HWIO_PMIC_ARB_CHNL213_WDATA0_ADDR A:0xd350010
y.create.l HWIO_PMIC_ARB_CHNL214_WDATA0_ADDR A:0xd360010
y.create.l HWIO_PMIC_ARB_CHNL215_WDATA0_ADDR A:0xd370010
y.create.l HWIO_PMIC_ARB_CHNL216_WDATA0_ADDR A:0xd380010
y.create.l HWIO_PMIC_ARB_CHNL217_WDATA0_ADDR A:0xd390010
y.create.l HWIO_PMIC_ARB_CHNL218_WDATA0_ADDR A:0xd3a0010
y.create.l HWIO_PMIC_ARB_CHNL219_WDATA0_ADDR A:0xd3b0010
y.create.l HWIO_PMIC_ARB_CHNL220_WDATA0_ADDR A:0xd3c0010
y.create.l HWIO_PMIC_ARB_CHNL221_WDATA0_ADDR A:0xd3d0010
y.create.l HWIO_PMIC_ARB_CHNL222_WDATA0_ADDR A:0xd3e0010
y.create.l HWIO_PMIC_ARB_CHNL223_WDATA0_ADDR A:0xd3f0010
y.create.l HWIO_PMIC_ARB_CHNL224_WDATA0_ADDR A:0xd400010
y.create.l HWIO_PMIC_ARB_CHNL225_WDATA0_ADDR A:0xd410010
y.create.l HWIO_PMIC_ARB_CHNL226_WDATA0_ADDR A:0xd420010
y.create.l HWIO_PMIC_ARB_CHNL227_WDATA0_ADDR A:0xd430010
y.create.l HWIO_PMIC_ARB_CHNL228_WDATA0_ADDR A:0xd440010
y.create.l HWIO_PMIC_ARB_CHNL229_WDATA0_ADDR A:0xd450010
y.create.l HWIO_PMIC_ARB_CHNL230_WDATA0_ADDR A:0xd460010
y.create.l HWIO_PMIC_ARB_CHNL231_WDATA0_ADDR A:0xd470010
y.create.l HWIO_PMIC_ARB_CHNL232_WDATA0_ADDR A:0xd480010
y.create.l HWIO_PMIC_ARB_CHNL233_WDATA0_ADDR A:0xd490010
y.create.l HWIO_PMIC_ARB_CHNL234_WDATA0_ADDR A:0xd4a0010
y.create.l HWIO_PMIC_ARB_CHNL235_WDATA0_ADDR A:0xd4b0010
y.create.l HWIO_PMIC_ARB_CHNL236_WDATA0_ADDR A:0xd4c0010
y.create.l HWIO_PMIC_ARB_CHNL237_WDATA0_ADDR A:0xd4d0010
y.create.l HWIO_PMIC_ARB_CHNL238_WDATA0_ADDR A:0xd4e0010
y.create.l HWIO_PMIC_ARB_CHNL239_WDATA0_ADDR A:0xd4f0010
y.create.l HWIO_PMIC_ARB_CHNL240_WDATA0_ADDR A:0xd500010
y.create.l HWIO_PMIC_ARB_CHNL241_WDATA0_ADDR A:0xd510010
y.create.l HWIO_PMIC_ARB_CHNL242_WDATA0_ADDR A:0xd520010
y.create.l HWIO_PMIC_ARB_CHNL243_WDATA0_ADDR A:0xd530010
y.create.l HWIO_PMIC_ARB_CHNL244_WDATA0_ADDR A:0xd540010
y.create.l HWIO_PMIC_ARB_CHNL245_WDATA0_ADDR A:0xd550010
y.create.l HWIO_PMIC_ARB_CHNL246_WDATA0_ADDR A:0xd560010
y.create.l HWIO_PMIC_ARB_CHNL247_WDATA0_ADDR A:0xd570010
y.create.l HWIO_PMIC_ARB_CHNL248_WDATA0_ADDR A:0xd580010
y.create.l HWIO_PMIC_ARB_CHNL249_WDATA0_ADDR A:0xd590010
y.create.l HWIO_PMIC_ARB_CHNL250_WDATA0_ADDR A:0xd5a0010
y.create.l HWIO_PMIC_ARB_CHNL251_WDATA0_ADDR A:0xd5b0010
y.create.l HWIO_PMIC_ARB_CHNL252_WDATA0_ADDR A:0xd5c0010
y.create.l HWIO_PMIC_ARB_CHNL253_WDATA0_ADDR A:0xd5d0010
y.create.l HWIO_PMIC_ARB_CHNL254_WDATA0_ADDR A:0xd5e0010
y.create.l HWIO_PMIC_ARB_CHNL255_WDATA0_ADDR A:0xd5f0010
y.create.l HWIO_PMIC_ARB_CHNL256_WDATA0_ADDR A:0xd600010
y.create.l HWIO_PMIC_ARB_CHNL257_WDATA0_ADDR A:0xd610010
y.create.l HWIO_PMIC_ARB_CHNL258_WDATA0_ADDR A:0xd620010
y.create.l HWIO_PMIC_ARB_CHNL259_WDATA0_ADDR A:0xd630010
y.create.l HWIO_PMIC_ARB_CHNL260_WDATA0_ADDR A:0xd640010
y.create.l HWIO_PMIC_ARB_CHNL261_WDATA0_ADDR A:0xd650010
y.create.l HWIO_PMIC_ARB_CHNL262_WDATA0_ADDR A:0xd660010
y.create.l HWIO_PMIC_ARB_CHNL263_WDATA0_ADDR A:0xd670010
y.create.l HWIO_PMIC_ARB_CHNL264_WDATA0_ADDR A:0xd680010
y.create.l HWIO_PMIC_ARB_CHNL265_WDATA0_ADDR A:0xd690010
y.create.l HWIO_PMIC_ARB_CHNL266_WDATA0_ADDR A:0xd6a0010
y.create.l HWIO_PMIC_ARB_CHNL267_WDATA0_ADDR A:0xd6b0010
y.create.l HWIO_PMIC_ARB_CHNL268_WDATA0_ADDR A:0xd6c0010
y.create.l HWIO_PMIC_ARB_CHNL269_WDATA0_ADDR A:0xd6d0010
y.create.l HWIO_PMIC_ARB_CHNL270_WDATA0_ADDR A:0xd6e0010
y.create.l HWIO_PMIC_ARB_CHNL271_WDATA0_ADDR A:0xd6f0010
y.create.l HWIO_PMIC_ARB_CHNL272_WDATA0_ADDR A:0xd700010
y.create.l HWIO_PMIC_ARB_CHNL273_WDATA0_ADDR A:0xd710010
y.create.l HWIO_PMIC_ARB_CHNL274_WDATA0_ADDR A:0xd720010
y.create.l HWIO_PMIC_ARB_CHNL275_WDATA0_ADDR A:0xd730010
y.create.l HWIO_PMIC_ARB_CHNL276_WDATA0_ADDR A:0xd740010
y.create.l HWIO_PMIC_ARB_CHNL277_WDATA0_ADDR A:0xd750010
y.create.l HWIO_PMIC_ARB_CHNL278_WDATA0_ADDR A:0xd760010
y.create.l HWIO_PMIC_ARB_CHNL279_WDATA0_ADDR A:0xd770010
y.create.l HWIO_PMIC_ARB_CHNL280_WDATA0_ADDR A:0xd780010
y.create.l HWIO_PMIC_ARB_CHNL281_WDATA0_ADDR A:0xd790010
y.create.l HWIO_PMIC_ARB_CHNL282_WDATA0_ADDR A:0xd7a0010
y.create.l HWIO_PMIC_ARB_CHNL283_WDATA0_ADDR A:0xd7b0010
y.create.l HWIO_PMIC_ARB_CHNL284_WDATA0_ADDR A:0xd7c0010
y.create.l HWIO_PMIC_ARB_CHNL285_WDATA0_ADDR A:0xd7d0010
y.create.l HWIO_PMIC_ARB_CHNL286_WDATA0_ADDR A:0xd7e0010
y.create.l HWIO_PMIC_ARB_CHNL287_WDATA0_ADDR A:0xd7f0010
y.create.l HWIO_PMIC_ARB_CHNL288_WDATA0_ADDR A:0xd800010
y.create.l HWIO_PMIC_ARB_CHNL289_WDATA0_ADDR A:0xd810010
y.create.l HWIO_PMIC_ARB_CHNL290_WDATA0_ADDR A:0xd820010
y.create.l HWIO_PMIC_ARB_CHNL291_WDATA0_ADDR A:0xd830010
y.create.l HWIO_PMIC_ARB_CHNL292_WDATA0_ADDR A:0xd840010
y.create.l HWIO_PMIC_ARB_CHNL293_WDATA0_ADDR A:0xd850010
y.create.l HWIO_PMIC_ARB_CHNL294_WDATA0_ADDR A:0xd860010
y.create.l HWIO_PMIC_ARB_CHNL295_WDATA0_ADDR A:0xd870010
y.create.l HWIO_PMIC_ARB_CHNL296_WDATA0_ADDR A:0xd880010
y.create.l HWIO_PMIC_ARB_CHNL297_WDATA0_ADDR A:0xd890010
y.create.l HWIO_PMIC_ARB_CHNL298_WDATA0_ADDR A:0xd8a0010
y.create.l HWIO_PMIC_ARB_CHNL299_WDATA0_ADDR A:0xd8b0010
y.create.l HWIO_PMIC_ARB_CHNL300_WDATA0_ADDR A:0xd8c0010
y.create.l HWIO_PMIC_ARB_CHNL301_WDATA0_ADDR A:0xd8d0010
y.create.l HWIO_PMIC_ARB_CHNL302_WDATA0_ADDR A:0xd8e0010
y.create.l HWIO_PMIC_ARB_CHNL303_WDATA0_ADDR A:0xd8f0010
y.create.l HWIO_PMIC_ARB_CHNL304_WDATA0_ADDR A:0xd900010
y.create.l HWIO_PMIC_ARB_CHNL305_WDATA0_ADDR A:0xd910010
y.create.l HWIO_PMIC_ARB_CHNL306_WDATA0_ADDR A:0xd920010
y.create.l HWIO_PMIC_ARB_CHNL307_WDATA0_ADDR A:0xd930010
y.create.l HWIO_PMIC_ARB_CHNL308_WDATA0_ADDR A:0xd940010
y.create.l HWIO_PMIC_ARB_CHNL309_WDATA0_ADDR A:0xd950010
y.create.l HWIO_PMIC_ARB_CHNL310_WDATA0_ADDR A:0xd960010
y.create.l HWIO_PMIC_ARB_CHNL311_WDATA0_ADDR A:0xd970010
y.create.l HWIO_PMIC_ARB_CHNL312_WDATA0_ADDR A:0xd980010
y.create.l HWIO_PMIC_ARB_CHNL313_WDATA0_ADDR A:0xd990010
y.create.l HWIO_PMIC_ARB_CHNL314_WDATA0_ADDR A:0xd9a0010
y.create.l HWIO_PMIC_ARB_CHNL315_WDATA0_ADDR A:0xd9b0010
y.create.l HWIO_PMIC_ARB_CHNL316_WDATA0_ADDR A:0xd9c0010
y.create.l HWIO_PMIC_ARB_CHNL317_WDATA0_ADDR A:0xd9d0010
y.create.l HWIO_PMIC_ARB_CHNL318_WDATA0_ADDR A:0xd9e0010
y.create.l HWIO_PMIC_ARB_CHNL319_WDATA0_ADDR A:0xd9f0010
y.create.l HWIO_PMIC_ARB_CHNL320_WDATA0_ADDR A:0xda00010
y.create.l HWIO_PMIC_ARB_CHNL321_WDATA0_ADDR A:0xda10010
y.create.l HWIO_PMIC_ARB_CHNL322_WDATA0_ADDR A:0xda20010
y.create.l HWIO_PMIC_ARB_CHNL323_WDATA0_ADDR A:0xda30010
y.create.l HWIO_PMIC_ARB_CHNL324_WDATA0_ADDR A:0xda40010
y.create.l HWIO_PMIC_ARB_CHNL325_WDATA0_ADDR A:0xda50010
y.create.l HWIO_PMIC_ARB_CHNL326_WDATA0_ADDR A:0xda60010
y.create.l HWIO_PMIC_ARB_CHNL327_WDATA0_ADDR A:0xda70010
y.create.l HWIO_PMIC_ARB_CHNL328_WDATA0_ADDR A:0xda80010
y.create.l HWIO_PMIC_ARB_CHNL329_WDATA0_ADDR A:0xda90010
y.create.l HWIO_PMIC_ARB_CHNL330_WDATA0_ADDR A:0xdaa0010
y.create.l HWIO_PMIC_ARB_CHNL331_WDATA0_ADDR A:0xdab0010
y.create.l HWIO_PMIC_ARB_CHNL332_WDATA0_ADDR A:0xdac0010
y.create.l HWIO_PMIC_ARB_CHNL333_WDATA0_ADDR A:0xdad0010
y.create.l HWIO_PMIC_ARB_CHNL334_WDATA0_ADDR A:0xdae0010
y.create.l HWIO_PMIC_ARB_CHNL335_WDATA0_ADDR A:0xdaf0010
y.create.l HWIO_PMIC_ARB_CHNL336_WDATA0_ADDR A:0xdb00010
y.create.l HWIO_PMIC_ARB_CHNL337_WDATA0_ADDR A:0xdb10010
y.create.l HWIO_PMIC_ARB_CHNL338_WDATA0_ADDR A:0xdb20010
y.create.l HWIO_PMIC_ARB_CHNL339_WDATA0_ADDR A:0xdb30010
y.create.l HWIO_PMIC_ARB_CHNL340_WDATA0_ADDR A:0xdb40010
y.create.l HWIO_PMIC_ARB_CHNL341_WDATA0_ADDR A:0xdb50010
y.create.l HWIO_PMIC_ARB_CHNL342_WDATA0_ADDR A:0xdb60010
y.create.l HWIO_PMIC_ARB_CHNL343_WDATA0_ADDR A:0xdb70010
y.create.l HWIO_PMIC_ARB_CHNL344_WDATA0_ADDR A:0xdb80010
y.create.l HWIO_PMIC_ARB_CHNL345_WDATA0_ADDR A:0xdb90010
y.create.l HWIO_PMIC_ARB_CHNL346_WDATA0_ADDR A:0xdba0010
y.create.l HWIO_PMIC_ARB_CHNL347_WDATA0_ADDR A:0xdbb0010
y.create.l HWIO_PMIC_ARB_CHNL348_WDATA0_ADDR A:0xdbc0010
y.create.l HWIO_PMIC_ARB_CHNL349_WDATA0_ADDR A:0xdbd0010
y.create.l HWIO_PMIC_ARB_CHNL350_WDATA0_ADDR A:0xdbe0010
y.create.l HWIO_PMIC_ARB_CHNL351_WDATA0_ADDR A:0xdbf0010
y.create.l HWIO_PMIC_ARB_CHNL352_WDATA0_ADDR A:0xdc00010
y.create.l HWIO_PMIC_ARB_CHNL353_WDATA0_ADDR A:0xdc10010
y.create.l HWIO_PMIC_ARB_CHNL354_WDATA0_ADDR A:0xdc20010
y.create.l HWIO_PMIC_ARB_CHNL355_WDATA0_ADDR A:0xdc30010
y.create.l HWIO_PMIC_ARB_CHNL356_WDATA0_ADDR A:0xdc40010
y.create.l HWIO_PMIC_ARB_CHNL357_WDATA0_ADDR A:0xdc50010
y.create.l HWIO_PMIC_ARB_CHNL358_WDATA0_ADDR A:0xdc60010
y.create.l HWIO_PMIC_ARB_CHNL359_WDATA0_ADDR A:0xdc70010
y.create.l HWIO_PMIC_ARB_CHNL360_WDATA0_ADDR A:0xdc80010
y.create.l HWIO_PMIC_ARB_CHNL361_WDATA0_ADDR A:0xdc90010
y.create.l HWIO_PMIC_ARB_CHNL362_WDATA0_ADDR A:0xdca0010
y.create.l HWIO_PMIC_ARB_CHNL363_WDATA0_ADDR A:0xdcb0010
y.create.l HWIO_PMIC_ARB_CHNL364_WDATA0_ADDR A:0xdcc0010
y.create.l HWIO_PMIC_ARB_CHNL365_WDATA0_ADDR A:0xdcd0010
y.create.l HWIO_PMIC_ARB_CHNL366_WDATA0_ADDR A:0xdce0010
y.create.l HWIO_PMIC_ARB_CHNL367_WDATA0_ADDR A:0xdcf0010
y.create.l HWIO_PMIC_ARB_CHNL368_WDATA0_ADDR A:0xdd00010
y.create.l HWIO_PMIC_ARB_CHNL369_WDATA0_ADDR A:0xdd10010
y.create.l HWIO_PMIC_ARB_CHNL370_WDATA0_ADDR A:0xdd20010
y.create.l HWIO_PMIC_ARB_CHNL371_WDATA0_ADDR A:0xdd30010
y.create.l HWIO_PMIC_ARB_CHNL372_WDATA0_ADDR A:0xdd40010
y.create.l HWIO_PMIC_ARB_CHNL373_WDATA0_ADDR A:0xdd50010
y.create.l HWIO_PMIC_ARB_CHNL374_WDATA0_ADDR A:0xdd60010
y.create.l HWIO_PMIC_ARB_CHNL375_WDATA0_ADDR A:0xdd70010
y.create.l HWIO_PMIC_ARB_CHNL376_WDATA0_ADDR A:0xdd80010
y.create.l HWIO_PMIC_ARB_CHNL377_WDATA0_ADDR A:0xdd90010
y.create.l HWIO_PMIC_ARB_CHNL378_WDATA0_ADDR A:0xdda0010
y.create.l HWIO_PMIC_ARB_CHNL379_WDATA0_ADDR A:0xddb0010
y.create.l HWIO_PMIC_ARB_CHNL380_WDATA0_ADDR A:0xddc0010
y.create.l HWIO_PMIC_ARB_CHNL381_WDATA0_ADDR A:0xddd0010
y.create.l HWIO_PMIC_ARB_CHNL382_WDATA0_ADDR A:0xdde0010
y.create.l HWIO_PMIC_ARB_CHNL383_WDATA0_ADDR A:0xddf0010
y.create.l HWIO_PMIC_ARB_CHNL384_WDATA0_ADDR A:0xde00010
y.create.l HWIO_PMIC_ARB_CHNL385_WDATA0_ADDR A:0xde10010
y.create.l HWIO_PMIC_ARB_CHNL386_WDATA0_ADDR A:0xde20010
y.create.l HWIO_PMIC_ARB_CHNL387_WDATA0_ADDR A:0xde30010
y.create.l HWIO_PMIC_ARB_CHNL388_WDATA0_ADDR A:0xde40010
y.create.l HWIO_PMIC_ARB_CHNL389_WDATA0_ADDR A:0xde50010
y.create.l HWIO_PMIC_ARB_CHNL390_WDATA0_ADDR A:0xde60010
y.create.l HWIO_PMIC_ARB_CHNL391_WDATA0_ADDR A:0xde70010
y.create.l HWIO_PMIC_ARB_CHNL392_WDATA0_ADDR A:0xde80010
y.create.l HWIO_PMIC_ARB_CHNL393_WDATA0_ADDR A:0xde90010
y.create.l HWIO_PMIC_ARB_CHNL394_WDATA0_ADDR A:0xdea0010
y.create.l HWIO_PMIC_ARB_CHNL395_WDATA0_ADDR A:0xdeb0010
y.create.l HWIO_PMIC_ARB_CHNL396_WDATA0_ADDR A:0xdec0010
y.create.l HWIO_PMIC_ARB_CHNL397_WDATA0_ADDR A:0xded0010
y.create.l HWIO_PMIC_ARB_CHNL398_WDATA0_ADDR A:0xdee0010
y.create.l HWIO_PMIC_ARB_CHNL399_WDATA0_ADDR A:0xdef0010
y.create.l HWIO_PMIC_ARB_CHNL400_WDATA0_ADDR A:0xdf00010
y.create.l HWIO_PMIC_ARB_CHNL401_WDATA0_ADDR A:0xdf10010
y.create.l HWIO_PMIC_ARB_CHNL402_WDATA0_ADDR A:0xdf20010
y.create.l HWIO_PMIC_ARB_CHNL403_WDATA0_ADDR A:0xdf30010
y.create.l HWIO_PMIC_ARB_CHNL404_WDATA0_ADDR A:0xdf40010
y.create.l HWIO_PMIC_ARB_CHNL405_WDATA0_ADDR A:0xdf50010
y.create.l HWIO_PMIC_ARB_CHNL406_WDATA0_ADDR A:0xdf60010
y.create.l HWIO_PMIC_ARB_CHNL407_WDATA0_ADDR A:0xdf70010
y.create.l HWIO_PMIC_ARB_CHNL408_WDATA0_ADDR A:0xdf80010
y.create.l HWIO_PMIC_ARB_CHNL409_WDATA0_ADDR A:0xdf90010
y.create.l HWIO_PMIC_ARB_CHNL410_WDATA0_ADDR A:0xdfa0010
y.create.l HWIO_PMIC_ARB_CHNL411_WDATA0_ADDR A:0xdfb0010
y.create.l HWIO_PMIC_ARB_CHNL412_WDATA0_ADDR A:0xdfc0010
y.create.l HWIO_PMIC_ARB_CHNL413_WDATA0_ADDR A:0xdfd0010
y.create.l HWIO_PMIC_ARB_CHNL414_WDATA0_ADDR A:0xdfe0010
y.create.l HWIO_PMIC_ARB_CHNL415_WDATA0_ADDR A:0xdff0010
y.create.l HWIO_PMIC_ARB_CHNL416_WDATA0_ADDR A:0xe000010
y.create.l HWIO_PMIC_ARB_CHNL417_WDATA0_ADDR A:0xe010010
y.create.l HWIO_PMIC_ARB_CHNL418_WDATA0_ADDR A:0xe020010
y.create.l HWIO_PMIC_ARB_CHNL419_WDATA0_ADDR A:0xe030010
y.create.l HWIO_PMIC_ARB_CHNL420_WDATA0_ADDR A:0xe040010
y.create.l HWIO_PMIC_ARB_CHNL421_WDATA0_ADDR A:0xe050010
y.create.l HWIO_PMIC_ARB_CHNL422_WDATA0_ADDR A:0xe060010
y.create.l HWIO_PMIC_ARB_CHNL423_WDATA0_ADDR A:0xe070010
y.create.l HWIO_PMIC_ARB_CHNL424_WDATA0_ADDR A:0xe080010
y.create.l HWIO_PMIC_ARB_CHNL425_WDATA0_ADDR A:0xe090010
y.create.l HWIO_PMIC_ARB_CHNL426_WDATA0_ADDR A:0xe0a0010
y.create.l HWIO_PMIC_ARB_CHNL427_WDATA0_ADDR A:0xe0b0010
y.create.l HWIO_PMIC_ARB_CHNL428_WDATA0_ADDR A:0xe0c0010
y.create.l HWIO_PMIC_ARB_CHNL429_WDATA0_ADDR A:0xe0d0010
y.create.l HWIO_PMIC_ARB_CHNL430_WDATA0_ADDR A:0xe0e0010
y.create.l HWIO_PMIC_ARB_CHNL431_WDATA0_ADDR A:0xe0f0010
y.create.l HWIO_PMIC_ARB_CHNL432_WDATA0_ADDR A:0xe100010
y.create.l HWIO_PMIC_ARB_CHNL433_WDATA0_ADDR A:0xe110010
y.create.l HWIO_PMIC_ARB_CHNL434_WDATA0_ADDR A:0xe120010
y.create.l HWIO_PMIC_ARB_CHNL435_WDATA0_ADDR A:0xe130010
y.create.l HWIO_PMIC_ARB_CHNL436_WDATA0_ADDR A:0xe140010
y.create.l HWIO_PMIC_ARB_CHNL437_WDATA0_ADDR A:0xe150010
y.create.l HWIO_PMIC_ARB_CHNL438_WDATA0_ADDR A:0xe160010
y.create.l HWIO_PMIC_ARB_CHNL439_WDATA0_ADDR A:0xe170010
y.create.l HWIO_PMIC_ARB_CHNL440_WDATA0_ADDR A:0xe180010
y.create.l HWIO_PMIC_ARB_CHNL441_WDATA0_ADDR A:0xe190010
y.create.l HWIO_PMIC_ARB_CHNL442_WDATA0_ADDR A:0xe1a0010
y.create.l HWIO_PMIC_ARB_CHNL443_WDATA0_ADDR A:0xe1b0010
y.create.l HWIO_PMIC_ARB_CHNL444_WDATA0_ADDR A:0xe1c0010
y.create.l HWIO_PMIC_ARB_CHNL445_WDATA0_ADDR A:0xe1d0010
y.create.l HWIO_PMIC_ARB_CHNL446_WDATA0_ADDR A:0xe1e0010
y.create.l HWIO_PMIC_ARB_CHNL447_WDATA0_ADDR A:0xe1f0010
y.create.l HWIO_PMIC_ARB_CHNL448_WDATA0_ADDR A:0xe200010
y.create.l HWIO_PMIC_ARB_CHNL449_WDATA0_ADDR A:0xe210010
y.create.l HWIO_PMIC_ARB_CHNL450_WDATA0_ADDR A:0xe220010
y.create.l HWIO_PMIC_ARB_CHNL451_WDATA0_ADDR A:0xe230010
y.create.l HWIO_PMIC_ARB_CHNL452_WDATA0_ADDR A:0xe240010
y.create.l HWIO_PMIC_ARB_CHNL453_WDATA0_ADDR A:0xe250010
y.create.l HWIO_PMIC_ARB_CHNL454_WDATA0_ADDR A:0xe260010
y.create.l HWIO_PMIC_ARB_CHNL455_WDATA0_ADDR A:0xe270010
y.create.l HWIO_PMIC_ARB_CHNL456_WDATA0_ADDR A:0xe280010
y.create.l HWIO_PMIC_ARB_CHNL457_WDATA0_ADDR A:0xe290010
y.create.l HWIO_PMIC_ARB_CHNL458_WDATA0_ADDR A:0xe2a0010
y.create.l HWIO_PMIC_ARB_CHNL459_WDATA0_ADDR A:0xe2b0010
y.create.l HWIO_PMIC_ARB_CHNL460_WDATA0_ADDR A:0xe2c0010
y.create.l HWIO_PMIC_ARB_CHNL461_WDATA0_ADDR A:0xe2d0010
y.create.l HWIO_PMIC_ARB_CHNL462_WDATA0_ADDR A:0xe2e0010
y.create.l HWIO_PMIC_ARB_CHNL463_WDATA0_ADDR A:0xe2f0010
y.create.l HWIO_PMIC_ARB_CHNL464_WDATA0_ADDR A:0xe300010
y.create.l HWIO_PMIC_ARB_CHNL465_WDATA0_ADDR A:0xe310010
y.create.l HWIO_PMIC_ARB_CHNL466_WDATA0_ADDR A:0xe320010
y.create.l HWIO_PMIC_ARB_CHNL467_WDATA0_ADDR A:0xe330010
y.create.l HWIO_PMIC_ARB_CHNL468_WDATA0_ADDR A:0xe340010
y.create.l HWIO_PMIC_ARB_CHNL469_WDATA0_ADDR A:0xe350010
y.create.l HWIO_PMIC_ARB_CHNL470_WDATA0_ADDR A:0xe360010
y.create.l HWIO_PMIC_ARB_CHNL471_WDATA0_ADDR A:0xe370010
y.create.l HWIO_PMIC_ARB_CHNL472_WDATA0_ADDR A:0xe380010
y.create.l HWIO_PMIC_ARB_CHNL473_WDATA0_ADDR A:0xe390010
y.create.l HWIO_PMIC_ARB_CHNL474_WDATA0_ADDR A:0xe3a0010
y.create.l HWIO_PMIC_ARB_CHNL475_WDATA0_ADDR A:0xe3b0010
y.create.l HWIO_PMIC_ARB_CHNL476_WDATA0_ADDR A:0xe3c0010
y.create.l HWIO_PMIC_ARB_CHNL477_WDATA0_ADDR A:0xe3d0010
y.create.l HWIO_PMIC_ARB_CHNL478_WDATA0_ADDR A:0xe3e0010
y.create.l HWIO_PMIC_ARB_CHNL479_WDATA0_ADDR A:0xe3f0010
y.create.l HWIO_PMIC_ARB_CHNL480_WDATA0_ADDR A:0xe400010
y.create.l HWIO_PMIC_ARB_CHNL481_WDATA0_ADDR A:0xe410010
y.create.l HWIO_PMIC_ARB_CHNL482_WDATA0_ADDR A:0xe420010
y.create.l HWIO_PMIC_ARB_CHNL483_WDATA0_ADDR A:0xe430010
y.create.l HWIO_PMIC_ARB_CHNL484_WDATA0_ADDR A:0xe440010
y.create.l HWIO_PMIC_ARB_CHNL485_WDATA0_ADDR A:0xe450010
y.create.l HWIO_PMIC_ARB_CHNL486_WDATA0_ADDR A:0xe460010
y.create.l HWIO_PMIC_ARB_CHNL487_WDATA0_ADDR A:0xe470010
y.create.l HWIO_PMIC_ARB_CHNL488_WDATA0_ADDR A:0xe480010
y.create.l HWIO_PMIC_ARB_CHNL489_WDATA0_ADDR A:0xe490010
y.create.l HWIO_PMIC_ARB_CHNL490_WDATA0_ADDR A:0xe4a0010
y.create.l HWIO_PMIC_ARB_CHNL491_WDATA0_ADDR A:0xe4b0010
y.create.l HWIO_PMIC_ARB_CHNL492_WDATA0_ADDR A:0xe4c0010
y.create.l HWIO_PMIC_ARB_CHNL493_WDATA0_ADDR A:0xe4d0010
y.create.l HWIO_PMIC_ARB_CHNL494_WDATA0_ADDR A:0xe4e0010
y.create.l HWIO_PMIC_ARB_CHNL495_WDATA0_ADDR A:0xe4f0010
y.create.l HWIO_PMIC_ARB_CHNL496_WDATA0_ADDR A:0xe500010
y.create.l HWIO_PMIC_ARB_CHNL497_WDATA0_ADDR A:0xe510010
y.create.l HWIO_PMIC_ARB_CHNL498_WDATA0_ADDR A:0xe520010
y.create.l HWIO_PMIC_ARB_CHNL499_WDATA0_ADDR A:0xe530010
y.create.l HWIO_PMIC_ARB_CHNL500_WDATA0_ADDR A:0xe540010
y.create.l HWIO_PMIC_ARB_CHNL501_WDATA0_ADDR A:0xe550010
y.create.l HWIO_PMIC_ARB_CHNL502_WDATA0_ADDR A:0xe560010
y.create.l HWIO_PMIC_ARB_CHNL503_WDATA0_ADDR A:0xe570010
y.create.l HWIO_PMIC_ARB_CHNL504_WDATA0_ADDR A:0xe580010
y.create.l HWIO_PMIC_ARB_CHNL505_WDATA0_ADDR A:0xe590010
y.create.l HWIO_PMIC_ARB_CHNL506_WDATA0_ADDR A:0xe5a0010
y.create.l HWIO_PMIC_ARB_CHNL507_WDATA0_ADDR A:0xe5b0010
y.create.l HWIO_PMIC_ARB_CHNL508_WDATA0_ADDR A:0xe5c0010
y.create.l HWIO_PMIC_ARB_CHNL509_WDATA0_ADDR A:0xe5d0010
y.create.l HWIO_PMIC_ARB_CHNL510_WDATA0_ADDR A:0xe5e0010
y.create.l HWIO_PMIC_ARB_CHNL511_WDATA0_ADDR A:0xe5f0010
y.create.l HWIO_PMIC_ARB_CHNL0_WDATA1_ADDR A:0xc600014
y.create.l HWIO_PMIC_ARB_CHNL1_WDATA1_ADDR A:0xc610014
y.create.l HWIO_PMIC_ARB_CHNL2_WDATA1_ADDR A:0xc620014
y.create.l HWIO_PMIC_ARB_CHNL3_WDATA1_ADDR A:0xc630014
y.create.l HWIO_PMIC_ARB_CHNL4_WDATA1_ADDR A:0xc640014
y.create.l HWIO_PMIC_ARB_CHNL5_WDATA1_ADDR A:0xc650014
y.create.l HWIO_PMIC_ARB_CHNL6_WDATA1_ADDR A:0xc660014
y.create.l HWIO_PMIC_ARB_CHNL7_WDATA1_ADDR A:0xc670014
y.create.l HWIO_PMIC_ARB_CHNL8_WDATA1_ADDR A:0xc680014
y.create.l HWIO_PMIC_ARB_CHNL9_WDATA1_ADDR A:0xc690014
y.create.l HWIO_PMIC_ARB_CHNL10_WDATA1_ADDR A:0xc6a0014
y.create.l HWIO_PMIC_ARB_CHNL11_WDATA1_ADDR A:0xc6b0014
y.create.l HWIO_PMIC_ARB_CHNL12_WDATA1_ADDR A:0xc6c0014
y.create.l HWIO_PMIC_ARB_CHNL13_WDATA1_ADDR A:0xc6d0014
y.create.l HWIO_PMIC_ARB_CHNL14_WDATA1_ADDR A:0xc6e0014
y.create.l HWIO_PMIC_ARB_CHNL15_WDATA1_ADDR A:0xc6f0014
y.create.l HWIO_PMIC_ARB_CHNL16_WDATA1_ADDR A:0xc700014
y.create.l HWIO_PMIC_ARB_CHNL17_WDATA1_ADDR A:0xc710014
y.create.l HWIO_PMIC_ARB_CHNL18_WDATA1_ADDR A:0xc720014
y.create.l HWIO_PMIC_ARB_CHNL19_WDATA1_ADDR A:0xc730014
y.create.l HWIO_PMIC_ARB_CHNL20_WDATA1_ADDR A:0xc740014
y.create.l HWIO_PMIC_ARB_CHNL21_WDATA1_ADDR A:0xc750014
y.create.l HWIO_PMIC_ARB_CHNL22_WDATA1_ADDR A:0xc760014
y.create.l HWIO_PMIC_ARB_CHNL23_WDATA1_ADDR A:0xc770014
y.create.l HWIO_PMIC_ARB_CHNL24_WDATA1_ADDR A:0xc780014
y.create.l HWIO_PMIC_ARB_CHNL25_WDATA1_ADDR A:0xc790014
y.create.l HWIO_PMIC_ARB_CHNL26_WDATA1_ADDR A:0xc7a0014
y.create.l HWIO_PMIC_ARB_CHNL27_WDATA1_ADDR A:0xc7b0014
y.create.l HWIO_PMIC_ARB_CHNL28_WDATA1_ADDR A:0xc7c0014
y.create.l HWIO_PMIC_ARB_CHNL29_WDATA1_ADDR A:0xc7d0014
y.create.l HWIO_PMIC_ARB_CHNL30_WDATA1_ADDR A:0xc7e0014
y.create.l HWIO_PMIC_ARB_CHNL31_WDATA1_ADDR A:0xc7f0014
y.create.l HWIO_PMIC_ARB_CHNL32_WDATA1_ADDR A:0xc800014
y.create.l HWIO_PMIC_ARB_CHNL33_WDATA1_ADDR A:0xc810014
y.create.l HWIO_PMIC_ARB_CHNL34_WDATA1_ADDR A:0xc820014
y.create.l HWIO_PMIC_ARB_CHNL35_WDATA1_ADDR A:0xc830014
y.create.l HWIO_PMIC_ARB_CHNL36_WDATA1_ADDR A:0xc840014
y.create.l HWIO_PMIC_ARB_CHNL37_WDATA1_ADDR A:0xc850014
y.create.l HWIO_PMIC_ARB_CHNL38_WDATA1_ADDR A:0xc860014
y.create.l HWIO_PMIC_ARB_CHNL39_WDATA1_ADDR A:0xc870014
y.create.l HWIO_PMIC_ARB_CHNL40_WDATA1_ADDR A:0xc880014
y.create.l HWIO_PMIC_ARB_CHNL41_WDATA1_ADDR A:0xc890014
y.create.l HWIO_PMIC_ARB_CHNL42_WDATA1_ADDR A:0xc8a0014
y.create.l HWIO_PMIC_ARB_CHNL43_WDATA1_ADDR A:0xc8b0014
y.create.l HWIO_PMIC_ARB_CHNL44_WDATA1_ADDR A:0xc8c0014
y.create.l HWIO_PMIC_ARB_CHNL45_WDATA1_ADDR A:0xc8d0014
y.create.l HWIO_PMIC_ARB_CHNL46_WDATA1_ADDR A:0xc8e0014
y.create.l HWIO_PMIC_ARB_CHNL47_WDATA1_ADDR A:0xc8f0014
y.create.l HWIO_PMIC_ARB_CHNL48_WDATA1_ADDR A:0xc900014
y.create.l HWIO_PMIC_ARB_CHNL49_WDATA1_ADDR A:0xc910014
y.create.l HWIO_PMIC_ARB_CHNL50_WDATA1_ADDR A:0xc920014
y.create.l HWIO_PMIC_ARB_CHNL51_WDATA1_ADDR A:0xc930014
y.create.l HWIO_PMIC_ARB_CHNL52_WDATA1_ADDR A:0xc940014
y.create.l HWIO_PMIC_ARB_CHNL53_WDATA1_ADDR A:0xc950014
y.create.l HWIO_PMIC_ARB_CHNL54_WDATA1_ADDR A:0xc960014
y.create.l HWIO_PMIC_ARB_CHNL55_WDATA1_ADDR A:0xc970014
y.create.l HWIO_PMIC_ARB_CHNL56_WDATA1_ADDR A:0xc980014
y.create.l HWIO_PMIC_ARB_CHNL57_WDATA1_ADDR A:0xc990014
y.create.l HWIO_PMIC_ARB_CHNL58_WDATA1_ADDR A:0xc9a0014
y.create.l HWIO_PMIC_ARB_CHNL59_WDATA1_ADDR A:0xc9b0014
y.create.l HWIO_PMIC_ARB_CHNL60_WDATA1_ADDR A:0xc9c0014
y.create.l HWIO_PMIC_ARB_CHNL61_WDATA1_ADDR A:0xc9d0014
y.create.l HWIO_PMIC_ARB_CHNL62_WDATA1_ADDR A:0xc9e0014
y.create.l HWIO_PMIC_ARB_CHNL63_WDATA1_ADDR A:0xc9f0014
y.create.l HWIO_PMIC_ARB_CHNL64_WDATA1_ADDR A:0xca00014
y.create.l HWIO_PMIC_ARB_CHNL65_WDATA1_ADDR A:0xca10014
y.create.l HWIO_PMIC_ARB_CHNL66_WDATA1_ADDR A:0xca20014
y.create.l HWIO_PMIC_ARB_CHNL67_WDATA1_ADDR A:0xca30014
y.create.l HWIO_PMIC_ARB_CHNL68_WDATA1_ADDR A:0xca40014
y.create.l HWIO_PMIC_ARB_CHNL69_WDATA1_ADDR A:0xca50014
y.create.l HWIO_PMIC_ARB_CHNL70_WDATA1_ADDR A:0xca60014
y.create.l HWIO_PMIC_ARB_CHNL71_WDATA1_ADDR A:0xca70014
y.create.l HWIO_PMIC_ARB_CHNL72_WDATA1_ADDR A:0xca80014
y.create.l HWIO_PMIC_ARB_CHNL73_WDATA1_ADDR A:0xca90014
y.create.l HWIO_PMIC_ARB_CHNL74_WDATA1_ADDR A:0xcaa0014
y.create.l HWIO_PMIC_ARB_CHNL75_WDATA1_ADDR A:0xcab0014
y.create.l HWIO_PMIC_ARB_CHNL76_WDATA1_ADDR A:0xcac0014
y.create.l HWIO_PMIC_ARB_CHNL77_WDATA1_ADDR A:0xcad0014
y.create.l HWIO_PMIC_ARB_CHNL78_WDATA1_ADDR A:0xcae0014
y.create.l HWIO_PMIC_ARB_CHNL79_WDATA1_ADDR A:0xcaf0014
y.create.l HWIO_PMIC_ARB_CHNL80_WDATA1_ADDR A:0xcb00014
y.create.l HWIO_PMIC_ARB_CHNL81_WDATA1_ADDR A:0xcb10014
y.create.l HWIO_PMIC_ARB_CHNL82_WDATA1_ADDR A:0xcb20014
y.create.l HWIO_PMIC_ARB_CHNL83_WDATA1_ADDR A:0xcb30014
y.create.l HWIO_PMIC_ARB_CHNL84_WDATA1_ADDR A:0xcb40014
y.create.l HWIO_PMIC_ARB_CHNL85_WDATA1_ADDR A:0xcb50014
y.create.l HWIO_PMIC_ARB_CHNL86_WDATA1_ADDR A:0xcb60014
y.create.l HWIO_PMIC_ARB_CHNL87_WDATA1_ADDR A:0xcb70014
y.create.l HWIO_PMIC_ARB_CHNL88_WDATA1_ADDR A:0xcb80014
y.create.l HWIO_PMIC_ARB_CHNL89_WDATA1_ADDR A:0xcb90014
y.create.l HWIO_PMIC_ARB_CHNL90_WDATA1_ADDR A:0xcba0014
y.create.l HWIO_PMIC_ARB_CHNL91_WDATA1_ADDR A:0xcbb0014
y.create.l HWIO_PMIC_ARB_CHNL92_WDATA1_ADDR A:0xcbc0014
y.create.l HWIO_PMIC_ARB_CHNL93_WDATA1_ADDR A:0xcbd0014
y.create.l HWIO_PMIC_ARB_CHNL94_WDATA1_ADDR A:0xcbe0014
y.create.l HWIO_PMIC_ARB_CHNL95_WDATA1_ADDR A:0xcbf0014
y.create.l HWIO_PMIC_ARB_CHNL96_WDATA1_ADDR A:0xcc00014
y.create.l HWIO_PMIC_ARB_CHNL97_WDATA1_ADDR A:0xcc10014
y.create.l HWIO_PMIC_ARB_CHNL98_WDATA1_ADDR A:0xcc20014
y.create.l HWIO_PMIC_ARB_CHNL99_WDATA1_ADDR A:0xcc30014
y.create.l HWIO_PMIC_ARB_CHNL100_WDATA1_ADDR A:0xcc40014
y.create.l HWIO_PMIC_ARB_CHNL101_WDATA1_ADDR A:0xcc50014
y.create.l HWIO_PMIC_ARB_CHNL102_WDATA1_ADDR A:0xcc60014
y.create.l HWIO_PMIC_ARB_CHNL103_WDATA1_ADDR A:0xcc70014
y.create.l HWIO_PMIC_ARB_CHNL104_WDATA1_ADDR A:0xcc80014
y.create.l HWIO_PMIC_ARB_CHNL105_WDATA1_ADDR A:0xcc90014
y.create.l HWIO_PMIC_ARB_CHNL106_WDATA1_ADDR A:0xcca0014
y.create.l HWIO_PMIC_ARB_CHNL107_WDATA1_ADDR A:0xccb0014
y.create.l HWIO_PMIC_ARB_CHNL108_WDATA1_ADDR A:0xccc0014
y.create.l HWIO_PMIC_ARB_CHNL109_WDATA1_ADDR A:0xccd0014
y.create.l HWIO_PMIC_ARB_CHNL110_WDATA1_ADDR A:0xcce0014
y.create.l HWIO_PMIC_ARB_CHNL111_WDATA1_ADDR A:0xccf0014
y.create.l HWIO_PMIC_ARB_CHNL112_WDATA1_ADDR A:0xcd00014
y.create.l HWIO_PMIC_ARB_CHNL113_WDATA1_ADDR A:0xcd10014
y.create.l HWIO_PMIC_ARB_CHNL114_WDATA1_ADDR A:0xcd20014
y.create.l HWIO_PMIC_ARB_CHNL115_WDATA1_ADDR A:0xcd30014
y.create.l HWIO_PMIC_ARB_CHNL116_WDATA1_ADDR A:0xcd40014
y.create.l HWIO_PMIC_ARB_CHNL117_WDATA1_ADDR A:0xcd50014
y.create.l HWIO_PMIC_ARB_CHNL118_WDATA1_ADDR A:0xcd60014
y.create.l HWIO_PMIC_ARB_CHNL119_WDATA1_ADDR A:0xcd70014
y.create.l HWIO_PMIC_ARB_CHNL120_WDATA1_ADDR A:0xcd80014
y.create.l HWIO_PMIC_ARB_CHNL121_WDATA1_ADDR A:0xcd90014
y.create.l HWIO_PMIC_ARB_CHNL122_WDATA1_ADDR A:0xcda0014
y.create.l HWIO_PMIC_ARB_CHNL123_WDATA1_ADDR A:0xcdb0014
y.create.l HWIO_PMIC_ARB_CHNL124_WDATA1_ADDR A:0xcdc0014
y.create.l HWIO_PMIC_ARB_CHNL125_WDATA1_ADDR A:0xcdd0014
y.create.l HWIO_PMIC_ARB_CHNL126_WDATA1_ADDR A:0xcde0014
y.create.l HWIO_PMIC_ARB_CHNL127_WDATA1_ADDR A:0xcdf0014
y.create.l HWIO_PMIC_ARB_CHNL128_WDATA1_ADDR A:0xce00014
y.create.l HWIO_PMIC_ARB_CHNL129_WDATA1_ADDR A:0xce10014
y.create.l HWIO_PMIC_ARB_CHNL130_WDATA1_ADDR A:0xce20014
y.create.l HWIO_PMIC_ARB_CHNL131_WDATA1_ADDR A:0xce30014
y.create.l HWIO_PMIC_ARB_CHNL132_WDATA1_ADDR A:0xce40014
y.create.l HWIO_PMIC_ARB_CHNL133_WDATA1_ADDR A:0xce50014
y.create.l HWIO_PMIC_ARB_CHNL134_WDATA1_ADDR A:0xce60014
y.create.l HWIO_PMIC_ARB_CHNL135_WDATA1_ADDR A:0xce70014
y.create.l HWIO_PMIC_ARB_CHNL136_WDATA1_ADDR A:0xce80014
y.create.l HWIO_PMIC_ARB_CHNL137_WDATA1_ADDR A:0xce90014
y.create.l HWIO_PMIC_ARB_CHNL138_WDATA1_ADDR A:0xcea0014
y.create.l HWIO_PMIC_ARB_CHNL139_WDATA1_ADDR A:0xceb0014
y.create.l HWIO_PMIC_ARB_CHNL140_WDATA1_ADDR A:0xcec0014
y.create.l HWIO_PMIC_ARB_CHNL141_WDATA1_ADDR A:0xced0014
y.create.l HWIO_PMIC_ARB_CHNL142_WDATA1_ADDR A:0xcee0014
y.create.l HWIO_PMIC_ARB_CHNL143_WDATA1_ADDR A:0xcef0014
y.create.l HWIO_PMIC_ARB_CHNL144_WDATA1_ADDR A:0xcf00014
y.create.l HWIO_PMIC_ARB_CHNL145_WDATA1_ADDR A:0xcf10014
y.create.l HWIO_PMIC_ARB_CHNL146_WDATA1_ADDR A:0xcf20014
y.create.l HWIO_PMIC_ARB_CHNL147_WDATA1_ADDR A:0xcf30014
y.create.l HWIO_PMIC_ARB_CHNL148_WDATA1_ADDR A:0xcf40014
y.create.l HWIO_PMIC_ARB_CHNL149_WDATA1_ADDR A:0xcf50014
y.create.l HWIO_PMIC_ARB_CHNL150_WDATA1_ADDR A:0xcf60014
y.create.l HWIO_PMIC_ARB_CHNL151_WDATA1_ADDR A:0xcf70014
y.create.l HWIO_PMIC_ARB_CHNL152_WDATA1_ADDR A:0xcf80014
y.create.l HWIO_PMIC_ARB_CHNL153_WDATA1_ADDR A:0xcf90014
y.create.l HWIO_PMIC_ARB_CHNL154_WDATA1_ADDR A:0xcfa0014
y.create.l HWIO_PMIC_ARB_CHNL155_WDATA1_ADDR A:0xcfb0014
y.create.l HWIO_PMIC_ARB_CHNL156_WDATA1_ADDR A:0xcfc0014
y.create.l HWIO_PMIC_ARB_CHNL157_WDATA1_ADDR A:0xcfd0014
y.create.l HWIO_PMIC_ARB_CHNL158_WDATA1_ADDR A:0xcfe0014
y.create.l HWIO_PMIC_ARB_CHNL159_WDATA1_ADDR A:0xcff0014
y.create.l HWIO_PMIC_ARB_CHNL160_WDATA1_ADDR A:0xd000014
y.create.l HWIO_PMIC_ARB_CHNL161_WDATA1_ADDR A:0xd010014
y.create.l HWIO_PMIC_ARB_CHNL162_WDATA1_ADDR A:0xd020014
y.create.l HWIO_PMIC_ARB_CHNL163_WDATA1_ADDR A:0xd030014
y.create.l HWIO_PMIC_ARB_CHNL164_WDATA1_ADDR A:0xd040014
y.create.l HWIO_PMIC_ARB_CHNL165_WDATA1_ADDR A:0xd050014
y.create.l HWIO_PMIC_ARB_CHNL166_WDATA1_ADDR A:0xd060014
y.create.l HWIO_PMIC_ARB_CHNL167_WDATA1_ADDR A:0xd070014
y.create.l HWIO_PMIC_ARB_CHNL168_WDATA1_ADDR A:0xd080014
y.create.l HWIO_PMIC_ARB_CHNL169_WDATA1_ADDR A:0xd090014
y.create.l HWIO_PMIC_ARB_CHNL170_WDATA1_ADDR A:0xd0a0014
y.create.l HWIO_PMIC_ARB_CHNL171_WDATA1_ADDR A:0xd0b0014
y.create.l HWIO_PMIC_ARB_CHNL172_WDATA1_ADDR A:0xd0c0014
y.create.l HWIO_PMIC_ARB_CHNL173_WDATA1_ADDR A:0xd0d0014
y.create.l HWIO_PMIC_ARB_CHNL174_WDATA1_ADDR A:0xd0e0014
y.create.l HWIO_PMIC_ARB_CHNL175_WDATA1_ADDR A:0xd0f0014
y.create.l HWIO_PMIC_ARB_CHNL176_WDATA1_ADDR A:0xd100014
y.create.l HWIO_PMIC_ARB_CHNL177_WDATA1_ADDR A:0xd110014
y.create.l HWIO_PMIC_ARB_CHNL178_WDATA1_ADDR A:0xd120014
y.create.l HWIO_PMIC_ARB_CHNL179_WDATA1_ADDR A:0xd130014
y.create.l HWIO_PMIC_ARB_CHNL180_WDATA1_ADDR A:0xd140014
y.create.l HWIO_PMIC_ARB_CHNL181_WDATA1_ADDR A:0xd150014
y.create.l HWIO_PMIC_ARB_CHNL182_WDATA1_ADDR A:0xd160014
y.create.l HWIO_PMIC_ARB_CHNL183_WDATA1_ADDR A:0xd170014
y.create.l HWIO_PMIC_ARB_CHNL184_WDATA1_ADDR A:0xd180014
y.create.l HWIO_PMIC_ARB_CHNL185_WDATA1_ADDR A:0xd190014
y.create.l HWIO_PMIC_ARB_CHNL186_WDATA1_ADDR A:0xd1a0014
y.create.l HWIO_PMIC_ARB_CHNL187_WDATA1_ADDR A:0xd1b0014
y.create.l HWIO_PMIC_ARB_CHNL188_WDATA1_ADDR A:0xd1c0014
y.create.l HWIO_PMIC_ARB_CHNL189_WDATA1_ADDR A:0xd1d0014
y.create.l HWIO_PMIC_ARB_CHNL190_WDATA1_ADDR A:0xd1e0014
y.create.l HWIO_PMIC_ARB_CHNL191_WDATA1_ADDR A:0xd1f0014
y.create.l HWIO_PMIC_ARB_CHNL192_WDATA1_ADDR A:0xd200014
y.create.l HWIO_PMIC_ARB_CHNL193_WDATA1_ADDR A:0xd210014
y.create.l HWIO_PMIC_ARB_CHNL194_WDATA1_ADDR A:0xd220014
y.create.l HWIO_PMIC_ARB_CHNL195_WDATA1_ADDR A:0xd230014
y.create.l HWIO_PMIC_ARB_CHNL196_WDATA1_ADDR A:0xd240014
y.create.l HWIO_PMIC_ARB_CHNL197_WDATA1_ADDR A:0xd250014
y.create.l HWIO_PMIC_ARB_CHNL198_WDATA1_ADDR A:0xd260014
y.create.l HWIO_PMIC_ARB_CHNL199_WDATA1_ADDR A:0xd270014
y.create.l HWIO_PMIC_ARB_CHNL200_WDATA1_ADDR A:0xd280014
y.create.l HWIO_PMIC_ARB_CHNL201_WDATA1_ADDR A:0xd290014
y.create.l HWIO_PMIC_ARB_CHNL202_WDATA1_ADDR A:0xd2a0014
y.create.l HWIO_PMIC_ARB_CHNL203_WDATA1_ADDR A:0xd2b0014
y.create.l HWIO_PMIC_ARB_CHNL204_WDATA1_ADDR A:0xd2c0014
y.create.l HWIO_PMIC_ARB_CHNL205_WDATA1_ADDR A:0xd2d0014
y.create.l HWIO_PMIC_ARB_CHNL206_WDATA1_ADDR A:0xd2e0014
y.create.l HWIO_PMIC_ARB_CHNL207_WDATA1_ADDR A:0xd2f0014
y.create.l HWIO_PMIC_ARB_CHNL208_WDATA1_ADDR A:0xd300014
y.create.l HWIO_PMIC_ARB_CHNL209_WDATA1_ADDR A:0xd310014
y.create.l HWIO_PMIC_ARB_CHNL210_WDATA1_ADDR A:0xd320014
y.create.l HWIO_PMIC_ARB_CHNL211_WDATA1_ADDR A:0xd330014
y.create.l HWIO_PMIC_ARB_CHNL212_WDATA1_ADDR A:0xd340014
y.create.l HWIO_PMIC_ARB_CHNL213_WDATA1_ADDR A:0xd350014
y.create.l HWIO_PMIC_ARB_CHNL214_WDATA1_ADDR A:0xd360014
y.create.l HWIO_PMIC_ARB_CHNL215_WDATA1_ADDR A:0xd370014
y.create.l HWIO_PMIC_ARB_CHNL216_WDATA1_ADDR A:0xd380014
y.create.l HWIO_PMIC_ARB_CHNL217_WDATA1_ADDR A:0xd390014
y.create.l HWIO_PMIC_ARB_CHNL218_WDATA1_ADDR A:0xd3a0014
y.create.l HWIO_PMIC_ARB_CHNL219_WDATA1_ADDR A:0xd3b0014
y.create.l HWIO_PMIC_ARB_CHNL220_WDATA1_ADDR A:0xd3c0014
y.create.l HWIO_PMIC_ARB_CHNL221_WDATA1_ADDR A:0xd3d0014
y.create.l HWIO_PMIC_ARB_CHNL222_WDATA1_ADDR A:0xd3e0014
y.create.l HWIO_PMIC_ARB_CHNL223_WDATA1_ADDR A:0xd3f0014
y.create.l HWIO_PMIC_ARB_CHNL224_WDATA1_ADDR A:0xd400014
y.create.l HWIO_PMIC_ARB_CHNL225_WDATA1_ADDR A:0xd410014
y.create.l HWIO_PMIC_ARB_CHNL226_WDATA1_ADDR A:0xd420014
y.create.l HWIO_PMIC_ARB_CHNL227_WDATA1_ADDR A:0xd430014
y.create.l HWIO_PMIC_ARB_CHNL228_WDATA1_ADDR A:0xd440014
y.create.l HWIO_PMIC_ARB_CHNL229_WDATA1_ADDR A:0xd450014
y.create.l HWIO_PMIC_ARB_CHNL230_WDATA1_ADDR A:0xd460014
y.create.l HWIO_PMIC_ARB_CHNL231_WDATA1_ADDR A:0xd470014
y.create.l HWIO_PMIC_ARB_CHNL232_WDATA1_ADDR A:0xd480014
y.create.l HWIO_PMIC_ARB_CHNL233_WDATA1_ADDR A:0xd490014
y.create.l HWIO_PMIC_ARB_CHNL234_WDATA1_ADDR A:0xd4a0014
y.create.l HWIO_PMIC_ARB_CHNL235_WDATA1_ADDR A:0xd4b0014
y.create.l HWIO_PMIC_ARB_CHNL236_WDATA1_ADDR A:0xd4c0014
y.create.l HWIO_PMIC_ARB_CHNL237_WDATA1_ADDR A:0xd4d0014
y.create.l HWIO_PMIC_ARB_CHNL238_WDATA1_ADDR A:0xd4e0014
y.create.l HWIO_PMIC_ARB_CHNL239_WDATA1_ADDR A:0xd4f0014
y.create.l HWIO_PMIC_ARB_CHNL240_WDATA1_ADDR A:0xd500014
y.create.l HWIO_PMIC_ARB_CHNL241_WDATA1_ADDR A:0xd510014
y.create.l HWIO_PMIC_ARB_CHNL242_WDATA1_ADDR A:0xd520014
y.create.l HWIO_PMIC_ARB_CHNL243_WDATA1_ADDR A:0xd530014
y.create.l HWIO_PMIC_ARB_CHNL244_WDATA1_ADDR A:0xd540014
y.create.l HWIO_PMIC_ARB_CHNL245_WDATA1_ADDR A:0xd550014
y.create.l HWIO_PMIC_ARB_CHNL246_WDATA1_ADDR A:0xd560014
y.create.l HWIO_PMIC_ARB_CHNL247_WDATA1_ADDR A:0xd570014
y.create.l HWIO_PMIC_ARB_CHNL248_WDATA1_ADDR A:0xd580014
y.create.l HWIO_PMIC_ARB_CHNL249_WDATA1_ADDR A:0xd590014
y.create.l HWIO_PMIC_ARB_CHNL250_WDATA1_ADDR A:0xd5a0014
y.create.l HWIO_PMIC_ARB_CHNL251_WDATA1_ADDR A:0xd5b0014
y.create.l HWIO_PMIC_ARB_CHNL252_WDATA1_ADDR A:0xd5c0014
y.create.l HWIO_PMIC_ARB_CHNL253_WDATA1_ADDR A:0xd5d0014
y.create.l HWIO_PMIC_ARB_CHNL254_WDATA1_ADDR A:0xd5e0014
y.create.l HWIO_PMIC_ARB_CHNL255_WDATA1_ADDR A:0xd5f0014
y.create.l HWIO_PMIC_ARB_CHNL256_WDATA1_ADDR A:0xd600014
y.create.l HWIO_PMIC_ARB_CHNL257_WDATA1_ADDR A:0xd610014
y.create.l HWIO_PMIC_ARB_CHNL258_WDATA1_ADDR A:0xd620014
y.create.l HWIO_PMIC_ARB_CHNL259_WDATA1_ADDR A:0xd630014
y.create.l HWIO_PMIC_ARB_CHNL260_WDATA1_ADDR A:0xd640014
y.create.l HWIO_PMIC_ARB_CHNL261_WDATA1_ADDR A:0xd650014
y.create.l HWIO_PMIC_ARB_CHNL262_WDATA1_ADDR A:0xd660014
y.create.l HWIO_PMIC_ARB_CHNL263_WDATA1_ADDR A:0xd670014
y.create.l HWIO_PMIC_ARB_CHNL264_WDATA1_ADDR A:0xd680014
y.create.l HWIO_PMIC_ARB_CHNL265_WDATA1_ADDR A:0xd690014
y.create.l HWIO_PMIC_ARB_CHNL266_WDATA1_ADDR A:0xd6a0014
y.create.l HWIO_PMIC_ARB_CHNL267_WDATA1_ADDR A:0xd6b0014
y.create.l HWIO_PMIC_ARB_CHNL268_WDATA1_ADDR A:0xd6c0014
y.create.l HWIO_PMIC_ARB_CHNL269_WDATA1_ADDR A:0xd6d0014
y.create.l HWIO_PMIC_ARB_CHNL270_WDATA1_ADDR A:0xd6e0014
y.create.l HWIO_PMIC_ARB_CHNL271_WDATA1_ADDR A:0xd6f0014
y.create.l HWIO_PMIC_ARB_CHNL272_WDATA1_ADDR A:0xd700014
y.create.l HWIO_PMIC_ARB_CHNL273_WDATA1_ADDR A:0xd710014
y.create.l HWIO_PMIC_ARB_CHNL274_WDATA1_ADDR A:0xd720014
y.create.l HWIO_PMIC_ARB_CHNL275_WDATA1_ADDR A:0xd730014
y.create.l HWIO_PMIC_ARB_CHNL276_WDATA1_ADDR A:0xd740014
y.create.l HWIO_PMIC_ARB_CHNL277_WDATA1_ADDR A:0xd750014
y.create.l HWIO_PMIC_ARB_CHNL278_WDATA1_ADDR A:0xd760014
y.create.l HWIO_PMIC_ARB_CHNL279_WDATA1_ADDR A:0xd770014
y.create.l HWIO_PMIC_ARB_CHNL280_WDATA1_ADDR A:0xd780014
y.create.l HWIO_PMIC_ARB_CHNL281_WDATA1_ADDR A:0xd790014
y.create.l HWIO_PMIC_ARB_CHNL282_WDATA1_ADDR A:0xd7a0014
y.create.l HWIO_PMIC_ARB_CHNL283_WDATA1_ADDR A:0xd7b0014
y.create.l HWIO_PMIC_ARB_CHNL284_WDATA1_ADDR A:0xd7c0014
y.create.l HWIO_PMIC_ARB_CHNL285_WDATA1_ADDR A:0xd7d0014
y.create.l HWIO_PMIC_ARB_CHNL286_WDATA1_ADDR A:0xd7e0014
y.create.l HWIO_PMIC_ARB_CHNL287_WDATA1_ADDR A:0xd7f0014
y.create.l HWIO_PMIC_ARB_CHNL288_WDATA1_ADDR A:0xd800014
y.create.l HWIO_PMIC_ARB_CHNL289_WDATA1_ADDR A:0xd810014
y.create.l HWIO_PMIC_ARB_CHNL290_WDATA1_ADDR A:0xd820014
y.create.l HWIO_PMIC_ARB_CHNL291_WDATA1_ADDR A:0xd830014
y.create.l HWIO_PMIC_ARB_CHNL292_WDATA1_ADDR A:0xd840014
y.create.l HWIO_PMIC_ARB_CHNL293_WDATA1_ADDR A:0xd850014
y.create.l HWIO_PMIC_ARB_CHNL294_WDATA1_ADDR A:0xd860014
y.create.l HWIO_PMIC_ARB_CHNL295_WDATA1_ADDR A:0xd870014
y.create.l HWIO_PMIC_ARB_CHNL296_WDATA1_ADDR A:0xd880014
y.create.l HWIO_PMIC_ARB_CHNL297_WDATA1_ADDR A:0xd890014
y.create.l HWIO_PMIC_ARB_CHNL298_WDATA1_ADDR A:0xd8a0014
y.create.l HWIO_PMIC_ARB_CHNL299_WDATA1_ADDR A:0xd8b0014
y.create.l HWIO_PMIC_ARB_CHNL300_WDATA1_ADDR A:0xd8c0014
y.create.l HWIO_PMIC_ARB_CHNL301_WDATA1_ADDR A:0xd8d0014
y.create.l HWIO_PMIC_ARB_CHNL302_WDATA1_ADDR A:0xd8e0014
y.create.l HWIO_PMIC_ARB_CHNL303_WDATA1_ADDR A:0xd8f0014
y.create.l HWIO_PMIC_ARB_CHNL304_WDATA1_ADDR A:0xd900014
y.create.l HWIO_PMIC_ARB_CHNL305_WDATA1_ADDR A:0xd910014
y.create.l HWIO_PMIC_ARB_CHNL306_WDATA1_ADDR A:0xd920014
y.create.l HWIO_PMIC_ARB_CHNL307_WDATA1_ADDR A:0xd930014
y.create.l HWIO_PMIC_ARB_CHNL308_WDATA1_ADDR A:0xd940014
y.create.l HWIO_PMIC_ARB_CHNL309_WDATA1_ADDR A:0xd950014
y.create.l HWIO_PMIC_ARB_CHNL310_WDATA1_ADDR A:0xd960014
y.create.l HWIO_PMIC_ARB_CHNL311_WDATA1_ADDR A:0xd970014
y.create.l HWIO_PMIC_ARB_CHNL312_WDATA1_ADDR A:0xd980014
y.create.l HWIO_PMIC_ARB_CHNL313_WDATA1_ADDR A:0xd990014
y.create.l HWIO_PMIC_ARB_CHNL314_WDATA1_ADDR A:0xd9a0014
y.create.l HWIO_PMIC_ARB_CHNL315_WDATA1_ADDR A:0xd9b0014
y.create.l HWIO_PMIC_ARB_CHNL316_WDATA1_ADDR A:0xd9c0014
y.create.l HWIO_PMIC_ARB_CHNL317_WDATA1_ADDR A:0xd9d0014
y.create.l HWIO_PMIC_ARB_CHNL318_WDATA1_ADDR A:0xd9e0014
y.create.l HWIO_PMIC_ARB_CHNL319_WDATA1_ADDR A:0xd9f0014
y.create.l HWIO_PMIC_ARB_CHNL320_WDATA1_ADDR A:0xda00014
y.create.l HWIO_PMIC_ARB_CHNL321_WDATA1_ADDR A:0xda10014
y.create.l HWIO_PMIC_ARB_CHNL322_WDATA1_ADDR A:0xda20014
y.create.l HWIO_PMIC_ARB_CHNL323_WDATA1_ADDR A:0xda30014
y.create.l HWIO_PMIC_ARB_CHNL324_WDATA1_ADDR A:0xda40014
y.create.l HWIO_PMIC_ARB_CHNL325_WDATA1_ADDR A:0xda50014
y.create.l HWIO_PMIC_ARB_CHNL326_WDATA1_ADDR A:0xda60014
y.create.l HWIO_PMIC_ARB_CHNL327_WDATA1_ADDR A:0xda70014
y.create.l HWIO_PMIC_ARB_CHNL328_WDATA1_ADDR A:0xda80014
y.create.l HWIO_PMIC_ARB_CHNL329_WDATA1_ADDR A:0xda90014
y.create.l HWIO_PMIC_ARB_CHNL330_WDATA1_ADDR A:0xdaa0014
y.create.l HWIO_PMIC_ARB_CHNL331_WDATA1_ADDR A:0xdab0014
y.create.l HWIO_PMIC_ARB_CHNL332_WDATA1_ADDR A:0xdac0014
y.create.l HWIO_PMIC_ARB_CHNL333_WDATA1_ADDR A:0xdad0014
y.create.l HWIO_PMIC_ARB_CHNL334_WDATA1_ADDR A:0xdae0014
y.create.l HWIO_PMIC_ARB_CHNL335_WDATA1_ADDR A:0xdaf0014
y.create.l HWIO_PMIC_ARB_CHNL336_WDATA1_ADDR A:0xdb00014
y.create.l HWIO_PMIC_ARB_CHNL337_WDATA1_ADDR A:0xdb10014
y.create.l HWIO_PMIC_ARB_CHNL338_WDATA1_ADDR A:0xdb20014
y.create.l HWIO_PMIC_ARB_CHNL339_WDATA1_ADDR A:0xdb30014
y.create.l HWIO_PMIC_ARB_CHNL340_WDATA1_ADDR A:0xdb40014
y.create.l HWIO_PMIC_ARB_CHNL341_WDATA1_ADDR A:0xdb50014
y.create.l HWIO_PMIC_ARB_CHNL342_WDATA1_ADDR A:0xdb60014
y.create.l HWIO_PMIC_ARB_CHNL343_WDATA1_ADDR A:0xdb70014
y.create.l HWIO_PMIC_ARB_CHNL344_WDATA1_ADDR A:0xdb80014
y.create.l HWIO_PMIC_ARB_CHNL345_WDATA1_ADDR A:0xdb90014
y.create.l HWIO_PMIC_ARB_CHNL346_WDATA1_ADDR A:0xdba0014
y.create.l HWIO_PMIC_ARB_CHNL347_WDATA1_ADDR A:0xdbb0014
y.create.l HWIO_PMIC_ARB_CHNL348_WDATA1_ADDR A:0xdbc0014
y.create.l HWIO_PMIC_ARB_CHNL349_WDATA1_ADDR A:0xdbd0014
y.create.l HWIO_PMIC_ARB_CHNL350_WDATA1_ADDR A:0xdbe0014
y.create.l HWIO_PMIC_ARB_CHNL351_WDATA1_ADDR A:0xdbf0014
y.create.l HWIO_PMIC_ARB_CHNL352_WDATA1_ADDR A:0xdc00014
y.create.l HWIO_PMIC_ARB_CHNL353_WDATA1_ADDR A:0xdc10014
y.create.l HWIO_PMIC_ARB_CHNL354_WDATA1_ADDR A:0xdc20014
y.create.l HWIO_PMIC_ARB_CHNL355_WDATA1_ADDR A:0xdc30014
y.create.l HWIO_PMIC_ARB_CHNL356_WDATA1_ADDR A:0xdc40014
y.create.l HWIO_PMIC_ARB_CHNL357_WDATA1_ADDR A:0xdc50014
y.create.l HWIO_PMIC_ARB_CHNL358_WDATA1_ADDR A:0xdc60014
y.create.l HWIO_PMIC_ARB_CHNL359_WDATA1_ADDR A:0xdc70014
y.create.l HWIO_PMIC_ARB_CHNL360_WDATA1_ADDR A:0xdc80014
y.create.l HWIO_PMIC_ARB_CHNL361_WDATA1_ADDR A:0xdc90014
y.create.l HWIO_PMIC_ARB_CHNL362_WDATA1_ADDR A:0xdca0014
y.create.l HWIO_PMIC_ARB_CHNL363_WDATA1_ADDR A:0xdcb0014
y.create.l HWIO_PMIC_ARB_CHNL364_WDATA1_ADDR A:0xdcc0014
y.create.l HWIO_PMIC_ARB_CHNL365_WDATA1_ADDR A:0xdcd0014
y.create.l HWIO_PMIC_ARB_CHNL366_WDATA1_ADDR A:0xdce0014
y.create.l HWIO_PMIC_ARB_CHNL367_WDATA1_ADDR A:0xdcf0014
y.create.l HWIO_PMIC_ARB_CHNL368_WDATA1_ADDR A:0xdd00014
y.create.l HWIO_PMIC_ARB_CHNL369_WDATA1_ADDR A:0xdd10014
y.create.l HWIO_PMIC_ARB_CHNL370_WDATA1_ADDR A:0xdd20014
y.create.l HWIO_PMIC_ARB_CHNL371_WDATA1_ADDR A:0xdd30014
y.create.l HWIO_PMIC_ARB_CHNL372_WDATA1_ADDR A:0xdd40014
y.create.l HWIO_PMIC_ARB_CHNL373_WDATA1_ADDR A:0xdd50014
y.create.l HWIO_PMIC_ARB_CHNL374_WDATA1_ADDR A:0xdd60014
y.create.l HWIO_PMIC_ARB_CHNL375_WDATA1_ADDR A:0xdd70014
y.create.l HWIO_PMIC_ARB_CHNL376_WDATA1_ADDR A:0xdd80014
y.create.l HWIO_PMIC_ARB_CHNL377_WDATA1_ADDR A:0xdd90014
y.create.l HWIO_PMIC_ARB_CHNL378_WDATA1_ADDR A:0xdda0014
y.create.l HWIO_PMIC_ARB_CHNL379_WDATA1_ADDR A:0xddb0014
y.create.l HWIO_PMIC_ARB_CHNL380_WDATA1_ADDR A:0xddc0014
y.create.l HWIO_PMIC_ARB_CHNL381_WDATA1_ADDR A:0xddd0014
y.create.l HWIO_PMIC_ARB_CHNL382_WDATA1_ADDR A:0xdde0014
y.create.l HWIO_PMIC_ARB_CHNL383_WDATA1_ADDR A:0xddf0014
y.create.l HWIO_PMIC_ARB_CHNL384_WDATA1_ADDR A:0xde00014
y.create.l HWIO_PMIC_ARB_CHNL385_WDATA1_ADDR A:0xde10014
y.create.l HWIO_PMIC_ARB_CHNL386_WDATA1_ADDR A:0xde20014
y.create.l HWIO_PMIC_ARB_CHNL387_WDATA1_ADDR A:0xde30014
y.create.l HWIO_PMIC_ARB_CHNL388_WDATA1_ADDR A:0xde40014
y.create.l HWIO_PMIC_ARB_CHNL389_WDATA1_ADDR A:0xde50014
y.create.l HWIO_PMIC_ARB_CHNL390_WDATA1_ADDR A:0xde60014
y.create.l HWIO_PMIC_ARB_CHNL391_WDATA1_ADDR A:0xde70014
y.create.l HWIO_PMIC_ARB_CHNL392_WDATA1_ADDR A:0xde80014
y.create.l HWIO_PMIC_ARB_CHNL393_WDATA1_ADDR A:0xde90014
y.create.l HWIO_PMIC_ARB_CHNL394_WDATA1_ADDR A:0xdea0014
y.create.l HWIO_PMIC_ARB_CHNL395_WDATA1_ADDR A:0xdeb0014
y.create.l HWIO_PMIC_ARB_CHNL396_WDATA1_ADDR A:0xdec0014
y.create.l HWIO_PMIC_ARB_CHNL397_WDATA1_ADDR A:0xded0014
y.create.l HWIO_PMIC_ARB_CHNL398_WDATA1_ADDR A:0xdee0014
y.create.l HWIO_PMIC_ARB_CHNL399_WDATA1_ADDR A:0xdef0014
y.create.l HWIO_PMIC_ARB_CHNL400_WDATA1_ADDR A:0xdf00014
y.create.l HWIO_PMIC_ARB_CHNL401_WDATA1_ADDR A:0xdf10014
y.create.l HWIO_PMIC_ARB_CHNL402_WDATA1_ADDR A:0xdf20014
y.create.l HWIO_PMIC_ARB_CHNL403_WDATA1_ADDR A:0xdf30014
y.create.l HWIO_PMIC_ARB_CHNL404_WDATA1_ADDR A:0xdf40014
y.create.l HWIO_PMIC_ARB_CHNL405_WDATA1_ADDR A:0xdf50014
y.create.l HWIO_PMIC_ARB_CHNL406_WDATA1_ADDR A:0xdf60014
y.create.l HWIO_PMIC_ARB_CHNL407_WDATA1_ADDR A:0xdf70014
y.create.l HWIO_PMIC_ARB_CHNL408_WDATA1_ADDR A:0xdf80014
y.create.l HWIO_PMIC_ARB_CHNL409_WDATA1_ADDR A:0xdf90014
y.create.l HWIO_PMIC_ARB_CHNL410_WDATA1_ADDR A:0xdfa0014
y.create.l HWIO_PMIC_ARB_CHNL411_WDATA1_ADDR A:0xdfb0014
y.create.l HWIO_PMIC_ARB_CHNL412_WDATA1_ADDR A:0xdfc0014
y.create.l HWIO_PMIC_ARB_CHNL413_WDATA1_ADDR A:0xdfd0014
y.create.l HWIO_PMIC_ARB_CHNL414_WDATA1_ADDR A:0xdfe0014
y.create.l HWIO_PMIC_ARB_CHNL415_WDATA1_ADDR A:0xdff0014
y.create.l HWIO_PMIC_ARB_CHNL416_WDATA1_ADDR A:0xe000014
y.create.l HWIO_PMIC_ARB_CHNL417_WDATA1_ADDR A:0xe010014
y.create.l HWIO_PMIC_ARB_CHNL418_WDATA1_ADDR A:0xe020014
y.create.l HWIO_PMIC_ARB_CHNL419_WDATA1_ADDR A:0xe030014
y.create.l HWIO_PMIC_ARB_CHNL420_WDATA1_ADDR A:0xe040014
y.create.l HWIO_PMIC_ARB_CHNL421_WDATA1_ADDR A:0xe050014
y.create.l HWIO_PMIC_ARB_CHNL422_WDATA1_ADDR A:0xe060014
y.create.l HWIO_PMIC_ARB_CHNL423_WDATA1_ADDR A:0xe070014
y.create.l HWIO_PMIC_ARB_CHNL424_WDATA1_ADDR A:0xe080014
y.create.l HWIO_PMIC_ARB_CHNL425_WDATA1_ADDR A:0xe090014
y.create.l HWIO_PMIC_ARB_CHNL426_WDATA1_ADDR A:0xe0a0014
y.create.l HWIO_PMIC_ARB_CHNL427_WDATA1_ADDR A:0xe0b0014
y.create.l HWIO_PMIC_ARB_CHNL428_WDATA1_ADDR A:0xe0c0014
y.create.l HWIO_PMIC_ARB_CHNL429_WDATA1_ADDR A:0xe0d0014
y.create.l HWIO_PMIC_ARB_CHNL430_WDATA1_ADDR A:0xe0e0014
y.create.l HWIO_PMIC_ARB_CHNL431_WDATA1_ADDR A:0xe0f0014
y.create.l HWIO_PMIC_ARB_CHNL432_WDATA1_ADDR A:0xe100014
y.create.l HWIO_PMIC_ARB_CHNL433_WDATA1_ADDR A:0xe110014
y.create.l HWIO_PMIC_ARB_CHNL434_WDATA1_ADDR A:0xe120014
y.create.l HWIO_PMIC_ARB_CHNL435_WDATA1_ADDR A:0xe130014
y.create.l HWIO_PMIC_ARB_CHNL436_WDATA1_ADDR A:0xe140014
y.create.l HWIO_PMIC_ARB_CHNL437_WDATA1_ADDR A:0xe150014
y.create.l HWIO_PMIC_ARB_CHNL438_WDATA1_ADDR A:0xe160014
y.create.l HWIO_PMIC_ARB_CHNL439_WDATA1_ADDR A:0xe170014
y.create.l HWIO_PMIC_ARB_CHNL440_WDATA1_ADDR A:0xe180014
y.create.l HWIO_PMIC_ARB_CHNL441_WDATA1_ADDR A:0xe190014
y.create.l HWIO_PMIC_ARB_CHNL442_WDATA1_ADDR A:0xe1a0014
y.create.l HWIO_PMIC_ARB_CHNL443_WDATA1_ADDR A:0xe1b0014
y.create.l HWIO_PMIC_ARB_CHNL444_WDATA1_ADDR A:0xe1c0014
y.create.l HWIO_PMIC_ARB_CHNL445_WDATA1_ADDR A:0xe1d0014
y.create.l HWIO_PMIC_ARB_CHNL446_WDATA1_ADDR A:0xe1e0014
y.create.l HWIO_PMIC_ARB_CHNL447_WDATA1_ADDR A:0xe1f0014
y.create.l HWIO_PMIC_ARB_CHNL448_WDATA1_ADDR A:0xe200014
y.create.l HWIO_PMIC_ARB_CHNL449_WDATA1_ADDR A:0xe210014
y.create.l HWIO_PMIC_ARB_CHNL450_WDATA1_ADDR A:0xe220014
y.create.l HWIO_PMIC_ARB_CHNL451_WDATA1_ADDR A:0xe230014
y.create.l HWIO_PMIC_ARB_CHNL452_WDATA1_ADDR A:0xe240014
y.create.l HWIO_PMIC_ARB_CHNL453_WDATA1_ADDR A:0xe250014
y.create.l HWIO_PMIC_ARB_CHNL454_WDATA1_ADDR A:0xe260014
y.create.l HWIO_PMIC_ARB_CHNL455_WDATA1_ADDR A:0xe270014
y.create.l HWIO_PMIC_ARB_CHNL456_WDATA1_ADDR A:0xe280014
y.create.l HWIO_PMIC_ARB_CHNL457_WDATA1_ADDR A:0xe290014
y.create.l HWIO_PMIC_ARB_CHNL458_WDATA1_ADDR A:0xe2a0014
y.create.l HWIO_PMIC_ARB_CHNL459_WDATA1_ADDR A:0xe2b0014
y.create.l HWIO_PMIC_ARB_CHNL460_WDATA1_ADDR A:0xe2c0014
y.create.l HWIO_PMIC_ARB_CHNL461_WDATA1_ADDR A:0xe2d0014
y.create.l HWIO_PMIC_ARB_CHNL462_WDATA1_ADDR A:0xe2e0014
y.create.l HWIO_PMIC_ARB_CHNL463_WDATA1_ADDR A:0xe2f0014
y.create.l HWIO_PMIC_ARB_CHNL464_WDATA1_ADDR A:0xe300014
y.create.l HWIO_PMIC_ARB_CHNL465_WDATA1_ADDR A:0xe310014
y.create.l HWIO_PMIC_ARB_CHNL466_WDATA1_ADDR A:0xe320014
y.create.l HWIO_PMIC_ARB_CHNL467_WDATA1_ADDR A:0xe330014
y.create.l HWIO_PMIC_ARB_CHNL468_WDATA1_ADDR A:0xe340014
y.create.l HWIO_PMIC_ARB_CHNL469_WDATA1_ADDR A:0xe350014
y.create.l HWIO_PMIC_ARB_CHNL470_WDATA1_ADDR A:0xe360014
y.create.l HWIO_PMIC_ARB_CHNL471_WDATA1_ADDR A:0xe370014
y.create.l HWIO_PMIC_ARB_CHNL472_WDATA1_ADDR A:0xe380014
y.create.l HWIO_PMIC_ARB_CHNL473_WDATA1_ADDR A:0xe390014
y.create.l HWIO_PMIC_ARB_CHNL474_WDATA1_ADDR A:0xe3a0014
y.create.l HWIO_PMIC_ARB_CHNL475_WDATA1_ADDR A:0xe3b0014
y.create.l HWIO_PMIC_ARB_CHNL476_WDATA1_ADDR A:0xe3c0014
y.create.l HWIO_PMIC_ARB_CHNL477_WDATA1_ADDR A:0xe3d0014
y.create.l HWIO_PMIC_ARB_CHNL478_WDATA1_ADDR A:0xe3e0014
y.create.l HWIO_PMIC_ARB_CHNL479_WDATA1_ADDR A:0xe3f0014
y.create.l HWIO_PMIC_ARB_CHNL480_WDATA1_ADDR A:0xe400014
y.create.l HWIO_PMIC_ARB_CHNL481_WDATA1_ADDR A:0xe410014
y.create.l HWIO_PMIC_ARB_CHNL482_WDATA1_ADDR A:0xe420014
y.create.l HWIO_PMIC_ARB_CHNL483_WDATA1_ADDR A:0xe430014
y.create.l HWIO_PMIC_ARB_CHNL484_WDATA1_ADDR A:0xe440014
y.create.l HWIO_PMIC_ARB_CHNL485_WDATA1_ADDR A:0xe450014
y.create.l HWIO_PMIC_ARB_CHNL486_WDATA1_ADDR A:0xe460014
y.create.l HWIO_PMIC_ARB_CHNL487_WDATA1_ADDR A:0xe470014
y.create.l HWIO_PMIC_ARB_CHNL488_WDATA1_ADDR A:0xe480014
y.create.l HWIO_PMIC_ARB_CHNL489_WDATA1_ADDR A:0xe490014
y.create.l HWIO_PMIC_ARB_CHNL490_WDATA1_ADDR A:0xe4a0014
y.create.l HWIO_PMIC_ARB_CHNL491_WDATA1_ADDR A:0xe4b0014
y.create.l HWIO_PMIC_ARB_CHNL492_WDATA1_ADDR A:0xe4c0014
y.create.l HWIO_PMIC_ARB_CHNL493_WDATA1_ADDR A:0xe4d0014
y.create.l HWIO_PMIC_ARB_CHNL494_WDATA1_ADDR A:0xe4e0014
y.create.l HWIO_PMIC_ARB_CHNL495_WDATA1_ADDR A:0xe4f0014
y.create.l HWIO_PMIC_ARB_CHNL496_WDATA1_ADDR A:0xe500014
y.create.l HWIO_PMIC_ARB_CHNL497_WDATA1_ADDR A:0xe510014
y.create.l HWIO_PMIC_ARB_CHNL498_WDATA1_ADDR A:0xe520014
y.create.l HWIO_PMIC_ARB_CHNL499_WDATA1_ADDR A:0xe530014
y.create.l HWIO_PMIC_ARB_CHNL500_WDATA1_ADDR A:0xe540014
y.create.l HWIO_PMIC_ARB_CHNL501_WDATA1_ADDR A:0xe550014
y.create.l HWIO_PMIC_ARB_CHNL502_WDATA1_ADDR A:0xe560014
y.create.l HWIO_PMIC_ARB_CHNL503_WDATA1_ADDR A:0xe570014
y.create.l HWIO_PMIC_ARB_CHNL504_WDATA1_ADDR A:0xe580014
y.create.l HWIO_PMIC_ARB_CHNL505_WDATA1_ADDR A:0xe590014
y.create.l HWIO_PMIC_ARB_CHNL506_WDATA1_ADDR A:0xe5a0014
y.create.l HWIO_PMIC_ARB_CHNL507_WDATA1_ADDR A:0xe5b0014
y.create.l HWIO_PMIC_ARB_CHNL508_WDATA1_ADDR A:0xe5c0014
y.create.l HWIO_PMIC_ARB_CHNL509_WDATA1_ADDR A:0xe5d0014
y.create.l HWIO_PMIC_ARB_CHNL510_WDATA1_ADDR A:0xe5e0014
y.create.l HWIO_PMIC_ARB_CHNL511_WDATA1_ADDR A:0xe5f0014
y.create.l HWIO_PMIC_ARB_CHNL0_RDATA0_ADDR A:0xc600018
y.create.l HWIO_PMIC_ARB_CHNL1_RDATA0_ADDR A:0xc610018
y.create.l HWIO_PMIC_ARB_CHNL2_RDATA0_ADDR A:0xc620018
y.create.l HWIO_PMIC_ARB_CHNL3_RDATA0_ADDR A:0xc630018
y.create.l HWIO_PMIC_ARB_CHNL4_RDATA0_ADDR A:0xc640018
y.create.l HWIO_PMIC_ARB_CHNL5_RDATA0_ADDR A:0xc650018
y.create.l HWIO_PMIC_ARB_CHNL6_RDATA0_ADDR A:0xc660018
y.create.l HWIO_PMIC_ARB_CHNL7_RDATA0_ADDR A:0xc670018
y.create.l HWIO_PMIC_ARB_CHNL8_RDATA0_ADDR A:0xc680018
y.create.l HWIO_PMIC_ARB_CHNL9_RDATA0_ADDR A:0xc690018
y.create.l HWIO_PMIC_ARB_CHNL10_RDATA0_ADDR A:0xc6a0018
y.create.l HWIO_PMIC_ARB_CHNL11_RDATA0_ADDR A:0xc6b0018
y.create.l HWIO_PMIC_ARB_CHNL12_RDATA0_ADDR A:0xc6c0018
y.create.l HWIO_PMIC_ARB_CHNL13_RDATA0_ADDR A:0xc6d0018
y.create.l HWIO_PMIC_ARB_CHNL14_RDATA0_ADDR A:0xc6e0018
y.create.l HWIO_PMIC_ARB_CHNL15_RDATA0_ADDR A:0xc6f0018
y.create.l HWIO_PMIC_ARB_CHNL16_RDATA0_ADDR A:0xc700018
y.create.l HWIO_PMIC_ARB_CHNL17_RDATA0_ADDR A:0xc710018
y.create.l HWIO_PMIC_ARB_CHNL18_RDATA0_ADDR A:0xc720018
y.create.l HWIO_PMIC_ARB_CHNL19_RDATA0_ADDR A:0xc730018
y.create.l HWIO_PMIC_ARB_CHNL20_RDATA0_ADDR A:0xc740018
y.create.l HWIO_PMIC_ARB_CHNL21_RDATA0_ADDR A:0xc750018
y.create.l HWIO_PMIC_ARB_CHNL22_RDATA0_ADDR A:0xc760018
y.create.l HWIO_PMIC_ARB_CHNL23_RDATA0_ADDR A:0xc770018
y.create.l HWIO_PMIC_ARB_CHNL24_RDATA0_ADDR A:0xc780018
y.create.l HWIO_PMIC_ARB_CHNL25_RDATA0_ADDR A:0xc790018
y.create.l HWIO_PMIC_ARB_CHNL26_RDATA0_ADDR A:0xc7a0018
y.create.l HWIO_PMIC_ARB_CHNL27_RDATA0_ADDR A:0xc7b0018
y.create.l HWIO_PMIC_ARB_CHNL28_RDATA0_ADDR A:0xc7c0018
y.create.l HWIO_PMIC_ARB_CHNL29_RDATA0_ADDR A:0xc7d0018
y.create.l HWIO_PMIC_ARB_CHNL30_RDATA0_ADDR A:0xc7e0018
y.create.l HWIO_PMIC_ARB_CHNL31_RDATA0_ADDR A:0xc7f0018
y.create.l HWIO_PMIC_ARB_CHNL32_RDATA0_ADDR A:0xc800018
y.create.l HWIO_PMIC_ARB_CHNL33_RDATA0_ADDR A:0xc810018
y.create.l HWIO_PMIC_ARB_CHNL34_RDATA0_ADDR A:0xc820018
y.create.l HWIO_PMIC_ARB_CHNL35_RDATA0_ADDR A:0xc830018
y.create.l HWIO_PMIC_ARB_CHNL36_RDATA0_ADDR A:0xc840018
y.create.l HWIO_PMIC_ARB_CHNL37_RDATA0_ADDR A:0xc850018
y.create.l HWIO_PMIC_ARB_CHNL38_RDATA0_ADDR A:0xc860018
y.create.l HWIO_PMIC_ARB_CHNL39_RDATA0_ADDR A:0xc870018
y.create.l HWIO_PMIC_ARB_CHNL40_RDATA0_ADDR A:0xc880018
y.create.l HWIO_PMIC_ARB_CHNL41_RDATA0_ADDR A:0xc890018
y.create.l HWIO_PMIC_ARB_CHNL42_RDATA0_ADDR A:0xc8a0018
y.create.l HWIO_PMIC_ARB_CHNL43_RDATA0_ADDR A:0xc8b0018
y.create.l HWIO_PMIC_ARB_CHNL44_RDATA0_ADDR A:0xc8c0018
y.create.l HWIO_PMIC_ARB_CHNL45_RDATA0_ADDR A:0xc8d0018
y.create.l HWIO_PMIC_ARB_CHNL46_RDATA0_ADDR A:0xc8e0018
y.create.l HWIO_PMIC_ARB_CHNL47_RDATA0_ADDR A:0xc8f0018
y.create.l HWIO_PMIC_ARB_CHNL48_RDATA0_ADDR A:0xc900018
y.create.l HWIO_PMIC_ARB_CHNL49_RDATA0_ADDR A:0xc910018
y.create.l HWIO_PMIC_ARB_CHNL50_RDATA0_ADDR A:0xc920018
y.create.l HWIO_PMIC_ARB_CHNL51_RDATA0_ADDR A:0xc930018
y.create.l HWIO_PMIC_ARB_CHNL52_RDATA0_ADDR A:0xc940018
y.create.l HWIO_PMIC_ARB_CHNL53_RDATA0_ADDR A:0xc950018
y.create.l HWIO_PMIC_ARB_CHNL54_RDATA0_ADDR A:0xc960018
y.create.l HWIO_PMIC_ARB_CHNL55_RDATA0_ADDR A:0xc970018
y.create.l HWIO_PMIC_ARB_CHNL56_RDATA0_ADDR A:0xc980018
y.create.l HWIO_PMIC_ARB_CHNL57_RDATA0_ADDR A:0xc990018
y.create.l HWIO_PMIC_ARB_CHNL58_RDATA0_ADDR A:0xc9a0018
y.create.l HWIO_PMIC_ARB_CHNL59_RDATA0_ADDR A:0xc9b0018
y.create.l HWIO_PMIC_ARB_CHNL60_RDATA0_ADDR A:0xc9c0018
y.create.l HWIO_PMIC_ARB_CHNL61_RDATA0_ADDR A:0xc9d0018
y.create.l HWIO_PMIC_ARB_CHNL62_RDATA0_ADDR A:0xc9e0018
y.create.l HWIO_PMIC_ARB_CHNL63_RDATA0_ADDR A:0xc9f0018
y.create.l HWIO_PMIC_ARB_CHNL64_RDATA0_ADDR A:0xca00018
y.create.l HWIO_PMIC_ARB_CHNL65_RDATA0_ADDR A:0xca10018
y.create.l HWIO_PMIC_ARB_CHNL66_RDATA0_ADDR A:0xca20018
y.create.l HWIO_PMIC_ARB_CHNL67_RDATA0_ADDR A:0xca30018
y.create.l HWIO_PMIC_ARB_CHNL68_RDATA0_ADDR A:0xca40018
y.create.l HWIO_PMIC_ARB_CHNL69_RDATA0_ADDR A:0xca50018
y.create.l HWIO_PMIC_ARB_CHNL70_RDATA0_ADDR A:0xca60018
y.create.l HWIO_PMIC_ARB_CHNL71_RDATA0_ADDR A:0xca70018
y.create.l HWIO_PMIC_ARB_CHNL72_RDATA0_ADDR A:0xca80018
y.create.l HWIO_PMIC_ARB_CHNL73_RDATA0_ADDR A:0xca90018
y.create.l HWIO_PMIC_ARB_CHNL74_RDATA0_ADDR A:0xcaa0018
y.create.l HWIO_PMIC_ARB_CHNL75_RDATA0_ADDR A:0xcab0018
y.create.l HWIO_PMIC_ARB_CHNL76_RDATA0_ADDR A:0xcac0018
y.create.l HWIO_PMIC_ARB_CHNL77_RDATA0_ADDR A:0xcad0018
y.create.l HWIO_PMIC_ARB_CHNL78_RDATA0_ADDR A:0xcae0018
y.create.l HWIO_PMIC_ARB_CHNL79_RDATA0_ADDR A:0xcaf0018
y.create.l HWIO_PMIC_ARB_CHNL80_RDATA0_ADDR A:0xcb00018
y.create.l HWIO_PMIC_ARB_CHNL81_RDATA0_ADDR A:0xcb10018
y.create.l HWIO_PMIC_ARB_CHNL82_RDATA0_ADDR A:0xcb20018
y.create.l HWIO_PMIC_ARB_CHNL83_RDATA0_ADDR A:0xcb30018
y.create.l HWIO_PMIC_ARB_CHNL84_RDATA0_ADDR A:0xcb40018
y.create.l HWIO_PMIC_ARB_CHNL85_RDATA0_ADDR A:0xcb50018
y.create.l HWIO_PMIC_ARB_CHNL86_RDATA0_ADDR A:0xcb60018
y.create.l HWIO_PMIC_ARB_CHNL87_RDATA0_ADDR A:0xcb70018
y.create.l HWIO_PMIC_ARB_CHNL88_RDATA0_ADDR A:0xcb80018
y.create.l HWIO_PMIC_ARB_CHNL89_RDATA0_ADDR A:0xcb90018
y.create.l HWIO_PMIC_ARB_CHNL90_RDATA0_ADDR A:0xcba0018
y.create.l HWIO_PMIC_ARB_CHNL91_RDATA0_ADDR A:0xcbb0018
y.create.l HWIO_PMIC_ARB_CHNL92_RDATA0_ADDR A:0xcbc0018
y.create.l HWIO_PMIC_ARB_CHNL93_RDATA0_ADDR A:0xcbd0018
y.create.l HWIO_PMIC_ARB_CHNL94_RDATA0_ADDR A:0xcbe0018
y.create.l HWIO_PMIC_ARB_CHNL95_RDATA0_ADDR A:0xcbf0018
y.create.l HWIO_PMIC_ARB_CHNL96_RDATA0_ADDR A:0xcc00018
y.create.l HWIO_PMIC_ARB_CHNL97_RDATA0_ADDR A:0xcc10018
y.create.l HWIO_PMIC_ARB_CHNL98_RDATA0_ADDR A:0xcc20018
y.create.l HWIO_PMIC_ARB_CHNL99_RDATA0_ADDR A:0xcc30018
y.create.l HWIO_PMIC_ARB_CHNL100_RDATA0_ADDR A:0xcc40018
y.create.l HWIO_PMIC_ARB_CHNL101_RDATA0_ADDR A:0xcc50018
y.create.l HWIO_PMIC_ARB_CHNL102_RDATA0_ADDR A:0xcc60018
y.create.l HWIO_PMIC_ARB_CHNL103_RDATA0_ADDR A:0xcc70018
y.create.l HWIO_PMIC_ARB_CHNL104_RDATA0_ADDR A:0xcc80018
y.create.l HWIO_PMIC_ARB_CHNL105_RDATA0_ADDR A:0xcc90018
y.create.l HWIO_PMIC_ARB_CHNL106_RDATA0_ADDR A:0xcca0018
y.create.l HWIO_PMIC_ARB_CHNL107_RDATA0_ADDR A:0xccb0018
y.create.l HWIO_PMIC_ARB_CHNL108_RDATA0_ADDR A:0xccc0018
y.create.l HWIO_PMIC_ARB_CHNL109_RDATA0_ADDR A:0xccd0018
y.create.l HWIO_PMIC_ARB_CHNL110_RDATA0_ADDR A:0xcce0018
y.create.l HWIO_PMIC_ARB_CHNL111_RDATA0_ADDR A:0xccf0018
y.create.l HWIO_PMIC_ARB_CHNL112_RDATA0_ADDR A:0xcd00018
y.create.l HWIO_PMIC_ARB_CHNL113_RDATA0_ADDR A:0xcd10018
y.create.l HWIO_PMIC_ARB_CHNL114_RDATA0_ADDR A:0xcd20018
y.create.l HWIO_PMIC_ARB_CHNL115_RDATA0_ADDR A:0xcd30018
y.create.l HWIO_PMIC_ARB_CHNL116_RDATA0_ADDR A:0xcd40018
y.create.l HWIO_PMIC_ARB_CHNL117_RDATA0_ADDR A:0xcd50018
y.create.l HWIO_PMIC_ARB_CHNL118_RDATA0_ADDR A:0xcd60018
y.create.l HWIO_PMIC_ARB_CHNL119_RDATA0_ADDR A:0xcd70018
y.create.l HWIO_PMIC_ARB_CHNL120_RDATA0_ADDR A:0xcd80018
y.create.l HWIO_PMIC_ARB_CHNL121_RDATA0_ADDR A:0xcd90018
y.create.l HWIO_PMIC_ARB_CHNL122_RDATA0_ADDR A:0xcda0018
y.create.l HWIO_PMIC_ARB_CHNL123_RDATA0_ADDR A:0xcdb0018
y.create.l HWIO_PMIC_ARB_CHNL124_RDATA0_ADDR A:0xcdc0018
y.create.l HWIO_PMIC_ARB_CHNL125_RDATA0_ADDR A:0xcdd0018
y.create.l HWIO_PMIC_ARB_CHNL126_RDATA0_ADDR A:0xcde0018
y.create.l HWIO_PMIC_ARB_CHNL127_RDATA0_ADDR A:0xcdf0018
y.create.l HWIO_PMIC_ARB_CHNL128_RDATA0_ADDR A:0xce00018
y.create.l HWIO_PMIC_ARB_CHNL129_RDATA0_ADDR A:0xce10018
y.create.l HWIO_PMIC_ARB_CHNL130_RDATA0_ADDR A:0xce20018
y.create.l HWIO_PMIC_ARB_CHNL131_RDATA0_ADDR A:0xce30018
y.create.l HWIO_PMIC_ARB_CHNL132_RDATA0_ADDR A:0xce40018
y.create.l HWIO_PMIC_ARB_CHNL133_RDATA0_ADDR A:0xce50018
y.create.l HWIO_PMIC_ARB_CHNL134_RDATA0_ADDR A:0xce60018
y.create.l HWIO_PMIC_ARB_CHNL135_RDATA0_ADDR A:0xce70018
y.create.l HWIO_PMIC_ARB_CHNL136_RDATA0_ADDR A:0xce80018
y.create.l HWIO_PMIC_ARB_CHNL137_RDATA0_ADDR A:0xce90018
y.create.l HWIO_PMIC_ARB_CHNL138_RDATA0_ADDR A:0xcea0018
y.create.l HWIO_PMIC_ARB_CHNL139_RDATA0_ADDR A:0xceb0018
y.create.l HWIO_PMIC_ARB_CHNL140_RDATA0_ADDR A:0xcec0018
y.create.l HWIO_PMIC_ARB_CHNL141_RDATA0_ADDR A:0xced0018
y.create.l HWIO_PMIC_ARB_CHNL142_RDATA0_ADDR A:0xcee0018
y.create.l HWIO_PMIC_ARB_CHNL143_RDATA0_ADDR A:0xcef0018
y.create.l HWIO_PMIC_ARB_CHNL144_RDATA0_ADDR A:0xcf00018
y.create.l HWIO_PMIC_ARB_CHNL145_RDATA0_ADDR A:0xcf10018
y.create.l HWIO_PMIC_ARB_CHNL146_RDATA0_ADDR A:0xcf20018
y.create.l HWIO_PMIC_ARB_CHNL147_RDATA0_ADDR A:0xcf30018
y.create.l HWIO_PMIC_ARB_CHNL148_RDATA0_ADDR A:0xcf40018
y.create.l HWIO_PMIC_ARB_CHNL149_RDATA0_ADDR A:0xcf50018
y.create.l HWIO_PMIC_ARB_CHNL150_RDATA0_ADDR A:0xcf60018
y.create.l HWIO_PMIC_ARB_CHNL151_RDATA0_ADDR A:0xcf70018
y.create.l HWIO_PMIC_ARB_CHNL152_RDATA0_ADDR A:0xcf80018
y.create.l HWIO_PMIC_ARB_CHNL153_RDATA0_ADDR A:0xcf90018
y.create.l HWIO_PMIC_ARB_CHNL154_RDATA0_ADDR A:0xcfa0018
y.create.l HWIO_PMIC_ARB_CHNL155_RDATA0_ADDR A:0xcfb0018
y.create.l HWIO_PMIC_ARB_CHNL156_RDATA0_ADDR A:0xcfc0018
y.create.l HWIO_PMIC_ARB_CHNL157_RDATA0_ADDR A:0xcfd0018
y.create.l HWIO_PMIC_ARB_CHNL158_RDATA0_ADDR A:0xcfe0018
y.create.l HWIO_PMIC_ARB_CHNL159_RDATA0_ADDR A:0xcff0018
y.create.l HWIO_PMIC_ARB_CHNL160_RDATA0_ADDR A:0xd000018
y.create.l HWIO_PMIC_ARB_CHNL161_RDATA0_ADDR A:0xd010018
y.create.l HWIO_PMIC_ARB_CHNL162_RDATA0_ADDR A:0xd020018
y.create.l HWIO_PMIC_ARB_CHNL163_RDATA0_ADDR A:0xd030018
y.create.l HWIO_PMIC_ARB_CHNL164_RDATA0_ADDR A:0xd040018
y.create.l HWIO_PMIC_ARB_CHNL165_RDATA0_ADDR A:0xd050018
y.create.l HWIO_PMIC_ARB_CHNL166_RDATA0_ADDR A:0xd060018
y.create.l HWIO_PMIC_ARB_CHNL167_RDATA0_ADDR A:0xd070018
y.create.l HWIO_PMIC_ARB_CHNL168_RDATA0_ADDR A:0xd080018
y.create.l HWIO_PMIC_ARB_CHNL169_RDATA0_ADDR A:0xd090018
y.create.l HWIO_PMIC_ARB_CHNL170_RDATA0_ADDR A:0xd0a0018
y.create.l HWIO_PMIC_ARB_CHNL171_RDATA0_ADDR A:0xd0b0018
y.create.l HWIO_PMIC_ARB_CHNL172_RDATA0_ADDR A:0xd0c0018
y.create.l HWIO_PMIC_ARB_CHNL173_RDATA0_ADDR A:0xd0d0018
y.create.l HWIO_PMIC_ARB_CHNL174_RDATA0_ADDR A:0xd0e0018
y.create.l HWIO_PMIC_ARB_CHNL175_RDATA0_ADDR A:0xd0f0018
y.create.l HWIO_PMIC_ARB_CHNL176_RDATA0_ADDR A:0xd100018
y.create.l HWIO_PMIC_ARB_CHNL177_RDATA0_ADDR A:0xd110018
y.create.l HWIO_PMIC_ARB_CHNL178_RDATA0_ADDR A:0xd120018
y.create.l HWIO_PMIC_ARB_CHNL179_RDATA0_ADDR A:0xd130018
y.create.l HWIO_PMIC_ARB_CHNL180_RDATA0_ADDR A:0xd140018
y.create.l HWIO_PMIC_ARB_CHNL181_RDATA0_ADDR A:0xd150018
y.create.l HWIO_PMIC_ARB_CHNL182_RDATA0_ADDR A:0xd160018
y.create.l HWIO_PMIC_ARB_CHNL183_RDATA0_ADDR A:0xd170018
y.create.l HWIO_PMIC_ARB_CHNL184_RDATA0_ADDR A:0xd180018
y.create.l HWIO_PMIC_ARB_CHNL185_RDATA0_ADDR A:0xd190018
y.create.l HWIO_PMIC_ARB_CHNL186_RDATA0_ADDR A:0xd1a0018
y.create.l HWIO_PMIC_ARB_CHNL187_RDATA0_ADDR A:0xd1b0018
y.create.l HWIO_PMIC_ARB_CHNL188_RDATA0_ADDR A:0xd1c0018
y.create.l HWIO_PMIC_ARB_CHNL189_RDATA0_ADDR A:0xd1d0018
y.create.l HWIO_PMIC_ARB_CHNL190_RDATA0_ADDR A:0xd1e0018
y.create.l HWIO_PMIC_ARB_CHNL191_RDATA0_ADDR A:0xd1f0018
y.create.l HWIO_PMIC_ARB_CHNL192_RDATA0_ADDR A:0xd200018
y.create.l HWIO_PMIC_ARB_CHNL193_RDATA0_ADDR A:0xd210018
y.create.l HWIO_PMIC_ARB_CHNL194_RDATA0_ADDR A:0xd220018
y.create.l HWIO_PMIC_ARB_CHNL195_RDATA0_ADDR A:0xd230018
y.create.l HWIO_PMIC_ARB_CHNL196_RDATA0_ADDR A:0xd240018
y.create.l HWIO_PMIC_ARB_CHNL197_RDATA0_ADDR A:0xd250018
y.create.l HWIO_PMIC_ARB_CHNL198_RDATA0_ADDR A:0xd260018
y.create.l HWIO_PMIC_ARB_CHNL199_RDATA0_ADDR A:0xd270018
y.create.l HWIO_PMIC_ARB_CHNL200_RDATA0_ADDR A:0xd280018
y.create.l HWIO_PMIC_ARB_CHNL201_RDATA0_ADDR A:0xd290018
y.create.l HWIO_PMIC_ARB_CHNL202_RDATA0_ADDR A:0xd2a0018
y.create.l HWIO_PMIC_ARB_CHNL203_RDATA0_ADDR A:0xd2b0018
y.create.l HWIO_PMIC_ARB_CHNL204_RDATA0_ADDR A:0xd2c0018
y.create.l HWIO_PMIC_ARB_CHNL205_RDATA0_ADDR A:0xd2d0018
y.create.l HWIO_PMIC_ARB_CHNL206_RDATA0_ADDR A:0xd2e0018
y.create.l HWIO_PMIC_ARB_CHNL207_RDATA0_ADDR A:0xd2f0018
y.create.l HWIO_PMIC_ARB_CHNL208_RDATA0_ADDR A:0xd300018
y.create.l HWIO_PMIC_ARB_CHNL209_RDATA0_ADDR A:0xd310018
y.create.l HWIO_PMIC_ARB_CHNL210_RDATA0_ADDR A:0xd320018
y.create.l HWIO_PMIC_ARB_CHNL211_RDATA0_ADDR A:0xd330018
y.create.l HWIO_PMIC_ARB_CHNL212_RDATA0_ADDR A:0xd340018
y.create.l HWIO_PMIC_ARB_CHNL213_RDATA0_ADDR A:0xd350018
y.create.l HWIO_PMIC_ARB_CHNL214_RDATA0_ADDR A:0xd360018
y.create.l HWIO_PMIC_ARB_CHNL215_RDATA0_ADDR A:0xd370018
y.create.l HWIO_PMIC_ARB_CHNL216_RDATA0_ADDR A:0xd380018
y.create.l HWIO_PMIC_ARB_CHNL217_RDATA0_ADDR A:0xd390018
y.create.l HWIO_PMIC_ARB_CHNL218_RDATA0_ADDR A:0xd3a0018
y.create.l HWIO_PMIC_ARB_CHNL219_RDATA0_ADDR A:0xd3b0018
y.create.l HWIO_PMIC_ARB_CHNL220_RDATA0_ADDR A:0xd3c0018
y.create.l HWIO_PMIC_ARB_CHNL221_RDATA0_ADDR A:0xd3d0018
y.create.l HWIO_PMIC_ARB_CHNL222_RDATA0_ADDR A:0xd3e0018
y.create.l HWIO_PMIC_ARB_CHNL223_RDATA0_ADDR A:0xd3f0018
y.create.l HWIO_PMIC_ARB_CHNL224_RDATA0_ADDR A:0xd400018
y.create.l HWIO_PMIC_ARB_CHNL225_RDATA0_ADDR A:0xd410018
y.create.l HWIO_PMIC_ARB_CHNL226_RDATA0_ADDR A:0xd420018
y.create.l HWIO_PMIC_ARB_CHNL227_RDATA0_ADDR A:0xd430018
y.create.l HWIO_PMIC_ARB_CHNL228_RDATA0_ADDR A:0xd440018
y.create.l HWIO_PMIC_ARB_CHNL229_RDATA0_ADDR A:0xd450018
y.create.l HWIO_PMIC_ARB_CHNL230_RDATA0_ADDR A:0xd460018
y.create.l HWIO_PMIC_ARB_CHNL231_RDATA0_ADDR A:0xd470018
y.create.l HWIO_PMIC_ARB_CHNL232_RDATA0_ADDR A:0xd480018
y.create.l HWIO_PMIC_ARB_CHNL233_RDATA0_ADDR A:0xd490018
y.create.l HWIO_PMIC_ARB_CHNL234_RDATA0_ADDR A:0xd4a0018
y.create.l HWIO_PMIC_ARB_CHNL235_RDATA0_ADDR A:0xd4b0018
y.create.l HWIO_PMIC_ARB_CHNL236_RDATA0_ADDR A:0xd4c0018
y.create.l HWIO_PMIC_ARB_CHNL237_RDATA0_ADDR A:0xd4d0018
y.create.l HWIO_PMIC_ARB_CHNL238_RDATA0_ADDR A:0xd4e0018
y.create.l HWIO_PMIC_ARB_CHNL239_RDATA0_ADDR A:0xd4f0018
y.create.l HWIO_PMIC_ARB_CHNL240_RDATA0_ADDR A:0xd500018
y.create.l HWIO_PMIC_ARB_CHNL241_RDATA0_ADDR A:0xd510018
y.create.l HWIO_PMIC_ARB_CHNL242_RDATA0_ADDR A:0xd520018
y.create.l HWIO_PMIC_ARB_CHNL243_RDATA0_ADDR A:0xd530018
y.create.l HWIO_PMIC_ARB_CHNL244_RDATA0_ADDR A:0xd540018
y.create.l HWIO_PMIC_ARB_CHNL245_RDATA0_ADDR A:0xd550018
y.create.l HWIO_PMIC_ARB_CHNL246_RDATA0_ADDR A:0xd560018
y.create.l HWIO_PMIC_ARB_CHNL247_RDATA0_ADDR A:0xd570018
y.create.l HWIO_PMIC_ARB_CHNL248_RDATA0_ADDR A:0xd580018
y.create.l HWIO_PMIC_ARB_CHNL249_RDATA0_ADDR A:0xd590018
y.create.l HWIO_PMIC_ARB_CHNL250_RDATA0_ADDR A:0xd5a0018
y.create.l HWIO_PMIC_ARB_CHNL251_RDATA0_ADDR A:0xd5b0018
y.create.l HWIO_PMIC_ARB_CHNL252_RDATA0_ADDR A:0xd5c0018
y.create.l HWIO_PMIC_ARB_CHNL253_RDATA0_ADDR A:0xd5d0018
y.create.l HWIO_PMIC_ARB_CHNL254_RDATA0_ADDR A:0xd5e0018
y.create.l HWIO_PMIC_ARB_CHNL255_RDATA0_ADDR A:0xd5f0018
y.create.l HWIO_PMIC_ARB_CHNL256_RDATA0_ADDR A:0xd600018
y.create.l HWIO_PMIC_ARB_CHNL257_RDATA0_ADDR A:0xd610018
y.create.l HWIO_PMIC_ARB_CHNL258_RDATA0_ADDR A:0xd620018
y.create.l HWIO_PMIC_ARB_CHNL259_RDATA0_ADDR A:0xd630018
y.create.l HWIO_PMIC_ARB_CHNL260_RDATA0_ADDR A:0xd640018
y.create.l HWIO_PMIC_ARB_CHNL261_RDATA0_ADDR A:0xd650018
y.create.l HWIO_PMIC_ARB_CHNL262_RDATA0_ADDR A:0xd660018
y.create.l HWIO_PMIC_ARB_CHNL263_RDATA0_ADDR A:0xd670018
y.create.l HWIO_PMIC_ARB_CHNL264_RDATA0_ADDR A:0xd680018
y.create.l HWIO_PMIC_ARB_CHNL265_RDATA0_ADDR A:0xd690018
y.create.l HWIO_PMIC_ARB_CHNL266_RDATA0_ADDR A:0xd6a0018
y.create.l HWIO_PMIC_ARB_CHNL267_RDATA0_ADDR A:0xd6b0018
y.create.l HWIO_PMIC_ARB_CHNL268_RDATA0_ADDR A:0xd6c0018
y.create.l HWIO_PMIC_ARB_CHNL269_RDATA0_ADDR A:0xd6d0018
y.create.l HWIO_PMIC_ARB_CHNL270_RDATA0_ADDR A:0xd6e0018
y.create.l HWIO_PMIC_ARB_CHNL271_RDATA0_ADDR A:0xd6f0018
y.create.l HWIO_PMIC_ARB_CHNL272_RDATA0_ADDR A:0xd700018
y.create.l HWIO_PMIC_ARB_CHNL273_RDATA0_ADDR A:0xd710018
y.create.l HWIO_PMIC_ARB_CHNL274_RDATA0_ADDR A:0xd720018
y.create.l HWIO_PMIC_ARB_CHNL275_RDATA0_ADDR A:0xd730018
y.create.l HWIO_PMIC_ARB_CHNL276_RDATA0_ADDR A:0xd740018
y.create.l HWIO_PMIC_ARB_CHNL277_RDATA0_ADDR A:0xd750018
y.create.l HWIO_PMIC_ARB_CHNL278_RDATA0_ADDR A:0xd760018
y.create.l HWIO_PMIC_ARB_CHNL279_RDATA0_ADDR A:0xd770018
y.create.l HWIO_PMIC_ARB_CHNL280_RDATA0_ADDR A:0xd780018
y.create.l HWIO_PMIC_ARB_CHNL281_RDATA0_ADDR A:0xd790018
y.create.l HWIO_PMIC_ARB_CHNL282_RDATA0_ADDR A:0xd7a0018
y.create.l HWIO_PMIC_ARB_CHNL283_RDATA0_ADDR A:0xd7b0018
y.create.l HWIO_PMIC_ARB_CHNL284_RDATA0_ADDR A:0xd7c0018
y.create.l HWIO_PMIC_ARB_CHNL285_RDATA0_ADDR A:0xd7d0018
y.create.l HWIO_PMIC_ARB_CHNL286_RDATA0_ADDR A:0xd7e0018
y.create.l HWIO_PMIC_ARB_CHNL287_RDATA0_ADDR A:0xd7f0018
y.create.l HWIO_PMIC_ARB_CHNL288_RDATA0_ADDR A:0xd800018
y.create.l HWIO_PMIC_ARB_CHNL289_RDATA0_ADDR A:0xd810018
y.create.l HWIO_PMIC_ARB_CHNL290_RDATA0_ADDR A:0xd820018
y.create.l HWIO_PMIC_ARB_CHNL291_RDATA0_ADDR A:0xd830018
y.create.l HWIO_PMIC_ARB_CHNL292_RDATA0_ADDR A:0xd840018
y.create.l HWIO_PMIC_ARB_CHNL293_RDATA0_ADDR A:0xd850018
y.create.l HWIO_PMIC_ARB_CHNL294_RDATA0_ADDR A:0xd860018
y.create.l HWIO_PMIC_ARB_CHNL295_RDATA0_ADDR A:0xd870018
y.create.l HWIO_PMIC_ARB_CHNL296_RDATA0_ADDR A:0xd880018
y.create.l HWIO_PMIC_ARB_CHNL297_RDATA0_ADDR A:0xd890018
y.create.l HWIO_PMIC_ARB_CHNL298_RDATA0_ADDR A:0xd8a0018
y.create.l HWIO_PMIC_ARB_CHNL299_RDATA0_ADDR A:0xd8b0018
y.create.l HWIO_PMIC_ARB_CHNL300_RDATA0_ADDR A:0xd8c0018
y.create.l HWIO_PMIC_ARB_CHNL301_RDATA0_ADDR A:0xd8d0018
y.create.l HWIO_PMIC_ARB_CHNL302_RDATA0_ADDR A:0xd8e0018
y.create.l HWIO_PMIC_ARB_CHNL303_RDATA0_ADDR A:0xd8f0018
y.create.l HWIO_PMIC_ARB_CHNL304_RDATA0_ADDR A:0xd900018
y.create.l HWIO_PMIC_ARB_CHNL305_RDATA0_ADDR A:0xd910018
y.create.l HWIO_PMIC_ARB_CHNL306_RDATA0_ADDR A:0xd920018
y.create.l HWIO_PMIC_ARB_CHNL307_RDATA0_ADDR A:0xd930018
y.create.l HWIO_PMIC_ARB_CHNL308_RDATA0_ADDR A:0xd940018
y.create.l HWIO_PMIC_ARB_CHNL309_RDATA0_ADDR A:0xd950018
y.create.l HWIO_PMIC_ARB_CHNL310_RDATA0_ADDR A:0xd960018
y.create.l HWIO_PMIC_ARB_CHNL311_RDATA0_ADDR A:0xd970018
y.create.l HWIO_PMIC_ARB_CHNL312_RDATA0_ADDR A:0xd980018
y.create.l HWIO_PMIC_ARB_CHNL313_RDATA0_ADDR A:0xd990018
y.create.l HWIO_PMIC_ARB_CHNL314_RDATA0_ADDR A:0xd9a0018
y.create.l HWIO_PMIC_ARB_CHNL315_RDATA0_ADDR A:0xd9b0018
y.create.l HWIO_PMIC_ARB_CHNL316_RDATA0_ADDR A:0xd9c0018
y.create.l HWIO_PMIC_ARB_CHNL317_RDATA0_ADDR A:0xd9d0018
y.create.l HWIO_PMIC_ARB_CHNL318_RDATA0_ADDR A:0xd9e0018
y.create.l HWIO_PMIC_ARB_CHNL319_RDATA0_ADDR A:0xd9f0018
y.create.l HWIO_PMIC_ARB_CHNL320_RDATA0_ADDR A:0xda00018
y.create.l HWIO_PMIC_ARB_CHNL321_RDATA0_ADDR A:0xda10018
y.create.l HWIO_PMIC_ARB_CHNL322_RDATA0_ADDR A:0xda20018
y.create.l HWIO_PMIC_ARB_CHNL323_RDATA0_ADDR A:0xda30018
y.create.l HWIO_PMIC_ARB_CHNL324_RDATA0_ADDR A:0xda40018
y.create.l HWIO_PMIC_ARB_CHNL325_RDATA0_ADDR A:0xda50018
y.create.l HWIO_PMIC_ARB_CHNL326_RDATA0_ADDR A:0xda60018
y.create.l HWIO_PMIC_ARB_CHNL327_RDATA0_ADDR A:0xda70018
y.create.l HWIO_PMIC_ARB_CHNL328_RDATA0_ADDR A:0xda80018
y.create.l HWIO_PMIC_ARB_CHNL329_RDATA0_ADDR A:0xda90018
y.create.l HWIO_PMIC_ARB_CHNL330_RDATA0_ADDR A:0xdaa0018
y.create.l HWIO_PMIC_ARB_CHNL331_RDATA0_ADDR A:0xdab0018
y.create.l HWIO_PMIC_ARB_CHNL332_RDATA0_ADDR A:0xdac0018
y.create.l HWIO_PMIC_ARB_CHNL333_RDATA0_ADDR A:0xdad0018
y.create.l HWIO_PMIC_ARB_CHNL334_RDATA0_ADDR A:0xdae0018
y.create.l HWIO_PMIC_ARB_CHNL335_RDATA0_ADDR A:0xdaf0018
y.create.l HWIO_PMIC_ARB_CHNL336_RDATA0_ADDR A:0xdb00018
y.create.l HWIO_PMIC_ARB_CHNL337_RDATA0_ADDR A:0xdb10018
y.create.l HWIO_PMIC_ARB_CHNL338_RDATA0_ADDR A:0xdb20018
y.create.l HWIO_PMIC_ARB_CHNL339_RDATA0_ADDR A:0xdb30018
y.create.l HWIO_PMIC_ARB_CHNL340_RDATA0_ADDR A:0xdb40018
y.create.l HWIO_PMIC_ARB_CHNL341_RDATA0_ADDR A:0xdb50018
y.create.l HWIO_PMIC_ARB_CHNL342_RDATA0_ADDR A:0xdb60018
y.create.l HWIO_PMIC_ARB_CHNL343_RDATA0_ADDR A:0xdb70018
y.create.l HWIO_PMIC_ARB_CHNL344_RDATA0_ADDR A:0xdb80018
y.create.l HWIO_PMIC_ARB_CHNL345_RDATA0_ADDR A:0xdb90018
y.create.l HWIO_PMIC_ARB_CHNL346_RDATA0_ADDR A:0xdba0018
y.create.l HWIO_PMIC_ARB_CHNL347_RDATA0_ADDR A:0xdbb0018
y.create.l HWIO_PMIC_ARB_CHNL348_RDATA0_ADDR A:0xdbc0018
y.create.l HWIO_PMIC_ARB_CHNL349_RDATA0_ADDR A:0xdbd0018
y.create.l HWIO_PMIC_ARB_CHNL350_RDATA0_ADDR A:0xdbe0018
y.create.l HWIO_PMIC_ARB_CHNL351_RDATA0_ADDR A:0xdbf0018
y.create.l HWIO_PMIC_ARB_CHNL352_RDATA0_ADDR A:0xdc00018
y.create.l HWIO_PMIC_ARB_CHNL353_RDATA0_ADDR A:0xdc10018
y.create.l HWIO_PMIC_ARB_CHNL354_RDATA0_ADDR A:0xdc20018
y.create.l HWIO_PMIC_ARB_CHNL355_RDATA0_ADDR A:0xdc30018
y.create.l HWIO_PMIC_ARB_CHNL356_RDATA0_ADDR A:0xdc40018
y.create.l HWIO_PMIC_ARB_CHNL357_RDATA0_ADDR A:0xdc50018
y.create.l HWIO_PMIC_ARB_CHNL358_RDATA0_ADDR A:0xdc60018
y.create.l HWIO_PMIC_ARB_CHNL359_RDATA0_ADDR A:0xdc70018
y.create.l HWIO_PMIC_ARB_CHNL360_RDATA0_ADDR A:0xdc80018
y.create.l HWIO_PMIC_ARB_CHNL361_RDATA0_ADDR A:0xdc90018
y.create.l HWIO_PMIC_ARB_CHNL362_RDATA0_ADDR A:0xdca0018
y.create.l HWIO_PMIC_ARB_CHNL363_RDATA0_ADDR A:0xdcb0018
y.create.l HWIO_PMIC_ARB_CHNL364_RDATA0_ADDR A:0xdcc0018
y.create.l HWIO_PMIC_ARB_CHNL365_RDATA0_ADDR A:0xdcd0018
y.create.l HWIO_PMIC_ARB_CHNL366_RDATA0_ADDR A:0xdce0018
y.create.l HWIO_PMIC_ARB_CHNL367_RDATA0_ADDR A:0xdcf0018
y.create.l HWIO_PMIC_ARB_CHNL368_RDATA0_ADDR A:0xdd00018
y.create.l HWIO_PMIC_ARB_CHNL369_RDATA0_ADDR A:0xdd10018
y.create.l HWIO_PMIC_ARB_CHNL370_RDATA0_ADDR A:0xdd20018
y.create.l HWIO_PMIC_ARB_CHNL371_RDATA0_ADDR A:0xdd30018
y.create.l HWIO_PMIC_ARB_CHNL372_RDATA0_ADDR A:0xdd40018
y.create.l HWIO_PMIC_ARB_CHNL373_RDATA0_ADDR A:0xdd50018
y.create.l HWIO_PMIC_ARB_CHNL374_RDATA0_ADDR A:0xdd60018
y.create.l HWIO_PMIC_ARB_CHNL375_RDATA0_ADDR A:0xdd70018
y.create.l HWIO_PMIC_ARB_CHNL376_RDATA0_ADDR A:0xdd80018
y.create.l HWIO_PMIC_ARB_CHNL377_RDATA0_ADDR A:0xdd90018
y.create.l HWIO_PMIC_ARB_CHNL378_RDATA0_ADDR A:0xdda0018
y.create.l HWIO_PMIC_ARB_CHNL379_RDATA0_ADDR A:0xddb0018
y.create.l HWIO_PMIC_ARB_CHNL380_RDATA0_ADDR A:0xddc0018
y.create.l HWIO_PMIC_ARB_CHNL381_RDATA0_ADDR A:0xddd0018
y.create.l HWIO_PMIC_ARB_CHNL382_RDATA0_ADDR A:0xdde0018
y.create.l HWIO_PMIC_ARB_CHNL383_RDATA0_ADDR A:0xddf0018
y.create.l HWIO_PMIC_ARB_CHNL384_RDATA0_ADDR A:0xde00018
y.create.l HWIO_PMIC_ARB_CHNL385_RDATA0_ADDR A:0xde10018
y.create.l HWIO_PMIC_ARB_CHNL386_RDATA0_ADDR A:0xde20018
y.create.l HWIO_PMIC_ARB_CHNL387_RDATA0_ADDR A:0xde30018
y.create.l HWIO_PMIC_ARB_CHNL388_RDATA0_ADDR A:0xde40018
y.create.l HWIO_PMIC_ARB_CHNL389_RDATA0_ADDR A:0xde50018
y.create.l HWIO_PMIC_ARB_CHNL390_RDATA0_ADDR A:0xde60018
y.create.l HWIO_PMIC_ARB_CHNL391_RDATA0_ADDR A:0xde70018
y.create.l HWIO_PMIC_ARB_CHNL392_RDATA0_ADDR A:0xde80018
y.create.l HWIO_PMIC_ARB_CHNL393_RDATA0_ADDR A:0xde90018
y.create.l HWIO_PMIC_ARB_CHNL394_RDATA0_ADDR A:0xdea0018
y.create.l HWIO_PMIC_ARB_CHNL395_RDATA0_ADDR A:0xdeb0018
y.create.l HWIO_PMIC_ARB_CHNL396_RDATA0_ADDR A:0xdec0018
y.create.l HWIO_PMIC_ARB_CHNL397_RDATA0_ADDR A:0xded0018
y.create.l HWIO_PMIC_ARB_CHNL398_RDATA0_ADDR A:0xdee0018
y.create.l HWIO_PMIC_ARB_CHNL399_RDATA0_ADDR A:0xdef0018
y.create.l HWIO_PMIC_ARB_CHNL400_RDATA0_ADDR A:0xdf00018
y.create.l HWIO_PMIC_ARB_CHNL401_RDATA0_ADDR A:0xdf10018
y.create.l HWIO_PMIC_ARB_CHNL402_RDATA0_ADDR A:0xdf20018
y.create.l HWIO_PMIC_ARB_CHNL403_RDATA0_ADDR A:0xdf30018
y.create.l HWIO_PMIC_ARB_CHNL404_RDATA0_ADDR A:0xdf40018
y.create.l HWIO_PMIC_ARB_CHNL405_RDATA0_ADDR A:0xdf50018
y.create.l HWIO_PMIC_ARB_CHNL406_RDATA0_ADDR A:0xdf60018
y.create.l HWIO_PMIC_ARB_CHNL407_RDATA0_ADDR A:0xdf70018
y.create.l HWIO_PMIC_ARB_CHNL408_RDATA0_ADDR A:0xdf80018
y.create.l HWIO_PMIC_ARB_CHNL409_RDATA0_ADDR A:0xdf90018
y.create.l HWIO_PMIC_ARB_CHNL410_RDATA0_ADDR A:0xdfa0018
y.create.l HWIO_PMIC_ARB_CHNL411_RDATA0_ADDR A:0xdfb0018
y.create.l HWIO_PMIC_ARB_CHNL412_RDATA0_ADDR A:0xdfc0018
y.create.l HWIO_PMIC_ARB_CHNL413_RDATA0_ADDR A:0xdfd0018
y.create.l HWIO_PMIC_ARB_CHNL414_RDATA0_ADDR A:0xdfe0018
y.create.l HWIO_PMIC_ARB_CHNL415_RDATA0_ADDR A:0xdff0018
y.create.l HWIO_PMIC_ARB_CHNL416_RDATA0_ADDR A:0xe000018
y.create.l HWIO_PMIC_ARB_CHNL417_RDATA0_ADDR A:0xe010018
y.create.l HWIO_PMIC_ARB_CHNL418_RDATA0_ADDR A:0xe020018
y.create.l HWIO_PMIC_ARB_CHNL419_RDATA0_ADDR A:0xe030018
y.create.l HWIO_PMIC_ARB_CHNL420_RDATA0_ADDR A:0xe040018
y.create.l HWIO_PMIC_ARB_CHNL421_RDATA0_ADDR A:0xe050018
y.create.l HWIO_PMIC_ARB_CHNL422_RDATA0_ADDR A:0xe060018
y.create.l HWIO_PMIC_ARB_CHNL423_RDATA0_ADDR A:0xe070018
y.create.l HWIO_PMIC_ARB_CHNL424_RDATA0_ADDR A:0xe080018
y.create.l HWIO_PMIC_ARB_CHNL425_RDATA0_ADDR A:0xe090018
y.create.l HWIO_PMIC_ARB_CHNL426_RDATA0_ADDR A:0xe0a0018
y.create.l HWIO_PMIC_ARB_CHNL427_RDATA0_ADDR A:0xe0b0018
y.create.l HWIO_PMIC_ARB_CHNL428_RDATA0_ADDR A:0xe0c0018
y.create.l HWIO_PMIC_ARB_CHNL429_RDATA0_ADDR A:0xe0d0018
y.create.l HWIO_PMIC_ARB_CHNL430_RDATA0_ADDR A:0xe0e0018
y.create.l HWIO_PMIC_ARB_CHNL431_RDATA0_ADDR A:0xe0f0018
y.create.l HWIO_PMIC_ARB_CHNL432_RDATA0_ADDR A:0xe100018
y.create.l HWIO_PMIC_ARB_CHNL433_RDATA0_ADDR A:0xe110018
y.create.l HWIO_PMIC_ARB_CHNL434_RDATA0_ADDR A:0xe120018
y.create.l HWIO_PMIC_ARB_CHNL435_RDATA0_ADDR A:0xe130018
y.create.l HWIO_PMIC_ARB_CHNL436_RDATA0_ADDR A:0xe140018
y.create.l HWIO_PMIC_ARB_CHNL437_RDATA0_ADDR A:0xe150018
y.create.l HWIO_PMIC_ARB_CHNL438_RDATA0_ADDR A:0xe160018
y.create.l HWIO_PMIC_ARB_CHNL439_RDATA0_ADDR A:0xe170018
y.create.l HWIO_PMIC_ARB_CHNL440_RDATA0_ADDR A:0xe180018
y.create.l HWIO_PMIC_ARB_CHNL441_RDATA0_ADDR A:0xe190018
y.create.l HWIO_PMIC_ARB_CHNL442_RDATA0_ADDR A:0xe1a0018
y.create.l HWIO_PMIC_ARB_CHNL443_RDATA0_ADDR A:0xe1b0018
y.create.l HWIO_PMIC_ARB_CHNL444_RDATA0_ADDR A:0xe1c0018
y.create.l HWIO_PMIC_ARB_CHNL445_RDATA0_ADDR A:0xe1d0018
y.create.l HWIO_PMIC_ARB_CHNL446_RDATA0_ADDR A:0xe1e0018
y.create.l HWIO_PMIC_ARB_CHNL447_RDATA0_ADDR A:0xe1f0018
y.create.l HWIO_PMIC_ARB_CHNL448_RDATA0_ADDR A:0xe200018
y.create.l HWIO_PMIC_ARB_CHNL449_RDATA0_ADDR A:0xe210018
y.create.l HWIO_PMIC_ARB_CHNL450_RDATA0_ADDR A:0xe220018
y.create.l HWIO_PMIC_ARB_CHNL451_RDATA0_ADDR A:0xe230018
y.create.l HWIO_PMIC_ARB_CHNL452_RDATA0_ADDR A:0xe240018
y.create.l HWIO_PMIC_ARB_CHNL453_RDATA0_ADDR A:0xe250018
y.create.l HWIO_PMIC_ARB_CHNL454_RDATA0_ADDR A:0xe260018
y.create.l HWIO_PMIC_ARB_CHNL455_RDATA0_ADDR A:0xe270018
y.create.l HWIO_PMIC_ARB_CHNL456_RDATA0_ADDR A:0xe280018
y.create.l HWIO_PMIC_ARB_CHNL457_RDATA0_ADDR A:0xe290018
y.create.l HWIO_PMIC_ARB_CHNL458_RDATA0_ADDR A:0xe2a0018
y.create.l HWIO_PMIC_ARB_CHNL459_RDATA0_ADDR A:0xe2b0018
y.create.l HWIO_PMIC_ARB_CHNL460_RDATA0_ADDR A:0xe2c0018
y.create.l HWIO_PMIC_ARB_CHNL461_RDATA0_ADDR A:0xe2d0018
y.create.l HWIO_PMIC_ARB_CHNL462_RDATA0_ADDR A:0xe2e0018
y.create.l HWIO_PMIC_ARB_CHNL463_RDATA0_ADDR A:0xe2f0018
y.create.l HWIO_PMIC_ARB_CHNL464_RDATA0_ADDR A:0xe300018
y.create.l HWIO_PMIC_ARB_CHNL465_RDATA0_ADDR A:0xe310018
y.create.l HWIO_PMIC_ARB_CHNL466_RDATA0_ADDR A:0xe320018
y.create.l HWIO_PMIC_ARB_CHNL467_RDATA0_ADDR A:0xe330018
y.create.l HWIO_PMIC_ARB_CHNL468_RDATA0_ADDR A:0xe340018
y.create.l HWIO_PMIC_ARB_CHNL469_RDATA0_ADDR A:0xe350018
y.create.l HWIO_PMIC_ARB_CHNL470_RDATA0_ADDR A:0xe360018
y.create.l HWIO_PMIC_ARB_CHNL471_RDATA0_ADDR A:0xe370018
y.create.l HWIO_PMIC_ARB_CHNL472_RDATA0_ADDR A:0xe380018
y.create.l HWIO_PMIC_ARB_CHNL473_RDATA0_ADDR A:0xe390018
y.create.l HWIO_PMIC_ARB_CHNL474_RDATA0_ADDR A:0xe3a0018
y.create.l HWIO_PMIC_ARB_CHNL475_RDATA0_ADDR A:0xe3b0018
y.create.l HWIO_PMIC_ARB_CHNL476_RDATA0_ADDR A:0xe3c0018
y.create.l HWIO_PMIC_ARB_CHNL477_RDATA0_ADDR A:0xe3d0018
y.create.l HWIO_PMIC_ARB_CHNL478_RDATA0_ADDR A:0xe3e0018
y.create.l HWIO_PMIC_ARB_CHNL479_RDATA0_ADDR A:0xe3f0018
y.create.l HWIO_PMIC_ARB_CHNL480_RDATA0_ADDR A:0xe400018
y.create.l HWIO_PMIC_ARB_CHNL481_RDATA0_ADDR A:0xe410018
y.create.l HWIO_PMIC_ARB_CHNL482_RDATA0_ADDR A:0xe420018
y.create.l HWIO_PMIC_ARB_CHNL483_RDATA0_ADDR A:0xe430018
y.create.l HWIO_PMIC_ARB_CHNL484_RDATA0_ADDR A:0xe440018
y.create.l HWIO_PMIC_ARB_CHNL485_RDATA0_ADDR A:0xe450018
y.create.l HWIO_PMIC_ARB_CHNL486_RDATA0_ADDR A:0xe460018
y.create.l HWIO_PMIC_ARB_CHNL487_RDATA0_ADDR A:0xe470018
y.create.l HWIO_PMIC_ARB_CHNL488_RDATA0_ADDR A:0xe480018
y.create.l HWIO_PMIC_ARB_CHNL489_RDATA0_ADDR A:0xe490018
y.create.l HWIO_PMIC_ARB_CHNL490_RDATA0_ADDR A:0xe4a0018
y.create.l HWIO_PMIC_ARB_CHNL491_RDATA0_ADDR A:0xe4b0018
y.create.l HWIO_PMIC_ARB_CHNL492_RDATA0_ADDR A:0xe4c0018
y.create.l HWIO_PMIC_ARB_CHNL493_RDATA0_ADDR A:0xe4d0018
y.create.l HWIO_PMIC_ARB_CHNL494_RDATA0_ADDR A:0xe4e0018
y.create.l HWIO_PMIC_ARB_CHNL495_RDATA0_ADDR A:0xe4f0018
y.create.l HWIO_PMIC_ARB_CHNL496_RDATA0_ADDR A:0xe500018
y.create.l HWIO_PMIC_ARB_CHNL497_RDATA0_ADDR A:0xe510018
y.create.l HWIO_PMIC_ARB_CHNL498_RDATA0_ADDR A:0xe520018
y.create.l HWIO_PMIC_ARB_CHNL499_RDATA0_ADDR A:0xe530018
y.create.l HWIO_PMIC_ARB_CHNL500_RDATA0_ADDR A:0xe540018
y.create.l HWIO_PMIC_ARB_CHNL501_RDATA0_ADDR A:0xe550018
y.create.l HWIO_PMIC_ARB_CHNL502_RDATA0_ADDR A:0xe560018
y.create.l HWIO_PMIC_ARB_CHNL503_RDATA0_ADDR A:0xe570018
y.create.l HWIO_PMIC_ARB_CHNL504_RDATA0_ADDR A:0xe580018
y.create.l HWIO_PMIC_ARB_CHNL505_RDATA0_ADDR A:0xe590018
y.create.l HWIO_PMIC_ARB_CHNL506_RDATA0_ADDR A:0xe5a0018
y.create.l HWIO_PMIC_ARB_CHNL507_RDATA0_ADDR A:0xe5b0018
y.create.l HWIO_PMIC_ARB_CHNL508_RDATA0_ADDR A:0xe5c0018
y.create.l HWIO_PMIC_ARB_CHNL509_RDATA0_ADDR A:0xe5d0018
y.create.l HWIO_PMIC_ARB_CHNL510_RDATA0_ADDR A:0xe5e0018
y.create.l HWIO_PMIC_ARB_CHNL511_RDATA0_ADDR A:0xe5f0018
y.create.l HWIO_PMIC_ARB_CHNL0_RDATA1_ADDR A:0xc60001c
y.create.l HWIO_PMIC_ARB_CHNL1_RDATA1_ADDR A:0xc61001c
y.create.l HWIO_PMIC_ARB_CHNL2_RDATA1_ADDR A:0xc62001c
y.create.l HWIO_PMIC_ARB_CHNL3_RDATA1_ADDR A:0xc63001c
y.create.l HWIO_PMIC_ARB_CHNL4_RDATA1_ADDR A:0xc64001c
y.create.l HWIO_PMIC_ARB_CHNL5_RDATA1_ADDR A:0xc65001c
y.create.l HWIO_PMIC_ARB_CHNL6_RDATA1_ADDR A:0xc66001c
y.create.l HWIO_PMIC_ARB_CHNL7_RDATA1_ADDR A:0xc67001c
y.create.l HWIO_PMIC_ARB_CHNL8_RDATA1_ADDR A:0xc68001c
y.create.l HWIO_PMIC_ARB_CHNL9_RDATA1_ADDR A:0xc69001c
y.create.l HWIO_PMIC_ARB_CHNL10_RDATA1_ADDR A:0xc6a001c
y.create.l HWIO_PMIC_ARB_CHNL11_RDATA1_ADDR A:0xc6b001c
y.create.l HWIO_PMIC_ARB_CHNL12_RDATA1_ADDR A:0xc6c001c
y.create.l HWIO_PMIC_ARB_CHNL13_RDATA1_ADDR A:0xc6d001c
y.create.l HWIO_PMIC_ARB_CHNL14_RDATA1_ADDR A:0xc6e001c
y.create.l HWIO_PMIC_ARB_CHNL15_RDATA1_ADDR A:0xc6f001c
y.create.l HWIO_PMIC_ARB_CHNL16_RDATA1_ADDR A:0xc70001c
y.create.l HWIO_PMIC_ARB_CHNL17_RDATA1_ADDR A:0xc71001c
y.create.l HWIO_PMIC_ARB_CHNL18_RDATA1_ADDR A:0xc72001c
y.create.l HWIO_PMIC_ARB_CHNL19_RDATA1_ADDR A:0xc73001c
y.create.l HWIO_PMIC_ARB_CHNL20_RDATA1_ADDR A:0xc74001c
y.create.l HWIO_PMIC_ARB_CHNL21_RDATA1_ADDR A:0xc75001c
y.create.l HWIO_PMIC_ARB_CHNL22_RDATA1_ADDR A:0xc76001c
y.create.l HWIO_PMIC_ARB_CHNL23_RDATA1_ADDR A:0xc77001c
y.create.l HWIO_PMIC_ARB_CHNL24_RDATA1_ADDR A:0xc78001c
y.create.l HWIO_PMIC_ARB_CHNL25_RDATA1_ADDR A:0xc79001c
y.create.l HWIO_PMIC_ARB_CHNL26_RDATA1_ADDR A:0xc7a001c
y.create.l HWIO_PMIC_ARB_CHNL27_RDATA1_ADDR A:0xc7b001c
y.create.l HWIO_PMIC_ARB_CHNL28_RDATA1_ADDR A:0xc7c001c
y.create.l HWIO_PMIC_ARB_CHNL29_RDATA1_ADDR A:0xc7d001c
y.create.l HWIO_PMIC_ARB_CHNL30_RDATA1_ADDR A:0xc7e001c
y.create.l HWIO_PMIC_ARB_CHNL31_RDATA1_ADDR A:0xc7f001c
y.create.l HWIO_PMIC_ARB_CHNL32_RDATA1_ADDR A:0xc80001c
y.create.l HWIO_PMIC_ARB_CHNL33_RDATA1_ADDR A:0xc81001c
y.create.l HWIO_PMIC_ARB_CHNL34_RDATA1_ADDR A:0xc82001c
y.create.l HWIO_PMIC_ARB_CHNL35_RDATA1_ADDR A:0xc83001c
y.create.l HWIO_PMIC_ARB_CHNL36_RDATA1_ADDR A:0xc84001c
y.create.l HWIO_PMIC_ARB_CHNL37_RDATA1_ADDR A:0xc85001c
y.create.l HWIO_PMIC_ARB_CHNL38_RDATA1_ADDR A:0xc86001c
y.create.l HWIO_PMIC_ARB_CHNL39_RDATA1_ADDR A:0xc87001c
y.create.l HWIO_PMIC_ARB_CHNL40_RDATA1_ADDR A:0xc88001c
y.create.l HWIO_PMIC_ARB_CHNL41_RDATA1_ADDR A:0xc89001c
y.create.l HWIO_PMIC_ARB_CHNL42_RDATA1_ADDR A:0xc8a001c
y.create.l HWIO_PMIC_ARB_CHNL43_RDATA1_ADDR A:0xc8b001c
y.create.l HWIO_PMIC_ARB_CHNL44_RDATA1_ADDR A:0xc8c001c
y.create.l HWIO_PMIC_ARB_CHNL45_RDATA1_ADDR A:0xc8d001c
y.create.l HWIO_PMIC_ARB_CHNL46_RDATA1_ADDR A:0xc8e001c
y.create.l HWIO_PMIC_ARB_CHNL47_RDATA1_ADDR A:0xc8f001c
y.create.l HWIO_PMIC_ARB_CHNL48_RDATA1_ADDR A:0xc90001c
y.create.l HWIO_PMIC_ARB_CHNL49_RDATA1_ADDR A:0xc91001c
y.create.l HWIO_PMIC_ARB_CHNL50_RDATA1_ADDR A:0xc92001c
y.create.l HWIO_PMIC_ARB_CHNL51_RDATA1_ADDR A:0xc93001c
y.create.l HWIO_PMIC_ARB_CHNL52_RDATA1_ADDR A:0xc94001c
y.create.l HWIO_PMIC_ARB_CHNL53_RDATA1_ADDR A:0xc95001c
y.create.l HWIO_PMIC_ARB_CHNL54_RDATA1_ADDR A:0xc96001c
y.create.l HWIO_PMIC_ARB_CHNL55_RDATA1_ADDR A:0xc97001c
y.create.l HWIO_PMIC_ARB_CHNL56_RDATA1_ADDR A:0xc98001c
y.create.l HWIO_PMIC_ARB_CHNL57_RDATA1_ADDR A:0xc99001c
y.create.l HWIO_PMIC_ARB_CHNL58_RDATA1_ADDR A:0xc9a001c
y.create.l HWIO_PMIC_ARB_CHNL59_RDATA1_ADDR A:0xc9b001c
y.create.l HWIO_PMIC_ARB_CHNL60_RDATA1_ADDR A:0xc9c001c
y.create.l HWIO_PMIC_ARB_CHNL61_RDATA1_ADDR A:0xc9d001c
y.create.l HWIO_PMIC_ARB_CHNL62_RDATA1_ADDR A:0xc9e001c
y.create.l HWIO_PMIC_ARB_CHNL63_RDATA1_ADDR A:0xc9f001c
y.create.l HWIO_PMIC_ARB_CHNL64_RDATA1_ADDR A:0xca0001c
y.create.l HWIO_PMIC_ARB_CHNL65_RDATA1_ADDR A:0xca1001c
y.create.l HWIO_PMIC_ARB_CHNL66_RDATA1_ADDR A:0xca2001c
y.create.l HWIO_PMIC_ARB_CHNL67_RDATA1_ADDR A:0xca3001c
y.create.l HWIO_PMIC_ARB_CHNL68_RDATA1_ADDR A:0xca4001c
y.create.l HWIO_PMIC_ARB_CHNL69_RDATA1_ADDR A:0xca5001c
y.create.l HWIO_PMIC_ARB_CHNL70_RDATA1_ADDR A:0xca6001c
y.create.l HWIO_PMIC_ARB_CHNL71_RDATA1_ADDR A:0xca7001c
y.create.l HWIO_PMIC_ARB_CHNL72_RDATA1_ADDR A:0xca8001c
y.create.l HWIO_PMIC_ARB_CHNL73_RDATA1_ADDR A:0xca9001c
y.create.l HWIO_PMIC_ARB_CHNL74_RDATA1_ADDR A:0xcaa001c
y.create.l HWIO_PMIC_ARB_CHNL75_RDATA1_ADDR A:0xcab001c
y.create.l HWIO_PMIC_ARB_CHNL76_RDATA1_ADDR A:0xcac001c
y.create.l HWIO_PMIC_ARB_CHNL77_RDATA1_ADDR A:0xcad001c
y.create.l HWIO_PMIC_ARB_CHNL78_RDATA1_ADDR A:0xcae001c
y.create.l HWIO_PMIC_ARB_CHNL79_RDATA1_ADDR A:0xcaf001c
y.create.l HWIO_PMIC_ARB_CHNL80_RDATA1_ADDR A:0xcb0001c
y.create.l HWIO_PMIC_ARB_CHNL81_RDATA1_ADDR A:0xcb1001c
y.create.l HWIO_PMIC_ARB_CHNL82_RDATA1_ADDR A:0xcb2001c
y.create.l HWIO_PMIC_ARB_CHNL83_RDATA1_ADDR A:0xcb3001c
y.create.l HWIO_PMIC_ARB_CHNL84_RDATA1_ADDR A:0xcb4001c
y.create.l HWIO_PMIC_ARB_CHNL85_RDATA1_ADDR A:0xcb5001c
y.create.l HWIO_PMIC_ARB_CHNL86_RDATA1_ADDR A:0xcb6001c
y.create.l HWIO_PMIC_ARB_CHNL87_RDATA1_ADDR A:0xcb7001c
y.create.l HWIO_PMIC_ARB_CHNL88_RDATA1_ADDR A:0xcb8001c
y.create.l HWIO_PMIC_ARB_CHNL89_RDATA1_ADDR A:0xcb9001c
y.create.l HWIO_PMIC_ARB_CHNL90_RDATA1_ADDR A:0xcba001c
y.create.l HWIO_PMIC_ARB_CHNL91_RDATA1_ADDR A:0xcbb001c
y.create.l HWIO_PMIC_ARB_CHNL92_RDATA1_ADDR A:0xcbc001c
y.create.l HWIO_PMIC_ARB_CHNL93_RDATA1_ADDR A:0xcbd001c
y.create.l HWIO_PMIC_ARB_CHNL94_RDATA1_ADDR A:0xcbe001c
y.create.l HWIO_PMIC_ARB_CHNL95_RDATA1_ADDR A:0xcbf001c
y.create.l HWIO_PMIC_ARB_CHNL96_RDATA1_ADDR A:0xcc0001c
y.create.l HWIO_PMIC_ARB_CHNL97_RDATA1_ADDR A:0xcc1001c
y.create.l HWIO_PMIC_ARB_CHNL98_RDATA1_ADDR A:0xcc2001c
y.create.l HWIO_PMIC_ARB_CHNL99_RDATA1_ADDR A:0xcc3001c
y.create.l HWIO_PMIC_ARB_CHNL100_RDATA1_ADDR A:0xcc4001c
y.create.l HWIO_PMIC_ARB_CHNL101_RDATA1_ADDR A:0xcc5001c
y.create.l HWIO_PMIC_ARB_CHNL102_RDATA1_ADDR A:0xcc6001c
y.create.l HWIO_PMIC_ARB_CHNL103_RDATA1_ADDR A:0xcc7001c
y.create.l HWIO_PMIC_ARB_CHNL104_RDATA1_ADDR A:0xcc8001c
y.create.l HWIO_PMIC_ARB_CHNL105_RDATA1_ADDR A:0xcc9001c
y.create.l HWIO_PMIC_ARB_CHNL106_RDATA1_ADDR A:0xcca001c
y.create.l HWIO_PMIC_ARB_CHNL107_RDATA1_ADDR A:0xccb001c
y.create.l HWIO_PMIC_ARB_CHNL108_RDATA1_ADDR A:0xccc001c
y.create.l HWIO_PMIC_ARB_CHNL109_RDATA1_ADDR A:0xccd001c
y.create.l HWIO_PMIC_ARB_CHNL110_RDATA1_ADDR A:0xcce001c
y.create.l HWIO_PMIC_ARB_CHNL111_RDATA1_ADDR A:0xccf001c
y.create.l HWIO_PMIC_ARB_CHNL112_RDATA1_ADDR A:0xcd0001c
y.create.l HWIO_PMIC_ARB_CHNL113_RDATA1_ADDR A:0xcd1001c
y.create.l HWIO_PMIC_ARB_CHNL114_RDATA1_ADDR A:0xcd2001c
y.create.l HWIO_PMIC_ARB_CHNL115_RDATA1_ADDR A:0xcd3001c
y.create.l HWIO_PMIC_ARB_CHNL116_RDATA1_ADDR A:0xcd4001c
y.create.l HWIO_PMIC_ARB_CHNL117_RDATA1_ADDR A:0xcd5001c
y.create.l HWIO_PMIC_ARB_CHNL118_RDATA1_ADDR A:0xcd6001c
y.create.l HWIO_PMIC_ARB_CHNL119_RDATA1_ADDR A:0xcd7001c
y.create.l HWIO_PMIC_ARB_CHNL120_RDATA1_ADDR A:0xcd8001c
y.create.l HWIO_PMIC_ARB_CHNL121_RDATA1_ADDR A:0xcd9001c
y.create.l HWIO_PMIC_ARB_CHNL122_RDATA1_ADDR A:0xcda001c
y.create.l HWIO_PMIC_ARB_CHNL123_RDATA1_ADDR A:0xcdb001c
y.create.l HWIO_PMIC_ARB_CHNL124_RDATA1_ADDR A:0xcdc001c
y.create.l HWIO_PMIC_ARB_CHNL125_RDATA1_ADDR A:0xcdd001c
y.create.l HWIO_PMIC_ARB_CHNL126_RDATA1_ADDR A:0xcde001c
y.create.l HWIO_PMIC_ARB_CHNL127_RDATA1_ADDR A:0xcdf001c
y.create.l HWIO_PMIC_ARB_CHNL128_RDATA1_ADDR A:0xce0001c
y.create.l HWIO_PMIC_ARB_CHNL129_RDATA1_ADDR A:0xce1001c
y.create.l HWIO_PMIC_ARB_CHNL130_RDATA1_ADDR A:0xce2001c
y.create.l HWIO_PMIC_ARB_CHNL131_RDATA1_ADDR A:0xce3001c
y.create.l HWIO_PMIC_ARB_CHNL132_RDATA1_ADDR A:0xce4001c
y.create.l HWIO_PMIC_ARB_CHNL133_RDATA1_ADDR A:0xce5001c
y.create.l HWIO_PMIC_ARB_CHNL134_RDATA1_ADDR A:0xce6001c
y.create.l HWIO_PMIC_ARB_CHNL135_RDATA1_ADDR A:0xce7001c
y.create.l HWIO_PMIC_ARB_CHNL136_RDATA1_ADDR A:0xce8001c
y.create.l HWIO_PMIC_ARB_CHNL137_RDATA1_ADDR A:0xce9001c
y.create.l HWIO_PMIC_ARB_CHNL138_RDATA1_ADDR A:0xcea001c
y.create.l HWIO_PMIC_ARB_CHNL139_RDATA1_ADDR A:0xceb001c
y.create.l HWIO_PMIC_ARB_CHNL140_RDATA1_ADDR A:0xcec001c
y.create.l HWIO_PMIC_ARB_CHNL141_RDATA1_ADDR A:0xced001c
y.create.l HWIO_PMIC_ARB_CHNL142_RDATA1_ADDR A:0xcee001c
y.create.l HWIO_PMIC_ARB_CHNL143_RDATA1_ADDR A:0xcef001c
y.create.l HWIO_PMIC_ARB_CHNL144_RDATA1_ADDR A:0xcf0001c
y.create.l HWIO_PMIC_ARB_CHNL145_RDATA1_ADDR A:0xcf1001c
y.create.l HWIO_PMIC_ARB_CHNL146_RDATA1_ADDR A:0xcf2001c
y.create.l HWIO_PMIC_ARB_CHNL147_RDATA1_ADDR A:0xcf3001c
y.create.l HWIO_PMIC_ARB_CHNL148_RDATA1_ADDR A:0xcf4001c
y.create.l HWIO_PMIC_ARB_CHNL149_RDATA1_ADDR A:0xcf5001c
y.create.l HWIO_PMIC_ARB_CHNL150_RDATA1_ADDR A:0xcf6001c
y.create.l HWIO_PMIC_ARB_CHNL151_RDATA1_ADDR A:0xcf7001c
y.create.l HWIO_PMIC_ARB_CHNL152_RDATA1_ADDR A:0xcf8001c
y.create.l HWIO_PMIC_ARB_CHNL153_RDATA1_ADDR A:0xcf9001c
y.create.l HWIO_PMIC_ARB_CHNL154_RDATA1_ADDR A:0xcfa001c
y.create.l HWIO_PMIC_ARB_CHNL155_RDATA1_ADDR A:0xcfb001c
y.create.l HWIO_PMIC_ARB_CHNL156_RDATA1_ADDR A:0xcfc001c
y.create.l HWIO_PMIC_ARB_CHNL157_RDATA1_ADDR A:0xcfd001c
y.create.l HWIO_PMIC_ARB_CHNL158_RDATA1_ADDR A:0xcfe001c
y.create.l HWIO_PMIC_ARB_CHNL159_RDATA1_ADDR A:0xcff001c
y.create.l HWIO_PMIC_ARB_CHNL160_RDATA1_ADDR A:0xd00001c
y.create.l HWIO_PMIC_ARB_CHNL161_RDATA1_ADDR A:0xd01001c
y.create.l HWIO_PMIC_ARB_CHNL162_RDATA1_ADDR A:0xd02001c
y.create.l HWIO_PMIC_ARB_CHNL163_RDATA1_ADDR A:0xd03001c
y.create.l HWIO_PMIC_ARB_CHNL164_RDATA1_ADDR A:0xd04001c
y.create.l HWIO_PMIC_ARB_CHNL165_RDATA1_ADDR A:0xd05001c
y.create.l HWIO_PMIC_ARB_CHNL166_RDATA1_ADDR A:0xd06001c
y.create.l HWIO_PMIC_ARB_CHNL167_RDATA1_ADDR A:0xd07001c
y.create.l HWIO_PMIC_ARB_CHNL168_RDATA1_ADDR A:0xd08001c
y.create.l HWIO_PMIC_ARB_CHNL169_RDATA1_ADDR A:0xd09001c
y.create.l HWIO_PMIC_ARB_CHNL170_RDATA1_ADDR A:0xd0a001c
y.create.l HWIO_PMIC_ARB_CHNL171_RDATA1_ADDR A:0xd0b001c
y.create.l HWIO_PMIC_ARB_CHNL172_RDATA1_ADDR A:0xd0c001c
y.create.l HWIO_PMIC_ARB_CHNL173_RDATA1_ADDR A:0xd0d001c
y.create.l HWIO_PMIC_ARB_CHNL174_RDATA1_ADDR A:0xd0e001c
y.create.l HWIO_PMIC_ARB_CHNL175_RDATA1_ADDR A:0xd0f001c
y.create.l HWIO_PMIC_ARB_CHNL176_RDATA1_ADDR A:0xd10001c
y.create.l HWIO_PMIC_ARB_CHNL177_RDATA1_ADDR A:0xd11001c
y.create.l HWIO_PMIC_ARB_CHNL178_RDATA1_ADDR A:0xd12001c
y.create.l HWIO_PMIC_ARB_CHNL179_RDATA1_ADDR A:0xd13001c
y.create.l HWIO_PMIC_ARB_CHNL180_RDATA1_ADDR A:0xd14001c
y.create.l HWIO_PMIC_ARB_CHNL181_RDATA1_ADDR A:0xd15001c
y.create.l HWIO_PMIC_ARB_CHNL182_RDATA1_ADDR A:0xd16001c
y.create.l HWIO_PMIC_ARB_CHNL183_RDATA1_ADDR A:0xd17001c
y.create.l HWIO_PMIC_ARB_CHNL184_RDATA1_ADDR A:0xd18001c
y.create.l HWIO_PMIC_ARB_CHNL185_RDATA1_ADDR A:0xd19001c
y.create.l HWIO_PMIC_ARB_CHNL186_RDATA1_ADDR A:0xd1a001c
y.create.l HWIO_PMIC_ARB_CHNL187_RDATA1_ADDR A:0xd1b001c
y.create.l HWIO_PMIC_ARB_CHNL188_RDATA1_ADDR A:0xd1c001c
y.create.l HWIO_PMIC_ARB_CHNL189_RDATA1_ADDR A:0xd1d001c
y.create.l HWIO_PMIC_ARB_CHNL190_RDATA1_ADDR A:0xd1e001c
y.create.l HWIO_PMIC_ARB_CHNL191_RDATA1_ADDR A:0xd1f001c
y.create.l HWIO_PMIC_ARB_CHNL192_RDATA1_ADDR A:0xd20001c
y.create.l HWIO_PMIC_ARB_CHNL193_RDATA1_ADDR A:0xd21001c
y.create.l HWIO_PMIC_ARB_CHNL194_RDATA1_ADDR A:0xd22001c
y.create.l HWIO_PMIC_ARB_CHNL195_RDATA1_ADDR A:0xd23001c
y.create.l HWIO_PMIC_ARB_CHNL196_RDATA1_ADDR A:0xd24001c
y.create.l HWIO_PMIC_ARB_CHNL197_RDATA1_ADDR A:0xd25001c
y.create.l HWIO_PMIC_ARB_CHNL198_RDATA1_ADDR A:0xd26001c
y.create.l HWIO_PMIC_ARB_CHNL199_RDATA1_ADDR A:0xd27001c
y.create.l HWIO_PMIC_ARB_CHNL200_RDATA1_ADDR A:0xd28001c
y.create.l HWIO_PMIC_ARB_CHNL201_RDATA1_ADDR A:0xd29001c
y.create.l HWIO_PMIC_ARB_CHNL202_RDATA1_ADDR A:0xd2a001c
y.create.l HWIO_PMIC_ARB_CHNL203_RDATA1_ADDR A:0xd2b001c
y.create.l HWIO_PMIC_ARB_CHNL204_RDATA1_ADDR A:0xd2c001c
y.create.l HWIO_PMIC_ARB_CHNL205_RDATA1_ADDR A:0xd2d001c
y.create.l HWIO_PMIC_ARB_CHNL206_RDATA1_ADDR A:0xd2e001c
y.create.l HWIO_PMIC_ARB_CHNL207_RDATA1_ADDR A:0xd2f001c
y.create.l HWIO_PMIC_ARB_CHNL208_RDATA1_ADDR A:0xd30001c
y.create.l HWIO_PMIC_ARB_CHNL209_RDATA1_ADDR A:0xd31001c
y.create.l HWIO_PMIC_ARB_CHNL210_RDATA1_ADDR A:0xd32001c
y.create.l HWIO_PMIC_ARB_CHNL211_RDATA1_ADDR A:0xd33001c
y.create.l HWIO_PMIC_ARB_CHNL212_RDATA1_ADDR A:0xd34001c
y.create.l HWIO_PMIC_ARB_CHNL213_RDATA1_ADDR A:0xd35001c
y.create.l HWIO_PMIC_ARB_CHNL214_RDATA1_ADDR A:0xd36001c
y.create.l HWIO_PMIC_ARB_CHNL215_RDATA1_ADDR A:0xd37001c
y.create.l HWIO_PMIC_ARB_CHNL216_RDATA1_ADDR A:0xd38001c
y.create.l HWIO_PMIC_ARB_CHNL217_RDATA1_ADDR A:0xd39001c
y.create.l HWIO_PMIC_ARB_CHNL218_RDATA1_ADDR A:0xd3a001c
y.create.l HWIO_PMIC_ARB_CHNL219_RDATA1_ADDR A:0xd3b001c
y.create.l HWIO_PMIC_ARB_CHNL220_RDATA1_ADDR A:0xd3c001c
y.create.l HWIO_PMIC_ARB_CHNL221_RDATA1_ADDR A:0xd3d001c
y.create.l HWIO_PMIC_ARB_CHNL222_RDATA1_ADDR A:0xd3e001c
y.create.l HWIO_PMIC_ARB_CHNL223_RDATA1_ADDR A:0xd3f001c
y.create.l HWIO_PMIC_ARB_CHNL224_RDATA1_ADDR A:0xd40001c
y.create.l HWIO_PMIC_ARB_CHNL225_RDATA1_ADDR A:0xd41001c
y.create.l HWIO_PMIC_ARB_CHNL226_RDATA1_ADDR A:0xd42001c
y.create.l HWIO_PMIC_ARB_CHNL227_RDATA1_ADDR A:0xd43001c
y.create.l HWIO_PMIC_ARB_CHNL228_RDATA1_ADDR A:0xd44001c
y.create.l HWIO_PMIC_ARB_CHNL229_RDATA1_ADDR A:0xd45001c
y.create.l HWIO_PMIC_ARB_CHNL230_RDATA1_ADDR A:0xd46001c
y.create.l HWIO_PMIC_ARB_CHNL231_RDATA1_ADDR A:0xd47001c
y.create.l HWIO_PMIC_ARB_CHNL232_RDATA1_ADDR A:0xd48001c
y.create.l HWIO_PMIC_ARB_CHNL233_RDATA1_ADDR A:0xd49001c
y.create.l HWIO_PMIC_ARB_CHNL234_RDATA1_ADDR A:0xd4a001c
y.create.l HWIO_PMIC_ARB_CHNL235_RDATA1_ADDR A:0xd4b001c
y.create.l HWIO_PMIC_ARB_CHNL236_RDATA1_ADDR A:0xd4c001c
y.create.l HWIO_PMIC_ARB_CHNL237_RDATA1_ADDR A:0xd4d001c
y.create.l HWIO_PMIC_ARB_CHNL238_RDATA1_ADDR A:0xd4e001c
y.create.l HWIO_PMIC_ARB_CHNL239_RDATA1_ADDR A:0xd4f001c
y.create.l HWIO_PMIC_ARB_CHNL240_RDATA1_ADDR A:0xd50001c
y.create.l HWIO_PMIC_ARB_CHNL241_RDATA1_ADDR A:0xd51001c
y.create.l HWIO_PMIC_ARB_CHNL242_RDATA1_ADDR A:0xd52001c
y.create.l HWIO_PMIC_ARB_CHNL243_RDATA1_ADDR A:0xd53001c
y.create.l HWIO_PMIC_ARB_CHNL244_RDATA1_ADDR A:0xd54001c
y.create.l HWIO_PMIC_ARB_CHNL245_RDATA1_ADDR A:0xd55001c
y.create.l HWIO_PMIC_ARB_CHNL246_RDATA1_ADDR A:0xd56001c
y.create.l HWIO_PMIC_ARB_CHNL247_RDATA1_ADDR A:0xd57001c
y.create.l HWIO_PMIC_ARB_CHNL248_RDATA1_ADDR A:0xd58001c
y.create.l HWIO_PMIC_ARB_CHNL249_RDATA1_ADDR A:0xd59001c
y.create.l HWIO_PMIC_ARB_CHNL250_RDATA1_ADDR A:0xd5a001c
y.create.l HWIO_PMIC_ARB_CHNL251_RDATA1_ADDR A:0xd5b001c
y.create.l HWIO_PMIC_ARB_CHNL252_RDATA1_ADDR A:0xd5c001c
y.create.l HWIO_PMIC_ARB_CHNL253_RDATA1_ADDR A:0xd5d001c
y.create.l HWIO_PMIC_ARB_CHNL254_RDATA1_ADDR A:0xd5e001c
y.create.l HWIO_PMIC_ARB_CHNL255_RDATA1_ADDR A:0xd5f001c
y.create.l HWIO_PMIC_ARB_CHNL256_RDATA1_ADDR A:0xd60001c
y.create.l HWIO_PMIC_ARB_CHNL257_RDATA1_ADDR A:0xd61001c
y.create.l HWIO_PMIC_ARB_CHNL258_RDATA1_ADDR A:0xd62001c
y.create.l HWIO_PMIC_ARB_CHNL259_RDATA1_ADDR A:0xd63001c
y.create.l HWIO_PMIC_ARB_CHNL260_RDATA1_ADDR A:0xd64001c
y.create.l HWIO_PMIC_ARB_CHNL261_RDATA1_ADDR A:0xd65001c
y.create.l HWIO_PMIC_ARB_CHNL262_RDATA1_ADDR A:0xd66001c
y.create.l HWIO_PMIC_ARB_CHNL263_RDATA1_ADDR A:0xd67001c
y.create.l HWIO_PMIC_ARB_CHNL264_RDATA1_ADDR A:0xd68001c
y.create.l HWIO_PMIC_ARB_CHNL265_RDATA1_ADDR A:0xd69001c
y.create.l HWIO_PMIC_ARB_CHNL266_RDATA1_ADDR A:0xd6a001c
y.create.l HWIO_PMIC_ARB_CHNL267_RDATA1_ADDR A:0xd6b001c
y.create.l HWIO_PMIC_ARB_CHNL268_RDATA1_ADDR A:0xd6c001c
y.create.l HWIO_PMIC_ARB_CHNL269_RDATA1_ADDR A:0xd6d001c
y.create.l HWIO_PMIC_ARB_CHNL270_RDATA1_ADDR A:0xd6e001c
y.create.l HWIO_PMIC_ARB_CHNL271_RDATA1_ADDR A:0xd6f001c
y.create.l HWIO_PMIC_ARB_CHNL272_RDATA1_ADDR A:0xd70001c
y.create.l HWIO_PMIC_ARB_CHNL273_RDATA1_ADDR A:0xd71001c
y.create.l HWIO_PMIC_ARB_CHNL274_RDATA1_ADDR A:0xd72001c
y.create.l HWIO_PMIC_ARB_CHNL275_RDATA1_ADDR A:0xd73001c
y.create.l HWIO_PMIC_ARB_CHNL276_RDATA1_ADDR A:0xd74001c
y.create.l HWIO_PMIC_ARB_CHNL277_RDATA1_ADDR A:0xd75001c
y.create.l HWIO_PMIC_ARB_CHNL278_RDATA1_ADDR A:0xd76001c
y.create.l HWIO_PMIC_ARB_CHNL279_RDATA1_ADDR A:0xd77001c
y.create.l HWIO_PMIC_ARB_CHNL280_RDATA1_ADDR A:0xd78001c
y.create.l HWIO_PMIC_ARB_CHNL281_RDATA1_ADDR A:0xd79001c
y.create.l HWIO_PMIC_ARB_CHNL282_RDATA1_ADDR A:0xd7a001c
y.create.l HWIO_PMIC_ARB_CHNL283_RDATA1_ADDR A:0xd7b001c
y.create.l HWIO_PMIC_ARB_CHNL284_RDATA1_ADDR A:0xd7c001c
y.create.l HWIO_PMIC_ARB_CHNL285_RDATA1_ADDR A:0xd7d001c
y.create.l HWIO_PMIC_ARB_CHNL286_RDATA1_ADDR A:0xd7e001c
y.create.l HWIO_PMIC_ARB_CHNL287_RDATA1_ADDR A:0xd7f001c
y.create.l HWIO_PMIC_ARB_CHNL288_RDATA1_ADDR A:0xd80001c
y.create.l HWIO_PMIC_ARB_CHNL289_RDATA1_ADDR A:0xd81001c
y.create.l HWIO_PMIC_ARB_CHNL290_RDATA1_ADDR A:0xd82001c
y.create.l HWIO_PMIC_ARB_CHNL291_RDATA1_ADDR A:0xd83001c
y.create.l HWIO_PMIC_ARB_CHNL292_RDATA1_ADDR A:0xd84001c
y.create.l HWIO_PMIC_ARB_CHNL293_RDATA1_ADDR A:0xd85001c
y.create.l HWIO_PMIC_ARB_CHNL294_RDATA1_ADDR A:0xd86001c
y.create.l HWIO_PMIC_ARB_CHNL295_RDATA1_ADDR A:0xd87001c
y.create.l HWIO_PMIC_ARB_CHNL296_RDATA1_ADDR A:0xd88001c
y.create.l HWIO_PMIC_ARB_CHNL297_RDATA1_ADDR A:0xd89001c
y.create.l HWIO_PMIC_ARB_CHNL298_RDATA1_ADDR A:0xd8a001c
y.create.l HWIO_PMIC_ARB_CHNL299_RDATA1_ADDR A:0xd8b001c
y.create.l HWIO_PMIC_ARB_CHNL300_RDATA1_ADDR A:0xd8c001c
y.create.l HWIO_PMIC_ARB_CHNL301_RDATA1_ADDR A:0xd8d001c
y.create.l HWIO_PMIC_ARB_CHNL302_RDATA1_ADDR A:0xd8e001c
y.create.l HWIO_PMIC_ARB_CHNL303_RDATA1_ADDR A:0xd8f001c
y.create.l HWIO_PMIC_ARB_CHNL304_RDATA1_ADDR A:0xd90001c
y.create.l HWIO_PMIC_ARB_CHNL305_RDATA1_ADDR A:0xd91001c
y.create.l HWIO_PMIC_ARB_CHNL306_RDATA1_ADDR A:0xd92001c
y.create.l HWIO_PMIC_ARB_CHNL307_RDATA1_ADDR A:0xd93001c
y.create.l HWIO_PMIC_ARB_CHNL308_RDATA1_ADDR A:0xd94001c
y.create.l HWIO_PMIC_ARB_CHNL309_RDATA1_ADDR A:0xd95001c
y.create.l HWIO_PMIC_ARB_CHNL310_RDATA1_ADDR A:0xd96001c
y.create.l HWIO_PMIC_ARB_CHNL311_RDATA1_ADDR A:0xd97001c
y.create.l HWIO_PMIC_ARB_CHNL312_RDATA1_ADDR A:0xd98001c
y.create.l HWIO_PMIC_ARB_CHNL313_RDATA1_ADDR A:0xd99001c
y.create.l HWIO_PMIC_ARB_CHNL314_RDATA1_ADDR A:0xd9a001c
y.create.l HWIO_PMIC_ARB_CHNL315_RDATA1_ADDR A:0xd9b001c
y.create.l HWIO_PMIC_ARB_CHNL316_RDATA1_ADDR A:0xd9c001c
y.create.l HWIO_PMIC_ARB_CHNL317_RDATA1_ADDR A:0xd9d001c
y.create.l HWIO_PMIC_ARB_CHNL318_RDATA1_ADDR A:0xd9e001c
y.create.l HWIO_PMIC_ARB_CHNL319_RDATA1_ADDR A:0xd9f001c
y.create.l HWIO_PMIC_ARB_CHNL320_RDATA1_ADDR A:0xda0001c
y.create.l HWIO_PMIC_ARB_CHNL321_RDATA1_ADDR A:0xda1001c
y.create.l HWIO_PMIC_ARB_CHNL322_RDATA1_ADDR A:0xda2001c
y.create.l HWIO_PMIC_ARB_CHNL323_RDATA1_ADDR A:0xda3001c
y.create.l HWIO_PMIC_ARB_CHNL324_RDATA1_ADDR A:0xda4001c
y.create.l HWIO_PMIC_ARB_CHNL325_RDATA1_ADDR A:0xda5001c
y.create.l HWIO_PMIC_ARB_CHNL326_RDATA1_ADDR A:0xda6001c
y.create.l HWIO_PMIC_ARB_CHNL327_RDATA1_ADDR A:0xda7001c
y.create.l HWIO_PMIC_ARB_CHNL328_RDATA1_ADDR A:0xda8001c
y.create.l HWIO_PMIC_ARB_CHNL329_RDATA1_ADDR A:0xda9001c
y.create.l HWIO_PMIC_ARB_CHNL330_RDATA1_ADDR A:0xdaa001c
y.create.l HWIO_PMIC_ARB_CHNL331_RDATA1_ADDR A:0xdab001c
y.create.l HWIO_PMIC_ARB_CHNL332_RDATA1_ADDR A:0xdac001c
y.create.l HWIO_PMIC_ARB_CHNL333_RDATA1_ADDR A:0xdad001c
y.create.l HWIO_PMIC_ARB_CHNL334_RDATA1_ADDR A:0xdae001c
y.create.l HWIO_PMIC_ARB_CHNL335_RDATA1_ADDR A:0xdaf001c
y.create.l HWIO_PMIC_ARB_CHNL336_RDATA1_ADDR A:0xdb0001c
y.create.l HWIO_PMIC_ARB_CHNL337_RDATA1_ADDR A:0xdb1001c
y.create.l HWIO_PMIC_ARB_CHNL338_RDATA1_ADDR A:0xdb2001c
y.create.l HWIO_PMIC_ARB_CHNL339_RDATA1_ADDR A:0xdb3001c
y.create.l HWIO_PMIC_ARB_CHNL340_RDATA1_ADDR A:0xdb4001c
y.create.l HWIO_PMIC_ARB_CHNL341_RDATA1_ADDR A:0xdb5001c
y.create.l HWIO_PMIC_ARB_CHNL342_RDATA1_ADDR A:0xdb6001c
y.create.l HWIO_PMIC_ARB_CHNL343_RDATA1_ADDR A:0xdb7001c
y.create.l HWIO_PMIC_ARB_CHNL344_RDATA1_ADDR A:0xdb8001c
y.create.l HWIO_PMIC_ARB_CHNL345_RDATA1_ADDR A:0xdb9001c
y.create.l HWIO_PMIC_ARB_CHNL346_RDATA1_ADDR A:0xdba001c
y.create.l HWIO_PMIC_ARB_CHNL347_RDATA1_ADDR A:0xdbb001c
y.create.l HWIO_PMIC_ARB_CHNL348_RDATA1_ADDR A:0xdbc001c
y.create.l HWIO_PMIC_ARB_CHNL349_RDATA1_ADDR A:0xdbd001c
y.create.l HWIO_PMIC_ARB_CHNL350_RDATA1_ADDR A:0xdbe001c
y.create.l HWIO_PMIC_ARB_CHNL351_RDATA1_ADDR A:0xdbf001c
y.create.l HWIO_PMIC_ARB_CHNL352_RDATA1_ADDR A:0xdc0001c
y.create.l HWIO_PMIC_ARB_CHNL353_RDATA1_ADDR A:0xdc1001c
y.create.l HWIO_PMIC_ARB_CHNL354_RDATA1_ADDR A:0xdc2001c
y.create.l HWIO_PMIC_ARB_CHNL355_RDATA1_ADDR A:0xdc3001c
y.create.l HWIO_PMIC_ARB_CHNL356_RDATA1_ADDR A:0xdc4001c
y.create.l HWIO_PMIC_ARB_CHNL357_RDATA1_ADDR A:0xdc5001c
y.create.l HWIO_PMIC_ARB_CHNL358_RDATA1_ADDR A:0xdc6001c
y.create.l HWIO_PMIC_ARB_CHNL359_RDATA1_ADDR A:0xdc7001c
y.create.l HWIO_PMIC_ARB_CHNL360_RDATA1_ADDR A:0xdc8001c
y.create.l HWIO_PMIC_ARB_CHNL361_RDATA1_ADDR A:0xdc9001c
y.create.l HWIO_PMIC_ARB_CHNL362_RDATA1_ADDR A:0xdca001c
y.create.l HWIO_PMIC_ARB_CHNL363_RDATA1_ADDR A:0xdcb001c
y.create.l HWIO_PMIC_ARB_CHNL364_RDATA1_ADDR A:0xdcc001c
y.create.l HWIO_PMIC_ARB_CHNL365_RDATA1_ADDR A:0xdcd001c
y.create.l HWIO_PMIC_ARB_CHNL366_RDATA1_ADDR A:0xdce001c
y.create.l HWIO_PMIC_ARB_CHNL367_RDATA1_ADDR A:0xdcf001c
y.create.l HWIO_PMIC_ARB_CHNL368_RDATA1_ADDR A:0xdd0001c
y.create.l HWIO_PMIC_ARB_CHNL369_RDATA1_ADDR A:0xdd1001c
y.create.l HWIO_PMIC_ARB_CHNL370_RDATA1_ADDR A:0xdd2001c
y.create.l HWIO_PMIC_ARB_CHNL371_RDATA1_ADDR A:0xdd3001c
y.create.l HWIO_PMIC_ARB_CHNL372_RDATA1_ADDR A:0xdd4001c
y.create.l HWIO_PMIC_ARB_CHNL373_RDATA1_ADDR A:0xdd5001c
y.create.l HWIO_PMIC_ARB_CHNL374_RDATA1_ADDR A:0xdd6001c
y.create.l HWIO_PMIC_ARB_CHNL375_RDATA1_ADDR A:0xdd7001c
y.create.l HWIO_PMIC_ARB_CHNL376_RDATA1_ADDR A:0xdd8001c
y.create.l HWIO_PMIC_ARB_CHNL377_RDATA1_ADDR A:0xdd9001c
y.create.l HWIO_PMIC_ARB_CHNL378_RDATA1_ADDR A:0xdda001c
y.create.l HWIO_PMIC_ARB_CHNL379_RDATA1_ADDR A:0xddb001c
y.create.l HWIO_PMIC_ARB_CHNL380_RDATA1_ADDR A:0xddc001c
y.create.l HWIO_PMIC_ARB_CHNL381_RDATA1_ADDR A:0xddd001c
y.create.l HWIO_PMIC_ARB_CHNL382_RDATA1_ADDR A:0xdde001c
y.create.l HWIO_PMIC_ARB_CHNL383_RDATA1_ADDR A:0xddf001c
y.create.l HWIO_PMIC_ARB_CHNL384_RDATA1_ADDR A:0xde0001c
y.create.l HWIO_PMIC_ARB_CHNL385_RDATA1_ADDR A:0xde1001c
y.create.l HWIO_PMIC_ARB_CHNL386_RDATA1_ADDR A:0xde2001c
y.create.l HWIO_PMIC_ARB_CHNL387_RDATA1_ADDR A:0xde3001c
y.create.l HWIO_PMIC_ARB_CHNL388_RDATA1_ADDR A:0xde4001c
y.create.l HWIO_PMIC_ARB_CHNL389_RDATA1_ADDR A:0xde5001c
y.create.l HWIO_PMIC_ARB_CHNL390_RDATA1_ADDR A:0xde6001c
y.create.l HWIO_PMIC_ARB_CHNL391_RDATA1_ADDR A:0xde7001c
y.create.l HWIO_PMIC_ARB_CHNL392_RDATA1_ADDR A:0xde8001c
y.create.l HWIO_PMIC_ARB_CHNL393_RDATA1_ADDR A:0xde9001c
y.create.l HWIO_PMIC_ARB_CHNL394_RDATA1_ADDR A:0xdea001c
y.create.l HWIO_PMIC_ARB_CHNL395_RDATA1_ADDR A:0xdeb001c
y.create.l HWIO_PMIC_ARB_CHNL396_RDATA1_ADDR A:0xdec001c
y.create.l HWIO_PMIC_ARB_CHNL397_RDATA1_ADDR A:0xded001c
y.create.l HWIO_PMIC_ARB_CHNL398_RDATA1_ADDR A:0xdee001c
y.create.l HWIO_PMIC_ARB_CHNL399_RDATA1_ADDR A:0xdef001c
y.create.l HWIO_PMIC_ARB_CHNL400_RDATA1_ADDR A:0xdf0001c
y.create.l HWIO_PMIC_ARB_CHNL401_RDATA1_ADDR A:0xdf1001c
y.create.l HWIO_PMIC_ARB_CHNL402_RDATA1_ADDR A:0xdf2001c
y.create.l HWIO_PMIC_ARB_CHNL403_RDATA1_ADDR A:0xdf3001c
y.create.l HWIO_PMIC_ARB_CHNL404_RDATA1_ADDR A:0xdf4001c
y.create.l HWIO_PMIC_ARB_CHNL405_RDATA1_ADDR A:0xdf5001c
y.create.l HWIO_PMIC_ARB_CHNL406_RDATA1_ADDR A:0xdf6001c
y.create.l HWIO_PMIC_ARB_CHNL407_RDATA1_ADDR A:0xdf7001c
y.create.l HWIO_PMIC_ARB_CHNL408_RDATA1_ADDR A:0xdf8001c
y.create.l HWIO_PMIC_ARB_CHNL409_RDATA1_ADDR A:0xdf9001c
y.create.l HWIO_PMIC_ARB_CHNL410_RDATA1_ADDR A:0xdfa001c
y.create.l HWIO_PMIC_ARB_CHNL411_RDATA1_ADDR A:0xdfb001c
y.create.l HWIO_PMIC_ARB_CHNL412_RDATA1_ADDR A:0xdfc001c
y.create.l HWIO_PMIC_ARB_CHNL413_RDATA1_ADDR A:0xdfd001c
y.create.l HWIO_PMIC_ARB_CHNL414_RDATA1_ADDR A:0xdfe001c
y.create.l HWIO_PMIC_ARB_CHNL415_RDATA1_ADDR A:0xdff001c
y.create.l HWIO_PMIC_ARB_CHNL416_RDATA1_ADDR A:0xe00001c
y.create.l HWIO_PMIC_ARB_CHNL417_RDATA1_ADDR A:0xe01001c
y.create.l HWIO_PMIC_ARB_CHNL418_RDATA1_ADDR A:0xe02001c
y.create.l HWIO_PMIC_ARB_CHNL419_RDATA1_ADDR A:0xe03001c
y.create.l HWIO_PMIC_ARB_CHNL420_RDATA1_ADDR A:0xe04001c
y.create.l HWIO_PMIC_ARB_CHNL421_RDATA1_ADDR A:0xe05001c
y.create.l HWIO_PMIC_ARB_CHNL422_RDATA1_ADDR A:0xe06001c
y.create.l HWIO_PMIC_ARB_CHNL423_RDATA1_ADDR A:0xe07001c
y.create.l HWIO_PMIC_ARB_CHNL424_RDATA1_ADDR A:0xe08001c
y.create.l HWIO_PMIC_ARB_CHNL425_RDATA1_ADDR A:0xe09001c
y.create.l HWIO_PMIC_ARB_CHNL426_RDATA1_ADDR A:0xe0a001c
y.create.l HWIO_PMIC_ARB_CHNL427_RDATA1_ADDR A:0xe0b001c
y.create.l HWIO_PMIC_ARB_CHNL428_RDATA1_ADDR A:0xe0c001c
y.create.l HWIO_PMIC_ARB_CHNL429_RDATA1_ADDR A:0xe0d001c
y.create.l HWIO_PMIC_ARB_CHNL430_RDATA1_ADDR A:0xe0e001c
y.create.l HWIO_PMIC_ARB_CHNL431_RDATA1_ADDR A:0xe0f001c
y.create.l HWIO_PMIC_ARB_CHNL432_RDATA1_ADDR A:0xe10001c
y.create.l HWIO_PMIC_ARB_CHNL433_RDATA1_ADDR A:0xe11001c
y.create.l HWIO_PMIC_ARB_CHNL434_RDATA1_ADDR A:0xe12001c
y.create.l HWIO_PMIC_ARB_CHNL435_RDATA1_ADDR A:0xe13001c
y.create.l HWIO_PMIC_ARB_CHNL436_RDATA1_ADDR A:0xe14001c
y.create.l HWIO_PMIC_ARB_CHNL437_RDATA1_ADDR A:0xe15001c
y.create.l HWIO_PMIC_ARB_CHNL438_RDATA1_ADDR A:0xe16001c
y.create.l HWIO_PMIC_ARB_CHNL439_RDATA1_ADDR A:0xe17001c
y.create.l HWIO_PMIC_ARB_CHNL440_RDATA1_ADDR A:0xe18001c
y.create.l HWIO_PMIC_ARB_CHNL441_RDATA1_ADDR A:0xe19001c
y.create.l HWIO_PMIC_ARB_CHNL442_RDATA1_ADDR A:0xe1a001c
y.create.l HWIO_PMIC_ARB_CHNL443_RDATA1_ADDR A:0xe1b001c
y.create.l HWIO_PMIC_ARB_CHNL444_RDATA1_ADDR A:0xe1c001c
y.create.l HWIO_PMIC_ARB_CHNL445_RDATA1_ADDR A:0xe1d001c
y.create.l HWIO_PMIC_ARB_CHNL446_RDATA1_ADDR A:0xe1e001c
y.create.l HWIO_PMIC_ARB_CHNL447_RDATA1_ADDR A:0xe1f001c
y.create.l HWIO_PMIC_ARB_CHNL448_RDATA1_ADDR A:0xe20001c
y.create.l HWIO_PMIC_ARB_CHNL449_RDATA1_ADDR A:0xe21001c
y.create.l HWIO_PMIC_ARB_CHNL450_RDATA1_ADDR A:0xe22001c
y.create.l HWIO_PMIC_ARB_CHNL451_RDATA1_ADDR A:0xe23001c
y.create.l HWIO_PMIC_ARB_CHNL452_RDATA1_ADDR A:0xe24001c
y.create.l HWIO_PMIC_ARB_CHNL453_RDATA1_ADDR A:0xe25001c
y.create.l HWIO_PMIC_ARB_CHNL454_RDATA1_ADDR A:0xe26001c
y.create.l HWIO_PMIC_ARB_CHNL455_RDATA1_ADDR A:0xe27001c
y.create.l HWIO_PMIC_ARB_CHNL456_RDATA1_ADDR A:0xe28001c
y.create.l HWIO_PMIC_ARB_CHNL457_RDATA1_ADDR A:0xe29001c
y.create.l HWIO_PMIC_ARB_CHNL458_RDATA1_ADDR A:0xe2a001c
y.create.l HWIO_PMIC_ARB_CHNL459_RDATA1_ADDR A:0xe2b001c
y.create.l HWIO_PMIC_ARB_CHNL460_RDATA1_ADDR A:0xe2c001c
y.create.l HWIO_PMIC_ARB_CHNL461_RDATA1_ADDR A:0xe2d001c
y.create.l HWIO_PMIC_ARB_CHNL462_RDATA1_ADDR A:0xe2e001c
y.create.l HWIO_PMIC_ARB_CHNL463_RDATA1_ADDR A:0xe2f001c
y.create.l HWIO_PMIC_ARB_CHNL464_RDATA1_ADDR A:0xe30001c
y.create.l HWIO_PMIC_ARB_CHNL465_RDATA1_ADDR A:0xe31001c
y.create.l HWIO_PMIC_ARB_CHNL466_RDATA1_ADDR A:0xe32001c
y.create.l HWIO_PMIC_ARB_CHNL467_RDATA1_ADDR A:0xe33001c
y.create.l HWIO_PMIC_ARB_CHNL468_RDATA1_ADDR A:0xe34001c
y.create.l HWIO_PMIC_ARB_CHNL469_RDATA1_ADDR A:0xe35001c
y.create.l HWIO_PMIC_ARB_CHNL470_RDATA1_ADDR A:0xe36001c
y.create.l HWIO_PMIC_ARB_CHNL471_RDATA1_ADDR A:0xe37001c
y.create.l HWIO_PMIC_ARB_CHNL472_RDATA1_ADDR A:0xe38001c
y.create.l HWIO_PMIC_ARB_CHNL473_RDATA1_ADDR A:0xe39001c
y.create.l HWIO_PMIC_ARB_CHNL474_RDATA1_ADDR A:0xe3a001c
y.create.l HWIO_PMIC_ARB_CHNL475_RDATA1_ADDR A:0xe3b001c
y.create.l HWIO_PMIC_ARB_CHNL476_RDATA1_ADDR A:0xe3c001c
y.create.l HWIO_PMIC_ARB_CHNL477_RDATA1_ADDR A:0xe3d001c
y.create.l HWIO_PMIC_ARB_CHNL478_RDATA1_ADDR A:0xe3e001c
y.create.l HWIO_PMIC_ARB_CHNL479_RDATA1_ADDR A:0xe3f001c
y.create.l HWIO_PMIC_ARB_CHNL480_RDATA1_ADDR A:0xe40001c
y.create.l HWIO_PMIC_ARB_CHNL481_RDATA1_ADDR A:0xe41001c
y.create.l HWIO_PMIC_ARB_CHNL482_RDATA1_ADDR A:0xe42001c
y.create.l HWIO_PMIC_ARB_CHNL483_RDATA1_ADDR A:0xe43001c
y.create.l HWIO_PMIC_ARB_CHNL484_RDATA1_ADDR A:0xe44001c
y.create.l HWIO_PMIC_ARB_CHNL485_RDATA1_ADDR A:0xe45001c
y.create.l HWIO_PMIC_ARB_CHNL486_RDATA1_ADDR A:0xe46001c
y.create.l HWIO_PMIC_ARB_CHNL487_RDATA1_ADDR A:0xe47001c
y.create.l HWIO_PMIC_ARB_CHNL488_RDATA1_ADDR A:0xe48001c
y.create.l HWIO_PMIC_ARB_CHNL489_RDATA1_ADDR A:0xe49001c
y.create.l HWIO_PMIC_ARB_CHNL490_RDATA1_ADDR A:0xe4a001c
y.create.l HWIO_PMIC_ARB_CHNL491_RDATA1_ADDR A:0xe4b001c
y.create.l HWIO_PMIC_ARB_CHNL492_RDATA1_ADDR A:0xe4c001c
y.create.l HWIO_PMIC_ARB_CHNL493_RDATA1_ADDR A:0xe4d001c
y.create.l HWIO_PMIC_ARB_CHNL494_RDATA1_ADDR A:0xe4e001c
y.create.l HWIO_PMIC_ARB_CHNL495_RDATA1_ADDR A:0xe4f001c
y.create.l HWIO_PMIC_ARB_CHNL496_RDATA1_ADDR A:0xe50001c
y.create.l HWIO_PMIC_ARB_CHNL497_RDATA1_ADDR A:0xe51001c
y.create.l HWIO_PMIC_ARB_CHNL498_RDATA1_ADDR A:0xe52001c
y.create.l HWIO_PMIC_ARB_CHNL499_RDATA1_ADDR A:0xe53001c
y.create.l HWIO_PMIC_ARB_CHNL500_RDATA1_ADDR A:0xe54001c
y.create.l HWIO_PMIC_ARB_CHNL501_RDATA1_ADDR A:0xe55001c
y.create.l HWIO_PMIC_ARB_CHNL502_RDATA1_ADDR A:0xe56001c
y.create.l HWIO_PMIC_ARB_CHNL503_RDATA1_ADDR A:0xe57001c
y.create.l HWIO_PMIC_ARB_CHNL504_RDATA1_ADDR A:0xe58001c
y.create.l HWIO_PMIC_ARB_CHNL505_RDATA1_ADDR A:0xe59001c
y.create.l HWIO_PMIC_ARB_CHNL506_RDATA1_ADDR A:0xe5a001c
y.create.l HWIO_PMIC_ARB_CHNL507_RDATA1_ADDR A:0xe5b001c
y.create.l HWIO_PMIC_ARB_CHNL508_RDATA1_ADDR A:0xe5c001c
y.create.l HWIO_PMIC_ARB_CHNL509_RDATA1_ADDR A:0xe5d001c
y.create.l HWIO_PMIC_ARB_CHNL510_RDATA1_ADDR A:0xe5e001c
y.create.l HWIO_PMIC_ARB_CHNL511_RDATA1_ADDR A:0xe5f001c
y.create.l HWIO_PMIC_ARB_CHNL0_RDATA2_ADDR A:0xc600020
y.create.l HWIO_PMIC_ARB_CHNL1_RDATA2_ADDR A:0xc610020
y.create.l HWIO_PMIC_ARB_CHNL2_RDATA2_ADDR A:0xc620020
y.create.l HWIO_PMIC_ARB_CHNL3_RDATA2_ADDR A:0xc630020
y.create.l HWIO_PMIC_ARB_CHNL4_RDATA2_ADDR A:0xc640020
y.create.l HWIO_PMIC_ARB_CHNL5_RDATA2_ADDR A:0xc650020
y.create.l HWIO_PMIC_ARB_CHNL6_RDATA2_ADDR A:0xc660020
y.create.l HWIO_PMIC_ARB_CHNL7_RDATA2_ADDR A:0xc670020
y.create.l HWIO_PMIC_ARB_CHNL8_RDATA2_ADDR A:0xc680020
y.create.l HWIO_PMIC_ARB_CHNL9_RDATA2_ADDR A:0xc690020
y.create.l HWIO_PMIC_ARB_CHNL10_RDATA2_ADDR A:0xc6a0020
y.create.l HWIO_PMIC_ARB_CHNL11_RDATA2_ADDR A:0xc6b0020
y.create.l HWIO_PMIC_ARB_CHNL12_RDATA2_ADDR A:0xc6c0020
y.create.l HWIO_PMIC_ARB_CHNL13_RDATA2_ADDR A:0xc6d0020
y.create.l HWIO_PMIC_ARB_CHNL14_RDATA2_ADDR A:0xc6e0020
y.create.l HWIO_PMIC_ARB_CHNL15_RDATA2_ADDR A:0xc6f0020
y.create.l HWIO_PMIC_ARB_CHNL16_RDATA2_ADDR A:0xc700020
y.create.l HWIO_PMIC_ARB_CHNL17_RDATA2_ADDR A:0xc710020
y.create.l HWIO_PMIC_ARB_CHNL18_RDATA2_ADDR A:0xc720020
y.create.l HWIO_PMIC_ARB_CHNL19_RDATA2_ADDR A:0xc730020
y.create.l HWIO_PMIC_ARB_CHNL20_RDATA2_ADDR A:0xc740020
y.create.l HWIO_PMIC_ARB_CHNL21_RDATA2_ADDR A:0xc750020
y.create.l HWIO_PMIC_ARB_CHNL22_RDATA2_ADDR A:0xc760020
y.create.l HWIO_PMIC_ARB_CHNL23_RDATA2_ADDR A:0xc770020
y.create.l HWIO_PMIC_ARB_CHNL24_RDATA2_ADDR A:0xc780020
y.create.l HWIO_PMIC_ARB_CHNL25_RDATA2_ADDR A:0xc790020
y.create.l HWIO_PMIC_ARB_CHNL26_RDATA2_ADDR A:0xc7a0020
y.create.l HWIO_PMIC_ARB_CHNL27_RDATA2_ADDR A:0xc7b0020
y.create.l HWIO_PMIC_ARB_CHNL28_RDATA2_ADDR A:0xc7c0020
y.create.l HWIO_PMIC_ARB_CHNL29_RDATA2_ADDR A:0xc7d0020
y.create.l HWIO_PMIC_ARB_CHNL30_RDATA2_ADDR A:0xc7e0020
y.create.l HWIO_PMIC_ARB_CHNL31_RDATA2_ADDR A:0xc7f0020
y.create.l HWIO_PMIC_ARB_CHNL32_RDATA2_ADDR A:0xc800020
y.create.l HWIO_PMIC_ARB_CHNL33_RDATA2_ADDR A:0xc810020
y.create.l HWIO_PMIC_ARB_CHNL34_RDATA2_ADDR A:0xc820020
y.create.l HWIO_PMIC_ARB_CHNL35_RDATA2_ADDR A:0xc830020
y.create.l HWIO_PMIC_ARB_CHNL36_RDATA2_ADDR A:0xc840020
y.create.l HWIO_PMIC_ARB_CHNL37_RDATA2_ADDR A:0xc850020
y.create.l HWIO_PMIC_ARB_CHNL38_RDATA2_ADDR A:0xc860020
y.create.l HWIO_PMIC_ARB_CHNL39_RDATA2_ADDR A:0xc870020
y.create.l HWIO_PMIC_ARB_CHNL40_RDATA2_ADDR A:0xc880020
y.create.l HWIO_PMIC_ARB_CHNL41_RDATA2_ADDR A:0xc890020
y.create.l HWIO_PMIC_ARB_CHNL42_RDATA2_ADDR A:0xc8a0020
y.create.l HWIO_PMIC_ARB_CHNL43_RDATA2_ADDR A:0xc8b0020
y.create.l HWIO_PMIC_ARB_CHNL44_RDATA2_ADDR A:0xc8c0020
y.create.l HWIO_PMIC_ARB_CHNL45_RDATA2_ADDR A:0xc8d0020
y.create.l HWIO_PMIC_ARB_CHNL46_RDATA2_ADDR A:0xc8e0020
y.create.l HWIO_PMIC_ARB_CHNL47_RDATA2_ADDR A:0xc8f0020
y.create.l HWIO_PMIC_ARB_CHNL48_RDATA2_ADDR A:0xc900020
y.create.l HWIO_PMIC_ARB_CHNL49_RDATA2_ADDR A:0xc910020
y.create.l HWIO_PMIC_ARB_CHNL50_RDATA2_ADDR A:0xc920020
y.create.l HWIO_PMIC_ARB_CHNL51_RDATA2_ADDR A:0xc930020
y.create.l HWIO_PMIC_ARB_CHNL52_RDATA2_ADDR A:0xc940020
y.create.l HWIO_PMIC_ARB_CHNL53_RDATA2_ADDR A:0xc950020
y.create.l HWIO_PMIC_ARB_CHNL54_RDATA2_ADDR A:0xc960020
y.create.l HWIO_PMIC_ARB_CHNL55_RDATA2_ADDR A:0xc970020
y.create.l HWIO_PMIC_ARB_CHNL56_RDATA2_ADDR A:0xc980020
y.create.l HWIO_PMIC_ARB_CHNL57_RDATA2_ADDR A:0xc990020
y.create.l HWIO_PMIC_ARB_CHNL58_RDATA2_ADDR A:0xc9a0020
y.create.l HWIO_PMIC_ARB_CHNL59_RDATA2_ADDR A:0xc9b0020
y.create.l HWIO_PMIC_ARB_CHNL60_RDATA2_ADDR A:0xc9c0020
y.create.l HWIO_PMIC_ARB_CHNL61_RDATA2_ADDR A:0xc9d0020
y.create.l HWIO_PMIC_ARB_CHNL62_RDATA2_ADDR A:0xc9e0020
y.create.l HWIO_PMIC_ARB_CHNL63_RDATA2_ADDR A:0xc9f0020
y.create.l HWIO_PMIC_ARB_CHNL64_RDATA2_ADDR A:0xca00020
y.create.l HWIO_PMIC_ARB_CHNL65_RDATA2_ADDR A:0xca10020
y.create.l HWIO_PMIC_ARB_CHNL66_RDATA2_ADDR A:0xca20020
y.create.l HWIO_PMIC_ARB_CHNL67_RDATA2_ADDR A:0xca30020
y.create.l HWIO_PMIC_ARB_CHNL68_RDATA2_ADDR A:0xca40020
y.create.l HWIO_PMIC_ARB_CHNL69_RDATA2_ADDR A:0xca50020
y.create.l HWIO_PMIC_ARB_CHNL70_RDATA2_ADDR A:0xca60020
y.create.l HWIO_PMIC_ARB_CHNL71_RDATA2_ADDR A:0xca70020
y.create.l HWIO_PMIC_ARB_CHNL72_RDATA2_ADDR A:0xca80020
y.create.l HWIO_PMIC_ARB_CHNL73_RDATA2_ADDR A:0xca90020
y.create.l HWIO_PMIC_ARB_CHNL74_RDATA2_ADDR A:0xcaa0020
y.create.l HWIO_PMIC_ARB_CHNL75_RDATA2_ADDR A:0xcab0020
y.create.l HWIO_PMIC_ARB_CHNL76_RDATA2_ADDR A:0xcac0020
y.create.l HWIO_PMIC_ARB_CHNL77_RDATA2_ADDR A:0xcad0020
y.create.l HWIO_PMIC_ARB_CHNL78_RDATA2_ADDR A:0xcae0020
y.create.l HWIO_PMIC_ARB_CHNL79_RDATA2_ADDR A:0xcaf0020
y.create.l HWIO_PMIC_ARB_CHNL80_RDATA2_ADDR A:0xcb00020
y.create.l HWIO_PMIC_ARB_CHNL81_RDATA2_ADDR A:0xcb10020
y.create.l HWIO_PMIC_ARB_CHNL82_RDATA2_ADDR A:0xcb20020
y.create.l HWIO_PMIC_ARB_CHNL83_RDATA2_ADDR A:0xcb30020
y.create.l HWIO_PMIC_ARB_CHNL84_RDATA2_ADDR A:0xcb40020
y.create.l HWIO_PMIC_ARB_CHNL85_RDATA2_ADDR A:0xcb50020
y.create.l HWIO_PMIC_ARB_CHNL86_RDATA2_ADDR A:0xcb60020
y.create.l HWIO_PMIC_ARB_CHNL87_RDATA2_ADDR A:0xcb70020
y.create.l HWIO_PMIC_ARB_CHNL88_RDATA2_ADDR A:0xcb80020
y.create.l HWIO_PMIC_ARB_CHNL89_RDATA2_ADDR A:0xcb90020
y.create.l HWIO_PMIC_ARB_CHNL90_RDATA2_ADDR A:0xcba0020
y.create.l HWIO_PMIC_ARB_CHNL91_RDATA2_ADDR A:0xcbb0020
y.create.l HWIO_PMIC_ARB_CHNL92_RDATA2_ADDR A:0xcbc0020
y.create.l HWIO_PMIC_ARB_CHNL93_RDATA2_ADDR A:0xcbd0020
y.create.l HWIO_PMIC_ARB_CHNL94_RDATA2_ADDR A:0xcbe0020
y.create.l HWIO_PMIC_ARB_CHNL95_RDATA2_ADDR A:0xcbf0020
y.create.l HWIO_PMIC_ARB_CHNL96_RDATA2_ADDR A:0xcc00020
y.create.l HWIO_PMIC_ARB_CHNL97_RDATA2_ADDR A:0xcc10020
y.create.l HWIO_PMIC_ARB_CHNL98_RDATA2_ADDR A:0xcc20020
y.create.l HWIO_PMIC_ARB_CHNL99_RDATA2_ADDR A:0xcc30020
y.create.l HWIO_PMIC_ARB_CHNL100_RDATA2_ADDR A:0xcc40020
y.create.l HWIO_PMIC_ARB_CHNL101_RDATA2_ADDR A:0xcc50020
y.create.l HWIO_PMIC_ARB_CHNL102_RDATA2_ADDR A:0xcc60020
y.create.l HWIO_PMIC_ARB_CHNL103_RDATA2_ADDR A:0xcc70020
y.create.l HWIO_PMIC_ARB_CHNL104_RDATA2_ADDR A:0xcc80020
y.create.l HWIO_PMIC_ARB_CHNL105_RDATA2_ADDR A:0xcc90020
y.create.l HWIO_PMIC_ARB_CHNL106_RDATA2_ADDR A:0xcca0020
y.create.l HWIO_PMIC_ARB_CHNL107_RDATA2_ADDR A:0xccb0020
y.create.l HWIO_PMIC_ARB_CHNL108_RDATA2_ADDR A:0xccc0020
y.create.l HWIO_PMIC_ARB_CHNL109_RDATA2_ADDR A:0xccd0020
y.create.l HWIO_PMIC_ARB_CHNL110_RDATA2_ADDR A:0xcce0020
y.create.l HWIO_PMIC_ARB_CHNL111_RDATA2_ADDR A:0xccf0020
y.create.l HWIO_PMIC_ARB_CHNL112_RDATA2_ADDR A:0xcd00020
y.create.l HWIO_PMIC_ARB_CHNL113_RDATA2_ADDR A:0xcd10020
y.create.l HWIO_PMIC_ARB_CHNL114_RDATA2_ADDR A:0xcd20020
y.create.l HWIO_PMIC_ARB_CHNL115_RDATA2_ADDR A:0xcd30020
y.create.l HWIO_PMIC_ARB_CHNL116_RDATA2_ADDR A:0xcd40020
y.create.l HWIO_PMIC_ARB_CHNL117_RDATA2_ADDR A:0xcd50020
y.create.l HWIO_PMIC_ARB_CHNL118_RDATA2_ADDR A:0xcd60020
y.create.l HWIO_PMIC_ARB_CHNL119_RDATA2_ADDR A:0xcd70020
y.create.l HWIO_PMIC_ARB_CHNL120_RDATA2_ADDR A:0xcd80020
y.create.l HWIO_PMIC_ARB_CHNL121_RDATA2_ADDR A:0xcd90020
y.create.l HWIO_PMIC_ARB_CHNL122_RDATA2_ADDR A:0xcda0020
y.create.l HWIO_PMIC_ARB_CHNL123_RDATA2_ADDR A:0xcdb0020
y.create.l HWIO_PMIC_ARB_CHNL124_RDATA2_ADDR A:0xcdc0020
y.create.l HWIO_PMIC_ARB_CHNL125_RDATA2_ADDR A:0xcdd0020
y.create.l HWIO_PMIC_ARB_CHNL126_RDATA2_ADDR A:0xcde0020
y.create.l HWIO_PMIC_ARB_CHNL127_RDATA2_ADDR A:0xcdf0020
y.create.l HWIO_PMIC_ARB_CHNL128_RDATA2_ADDR A:0xce00020
y.create.l HWIO_PMIC_ARB_CHNL129_RDATA2_ADDR A:0xce10020
y.create.l HWIO_PMIC_ARB_CHNL130_RDATA2_ADDR A:0xce20020
y.create.l HWIO_PMIC_ARB_CHNL131_RDATA2_ADDR A:0xce30020
y.create.l HWIO_PMIC_ARB_CHNL132_RDATA2_ADDR A:0xce40020
y.create.l HWIO_PMIC_ARB_CHNL133_RDATA2_ADDR A:0xce50020
y.create.l HWIO_PMIC_ARB_CHNL134_RDATA2_ADDR A:0xce60020
y.create.l HWIO_PMIC_ARB_CHNL135_RDATA2_ADDR A:0xce70020
y.create.l HWIO_PMIC_ARB_CHNL136_RDATA2_ADDR A:0xce80020
y.create.l HWIO_PMIC_ARB_CHNL137_RDATA2_ADDR A:0xce90020
y.create.l HWIO_PMIC_ARB_CHNL138_RDATA2_ADDR A:0xcea0020
y.create.l HWIO_PMIC_ARB_CHNL139_RDATA2_ADDR A:0xceb0020
y.create.l HWIO_PMIC_ARB_CHNL140_RDATA2_ADDR A:0xcec0020
y.create.l HWIO_PMIC_ARB_CHNL141_RDATA2_ADDR A:0xced0020
y.create.l HWIO_PMIC_ARB_CHNL142_RDATA2_ADDR A:0xcee0020
y.create.l HWIO_PMIC_ARB_CHNL143_RDATA2_ADDR A:0xcef0020
y.create.l HWIO_PMIC_ARB_CHNL144_RDATA2_ADDR A:0xcf00020
y.create.l HWIO_PMIC_ARB_CHNL145_RDATA2_ADDR A:0xcf10020
y.create.l HWIO_PMIC_ARB_CHNL146_RDATA2_ADDR A:0xcf20020
y.create.l HWIO_PMIC_ARB_CHNL147_RDATA2_ADDR A:0xcf30020
y.create.l HWIO_PMIC_ARB_CHNL148_RDATA2_ADDR A:0xcf40020
y.create.l HWIO_PMIC_ARB_CHNL149_RDATA2_ADDR A:0xcf50020
y.create.l HWIO_PMIC_ARB_CHNL150_RDATA2_ADDR A:0xcf60020
y.create.l HWIO_PMIC_ARB_CHNL151_RDATA2_ADDR A:0xcf70020
y.create.l HWIO_PMIC_ARB_CHNL152_RDATA2_ADDR A:0xcf80020
y.create.l HWIO_PMIC_ARB_CHNL153_RDATA2_ADDR A:0xcf90020
y.create.l HWIO_PMIC_ARB_CHNL154_RDATA2_ADDR A:0xcfa0020
y.create.l HWIO_PMIC_ARB_CHNL155_RDATA2_ADDR A:0xcfb0020
y.create.l HWIO_PMIC_ARB_CHNL156_RDATA2_ADDR A:0xcfc0020
y.create.l HWIO_PMIC_ARB_CHNL157_RDATA2_ADDR A:0xcfd0020
y.create.l HWIO_PMIC_ARB_CHNL158_RDATA2_ADDR A:0xcfe0020
y.create.l HWIO_PMIC_ARB_CHNL159_RDATA2_ADDR A:0xcff0020
y.create.l HWIO_PMIC_ARB_CHNL160_RDATA2_ADDR A:0xd000020
y.create.l HWIO_PMIC_ARB_CHNL161_RDATA2_ADDR A:0xd010020
y.create.l HWIO_PMIC_ARB_CHNL162_RDATA2_ADDR A:0xd020020
y.create.l HWIO_PMIC_ARB_CHNL163_RDATA2_ADDR A:0xd030020
y.create.l HWIO_PMIC_ARB_CHNL164_RDATA2_ADDR A:0xd040020
y.create.l HWIO_PMIC_ARB_CHNL165_RDATA2_ADDR A:0xd050020
y.create.l HWIO_PMIC_ARB_CHNL166_RDATA2_ADDR A:0xd060020
y.create.l HWIO_PMIC_ARB_CHNL167_RDATA2_ADDR A:0xd070020
y.create.l HWIO_PMIC_ARB_CHNL168_RDATA2_ADDR A:0xd080020
y.create.l HWIO_PMIC_ARB_CHNL169_RDATA2_ADDR A:0xd090020
y.create.l HWIO_PMIC_ARB_CHNL170_RDATA2_ADDR A:0xd0a0020
y.create.l HWIO_PMIC_ARB_CHNL171_RDATA2_ADDR A:0xd0b0020
y.create.l HWIO_PMIC_ARB_CHNL172_RDATA2_ADDR A:0xd0c0020
y.create.l HWIO_PMIC_ARB_CHNL173_RDATA2_ADDR A:0xd0d0020
y.create.l HWIO_PMIC_ARB_CHNL174_RDATA2_ADDR A:0xd0e0020
y.create.l HWIO_PMIC_ARB_CHNL175_RDATA2_ADDR A:0xd0f0020
y.create.l HWIO_PMIC_ARB_CHNL176_RDATA2_ADDR A:0xd100020
y.create.l HWIO_PMIC_ARB_CHNL177_RDATA2_ADDR A:0xd110020
y.create.l HWIO_PMIC_ARB_CHNL178_RDATA2_ADDR A:0xd120020
y.create.l HWIO_PMIC_ARB_CHNL179_RDATA2_ADDR A:0xd130020
y.create.l HWIO_PMIC_ARB_CHNL180_RDATA2_ADDR A:0xd140020
y.create.l HWIO_PMIC_ARB_CHNL181_RDATA2_ADDR A:0xd150020
y.create.l HWIO_PMIC_ARB_CHNL182_RDATA2_ADDR A:0xd160020
y.create.l HWIO_PMIC_ARB_CHNL183_RDATA2_ADDR A:0xd170020
y.create.l HWIO_PMIC_ARB_CHNL184_RDATA2_ADDR A:0xd180020
y.create.l HWIO_PMIC_ARB_CHNL185_RDATA2_ADDR A:0xd190020
y.create.l HWIO_PMIC_ARB_CHNL186_RDATA2_ADDR A:0xd1a0020
y.create.l HWIO_PMIC_ARB_CHNL187_RDATA2_ADDR A:0xd1b0020
y.create.l HWIO_PMIC_ARB_CHNL188_RDATA2_ADDR A:0xd1c0020
y.create.l HWIO_PMIC_ARB_CHNL189_RDATA2_ADDR A:0xd1d0020
y.create.l HWIO_PMIC_ARB_CHNL190_RDATA2_ADDR A:0xd1e0020
y.create.l HWIO_PMIC_ARB_CHNL191_RDATA2_ADDR A:0xd1f0020
y.create.l HWIO_PMIC_ARB_CHNL192_RDATA2_ADDR A:0xd200020
y.create.l HWIO_PMIC_ARB_CHNL193_RDATA2_ADDR A:0xd210020
y.create.l HWIO_PMIC_ARB_CHNL194_RDATA2_ADDR A:0xd220020
y.create.l HWIO_PMIC_ARB_CHNL195_RDATA2_ADDR A:0xd230020
y.create.l HWIO_PMIC_ARB_CHNL196_RDATA2_ADDR A:0xd240020
y.create.l HWIO_PMIC_ARB_CHNL197_RDATA2_ADDR A:0xd250020
y.create.l HWIO_PMIC_ARB_CHNL198_RDATA2_ADDR A:0xd260020
y.create.l HWIO_PMIC_ARB_CHNL199_RDATA2_ADDR A:0xd270020
y.create.l HWIO_PMIC_ARB_CHNL200_RDATA2_ADDR A:0xd280020
y.create.l HWIO_PMIC_ARB_CHNL201_RDATA2_ADDR A:0xd290020
y.create.l HWIO_PMIC_ARB_CHNL202_RDATA2_ADDR A:0xd2a0020
y.create.l HWIO_PMIC_ARB_CHNL203_RDATA2_ADDR A:0xd2b0020
y.create.l HWIO_PMIC_ARB_CHNL204_RDATA2_ADDR A:0xd2c0020
y.create.l HWIO_PMIC_ARB_CHNL205_RDATA2_ADDR A:0xd2d0020
y.create.l HWIO_PMIC_ARB_CHNL206_RDATA2_ADDR A:0xd2e0020
y.create.l HWIO_PMIC_ARB_CHNL207_RDATA2_ADDR A:0xd2f0020
y.create.l HWIO_PMIC_ARB_CHNL208_RDATA2_ADDR A:0xd300020
y.create.l HWIO_PMIC_ARB_CHNL209_RDATA2_ADDR A:0xd310020
y.create.l HWIO_PMIC_ARB_CHNL210_RDATA2_ADDR A:0xd320020
y.create.l HWIO_PMIC_ARB_CHNL211_RDATA2_ADDR A:0xd330020
y.create.l HWIO_PMIC_ARB_CHNL212_RDATA2_ADDR A:0xd340020
y.create.l HWIO_PMIC_ARB_CHNL213_RDATA2_ADDR A:0xd350020
y.create.l HWIO_PMIC_ARB_CHNL214_RDATA2_ADDR A:0xd360020
y.create.l HWIO_PMIC_ARB_CHNL215_RDATA2_ADDR A:0xd370020
y.create.l HWIO_PMIC_ARB_CHNL216_RDATA2_ADDR A:0xd380020
y.create.l HWIO_PMIC_ARB_CHNL217_RDATA2_ADDR A:0xd390020
y.create.l HWIO_PMIC_ARB_CHNL218_RDATA2_ADDR A:0xd3a0020
y.create.l HWIO_PMIC_ARB_CHNL219_RDATA2_ADDR A:0xd3b0020
y.create.l HWIO_PMIC_ARB_CHNL220_RDATA2_ADDR A:0xd3c0020
y.create.l HWIO_PMIC_ARB_CHNL221_RDATA2_ADDR A:0xd3d0020
y.create.l HWIO_PMIC_ARB_CHNL222_RDATA2_ADDR A:0xd3e0020
y.create.l HWIO_PMIC_ARB_CHNL223_RDATA2_ADDR A:0xd3f0020
y.create.l HWIO_PMIC_ARB_CHNL224_RDATA2_ADDR A:0xd400020
y.create.l HWIO_PMIC_ARB_CHNL225_RDATA2_ADDR A:0xd410020
y.create.l HWIO_PMIC_ARB_CHNL226_RDATA2_ADDR A:0xd420020
y.create.l HWIO_PMIC_ARB_CHNL227_RDATA2_ADDR A:0xd430020
y.create.l HWIO_PMIC_ARB_CHNL228_RDATA2_ADDR A:0xd440020
y.create.l HWIO_PMIC_ARB_CHNL229_RDATA2_ADDR A:0xd450020
y.create.l HWIO_PMIC_ARB_CHNL230_RDATA2_ADDR A:0xd460020
y.create.l HWIO_PMIC_ARB_CHNL231_RDATA2_ADDR A:0xd470020
y.create.l HWIO_PMIC_ARB_CHNL232_RDATA2_ADDR A:0xd480020
y.create.l HWIO_PMIC_ARB_CHNL233_RDATA2_ADDR A:0xd490020
y.create.l HWIO_PMIC_ARB_CHNL234_RDATA2_ADDR A:0xd4a0020
y.create.l HWIO_PMIC_ARB_CHNL235_RDATA2_ADDR A:0xd4b0020
y.create.l HWIO_PMIC_ARB_CHNL236_RDATA2_ADDR A:0xd4c0020
y.create.l HWIO_PMIC_ARB_CHNL237_RDATA2_ADDR A:0xd4d0020
y.create.l HWIO_PMIC_ARB_CHNL238_RDATA2_ADDR A:0xd4e0020
y.create.l HWIO_PMIC_ARB_CHNL239_RDATA2_ADDR A:0xd4f0020
y.create.l HWIO_PMIC_ARB_CHNL240_RDATA2_ADDR A:0xd500020
y.create.l HWIO_PMIC_ARB_CHNL241_RDATA2_ADDR A:0xd510020
y.create.l HWIO_PMIC_ARB_CHNL242_RDATA2_ADDR A:0xd520020
y.create.l HWIO_PMIC_ARB_CHNL243_RDATA2_ADDR A:0xd530020
y.create.l HWIO_PMIC_ARB_CHNL244_RDATA2_ADDR A:0xd540020
y.create.l HWIO_PMIC_ARB_CHNL245_RDATA2_ADDR A:0xd550020
y.create.l HWIO_PMIC_ARB_CHNL246_RDATA2_ADDR A:0xd560020
y.create.l HWIO_PMIC_ARB_CHNL247_RDATA2_ADDR A:0xd570020
y.create.l HWIO_PMIC_ARB_CHNL248_RDATA2_ADDR A:0xd580020
y.create.l HWIO_PMIC_ARB_CHNL249_RDATA2_ADDR A:0xd590020
y.create.l HWIO_PMIC_ARB_CHNL250_RDATA2_ADDR A:0xd5a0020
y.create.l HWIO_PMIC_ARB_CHNL251_RDATA2_ADDR A:0xd5b0020
y.create.l HWIO_PMIC_ARB_CHNL252_RDATA2_ADDR A:0xd5c0020
y.create.l HWIO_PMIC_ARB_CHNL253_RDATA2_ADDR A:0xd5d0020
y.create.l HWIO_PMIC_ARB_CHNL254_RDATA2_ADDR A:0xd5e0020
y.create.l HWIO_PMIC_ARB_CHNL255_RDATA2_ADDR A:0xd5f0020
y.create.l HWIO_PMIC_ARB_CHNL256_RDATA2_ADDR A:0xd600020
y.create.l HWIO_PMIC_ARB_CHNL257_RDATA2_ADDR A:0xd610020
y.create.l HWIO_PMIC_ARB_CHNL258_RDATA2_ADDR A:0xd620020
y.create.l HWIO_PMIC_ARB_CHNL259_RDATA2_ADDR A:0xd630020
y.create.l HWIO_PMIC_ARB_CHNL260_RDATA2_ADDR A:0xd640020
y.create.l HWIO_PMIC_ARB_CHNL261_RDATA2_ADDR A:0xd650020
y.create.l HWIO_PMIC_ARB_CHNL262_RDATA2_ADDR A:0xd660020
y.create.l HWIO_PMIC_ARB_CHNL263_RDATA2_ADDR A:0xd670020
y.create.l HWIO_PMIC_ARB_CHNL264_RDATA2_ADDR A:0xd680020
y.create.l HWIO_PMIC_ARB_CHNL265_RDATA2_ADDR A:0xd690020
y.create.l HWIO_PMIC_ARB_CHNL266_RDATA2_ADDR A:0xd6a0020
y.create.l HWIO_PMIC_ARB_CHNL267_RDATA2_ADDR A:0xd6b0020
y.create.l HWIO_PMIC_ARB_CHNL268_RDATA2_ADDR A:0xd6c0020
y.create.l HWIO_PMIC_ARB_CHNL269_RDATA2_ADDR A:0xd6d0020
y.create.l HWIO_PMIC_ARB_CHNL270_RDATA2_ADDR A:0xd6e0020
y.create.l HWIO_PMIC_ARB_CHNL271_RDATA2_ADDR A:0xd6f0020
y.create.l HWIO_PMIC_ARB_CHNL272_RDATA2_ADDR A:0xd700020
y.create.l HWIO_PMIC_ARB_CHNL273_RDATA2_ADDR A:0xd710020
y.create.l HWIO_PMIC_ARB_CHNL274_RDATA2_ADDR A:0xd720020
y.create.l HWIO_PMIC_ARB_CHNL275_RDATA2_ADDR A:0xd730020
y.create.l HWIO_PMIC_ARB_CHNL276_RDATA2_ADDR A:0xd740020
y.create.l HWIO_PMIC_ARB_CHNL277_RDATA2_ADDR A:0xd750020
y.create.l HWIO_PMIC_ARB_CHNL278_RDATA2_ADDR A:0xd760020
y.create.l HWIO_PMIC_ARB_CHNL279_RDATA2_ADDR A:0xd770020
y.create.l HWIO_PMIC_ARB_CHNL280_RDATA2_ADDR A:0xd780020
y.create.l HWIO_PMIC_ARB_CHNL281_RDATA2_ADDR A:0xd790020
y.create.l HWIO_PMIC_ARB_CHNL282_RDATA2_ADDR A:0xd7a0020
y.create.l HWIO_PMIC_ARB_CHNL283_RDATA2_ADDR A:0xd7b0020
y.create.l HWIO_PMIC_ARB_CHNL284_RDATA2_ADDR A:0xd7c0020
y.create.l HWIO_PMIC_ARB_CHNL285_RDATA2_ADDR A:0xd7d0020
y.create.l HWIO_PMIC_ARB_CHNL286_RDATA2_ADDR A:0xd7e0020
y.create.l HWIO_PMIC_ARB_CHNL287_RDATA2_ADDR A:0xd7f0020
y.create.l HWIO_PMIC_ARB_CHNL288_RDATA2_ADDR A:0xd800020
y.create.l HWIO_PMIC_ARB_CHNL289_RDATA2_ADDR A:0xd810020
y.create.l HWIO_PMIC_ARB_CHNL290_RDATA2_ADDR A:0xd820020
y.create.l HWIO_PMIC_ARB_CHNL291_RDATA2_ADDR A:0xd830020
y.create.l HWIO_PMIC_ARB_CHNL292_RDATA2_ADDR A:0xd840020
y.create.l HWIO_PMIC_ARB_CHNL293_RDATA2_ADDR A:0xd850020
y.create.l HWIO_PMIC_ARB_CHNL294_RDATA2_ADDR A:0xd860020
y.create.l HWIO_PMIC_ARB_CHNL295_RDATA2_ADDR A:0xd870020
y.create.l HWIO_PMIC_ARB_CHNL296_RDATA2_ADDR A:0xd880020
y.create.l HWIO_PMIC_ARB_CHNL297_RDATA2_ADDR A:0xd890020
y.create.l HWIO_PMIC_ARB_CHNL298_RDATA2_ADDR A:0xd8a0020
y.create.l HWIO_PMIC_ARB_CHNL299_RDATA2_ADDR A:0xd8b0020
y.create.l HWIO_PMIC_ARB_CHNL300_RDATA2_ADDR A:0xd8c0020
y.create.l HWIO_PMIC_ARB_CHNL301_RDATA2_ADDR A:0xd8d0020
y.create.l HWIO_PMIC_ARB_CHNL302_RDATA2_ADDR A:0xd8e0020
y.create.l HWIO_PMIC_ARB_CHNL303_RDATA2_ADDR A:0xd8f0020
y.create.l HWIO_PMIC_ARB_CHNL304_RDATA2_ADDR A:0xd900020
y.create.l HWIO_PMIC_ARB_CHNL305_RDATA2_ADDR A:0xd910020
y.create.l HWIO_PMIC_ARB_CHNL306_RDATA2_ADDR A:0xd920020
y.create.l HWIO_PMIC_ARB_CHNL307_RDATA2_ADDR A:0xd930020
y.create.l HWIO_PMIC_ARB_CHNL308_RDATA2_ADDR A:0xd940020
y.create.l HWIO_PMIC_ARB_CHNL309_RDATA2_ADDR A:0xd950020
y.create.l HWIO_PMIC_ARB_CHNL310_RDATA2_ADDR A:0xd960020
y.create.l HWIO_PMIC_ARB_CHNL311_RDATA2_ADDR A:0xd970020
y.create.l HWIO_PMIC_ARB_CHNL312_RDATA2_ADDR A:0xd980020
y.create.l HWIO_PMIC_ARB_CHNL313_RDATA2_ADDR A:0xd990020
y.create.l HWIO_PMIC_ARB_CHNL314_RDATA2_ADDR A:0xd9a0020
y.create.l HWIO_PMIC_ARB_CHNL315_RDATA2_ADDR A:0xd9b0020
y.create.l HWIO_PMIC_ARB_CHNL316_RDATA2_ADDR A:0xd9c0020
y.create.l HWIO_PMIC_ARB_CHNL317_RDATA2_ADDR A:0xd9d0020
y.create.l HWIO_PMIC_ARB_CHNL318_RDATA2_ADDR A:0xd9e0020
y.create.l HWIO_PMIC_ARB_CHNL319_RDATA2_ADDR A:0xd9f0020
y.create.l HWIO_PMIC_ARB_CHNL320_RDATA2_ADDR A:0xda00020
y.create.l HWIO_PMIC_ARB_CHNL321_RDATA2_ADDR A:0xda10020
y.create.l HWIO_PMIC_ARB_CHNL322_RDATA2_ADDR A:0xda20020
y.create.l HWIO_PMIC_ARB_CHNL323_RDATA2_ADDR A:0xda30020
y.create.l HWIO_PMIC_ARB_CHNL324_RDATA2_ADDR A:0xda40020
y.create.l HWIO_PMIC_ARB_CHNL325_RDATA2_ADDR A:0xda50020
y.create.l HWIO_PMIC_ARB_CHNL326_RDATA2_ADDR A:0xda60020
y.create.l HWIO_PMIC_ARB_CHNL327_RDATA2_ADDR A:0xda70020
y.create.l HWIO_PMIC_ARB_CHNL328_RDATA2_ADDR A:0xda80020
y.create.l HWIO_PMIC_ARB_CHNL329_RDATA2_ADDR A:0xda90020
y.create.l HWIO_PMIC_ARB_CHNL330_RDATA2_ADDR A:0xdaa0020
y.create.l HWIO_PMIC_ARB_CHNL331_RDATA2_ADDR A:0xdab0020
y.create.l HWIO_PMIC_ARB_CHNL332_RDATA2_ADDR A:0xdac0020
y.create.l HWIO_PMIC_ARB_CHNL333_RDATA2_ADDR A:0xdad0020
y.create.l HWIO_PMIC_ARB_CHNL334_RDATA2_ADDR A:0xdae0020
y.create.l HWIO_PMIC_ARB_CHNL335_RDATA2_ADDR A:0xdaf0020
y.create.l HWIO_PMIC_ARB_CHNL336_RDATA2_ADDR A:0xdb00020
y.create.l HWIO_PMIC_ARB_CHNL337_RDATA2_ADDR A:0xdb10020
y.create.l HWIO_PMIC_ARB_CHNL338_RDATA2_ADDR A:0xdb20020
y.create.l HWIO_PMIC_ARB_CHNL339_RDATA2_ADDR A:0xdb30020
y.create.l HWIO_PMIC_ARB_CHNL340_RDATA2_ADDR A:0xdb40020
y.create.l HWIO_PMIC_ARB_CHNL341_RDATA2_ADDR A:0xdb50020
y.create.l HWIO_PMIC_ARB_CHNL342_RDATA2_ADDR A:0xdb60020
y.create.l HWIO_PMIC_ARB_CHNL343_RDATA2_ADDR A:0xdb70020
y.create.l HWIO_PMIC_ARB_CHNL344_RDATA2_ADDR A:0xdb80020
y.create.l HWIO_PMIC_ARB_CHNL345_RDATA2_ADDR A:0xdb90020
y.create.l HWIO_PMIC_ARB_CHNL346_RDATA2_ADDR A:0xdba0020
y.create.l HWIO_PMIC_ARB_CHNL347_RDATA2_ADDR A:0xdbb0020
y.create.l HWIO_PMIC_ARB_CHNL348_RDATA2_ADDR A:0xdbc0020
y.create.l HWIO_PMIC_ARB_CHNL349_RDATA2_ADDR A:0xdbd0020
y.create.l HWIO_PMIC_ARB_CHNL350_RDATA2_ADDR A:0xdbe0020
y.create.l HWIO_PMIC_ARB_CHNL351_RDATA2_ADDR A:0xdbf0020
y.create.l HWIO_PMIC_ARB_CHNL352_RDATA2_ADDR A:0xdc00020
y.create.l HWIO_PMIC_ARB_CHNL353_RDATA2_ADDR A:0xdc10020
y.create.l HWIO_PMIC_ARB_CHNL354_RDATA2_ADDR A:0xdc20020
y.create.l HWIO_PMIC_ARB_CHNL355_RDATA2_ADDR A:0xdc30020
y.create.l HWIO_PMIC_ARB_CHNL356_RDATA2_ADDR A:0xdc40020
y.create.l HWIO_PMIC_ARB_CHNL357_RDATA2_ADDR A:0xdc50020
y.create.l HWIO_PMIC_ARB_CHNL358_RDATA2_ADDR A:0xdc60020
y.create.l HWIO_PMIC_ARB_CHNL359_RDATA2_ADDR A:0xdc70020
y.create.l HWIO_PMIC_ARB_CHNL360_RDATA2_ADDR A:0xdc80020
y.create.l HWIO_PMIC_ARB_CHNL361_RDATA2_ADDR A:0xdc90020
y.create.l HWIO_PMIC_ARB_CHNL362_RDATA2_ADDR A:0xdca0020
y.create.l HWIO_PMIC_ARB_CHNL363_RDATA2_ADDR A:0xdcb0020
y.create.l HWIO_PMIC_ARB_CHNL364_RDATA2_ADDR A:0xdcc0020
y.create.l HWIO_PMIC_ARB_CHNL365_RDATA2_ADDR A:0xdcd0020
y.create.l HWIO_PMIC_ARB_CHNL366_RDATA2_ADDR A:0xdce0020
y.create.l HWIO_PMIC_ARB_CHNL367_RDATA2_ADDR A:0xdcf0020
y.create.l HWIO_PMIC_ARB_CHNL368_RDATA2_ADDR A:0xdd00020
y.create.l HWIO_PMIC_ARB_CHNL369_RDATA2_ADDR A:0xdd10020
y.create.l HWIO_PMIC_ARB_CHNL370_RDATA2_ADDR A:0xdd20020
y.create.l HWIO_PMIC_ARB_CHNL371_RDATA2_ADDR A:0xdd30020
y.create.l HWIO_PMIC_ARB_CHNL372_RDATA2_ADDR A:0xdd40020
y.create.l HWIO_PMIC_ARB_CHNL373_RDATA2_ADDR A:0xdd50020
y.create.l HWIO_PMIC_ARB_CHNL374_RDATA2_ADDR A:0xdd60020
y.create.l HWIO_PMIC_ARB_CHNL375_RDATA2_ADDR A:0xdd70020
y.create.l HWIO_PMIC_ARB_CHNL376_RDATA2_ADDR A:0xdd80020
y.create.l HWIO_PMIC_ARB_CHNL377_RDATA2_ADDR A:0xdd90020
y.create.l HWIO_PMIC_ARB_CHNL378_RDATA2_ADDR A:0xdda0020
y.create.l HWIO_PMIC_ARB_CHNL379_RDATA2_ADDR A:0xddb0020
y.create.l HWIO_PMIC_ARB_CHNL380_RDATA2_ADDR A:0xddc0020
y.create.l HWIO_PMIC_ARB_CHNL381_RDATA2_ADDR A:0xddd0020
y.create.l HWIO_PMIC_ARB_CHNL382_RDATA2_ADDR A:0xdde0020
y.create.l HWIO_PMIC_ARB_CHNL383_RDATA2_ADDR A:0xddf0020
y.create.l HWIO_PMIC_ARB_CHNL384_RDATA2_ADDR A:0xde00020
y.create.l HWIO_PMIC_ARB_CHNL385_RDATA2_ADDR A:0xde10020
y.create.l HWIO_PMIC_ARB_CHNL386_RDATA2_ADDR A:0xde20020
y.create.l HWIO_PMIC_ARB_CHNL387_RDATA2_ADDR A:0xde30020
y.create.l HWIO_PMIC_ARB_CHNL388_RDATA2_ADDR A:0xde40020
y.create.l HWIO_PMIC_ARB_CHNL389_RDATA2_ADDR A:0xde50020
y.create.l HWIO_PMIC_ARB_CHNL390_RDATA2_ADDR A:0xde60020
y.create.l HWIO_PMIC_ARB_CHNL391_RDATA2_ADDR A:0xde70020
y.create.l HWIO_PMIC_ARB_CHNL392_RDATA2_ADDR A:0xde80020
y.create.l HWIO_PMIC_ARB_CHNL393_RDATA2_ADDR A:0xde90020
y.create.l HWIO_PMIC_ARB_CHNL394_RDATA2_ADDR A:0xdea0020
y.create.l HWIO_PMIC_ARB_CHNL395_RDATA2_ADDR A:0xdeb0020
y.create.l HWIO_PMIC_ARB_CHNL396_RDATA2_ADDR A:0xdec0020
y.create.l HWIO_PMIC_ARB_CHNL397_RDATA2_ADDR A:0xded0020
y.create.l HWIO_PMIC_ARB_CHNL398_RDATA2_ADDR A:0xdee0020
y.create.l HWIO_PMIC_ARB_CHNL399_RDATA2_ADDR A:0xdef0020
y.create.l HWIO_PMIC_ARB_CHNL400_RDATA2_ADDR A:0xdf00020
y.create.l HWIO_PMIC_ARB_CHNL401_RDATA2_ADDR A:0xdf10020
y.create.l HWIO_PMIC_ARB_CHNL402_RDATA2_ADDR A:0xdf20020
y.create.l HWIO_PMIC_ARB_CHNL403_RDATA2_ADDR A:0xdf30020
y.create.l HWIO_PMIC_ARB_CHNL404_RDATA2_ADDR A:0xdf40020
y.create.l HWIO_PMIC_ARB_CHNL405_RDATA2_ADDR A:0xdf50020
y.create.l HWIO_PMIC_ARB_CHNL406_RDATA2_ADDR A:0xdf60020
y.create.l HWIO_PMIC_ARB_CHNL407_RDATA2_ADDR A:0xdf70020
y.create.l HWIO_PMIC_ARB_CHNL408_RDATA2_ADDR A:0xdf80020
y.create.l HWIO_PMIC_ARB_CHNL409_RDATA2_ADDR A:0xdf90020
y.create.l HWIO_PMIC_ARB_CHNL410_RDATA2_ADDR A:0xdfa0020
y.create.l HWIO_PMIC_ARB_CHNL411_RDATA2_ADDR A:0xdfb0020
y.create.l HWIO_PMIC_ARB_CHNL412_RDATA2_ADDR A:0xdfc0020
y.create.l HWIO_PMIC_ARB_CHNL413_RDATA2_ADDR A:0xdfd0020
y.create.l HWIO_PMIC_ARB_CHNL414_RDATA2_ADDR A:0xdfe0020
y.create.l HWIO_PMIC_ARB_CHNL415_RDATA2_ADDR A:0xdff0020
y.create.l HWIO_PMIC_ARB_CHNL416_RDATA2_ADDR A:0xe000020
y.create.l HWIO_PMIC_ARB_CHNL417_RDATA2_ADDR A:0xe010020
y.create.l HWIO_PMIC_ARB_CHNL418_RDATA2_ADDR A:0xe020020
y.create.l HWIO_PMIC_ARB_CHNL419_RDATA2_ADDR A:0xe030020
y.create.l HWIO_PMIC_ARB_CHNL420_RDATA2_ADDR A:0xe040020
y.create.l HWIO_PMIC_ARB_CHNL421_RDATA2_ADDR A:0xe050020
y.create.l HWIO_PMIC_ARB_CHNL422_RDATA2_ADDR A:0xe060020
y.create.l HWIO_PMIC_ARB_CHNL423_RDATA2_ADDR A:0xe070020
y.create.l HWIO_PMIC_ARB_CHNL424_RDATA2_ADDR A:0xe080020
y.create.l HWIO_PMIC_ARB_CHNL425_RDATA2_ADDR A:0xe090020
y.create.l HWIO_PMIC_ARB_CHNL426_RDATA2_ADDR A:0xe0a0020
y.create.l HWIO_PMIC_ARB_CHNL427_RDATA2_ADDR A:0xe0b0020
y.create.l HWIO_PMIC_ARB_CHNL428_RDATA2_ADDR A:0xe0c0020
y.create.l HWIO_PMIC_ARB_CHNL429_RDATA2_ADDR A:0xe0d0020
y.create.l HWIO_PMIC_ARB_CHNL430_RDATA2_ADDR A:0xe0e0020
y.create.l HWIO_PMIC_ARB_CHNL431_RDATA2_ADDR A:0xe0f0020
y.create.l HWIO_PMIC_ARB_CHNL432_RDATA2_ADDR A:0xe100020
y.create.l HWIO_PMIC_ARB_CHNL433_RDATA2_ADDR A:0xe110020
y.create.l HWIO_PMIC_ARB_CHNL434_RDATA2_ADDR A:0xe120020
y.create.l HWIO_PMIC_ARB_CHNL435_RDATA2_ADDR A:0xe130020
y.create.l HWIO_PMIC_ARB_CHNL436_RDATA2_ADDR A:0xe140020
y.create.l HWIO_PMIC_ARB_CHNL437_RDATA2_ADDR A:0xe150020
y.create.l HWIO_PMIC_ARB_CHNL438_RDATA2_ADDR A:0xe160020
y.create.l HWIO_PMIC_ARB_CHNL439_RDATA2_ADDR A:0xe170020
y.create.l HWIO_PMIC_ARB_CHNL440_RDATA2_ADDR A:0xe180020
y.create.l HWIO_PMIC_ARB_CHNL441_RDATA2_ADDR A:0xe190020
y.create.l HWIO_PMIC_ARB_CHNL442_RDATA2_ADDR A:0xe1a0020
y.create.l HWIO_PMIC_ARB_CHNL443_RDATA2_ADDR A:0xe1b0020
y.create.l HWIO_PMIC_ARB_CHNL444_RDATA2_ADDR A:0xe1c0020
y.create.l HWIO_PMIC_ARB_CHNL445_RDATA2_ADDR A:0xe1d0020
y.create.l HWIO_PMIC_ARB_CHNL446_RDATA2_ADDR A:0xe1e0020
y.create.l HWIO_PMIC_ARB_CHNL447_RDATA2_ADDR A:0xe1f0020
y.create.l HWIO_PMIC_ARB_CHNL448_RDATA2_ADDR A:0xe200020
y.create.l HWIO_PMIC_ARB_CHNL449_RDATA2_ADDR A:0xe210020
y.create.l HWIO_PMIC_ARB_CHNL450_RDATA2_ADDR A:0xe220020
y.create.l HWIO_PMIC_ARB_CHNL451_RDATA2_ADDR A:0xe230020
y.create.l HWIO_PMIC_ARB_CHNL452_RDATA2_ADDR A:0xe240020
y.create.l HWIO_PMIC_ARB_CHNL453_RDATA2_ADDR A:0xe250020
y.create.l HWIO_PMIC_ARB_CHNL454_RDATA2_ADDR A:0xe260020
y.create.l HWIO_PMIC_ARB_CHNL455_RDATA2_ADDR A:0xe270020
y.create.l HWIO_PMIC_ARB_CHNL456_RDATA2_ADDR A:0xe280020
y.create.l HWIO_PMIC_ARB_CHNL457_RDATA2_ADDR A:0xe290020
y.create.l HWIO_PMIC_ARB_CHNL458_RDATA2_ADDR A:0xe2a0020
y.create.l HWIO_PMIC_ARB_CHNL459_RDATA2_ADDR A:0xe2b0020
y.create.l HWIO_PMIC_ARB_CHNL460_RDATA2_ADDR A:0xe2c0020
y.create.l HWIO_PMIC_ARB_CHNL461_RDATA2_ADDR A:0xe2d0020
y.create.l HWIO_PMIC_ARB_CHNL462_RDATA2_ADDR A:0xe2e0020
y.create.l HWIO_PMIC_ARB_CHNL463_RDATA2_ADDR A:0xe2f0020
y.create.l HWIO_PMIC_ARB_CHNL464_RDATA2_ADDR A:0xe300020
y.create.l HWIO_PMIC_ARB_CHNL465_RDATA2_ADDR A:0xe310020
y.create.l HWIO_PMIC_ARB_CHNL466_RDATA2_ADDR A:0xe320020
y.create.l HWIO_PMIC_ARB_CHNL467_RDATA2_ADDR A:0xe330020
y.create.l HWIO_PMIC_ARB_CHNL468_RDATA2_ADDR A:0xe340020
y.create.l HWIO_PMIC_ARB_CHNL469_RDATA2_ADDR A:0xe350020
y.create.l HWIO_PMIC_ARB_CHNL470_RDATA2_ADDR A:0xe360020
y.create.l HWIO_PMIC_ARB_CHNL471_RDATA2_ADDR A:0xe370020
y.create.l HWIO_PMIC_ARB_CHNL472_RDATA2_ADDR A:0xe380020
y.create.l HWIO_PMIC_ARB_CHNL473_RDATA2_ADDR A:0xe390020
y.create.l HWIO_PMIC_ARB_CHNL474_RDATA2_ADDR A:0xe3a0020
y.create.l HWIO_PMIC_ARB_CHNL475_RDATA2_ADDR A:0xe3b0020
y.create.l HWIO_PMIC_ARB_CHNL476_RDATA2_ADDR A:0xe3c0020
y.create.l HWIO_PMIC_ARB_CHNL477_RDATA2_ADDR A:0xe3d0020
y.create.l HWIO_PMIC_ARB_CHNL478_RDATA2_ADDR A:0xe3e0020
y.create.l HWIO_PMIC_ARB_CHNL479_RDATA2_ADDR A:0xe3f0020
y.create.l HWIO_PMIC_ARB_CHNL480_RDATA2_ADDR A:0xe400020
y.create.l HWIO_PMIC_ARB_CHNL481_RDATA2_ADDR A:0xe410020
y.create.l HWIO_PMIC_ARB_CHNL482_RDATA2_ADDR A:0xe420020
y.create.l HWIO_PMIC_ARB_CHNL483_RDATA2_ADDR A:0xe430020
y.create.l HWIO_PMIC_ARB_CHNL484_RDATA2_ADDR A:0xe440020
y.create.l HWIO_PMIC_ARB_CHNL485_RDATA2_ADDR A:0xe450020
y.create.l HWIO_PMIC_ARB_CHNL486_RDATA2_ADDR A:0xe460020
y.create.l HWIO_PMIC_ARB_CHNL487_RDATA2_ADDR A:0xe470020
y.create.l HWIO_PMIC_ARB_CHNL488_RDATA2_ADDR A:0xe480020
y.create.l HWIO_PMIC_ARB_CHNL489_RDATA2_ADDR A:0xe490020
y.create.l HWIO_PMIC_ARB_CHNL490_RDATA2_ADDR A:0xe4a0020
y.create.l HWIO_PMIC_ARB_CHNL491_RDATA2_ADDR A:0xe4b0020
y.create.l HWIO_PMIC_ARB_CHNL492_RDATA2_ADDR A:0xe4c0020
y.create.l HWIO_PMIC_ARB_CHNL493_RDATA2_ADDR A:0xe4d0020
y.create.l HWIO_PMIC_ARB_CHNL494_RDATA2_ADDR A:0xe4e0020
y.create.l HWIO_PMIC_ARB_CHNL495_RDATA2_ADDR A:0xe4f0020
y.create.l HWIO_PMIC_ARB_CHNL496_RDATA2_ADDR A:0xe500020
y.create.l HWIO_PMIC_ARB_CHNL497_RDATA2_ADDR A:0xe510020
y.create.l HWIO_PMIC_ARB_CHNL498_RDATA2_ADDR A:0xe520020
y.create.l HWIO_PMIC_ARB_CHNL499_RDATA2_ADDR A:0xe530020
y.create.l HWIO_PMIC_ARB_CHNL500_RDATA2_ADDR A:0xe540020
y.create.l HWIO_PMIC_ARB_CHNL501_RDATA2_ADDR A:0xe550020
y.create.l HWIO_PMIC_ARB_CHNL502_RDATA2_ADDR A:0xe560020
y.create.l HWIO_PMIC_ARB_CHNL503_RDATA2_ADDR A:0xe570020
y.create.l HWIO_PMIC_ARB_CHNL504_RDATA2_ADDR A:0xe580020
y.create.l HWIO_PMIC_ARB_CHNL505_RDATA2_ADDR A:0xe590020
y.create.l HWIO_PMIC_ARB_CHNL506_RDATA2_ADDR A:0xe5a0020
y.create.l HWIO_PMIC_ARB_CHNL507_RDATA2_ADDR A:0xe5b0020
y.create.l HWIO_PMIC_ARB_CHNL508_RDATA2_ADDR A:0xe5c0020
y.create.l HWIO_PMIC_ARB_CHNL509_RDATA2_ADDR A:0xe5d0020
y.create.l HWIO_PMIC_ARB_CHNL510_RDATA2_ADDR A:0xe5e0020
y.create.l HWIO_PMIC_ARB_CHNL511_RDATA2_ADDR A:0xe5f0020
y.create.l HWIO_SPMI_PIC_ACC_ENABLE0_ADDR A:0xc600100
y.create.l HWIO_SPMI_PIC_ACC_ENABLE1_ADDR A:0xc610100
y.create.l HWIO_SPMI_PIC_ACC_ENABLE2_ADDR A:0xc620100
y.create.l HWIO_SPMI_PIC_ACC_ENABLE3_ADDR A:0xc630100
y.create.l HWIO_SPMI_PIC_ACC_ENABLE4_ADDR A:0xc640100
y.create.l HWIO_SPMI_PIC_ACC_ENABLE5_ADDR A:0xc650100
y.create.l HWIO_SPMI_PIC_ACC_ENABLE6_ADDR A:0xc660100
y.create.l HWIO_SPMI_PIC_ACC_ENABLE7_ADDR A:0xc670100
y.create.l HWIO_SPMI_PIC_ACC_ENABLE8_ADDR A:0xc680100
y.create.l HWIO_SPMI_PIC_ACC_ENABLE9_ADDR A:0xc690100
y.create.l HWIO_SPMI_PIC_ACC_ENABLE10_ADDR A:0xc6a0100
y.create.l HWIO_SPMI_PIC_ACC_ENABLE11_ADDR A:0xc6b0100
y.create.l HWIO_SPMI_PIC_ACC_ENABLE12_ADDR A:0xc6c0100
y.create.l HWIO_SPMI_PIC_ACC_ENABLE13_ADDR A:0xc6d0100
y.create.l HWIO_SPMI_PIC_ACC_ENABLE14_ADDR A:0xc6e0100
y.create.l HWIO_SPMI_PIC_ACC_ENABLE15_ADDR A:0xc6f0100
y.create.l HWIO_SPMI_PIC_ACC_ENABLE16_ADDR A:0xc700100
y.create.l HWIO_SPMI_PIC_ACC_ENABLE17_ADDR A:0xc710100
y.create.l HWIO_SPMI_PIC_ACC_ENABLE18_ADDR A:0xc720100
y.create.l HWIO_SPMI_PIC_ACC_ENABLE19_ADDR A:0xc730100
y.create.l HWIO_SPMI_PIC_ACC_ENABLE20_ADDR A:0xc740100
y.create.l HWIO_SPMI_PIC_ACC_ENABLE21_ADDR A:0xc750100
y.create.l HWIO_SPMI_PIC_ACC_ENABLE22_ADDR A:0xc760100
y.create.l HWIO_SPMI_PIC_ACC_ENABLE23_ADDR A:0xc770100
y.create.l HWIO_SPMI_PIC_ACC_ENABLE24_ADDR A:0xc780100
y.create.l HWIO_SPMI_PIC_ACC_ENABLE25_ADDR A:0xc790100
y.create.l HWIO_SPMI_PIC_ACC_ENABLE26_ADDR A:0xc7a0100
y.create.l HWIO_SPMI_PIC_ACC_ENABLE27_ADDR A:0xc7b0100
y.create.l HWIO_SPMI_PIC_ACC_ENABLE28_ADDR A:0xc7c0100
y.create.l HWIO_SPMI_PIC_ACC_ENABLE29_ADDR A:0xc7d0100
y.create.l HWIO_SPMI_PIC_ACC_ENABLE30_ADDR A:0xc7e0100
y.create.l HWIO_SPMI_PIC_ACC_ENABLE31_ADDR A:0xc7f0100
y.create.l HWIO_SPMI_PIC_ACC_ENABLE32_ADDR A:0xc800100
y.create.l HWIO_SPMI_PIC_ACC_ENABLE33_ADDR A:0xc810100
y.create.l HWIO_SPMI_PIC_ACC_ENABLE34_ADDR A:0xc820100
y.create.l HWIO_SPMI_PIC_ACC_ENABLE35_ADDR A:0xc830100
y.create.l HWIO_SPMI_PIC_ACC_ENABLE36_ADDR A:0xc840100
y.create.l HWIO_SPMI_PIC_ACC_ENABLE37_ADDR A:0xc850100
y.create.l HWIO_SPMI_PIC_ACC_ENABLE38_ADDR A:0xc860100
y.create.l HWIO_SPMI_PIC_ACC_ENABLE39_ADDR A:0xc870100
y.create.l HWIO_SPMI_PIC_ACC_ENABLE40_ADDR A:0xc880100
y.create.l HWIO_SPMI_PIC_ACC_ENABLE41_ADDR A:0xc890100
y.create.l HWIO_SPMI_PIC_ACC_ENABLE42_ADDR A:0xc8a0100
y.create.l HWIO_SPMI_PIC_ACC_ENABLE43_ADDR A:0xc8b0100
y.create.l HWIO_SPMI_PIC_ACC_ENABLE44_ADDR A:0xc8c0100
y.create.l HWIO_SPMI_PIC_ACC_ENABLE45_ADDR A:0xc8d0100
y.create.l HWIO_SPMI_PIC_ACC_ENABLE46_ADDR A:0xc8e0100
y.create.l HWIO_SPMI_PIC_ACC_ENABLE47_ADDR A:0xc8f0100
y.create.l HWIO_SPMI_PIC_ACC_ENABLE48_ADDR A:0xc900100
y.create.l HWIO_SPMI_PIC_ACC_ENABLE49_ADDR A:0xc910100
y.create.l HWIO_SPMI_PIC_ACC_ENABLE50_ADDR A:0xc920100
y.create.l HWIO_SPMI_PIC_ACC_ENABLE51_ADDR A:0xc930100
y.create.l HWIO_SPMI_PIC_ACC_ENABLE52_ADDR A:0xc940100
y.create.l HWIO_SPMI_PIC_ACC_ENABLE53_ADDR A:0xc950100
y.create.l HWIO_SPMI_PIC_ACC_ENABLE54_ADDR A:0xc960100
y.create.l HWIO_SPMI_PIC_ACC_ENABLE55_ADDR A:0xc970100
y.create.l HWIO_SPMI_PIC_ACC_ENABLE56_ADDR A:0xc980100
y.create.l HWIO_SPMI_PIC_ACC_ENABLE57_ADDR A:0xc990100
y.create.l HWIO_SPMI_PIC_ACC_ENABLE58_ADDR A:0xc9a0100
y.create.l HWIO_SPMI_PIC_ACC_ENABLE59_ADDR A:0xc9b0100
y.create.l HWIO_SPMI_PIC_ACC_ENABLE60_ADDR A:0xc9c0100
y.create.l HWIO_SPMI_PIC_ACC_ENABLE61_ADDR A:0xc9d0100
y.create.l HWIO_SPMI_PIC_ACC_ENABLE62_ADDR A:0xc9e0100
y.create.l HWIO_SPMI_PIC_ACC_ENABLE63_ADDR A:0xc9f0100
y.create.l HWIO_SPMI_PIC_ACC_ENABLE64_ADDR A:0xca00100
y.create.l HWIO_SPMI_PIC_ACC_ENABLE65_ADDR A:0xca10100
y.create.l HWIO_SPMI_PIC_ACC_ENABLE66_ADDR A:0xca20100
y.create.l HWIO_SPMI_PIC_ACC_ENABLE67_ADDR A:0xca30100
y.create.l HWIO_SPMI_PIC_ACC_ENABLE68_ADDR A:0xca40100
y.create.l HWIO_SPMI_PIC_ACC_ENABLE69_ADDR A:0xca50100
y.create.l HWIO_SPMI_PIC_ACC_ENABLE70_ADDR A:0xca60100
y.create.l HWIO_SPMI_PIC_ACC_ENABLE71_ADDR A:0xca70100
y.create.l HWIO_SPMI_PIC_ACC_ENABLE72_ADDR A:0xca80100
y.create.l HWIO_SPMI_PIC_ACC_ENABLE73_ADDR A:0xca90100
y.create.l HWIO_SPMI_PIC_ACC_ENABLE74_ADDR A:0xcaa0100
y.create.l HWIO_SPMI_PIC_ACC_ENABLE75_ADDR A:0xcab0100
y.create.l HWIO_SPMI_PIC_ACC_ENABLE76_ADDR A:0xcac0100
y.create.l HWIO_SPMI_PIC_ACC_ENABLE77_ADDR A:0xcad0100
y.create.l HWIO_SPMI_PIC_ACC_ENABLE78_ADDR A:0xcae0100
y.create.l HWIO_SPMI_PIC_ACC_ENABLE79_ADDR A:0xcaf0100
y.create.l HWIO_SPMI_PIC_ACC_ENABLE80_ADDR A:0xcb00100
y.create.l HWIO_SPMI_PIC_ACC_ENABLE81_ADDR A:0xcb10100
y.create.l HWIO_SPMI_PIC_ACC_ENABLE82_ADDR A:0xcb20100
y.create.l HWIO_SPMI_PIC_ACC_ENABLE83_ADDR A:0xcb30100
y.create.l HWIO_SPMI_PIC_ACC_ENABLE84_ADDR A:0xcb40100
y.create.l HWIO_SPMI_PIC_ACC_ENABLE85_ADDR A:0xcb50100
y.create.l HWIO_SPMI_PIC_ACC_ENABLE86_ADDR A:0xcb60100
y.create.l HWIO_SPMI_PIC_ACC_ENABLE87_ADDR A:0xcb70100
y.create.l HWIO_SPMI_PIC_ACC_ENABLE88_ADDR A:0xcb80100
y.create.l HWIO_SPMI_PIC_ACC_ENABLE89_ADDR A:0xcb90100
y.create.l HWIO_SPMI_PIC_ACC_ENABLE90_ADDR A:0xcba0100
y.create.l HWIO_SPMI_PIC_ACC_ENABLE91_ADDR A:0xcbb0100
y.create.l HWIO_SPMI_PIC_ACC_ENABLE92_ADDR A:0xcbc0100
y.create.l HWIO_SPMI_PIC_ACC_ENABLE93_ADDR A:0xcbd0100
y.create.l HWIO_SPMI_PIC_ACC_ENABLE94_ADDR A:0xcbe0100
y.create.l HWIO_SPMI_PIC_ACC_ENABLE95_ADDR A:0xcbf0100
y.create.l HWIO_SPMI_PIC_ACC_ENABLE96_ADDR A:0xcc00100
y.create.l HWIO_SPMI_PIC_ACC_ENABLE97_ADDR A:0xcc10100
y.create.l HWIO_SPMI_PIC_ACC_ENABLE98_ADDR A:0xcc20100
y.create.l HWIO_SPMI_PIC_ACC_ENABLE99_ADDR A:0xcc30100
y.create.l HWIO_SPMI_PIC_ACC_ENABLE100_ADDR A:0xcc40100
y.create.l HWIO_SPMI_PIC_ACC_ENABLE101_ADDR A:0xcc50100
y.create.l HWIO_SPMI_PIC_ACC_ENABLE102_ADDR A:0xcc60100
y.create.l HWIO_SPMI_PIC_ACC_ENABLE103_ADDR A:0xcc70100
y.create.l HWIO_SPMI_PIC_ACC_ENABLE104_ADDR A:0xcc80100
y.create.l HWIO_SPMI_PIC_ACC_ENABLE105_ADDR A:0xcc90100
y.create.l HWIO_SPMI_PIC_ACC_ENABLE106_ADDR A:0xcca0100
y.create.l HWIO_SPMI_PIC_ACC_ENABLE107_ADDR A:0xccb0100
y.create.l HWIO_SPMI_PIC_ACC_ENABLE108_ADDR A:0xccc0100
y.create.l HWIO_SPMI_PIC_ACC_ENABLE109_ADDR A:0xccd0100
y.create.l HWIO_SPMI_PIC_ACC_ENABLE110_ADDR A:0xcce0100
y.create.l HWIO_SPMI_PIC_ACC_ENABLE111_ADDR A:0xccf0100
y.create.l HWIO_SPMI_PIC_ACC_ENABLE112_ADDR A:0xcd00100
y.create.l HWIO_SPMI_PIC_ACC_ENABLE113_ADDR A:0xcd10100
y.create.l HWIO_SPMI_PIC_ACC_ENABLE114_ADDR A:0xcd20100
y.create.l HWIO_SPMI_PIC_ACC_ENABLE115_ADDR A:0xcd30100
y.create.l HWIO_SPMI_PIC_ACC_ENABLE116_ADDR A:0xcd40100
y.create.l HWIO_SPMI_PIC_ACC_ENABLE117_ADDR A:0xcd50100
y.create.l HWIO_SPMI_PIC_ACC_ENABLE118_ADDR A:0xcd60100
y.create.l HWIO_SPMI_PIC_ACC_ENABLE119_ADDR A:0xcd70100
y.create.l HWIO_SPMI_PIC_ACC_ENABLE120_ADDR A:0xcd80100
y.create.l HWIO_SPMI_PIC_ACC_ENABLE121_ADDR A:0xcd90100
y.create.l HWIO_SPMI_PIC_ACC_ENABLE122_ADDR A:0xcda0100
y.create.l HWIO_SPMI_PIC_ACC_ENABLE123_ADDR A:0xcdb0100
y.create.l HWIO_SPMI_PIC_ACC_ENABLE124_ADDR A:0xcdc0100
y.create.l HWIO_SPMI_PIC_ACC_ENABLE125_ADDR A:0xcdd0100
y.create.l HWIO_SPMI_PIC_ACC_ENABLE126_ADDR A:0xcde0100
y.create.l HWIO_SPMI_PIC_ACC_ENABLE127_ADDR A:0xcdf0100
y.create.l HWIO_SPMI_PIC_ACC_ENABLE128_ADDR A:0xce00100
y.create.l HWIO_SPMI_PIC_ACC_ENABLE129_ADDR A:0xce10100
y.create.l HWIO_SPMI_PIC_ACC_ENABLE130_ADDR A:0xce20100
y.create.l HWIO_SPMI_PIC_ACC_ENABLE131_ADDR A:0xce30100
y.create.l HWIO_SPMI_PIC_ACC_ENABLE132_ADDR A:0xce40100
y.create.l HWIO_SPMI_PIC_ACC_ENABLE133_ADDR A:0xce50100
y.create.l HWIO_SPMI_PIC_ACC_ENABLE134_ADDR A:0xce60100
y.create.l HWIO_SPMI_PIC_ACC_ENABLE135_ADDR A:0xce70100
y.create.l HWIO_SPMI_PIC_ACC_ENABLE136_ADDR A:0xce80100
y.create.l HWIO_SPMI_PIC_ACC_ENABLE137_ADDR A:0xce90100
y.create.l HWIO_SPMI_PIC_ACC_ENABLE138_ADDR A:0xcea0100
y.create.l HWIO_SPMI_PIC_ACC_ENABLE139_ADDR A:0xceb0100
y.create.l HWIO_SPMI_PIC_ACC_ENABLE140_ADDR A:0xcec0100
y.create.l HWIO_SPMI_PIC_ACC_ENABLE141_ADDR A:0xced0100
y.create.l HWIO_SPMI_PIC_ACC_ENABLE142_ADDR A:0xcee0100
y.create.l HWIO_SPMI_PIC_ACC_ENABLE143_ADDR A:0xcef0100
y.create.l HWIO_SPMI_PIC_ACC_ENABLE144_ADDR A:0xcf00100
y.create.l HWIO_SPMI_PIC_ACC_ENABLE145_ADDR A:0xcf10100
y.create.l HWIO_SPMI_PIC_ACC_ENABLE146_ADDR A:0xcf20100
y.create.l HWIO_SPMI_PIC_ACC_ENABLE147_ADDR A:0xcf30100
y.create.l HWIO_SPMI_PIC_ACC_ENABLE148_ADDR A:0xcf40100
y.create.l HWIO_SPMI_PIC_ACC_ENABLE149_ADDR A:0xcf50100
y.create.l HWIO_SPMI_PIC_ACC_ENABLE150_ADDR A:0xcf60100
y.create.l HWIO_SPMI_PIC_ACC_ENABLE151_ADDR A:0xcf70100
y.create.l HWIO_SPMI_PIC_ACC_ENABLE152_ADDR A:0xcf80100
y.create.l HWIO_SPMI_PIC_ACC_ENABLE153_ADDR A:0xcf90100
y.create.l HWIO_SPMI_PIC_ACC_ENABLE154_ADDR A:0xcfa0100
y.create.l HWIO_SPMI_PIC_ACC_ENABLE155_ADDR A:0xcfb0100
y.create.l HWIO_SPMI_PIC_ACC_ENABLE156_ADDR A:0xcfc0100
y.create.l HWIO_SPMI_PIC_ACC_ENABLE157_ADDR A:0xcfd0100
y.create.l HWIO_SPMI_PIC_ACC_ENABLE158_ADDR A:0xcfe0100
y.create.l HWIO_SPMI_PIC_ACC_ENABLE159_ADDR A:0xcff0100
y.create.l HWIO_SPMI_PIC_ACC_ENABLE160_ADDR A:0xd000100
y.create.l HWIO_SPMI_PIC_ACC_ENABLE161_ADDR A:0xd010100
y.create.l HWIO_SPMI_PIC_ACC_ENABLE162_ADDR A:0xd020100
y.create.l HWIO_SPMI_PIC_ACC_ENABLE163_ADDR A:0xd030100
y.create.l HWIO_SPMI_PIC_ACC_ENABLE164_ADDR A:0xd040100
y.create.l HWIO_SPMI_PIC_ACC_ENABLE165_ADDR A:0xd050100
y.create.l HWIO_SPMI_PIC_ACC_ENABLE166_ADDR A:0xd060100
y.create.l HWIO_SPMI_PIC_ACC_ENABLE167_ADDR A:0xd070100
y.create.l HWIO_SPMI_PIC_ACC_ENABLE168_ADDR A:0xd080100
y.create.l HWIO_SPMI_PIC_ACC_ENABLE169_ADDR A:0xd090100
y.create.l HWIO_SPMI_PIC_ACC_ENABLE170_ADDR A:0xd0a0100
y.create.l HWIO_SPMI_PIC_ACC_ENABLE171_ADDR A:0xd0b0100
y.create.l HWIO_SPMI_PIC_ACC_ENABLE172_ADDR A:0xd0c0100
y.create.l HWIO_SPMI_PIC_ACC_ENABLE173_ADDR A:0xd0d0100
y.create.l HWIO_SPMI_PIC_ACC_ENABLE174_ADDR A:0xd0e0100
y.create.l HWIO_SPMI_PIC_ACC_ENABLE175_ADDR A:0xd0f0100
y.create.l HWIO_SPMI_PIC_ACC_ENABLE176_ADDR A:0xd100100
y.create.l HWIO_SPMI_PIC_ACC_ENABLE177_ADDR A:0xd110100
y.create.l HWIO_SPMI_PIC_ACC_ENABLE178_ADDR A:0xd120100
y.create.l HWIO_SPMI_PIC_ACC_ENABLE179_ADDR A:0xd130100
y.create.l HWIO_SPMI_PIC_ACC_ENABLE180_ADDR A:0xd140100
y.create.l HWIO_SPMI_PIC_ACC_ENABLE181_ADDR A:0xd150100
y.create.l HWIO_SPMI_PIC_ACC_ENABLE182_ADDR A:0xd160100
y.create.l HWIO_SPMI_PIC_ACC_ENABLE183_ADDR A:0xd170100
y.create.l HWIO_SPMI_PIC_ACC_ENABLE184_ADDR A:0xd180100
y.create.l HWIO_SPMI_PIC_ACC_ENABLE185_ADDR A:0xd190100
y.create.l HWIO_SPMI_PIC_ACC_ENABLE186_ADDR A:0xd1a0100
y.create.l HWIO_SPMI_PIC_ACC_ENABLE187_ADDR A:0xd1b0100
y.create.l HWIO_SPMI_PIC_ACC_ENABLE188_ADDR A:0xd1c0100
y.create.l HWIO_SPMI_PIC_ACC_ENABLE189_ADDR A:0xd1d0100
y.create.l HWIO_SPMI_PIC_ACC_ENABLE190_ADDR A:0xd1e0100
y.create.l HWIO_SPMI_PIC_ACC_ENABLE191_ADDR A:0xd1f0100
y.create.l HWIO_SPMI_PIC_ACC_ENABLE192_ADDR A:0xd200100
y.create.l HWIO_SPMI_PIC_ACC_ENABLE193_ADDR A:0xd210100
y.create.l HWIO_SPMI_PIC_ACC_ENABLE194_ADDR A:0xd220100
y.create.l HWIO_SPMI_PIC_ACC_ENABLE195_ADDR A:0xd230100
y.create.l HWIO_SPMI_PIC_ACC_ENABLE196_ADDR A:0xd240100
y.create.l HWIO_SPMI_PIC_ACC_ENABLE197_ADDR A:0xd250100
y.create.l HWIO_SPMI_PIC_ACC_ENABLE198_ADDR A:0xd260100
y.create.l HWIO_SPMI_PIC_ACC_ENABLE199_ADDR A:0xd270100
y.create.l HWIO_SPMI_PIC_ACC_ENABLE200_ADDR A:0xd280100
y.create.l HWIO_SPMI_PIC_ACC_ENABLE201_ADDR A:0xd290100
y.create.l HWIO_SPMI_PIC_ACC_ENABLE202_ADDR A:0xd2a0100
y.create.l HWIO_SPMI_PIC_ACC_ENABLE203_ADDR A:0xd2b0100
y.create.l HWIO_SPMI_PIC_ACC_ENABLE204_ADDR A:0xd2c0100
y.create.l HWIO_SPMI_PIC_ACC_ENABLE205_ADDR A:0xd2d0100
y.create.l HWIO_SPMI_PIC_ACC_ENABLE206_ADDR A:0xd2e0100
y.create.l HWIO_SPMI_PIC_ACC_ENABLE207_ADDR A:0xd2f0100
y.create.l HWIO_SPMI_PIC_ACC_ENABLE208_ADDR A:0xd300100
y.create.l HWIO_SPMI_PIC_ACC_ENABLE209_ADDR A:0xd310100
y.create.l HWIO_SPMI_PIC_ACC_ENABLE210_ADDR A:0xd320100
y.create.l HWIO_SPMI_PIC_ACC_ENABLE211_ADDR A:0xd330100
y.create.l HWIO_SPMI_PIC_ACC_ENABLE212_ADDR A:0xd340100
y.create.l HWIO_SPMI_PIC_ACC_ENABLE213_ADDR A:0xd350100
y.create.l HWIO_SPMI_PIC_ACC_ENABLE214_ADDR A:0xd360100
y.create.l HWIO_SPMI_PIC_ACC_ENABLE215_ADDR A:0xd370100
y.create.l HWIO_SPMI_PIC_ACC_ENABLE216_ADDR A:0xd380100
y.create.l HWIO_SPMI_PIC_ACC_ENABLE217_ADDR A:0xd390100
y.create.l HWIO_SPMI_PIC_ACC_ENABLE218_ADDR A:0xd3a0100
y.create.l HWIO_SPMI_PIC_ACC_ENABLE219_ADDR A:0xd3b0100
y.create.l HWIO_SPMI_PIC_ACC_ENABLE220_ADDR A:0xd3c0100
y.create.l HWIO_SPMI_PIC_ACC_ENABLE221_ADDR A:0xd3d0100
y.create.l HWIO_SPMI_PIC_ACC_ENABLE222_ADDR A:0xd3e0100
y.create.l HWIO_SPMI_PIC_ACC_ENABLE223_ADDR A:0xd3f0100
y.create.l HWIO_SPMI_PIC_ACC_ENABLE224_ADDR A:0xd400100
y.create.l HWIO_SPMI_PIC_ACC_ENABLE225_ADDR A:0xd410100
y.create.l HWIO_SPMI_PIC_ACC_ENABLE226_ADDR A:0xd420100
y.create.l HWIO_SPMI_PIC_ACC_ENABLE227_ADDR A:0xd430100
y.create.l HWIO_SPMI_PIC_ACC_ENABLE228_ADDR A:0xd440100
y.create.l HWIO_SPMI_PIC_ACC_ENABLE229_ADDR A:0xd450100
y.create.l HWIO_SPMI_PIC_ACC_ENABLE230_ADDR A:0xd460100
y.create.l HWIO_SPMI_PIC_ACC_ENABLE231_ADDR A:0xd470100
y.create.l HWIO_SPMI_PIC_ACC_ENABLE232_ADDR A:0xd480100
y.create.l HWIO_SPMI_PIC_ACC_ENABLE233_ADDR A:0xd490100
y.create.l HWIO_SPMI_PIC_ACC_ENABLE234_ADDR A:0xd4a0100
y.create.l HWIO_SPMI_PIC_ACC_ENABLE235_ADDR A:0xd4b0100
y.create.l HWIO_SPMI_PIC_ACC_ENABLE236_ADDR A:0xd4c0100
y.create.l HWIO_SPMI_PIC_ACC_ENABLE237_ADDR A:0xd4d0100
y.create.l HWIO_SPMI_PIC_ACC_ENABLE238_ADDR A:0xd4e0100
y.create.l HWIO_SPMI_PIC_ACC_ENABLE239_ADDR A:0xd4f0100
y.create.l HWIO_SPMI_PIC_ACC_ENABLE240_ADDR A:0xd500100
y.create.l HWIO_SPMI_PIC_ACC_ENABLE241_ADDR A:0xd510100
y.create.l HWIO_SPMI_PIC_ACC_ENABLE242_ADDR A:0xd520100
y.create.l HWIO_SPMI_PIC_ACC_ENABLE243_ADDR A:0xd530100
y.create.l HWIO_SPMI_PIC_ACC_ENABLE244_ADDR A:0xd540100
y.create.l HWIO_SPMI_PIC_ACC_ENABLE245_ADDR A:0xd550100
y.create.l HWIO_SPMI_PIC_ACC_ENABLE246_ADDR A:0xd560100
y.create.l HWIO_SPMI_PIC_ACC_ENABLE247_ADDR A:0xd570100
y.create.l HWIO_SPMI_PIC_ACC_ENABLE248_ADDR A:0xd580100
y.create.l HWIO_SPMI_PIC_ACC_ENABLE249_ADDR A:0xd590100
y.create.l HWIO_SPMI_PIC_ACC_ENABLE250_ADDR A:0xd5a0100
y.create.l HWIO_SPMI_PIC_ACC_ENABLE251_ADDR A:0xd5b0100
y.create.l HWIO_SPMI_PIC_ACC_ENABLE252_ADDR A:0xd5c0100
y.create.l HWIO_SPMI_PIC_ACC_ENABLE253_ADDR A:0xd5d0100
y.create.l HWIO_SPMI_PIC_ACC_ENABLE254_ADDR A:0xd5e0100
y.create.l HWIO_SPMI_PIC_ACC_ENABLE255_ADDR A:0xd5f0100
y.create.l HWIO_SPMI_PIC_ACC_ENABLE256_ADDR A:0xd600100
y.create.l HWIO_SPMI_PIC_ACC_ENABLE257_ADDR A:0xd610100
y.create.l HWIO_SPMI_PIC_ACC_ENABLE258_ADDR A:0xd620100
y.create.l HWIO_SPMI_PIC_ACC_ENABLE259_ADDR A:0xd630100
y.create.l HWIO_SPMI_PIC_ACC_ENABLE260_ADDR A:0xd640100
y.create.l HWIO_SPMI_PIC_ACC_ENABLE261_ADDR A:0xd650100
y.create.l HWIO_SPMI_PIC_ACC_ENABLE262_ADDR A:0xd660100
y.create.l HWIO_SPMI_PIC_ACC_ENABLE263_ADDR A:0xd670100
y.create.l HWIO_SPMI_PIC_ACC_ENABLE264_ADDR A:0xd680100
y.create.l HWIO_SPMI_PIC_ACC_ENABLE265_ADDR A:0xd690100
y.create.l HWIO_SPMI_PIC_ACC_ENABLE266_ADDR A:0xd6a0100
y.create.l HWIO_SPMI_PIC_ACC_ENABLE267_ADDR A:0xd6b0100
y.create.l HWIO_SPMI_PIC_ACC_ENABLE268_ADDR A:0xd6c0100
y.create.l HWIO_SPMI_PIC_ACC_ENABLE269_ADDR A:0xd6d0100
y.create.l HWIO_SPMI_PIC_ACC_ENABLE270_ADDR A:0xd6e0100
y.create.l HWIO_SPMI_PIC_ACC_ENABLE271_ADDR A:0xd6f0100
y.create.l HWIO_SPMI_PIC_ACC_ENABLE272_ADDR A:0xd700100
y.create.l HWIO_SPMI_PIC_ACC_ENABLE273_ADDR A:0xd710100
y.create.l HWIO_SPMI_PIC_ACC_ENABLE274_ADDR A:0xd720100
y.create.l HWIO_SPMI_PIC_ACC_ENABLE275_ADDR A:0xd730100
y.create.l HWIO_SPMI_PIC_ACC_ENABLE276_ADDR A:0xd740100
y.create.l HWIO_SPMI_PIC_ACC_ENABLE277_ADDR A:0xd750100
y.create.l HWIO_SPMI_PIC_ACC_ENABLE278_ADDR A:0xd760100
y.create.l HWIO_SPMI_PIC_ACC_ENABLE279_ADDR A:0xd770100
y.create.l HWIO_SPMI_PIC_ACC_ENABLE280_ADDR A:0xd780100
y.create.l HWIO_SPMI_PIC_ACC_ENABLE281_ADDR A:0xd790100
y.create.l HWIO_SPMI_PIC_ACC_ENABLE282_ADDR A:0xd7a0100
y.create.l HWIO_SPMI_PIC_ACC_ENABLE283_ADDR A:0xd7b0100
y.create.l HWIO_SPMI_PIC_ACC_ENABLE284_ADDR A:0xd7c0100
y.create.l HWIO_SPMI_PIC_ACC_ENABLE285_ADDR A:0xd7d0100
y.create.l HWIO_SPMI_PIC_ACC_ENABLE286_ADDR A:0xd7e0100
y.create.l HWIO_SPMI_PIC_ACC_ENABLE287_ADDR A:0xd7f0100
y.create.l HWIO_SPMI_PIC_ACC_ENABLE288_ADDR A:0xd800100
y.create.l HWIO_SPMI_PIC_ACC_ENABLE289_ADDR A:0xd810100
y.create.l HWIO_SPMI_PIC_ACC_ENABLE290_ADDR A:0xd820100
y.create.l HWIO_SPMI_PIC_ACC_ENABLE291_ADDR A:0xd830100
y.create.l HWIO_SPMI_PIC_ACC_ENABLE292_ADDR A:0xd840100
y.create.l HWIO_SPMI_PIC_ACC_ENABLE293_ADDR A:0xd850100
y.create.l HWIO_SPMI_PIC_ACC_ENABLE294_ADDR A:0xd860100
y.create.l HWIO_SPMI_PIC_ACC_ENABLE295_ADDR A:0xd870100
y.create.l HWIO_SPMI_PIC_ACC_ENABLE296_ADDR A:0xd880100
y.create.l HWIO_SPMI_PIC_ACC_ENABLE297_ADDR A:0xd890100
y.create.l HWIO_SPMI_PIC_ACC_ENABLE298_ADDR A:0xd8a0100
y.create.l HWIO_SPMI_PIC_ACC_ENABLE299_ADDR A:0xd8b0100
y.create.l HWIO_SPMI_PIC_ACC_ENABLE300_ADDR A:0xd8c0100
y.create.l HWIO_SPMI_PIC_ACC_ENABLE301_ADDR A:0xd8d0100
y.create.l HWIO_SPMI_PIC_ACC_ENABLE302_ADDR A:0xd8e0100
y.create.l HWIO_SPMI_PIC_ACC_ENABLE303_ADDR A:0xd8f0100
y.create.l HWIO_SPMI_PIC_ACC_ENABLE304_ADDR A:0xd900100
y.create.l HWIO_SPMI_PIC_ACC_ENABLE305_ADDR A:0xd910100
y.create.l HWIO_SPMI_PIC_ACC_ENABLE306_ADDR A:0xd920100
y.create.l HWIO_SPMI_PIC_ACC_ENABLE307_ADDR A:0xd930100
y.create.l HWIO_SPMI_PIC_ACC_ENABLE308_ADDR A:0xd940100
y.create.l HWIO_SPMI_PIC_ACC_ENABLE309_ADDR A:0xd950100
y.create.l HWIO_SPMI_PIC_ACC_ENABLE310_ADDR A:0xd960100
y.create.l HWIO_SPMI_PIC_ACC_ENABLE311_ADDR A:0xd970100
y.create.l HWIO_SPMI_PIC_ACC_ENABLE312_ADDR A:0xd980100
y.create.l HWIO_SPMI_PIC_ACC_ENABLE313_ADDR A:0xd990100
y.create.l HWIO_SPMI_PIC_ACC_ENABLE314_ADDR A:0xd9a0100
y.create.l HWIO_SPMI_PIC_ACC_ENABLE315_ADDR A:0xd9b0100
y.create.l HWIO_SPMI_PIC_ACC_ENABLE316_ADDR A:0xd9c0100
y.create.l HWIO_SPMI_PIC_ACC_ENABLE317_ADDR A:0xd9d0100
y.create.l HWIO_SPMI_PIC_ACC_ENABLE318_ADDR A:0xd9e0100
y.create.l HWIO_SPMI_PIC_ACC_ENABLE319_ADDR A:0xd9f0100
y.create.l HWIO_SPMI_PIC_ACC_ENABLE320_ADDR A:0xda00100
y.create.l HWIO_SPMI_PIC_ACC_ENABLE321_ADDR A:0xda10100
y.create.l HWIO_SPMI_PIC_ACC_ENABLE322_ADDR A:0xda20100
y.create.l HWIO_SPMI_PIC_ACC_ENABLE323_ADDR A:0xda30100
y.create.l HWIO_SPMI_PIC_ACC_ENABLE324_ADDR A:0xda40100
y.create.l HWIO_SPMI_PIC_ACC_ENABLE325_ADDR A:0xda50100
y.create.l HWIO_SPMI_PIC_ACC_ENABLE326_ADDR A:0xda60100
y.create.l HWIO_SPMI_PIC_ACC_ENABLE327_ADDR A:0xda70100
y.create.l HWIO_SPMI_PIC_ACC_ENABLE328_ADDR A:0xda80100
y.create.l HWIO_SPMI_PIC_ACC_ENABLE329_ADDR A:0xda90100
y.create.l HWIO_SPMI_PIC_ACC_ENABLE330_ADDR A:0xdaa0100
y.create.l HWIO_SPMI_PIC_ACC_ENABLE331_ADDR A:0xdab0100
y.create.l HWIO_SPMI_PIC_ACC_ENABLE332_ADDR A:0xdac0100
y.create.l HWIO_SPMI_PIC_ACC_ENABLE333_ADDR A:0xdad0100
y.create.l HWIO_SPMI_PIC_ACC_ENABLE334_ADDR A:0xdae0100
y.create.l HWIO_SPMI_PIC_ACC_ENABLE335_ADDR A:0xdaf0100
y.create.l HWIO_SPMI_PIC_ACC_ENABLE336_ADDR A:0xdb00100
y.create.l HWIO_SPMI_PIC_ACC_ENABLE337_ADDR A:0xdb10100
y.create.l HWIO_SPMI_PIC_ACC_ENABLE338_ADDR A:0xdb20100
y.create.l HWIO_SPMI_PIC_ACC_ENABLE339_ADDR A:0xdb30100
y.create.l HWIO_SPMI_PIC_ACC_ENABLE340_ADDR A:0xdb40100
y.create.l HWIO_SPMI_PIC_ACC_ENABLE341_ADDR A:0xdb50100
y.create.l HWIO_SPMI_PIC_ACC_ENABLE342_ADDR A:0xdb60100
y.create.l HWIO_SPMI_PIC_ACC_ENABLE343_ADDR A:0xdb70100
y.create.l HWIO_SPMI_PIC_ACC_ENABLE344_ADDR A:0xdb80100
y.create.l HWIO_SPMI_PIC_ACC_ENABLE345_ADDR A:0xdb90100
y.create.l HWIO_SPMI_PIC_ACC_ENABLE346_ADDR A:0xdba0100
y.create.l HWIO_SPMI_PIC_ACC_ENABLE347_ADDR A:0xdbb0100
y.create.l HWIO_SPMI_PIC_ACC_ENABLE348_ADDR A:0xdbc0100
y.create.l HWIO_SPMI_PIC_ACC_ENABLE349_ADDR A:0xdbd0100
y.create.l HWIO_SPMI_PIC_ACC_ENABLE350_ADDR A:0xdbe0100
y.create.l HWIO_SPMI_PIC_ACC_ENABLE351_ADDR A:0xdbf0100
y.create.l HWIO_SPMI_PIC_ACC_ENABLE352_ADDR A:0xdc00100
y.create.l HWIO_SPMI_PIC_ACC_ENABLE353_ADDR A:0xdc10100
y.create.l HWIO_SPMI_PIC_ACC_ENABLE354_ADDR A:0xdc20100
y.create.l HWIO_SPMI_PIC_ACC_ENABLE355_ADDR A:0xdc30100
y.create.l HWIO_SPMI_PIC_ACC_ENABLE356_ADDR A:0xdc40100
y.create.l HWIO_SPMI_PIC_ACC_ENABLE357_ADDR A:0xdc50100
y.create.l HWIO_SPMI_PIC_ACC_ENABLE358_ADDR A:0xdc60100
y.create.l HWIO_SPMI_PIC_ACC_ENABLE359_ADDR A:0xdc70100
y.create.l HWIO_SPMI_PIC_ACC_ENABLE360_ADDR A:0xdc80100
y.create.l HWIO_SPMI_PIC_ACC_ENABLE361_ADDR A:0xdc90100
y.create.l HWIO_SPMI_PIC_ACC_ENABLE362_ADDR A:0xdca0100
y.create.l HWIO_SPMI_PIC_ACC_ENABLE363_ADDR A:0xdcb0100
y.create.l HWIO_SPMI_PIC_ACC_ENABLE364_ADDR A:0xdcc0100
y.create.l HWIO_SPMI_PIC_ACC_ENABLE365_ADDR A:0xdcd0100
y.create.l HWIO_SPMI_PIC_ACC_ENABLE366_ADDR A:0xdce0100
y.create.l HWIO_SPMI_PIC_ACC_ENABLE367_ADDR A:0xdcf0100
y.create.l HWIO_SPMI_PIC_ACC_ENABLE368_ADDR A:0xdd00100
y.create.l HWIO_SPMI_PIC_ACC_ENABLE369_ADDR A:0xdd10100
y.create.l HWIO_SPMI_PIC_ACC_ENABLE370_ADDR A:0xdd20100
y.create.l HWIO_SPMI_PIC_ACC_ENABLE371_ADDR A:0xdd30100
y.create.l HWIO_SPMI_PIC_ACC_ENABLE372_ADDR A:0xdd40100
y.create.l HWIO_SPMI_PIC_ACC_ENABLE373_ADDR A:0xdd50100
y.create.l HWIO_SPMI_PIC_ACC_ENABLE374_ADDR A:0xdd60100
y.create.l HWIO_SPMI_PIC_ACC_ENABLE375_ADDR A:0xdd70100
y.create.l HWIO_SPMI_PIC_ACC_ENABLE376_ADDR A:0xdd80100
y.create.l HWIO_SPMI_PIC_ACC_ENABLE377_ADDR A:0xdd90100
y.create.l HWIO_SPMI_PIC_ACC_ENABLE378_ADDR A:0xdda0100
y.create.l HWIO_SPMI_PIC_ACC_ENABLE379_ADDR A:0xddb0100
y.create.l HWIO_SPMI_PIC_ACC_ENABLE380_ADDR A:0xddc0100
y.create.l HWIO_SPMI_PIC_ACC_ENABLE381_ADDR A:0xddd0100
y.create.l HWIO_SPMI_PIC_ACC_ENABLE382_ADDR A:0xdde0100
y.create.l HWIO_SPMI_PIC_ACC_ENABLE383_ADDR A:0xddf0100
y.create.l HWIO_SPMI_PIC_ACC_ENABLE384_ADDR A:0xde00100
y.create.l HWIO_SPMI_PIC_ACC_ENABLE385_ADDR A:0xde10100
y.create.l HWIO_SPMI_PIC_ACC_ENABLE386_ADDR A:0xde20100
y.create.l HWIO_SPMI_PIC_ACC_ENABLE387_ADDR A:0xde30100
y.create.l HWIO_SPMI_PIC_ACC_ENABLE388_ADDR A:0xde40100
y.create.l HWIO_SPMI_PIC_ACC_ENABLE389_ADDR A:0xde50100
y.create.l HWIO_SPMI_PIC_ACC_ENABLE390_ADDR A:0xde60100
y.create.l HWIO_SPMI_PIC_ACC_ENABLE391_ADDR A:0xde70100
y.create.l HWIO_SPMI_PIC_ACC_ENABLE392_ADDR A:0xde80100
y.create.l HWIO_SPMI_PIC_ACC_ENABLE393_ADDR A:0xde90100
y.create.l HWIO_SPMI_PIC_ACC_ENABLE394_ADDR A:0xdea0100
y.create.l HWIO_SPMI_PIC_ACC_ENABLE395_ADDR A:0xdeb0100
y.create.l HWIO_SPMI_PIC_ACC_ENABLE396_ADDR A:0xdec0100
y.create.l HWIO_SPMI_PIC_ACC_ENABLE397_ADDR A:0xded0100
y.create.l HWIO_SPMI_PIC_ACC_ENABLE398_ADDR A:0xdee0100
y.create.l HWIO_SPMI_PIC_ACC_ENABLE399_ADDR A:0xdef0100
y.create.l HWIO_SPMI_PIC_ACC_ENABLE400_ADDR A:0xdf00100
y.create.l HWIO_SPMI_PIC_ACC_ENABLE401_ADDR A:0xdf10100
y.create.l HWIO_SPMI_PIC_ACC_ENABLE402_ADDR A:0xdf20100
y.create.l HWIO_SPMI_PIC_ACC_ENABLE403_ADDR A:0xdf30100
y.create.l HWIO_SPMI_PIC_ACC_ENABLE404_ADDR A:0xdf40100
y.create.l HWIO_SPMI_PIC_ACC_ENABLE405_ADDR A:0xdf50100
y.create.l HWIO_SPMI_PIC_ACC_ENABLE406_ADDR A:0xdf60100
y.create.l HWIO_SPMI_PIC_ACC_ENABLE407_ADDR A:0xdf70100
y.create.l HWIO_SPMI_PIC_ACC_ENABLE408_ADDR A:0xdf80100
y.create.l HWIO_SPMI_PIC_ACC_ENABLE409_ADDR A:0xdf90100
y.create.l HWIO_SPMI_PIC_ACC_ENABLE410_ADDR A:0xdfa0100
y.create.l HWIO_SPMI_PIC_ACC_ENABLE411_ADDR A:0xdfb0100
y.create.l HWIO_SPMI_PIC_ACC_ENABLE412_ADDR A:0xdfc0100
y.create.l HWIO_SPMI_PIC_ACC_ENABLE413_ADDR A:0xdfd0100
y.create.l HWIO_SPMI_PIC_ACC_ENABLE414_ADDR A:0xdfe0100
y.create.l HWIO_SPMI_PIC_ACC_ENABLE415_ADDR A:0xdff0100
y.create.l HWIO_SPMI_PIC_ACC_ENABLE416_ADDR A:0xe000100
y.create.l HWIO_SPMI_PIC_ACC_ENABLE417_ADDR A:0xe010100
y.create.l HWIO_SPMI_PIC_ACC_ENABLE418_ADDR A:0xe020100
y.create.l HWIO_SPMI_PIC_ACC_ENABLE419_ADDR A:0xe030100
y.create.l HWIO_SPMI_PIC_ACC_ENABLE420_ADDR A:0xe040100
y.create.l HWIO_SPMI_PIC_ACC_ENABLE421_ADDR A:0xe050100
y.create.l HWIO_SPMI_PIC_ACC_ENABLE422_ADDR A:0xe060100
y.create.l HWIO_SPMI_PIC_ACC_ENABLE423_ADDR A:0xe070100
y.create.l HWIO_SPMI_PIC_ACC_ENABLE424_ADDR A:0xe080100
y.create.l HWIO_SPMI_PIC_ACC_ENABLE425_ADDR A:0xe090100
y.create.l HWIO_SPMI_PIC_ACC_ENABLE426_ADDR A:0xe0a0100
y.create.l HWIO_SPMI_PIC_ACC_ENABLE427_ADDR A:0xe0b0100
y.create.l HWIO_SPMI_PIC_ACC_ENABLE428_ADDR A:0xe0c0100
y.create.l HWIO_SPMI_PIC_ACC_ENABLE429_ADDR A:0xe0d0100
y.create.l HWIO_SPMI_PIC_ACC_ENABLE430_ADDR A:0xe0e0100
y.create.l HWIO_SPMI_PIC_ACC_ENABLE431_ADDR A:0xe0f0100
y.create.l HWIO_SPMI_PIC_ACC_ENABLE432_ADDR A:0xe100100
y.create.l HWIO_SPMI_PIC_ACC_ENABLE433_ADDR A:0xe110100
y.create.l HWIO_SPMI_PIC_ACC_ENABLE434_ADDR A:0xe120100
y.create.l HWIO_SPMI_PIC_ACC_ENABLE435_ADDR A:0xe130100
y.create.l HWIO_SPMI_PIC_ACC_ENABLE436_ADDR A:0xe140100
y.create.l HWIO_SPMI_PIC_ACC_ENABLE437_ADDR A:0xe150100
y.create.l HWIO_SPMI_PIC_ACC_ENABLE438_ADDR A:0xe160100
y.create.l HWIO_SPMI_PIC_ACC_ENABLE439_ADDR A:0xe170100
y.create.l HWIO_SPMI_PIC_ACC_ENABLE440_ADDR A:0xe180100
y.create.l HWIO_SPMI_PIC_ACC_ENABLE441_ADDR A:0xe190100
y.create.l HWIO_SPMI_PIC_ACC_ENABLE442_ADDR A:0xe1a0100
y.create.l HWIO_SPMI_PIC_ACC_ENABLE443_ADDR A:0xe1b0100
y.create.l HWIO_SPMI_PIC_ACC_ENABLE444_ADDR A:0xe1c0100
y.create.l HWIO_SPMI_PIC_ACC_ENABLE445_ADDR A:0xe1d0100
y.create.l HWIO_SPMI_PIC_ACC_ENABLE446_ADDR A:0xe1e0100
y.create.l HWIO_SPMI_PIC_ACC_ENABLE447_ADDR A:0xe1f0100
y.create.l HWIO_SPMI_PIC_ACC_ENABLE448_ADDR A:0xe200100
y.create.l HWIO_SPMI_PIC_ACC_ENABLE449_ADDR A:0xe210100
y.create.l HWIO_SPMI_PIC_ACC_ENABLE450_ADDR A:0xe220100
y.create.l HWIO_SPMI_PIC_ACC_ENABLE451_ADDR A:0xe230100
y.create.l HWIO_SPMI_PIC_ACC_ENABLE452_ADDR A:0xe240100
y.create.l HWIO_SPMI_PIC_ACC_ENABLE453_ADDR A:0xe250100
y.create.l HWIO_SPMI_PIC_ACC_ENABLE454_ADDR A:0xe260100
y.create.l HWIO_SPMI_PIC_ACC_ENABLE455_ADDR A:0xe270100
y.create.l HWIO_SPMI_PIC_ACC_ENABLE456_ADDR A:0xe280100
y.create.l HWIO_SPMI_PIC_ACC_ENABLE457_ADDR A:0xe290100
y.create.l HWIO_SPMI_PIC_ACC_ENABLE458_ADDR A:0xe2a0100
y.create.l HWIO_SPMI_PIC_ACC_ENABLE459_ADDR A:0xe2b0100
y.create.l HWIO_SPMI_PIC_ACC_ENABLE460_ADDR A:0xe2c0100
y.create.l HWIO_SPMI_PIC_ACC_ENABLE461_ADDR A:0xe2d0100
y.create.l HWIO_SPMI_PIC_ACC_ENABLE462_ADDR A:0xe2e0100
y.create.l HWIO_SPMI_PIC_ACC_ENABLE463_ADDR A:0xe2f0100
y.create.l HWIO_SPMI_PIC_ACC_ENABLE464_ADDR A:0xe300100
y.create.l HWIO_SPMI_PIC_ACC_ENABLE465_ADDR A:0xe310100
y.create.l HWIO_SPMI_PIC_ACC_ENABLE466_ADDR A:0xe320100
y.create.l HWIO_SPMI_PIC_ACC_ENABLE467_ADDR A:0xe330100
y.create.l HWIO_SPMI_PIC_ACC_ENABLE468_ADDR A:0xe340100
y.create.l HWIO_SPMI_PIC_ACC_ENABLE469_ADDR A:0xe350100
y.create.l HWIO_SPMI_PIC_ACC_ENABLE470_ADDR A:0xe360100
y.create.l HWIO_SPMI_PIC_ACC_ENABLE471_ADDR A:0xe370100
y.create.l HWIO_SPMI_PIC_ACC_ENABLE472_ADDR A:0xe380100
y.create.l HWIO_SPMI_PIC_ACC_ENABLE473_ADDR A:0xe390100
y.create.l HWIO_SPMI_PIC_ACC_ENABLE474_ADDR A:0xe3a0100
y.create.l HWIO_SPMI_PIC_ACC_ENABLE475_ADDR A:0xe3b0100
y.create.l HWIO_SPMI_PIC_ACC_ENABLE476_ADDR A:0xe3c0100
y.create.l HWIO_SPMI_PIC_ACC_ENABLE477_ADDR A:0xe3d0100
y.create.l HWIO_SPMI_PIC_ACC_ENABLE478_ADDR A:0xe3e0100
y.create.l HWIO_SPMI_PIC_ACC_ENABLE479_ADDR A:0xe3f0100
y.create.l HWIO_SPMI_PIC_ACC_ENABLE480_ADDR A:0xe400100
y.create.l HWIO_SPMI_PIC_ACC_ENABLE481_ADDR A:0xe410100
y.create.l HWIO_SPMI_PIC_ACC_ENABLE482_ADDR A:0xe420100
y.create.l HWIO_SPMI_PIC_ACC_ENABLE483_ADDR A:0xe430100
y.create.l HWIO_SPMI_PIC_ACC_ENABLE484_ADDR A:0xe440100
y.create.l HWIO_SPMI_PIC_ACC_ENABLE485_ADDR A:0xe450100
y.create.l HWIO_SPMI_PIC_ACC_ENABLE486_ADDR A:0xe460100
y.create.l HWIO_SPMI_PIC_ACC_ENABLE487_ADDR A:0xe470100
y.create.l HWIO_SPMI_PIC_ACC_ENABLE488_ADDR A:0xe480100
y.create.l HWIO_SPMI_PIC_ACC_ENABLE489_ADDR A:0xe490100
y.create.l HWIO_SPMI_PIC_ACC_ENABLE490_ADDR A:0xe4a0100
y.create.l HWIO_SPMI_PIC_ACC_ENABLE491_ADDR A:0xe4b0100
y.create.l HWIO_SPMI_PIC_ACC_ENABLE492_ADDR A:0xe4c0100
y.create.l HWIO_SPMI_PIC_ACC_ENABLE493_ADDR A:0xe4d0100
y.create.l HWIO_SPMI_PIC_ACC_ENABLE494_ADDR A:0xe4e0100
y.create.l HWIO_SPMI_PIC_ACC_ENABLE495_ADDR A:0xe4f0100
y.create.l HWIO_SPMI_PIC_ACC_ENABLE496_ADDR A:0xe500100
y.create.l HWIO_SPMI_PIC_ACC_ENABLE497_ADDR A:0xe510100
y.create.l HWIO_SPMI_PIC_ACC_ENABLE498_ADDR A:0xe520100
y.create.l HWIO_SPMI_PIC_ACC_ENABLE499_ADDR A:0xe530100
y.create.l HWIO_SPMI_PIC_ACC_ENABLE500_ADDR A:0xe540100
y.create.l HWIO_SPMI_PIC_ACC_ENABLE501_ADDR A:0xe550100
y.create.l HWIO_SPMI_PIC_ACC_ENABLE502_ADDR A:0xe560100
y.create.l HWIO_SPMI_PIC_ACC_ENABLE503_ADDR A:0xe570100
y.create.l HWIO_SPMI_PIC_ACC_ENABLE504_ADDR A:0xe580100
y.create.l HWIO_SPMI_PIC_ACC_ENABLE505_ADDR A:0xe590100
y.create.l HWIO_SPMI_PIC_ACC_ENABLE506_ADDR A:0xe5a0100
y.create.l HWIO_SPMI_PIC_ACC_ENABLE507_ADDR A:0xe5b0100
y.create.l HWIO_SPMI_PIC_ACC_ENABLE508_ADDR A:0xe5c0100
y.create.l HWIO_SPMI_PIC_ACC_ENABLE509_ADDR A:0xe5d0100
y.create.l HWIO_SPMI_PIC_ACC_ENABLE510_ADDR A:0xe5e0100
y.create.l HWIO_SPMI_PIC_ACC_ENABLE511_ADDR A:0xe5f0100
y.create.l HWIO_SPMI_PIC_IRQ_STATUS0_ADDR A:0xc600104
y.create.l HWIO_SPMI_PIC_IRQ_STATUS1_ADDR A:0xc610104
y.create.l HWIO_SPMI_PIC_IRQ_STATUS2_ADDR A:0xc620104
y.create.l HWIO_SPMI_PIC_IRQ_STATUS3_ADDR A:0xc630104
y.create.l HWIO_SPMI_PIC_IRQ_STATUS4_ADDR A:0xc640104
y.create.l HWIO_SPMI_PIC_IRQ_STATUS5_ADDR A:0xc650104
y.create.l HWIO_SPMI_PIC_IRQ_STATUS6_ADDR A:0xc660104
y.create.l HWIO_SPMI_PIC_IRQ_STATUS7_ADDR A:0xc670104
y.create.l HWIO_SPMI_PIC_IRQ_STATUS8_ADDR A:0xc680104
y.create.l HWIO_SPMI_PIC_IRQ_STATUS9_ADDR A:0xc690104
y.create.l HWIO_SPMI_PIC_IRQ_STATUS10_ADDR A:0xc6a0104
y.create.l HWIO_SPMI_PIC_IRQ_STATUS11_ADDR A:0xc6b0104
y.create.l HWIO_SPMI_PIC_IRQ_STATUS12_ADDR A:0xc6c0104
y.create.l HWIO_SPMI_PIC_IRQ_STATUS13_ADDR A:0xc6d0104
y.create.l HWIO_SPMI_PIC_IRQ_STATUS14_ADDR A:0xc6e0104
y.create.l HWIO_SPMI_PIC_IRQ_STATUS15_ADDR A:0xc6f0104
y.create.l HWIO_SPMI_PIC_IRQ_STATUS16_ADDR A:0xc700104
y.create.l HWIO_SPMI_PIC_IRQ_STATUS17_ADDR A:0xc710104
y.create.l HWIO_SPMI_PIC_IRQ_STATUS18_ADDR A:0xc720104
y.create.l HWIO_SPMI_PIC_IRQ_STATUS19_ADDR A:0xc730104
y.create.l HWIO_SPMI_PIC_IRQ_STATUS20_ADDR A:0xc740104
y.create.l HWIO_SPMI_PIC_IRQ_STATUS21_ADDR A:0xc750104
y.create.l HWIO_SPMI_PIC_IRQ_STATUS22_ADDR A:0xc760104
y.create.l HWIO_SPMI_PIC_IRQ_STATUS23_ADDR A:0xc770104
y.create.l HWIO_SPMI_PIC_IRQ_STATUS24_ADDR A:0xc780104
y.create.l HWIO_SPMI_PIC_IRQ_STATUS25_ADDR A:0xc790104
y.create.l HWIO_SPMI_PIC_IRQ_STATUS26_ADDR A:0xc7a0104
y.create.l HWIO_SPMI_PIC_IRQ_STATUS27_ADDR A:0xc7b0104
y.create.l HWIO_SPMI_PIC_IRQ_STATUS28_ADDR A:0xc7c0104
y.create.l HWIO_SPMI_PIC_IRQ_STATUS29_ADDR A:0xc7d0104
y.create.l HWIO_SPMI_PIC_IRQ_STATUS30_ADDR A:0xc7e0104
y.create.l HWIO_SPMI_PIC_IRQ_STATUS31_ADDR A:0xc7f0104
y.create.l HWIO_SPMI_PIC_IRQ_STATUS32_ADDR A:0xc800104
y.create.l HWIO_SPMI_PIC_IRQ_STATUS33_ADDR A:0xc810104
y.create.l HWIO_SPMI_PIC_IRQ_STATUS34_ADDR A:0xc820104
y.create.l HWIO_SPMI_PIC_IRQ_STATUS35_ADDR A:0xc830104
y.create.l HWIO_SPMI_PIC_IRQ_STATUS36_ADDR A:0xc840104
y.create.l HWIO_SPMI_PIC_IRQ_STATUS37_ADDR A:0xc850104
y.create.l HWIO_SPMI_PIC_IRQ_STATUS38_ADDR A:0xc860104
y.create.l HWIO_SPMI_PIC_IRQ_STATUS39_ADDR A:0xc870104
y.create.l HWIO_SPMI_PIC_IRQ_STATUS40_ADDR A:0xc880104
y.create.l HWIO_SPMI_PIC_IRQ_STATUS41_ADDR A:0xc890104
y.create.l HWIO_SPMI_PIC_IRQ_STATUS42_ADDR A:0xc8a0104
y.create.l HWIO_SPMI_PIC_IRQ_STATUS43_ADDR A:0xc8b0104
y.create.l HWIO_SPMI_PIC_IRQ_STATUS44_ADDR A:0xc8c0104
y.create.l HWIO_SPMI_PIC_IRQ_STATUS45_ADDR A:0xc8d0104
y.create.l HWIO_SPMI_PIC_IRQ_STATUS46_ADDR A:0xc8e0104
y.create.l HWIO_SPMI_PIC_IRQ_STATUS47_ADDR A:0xc8f0104
y.create.l HWIO_SPMI_PIC_IRQ_STATUS48_ADDR A:0xc900104
y.create.l HWIO_SPMI_PIC_IRQ_STATUS49_ADDR A:0xc910104
y.create.l HWIO_SPMI_PIC_IRQ_STATUS50_ADDR A:0xc920104
y.create.l HWIO_SPMI_PIC_IRQ_STATUS51_ADDR A:0xc930104
y.create.l HWIO_SPMI_PIC_IRQ_STATUS52_ADDR A:0xc940104
y.create.l HWIO_SPMI_PIC_IRQ_STATUS53_ADDR A:0xc950104
y.create.l HWIO_SPMI_PIC_IRQ_STATUS54_ADDR A:0xc960104
y.create.l HWIO_SPMI_PIC_IRQ_STATUS55_ADDR A:0xc970104
y.create.l HWIO_SPMI_PIC_IRQ_STATUS56_ADDR A:0xc980104
y.create.l HWIO_SPMI_PIC_IRQ_STATUS57_ADDR A:0xc990104
y.create.l HWIO_SPMI_PIC_IRQ_STATUS58_ADDR A:0xc9a0104
y.create.l HWIO_SPMI_PIC_IRQ_STATUS59_ADDR A:0xc9b0104
y.create.l HWIO_SPMI_PIC_IRQ_STATUS60_ADDR A:0xc9c0104
y.create.l HWIO_SPMI_PIC_IRQ_STATUS61_ADDR A:0xc9d0104
y.create.l HWIO_SPMI_PIC_IRQ_STATUS62_ADDR A:0xc9e0104
y.create.l HWIO_SPMI_PIC_IRQ_STATUS63_ADDR A:0xc9f0104
y.create.l HWIO_SPMI_PIC_IRQ_STATUS64_ADDR A:0xca00104
y.create.l HWIO_SPMI_PIC_IRQ_STATUS65_ADDR A:0xca10104
y.create.l HWIO_SPMI_PIC_IRQ_STATUS66_ADDR A:0xca20104
y.create.l HWIO_SPMI_PIC_IRQ_STATUS67_ADDR A:0xca30104
y.create.l HWIO_SPMI_PIC_IRQ_STATUS68_ADDR A:0xca40104
y.create.l HWIO_SPMI_PIC_IRQ_STATUS69_ADDR A:0xca50104
y.create.l HWIO_SPMI_PIC_IRQ_STATUS70_ADDR A:0xca60104
y.create.l HWIO_SPMI_PIC_IRQ_STATUS71_ADDR A:0xca70104
y.create.l HWIO_SPMI_PIC_IRQ_STATUS72_ADDR A:0xca80104
y.create.l HWIO_SPMI_PIC_IRQ_STATUS73_ADDR A:0xca90104
y.create.l HWIO_SPMI_PIC_IRQ_STATUS74_ADDR A:0xcaa0104
y.create.l HWIO_SPMI_PIC_IRQ_STATUS75_ADDR A:0xcab0104
y.create.l HWIO_SPMI_PIC_IRQ_STATUS76_ADDR A:0xcac0104
y.create.l HWIO_SPMI_PIC_IRQ_STATUS77_ADDR A:0xcad0104
y.create.l HWIO_SPMI_PIC_IRQ_STATUS78_ADDR A:0xcae0104
y.create.l HWIO_SPMI_PIC_IRQ_STATUS79_ADDR A:0xcaf0104
y.create.l HWIO_SPMI_PIC_IRQ_STATUS80_ADDR A:0xcb00104
y.create.l HWIO_SPMI_PIC_IRQ_STATUS81_ADDR A:0xcb10104
y.create.l HWIO_SPMI_PIC_IRQ_STATUS82_ADDR A:0xcb20104
y.create.l HWIO_SPMI_PIC_IRQ_STATUS83_ADDR A:0xcb30104
y.create.l HWIO_SPMI_PIC_IRQ_STATUS84_ADDR A:0xcb40104
y.create.l HWIO_SPMI_PIC_IRQ_STATUS85_ADDR A:0xcb50104
y.create.l HWIO_SPMI_PIC_IRQ_STATUS86_ADDR A:0xcb60104
y.create.l HWIO_SPMI_PIC_IRQ_STATUS87_ADDR A:0xcb70104
y.create.l HWIO_SPMI_PIC_IRQ_STATUS88_ADDR A:0xcb80104
y.create.l HWIO_SPMI_PIC_IRQ_STATUS89_ADDR A:0xcb90104
y.create.l HWIO_SPMI_PIC_IRQ_STATUS90_ADDR A:0xcba0104
y.create.l HWIO_SPMI_PIC_IRQ_STATUS91_ADDR A:0xcbb0104
y.create.l HWIO_SPMI_PIC_IRQ_STATUS92_ADDR A:0xcbc0104
y.create.l HWIO_SPMI_PIC_IRQ_STATUS93_ADDR A:0xcbd0104
y.create.l HWIO_SPMI_PIC_IRQ_STATUS94_ADDR A:0xcbe0104
y.create.l HWIO_SPMI_PIC_IRQ_STATUS95_ADDR A:0xcbf0104
y.create.l HWIO_SPMI_PIC_IRQ_STATUS96_ADDR A:0xcc00104
y.create.l HWIO_SPMI_PIC_IRQ_STATUS97_ADDR A:0xcc10104
y.create.l HWIO_SPMI_PIC_IRQ_STATUS98_ADDR A:0xcc20104
y.create.l HWIO_SPMI_PIC_IRQ_STATUS99_ADDR A:0xcc30104
y.create.l HWIO_SPMI_PIC_IRQ_STATUS100_ADDR A:0xcc40104
y.create.l HWIO_SPMI_PIC_IRQ_STATUS101_ADDR A:0xcc50104
y.create.l HWIO_SPMI_PIC_IRQ_STATUS102_ADDR A:0xcc60104
y.create.l HWIO_SPMI_PIC_IRQ_STATUS103_ADDR A:0xcc70104
y.create.l HWIO_SPMI_PIC_IRQ_STATUS104_ADDR A:0xcc80104
y.create.l HWIO_SPMI_PIC_IRQ_STATUS105_ADDR A:0xcc90104
y.create.l HWIO_SPMI_PIC_IRQ_STATUS106_ADDR A:0xcca0104
y.create.l HWIO_SPMI_PIC_IRQ_STATUS107_ADDR A:0xccb0104
y.create.l HWIO_SPMI_PIC_IRQ_STATUS108_ADDR A:0xccc0104
y.create.l HWIO_SPMI_PIC_IRQ_STATUS109_ADDR A:0xccd0104
y.create.l HWIO_SPMI_PIC_IRQ_STATUS110_ADDR A:0xcce0104
y.create.l HWIO_SPMI_PIC_IRQ_STATUS111_ADDR A:0xccf0104
y.create.l HWIO_SPMI_PIC_IRQ_STATUS112_ADDR A:0xcd00104
y.create.l HWIO_SPMI_PIC_IRQ_STATUS113_ADDR A:0xcd10104
y.create.l HWIO_SPMI_PIC_IRQ_STATUS114_ADDR A:0xcd20104
y.create.l HWIO_SPMI_PIC_IRQ_STATUS115_ADDR A:0xcd30104
y.create.l HWIO_SPMI_PIC_IRQ_STATUS116_ADDR A:0xcd40104
y.create.l HWIO_SPMI_PIC_IRQ_STATUS117_ADDR A:0xcd50104
y.create.l HWIO_SPMI_PIC_IRQ_STATUS118_ADDR A:0xcd60104
y.create.l HWIO_SPMI_PIC_IRQ_STATUS119_ADDR A:0xcd70104
y.create.l HWIO_SPMI_PIC_IRQ_STATUS120_ADDR A:0xcd80104
y.create.l HWIO_SPMI_PIC_IRQ_STATUS121_ADDR A:0xcd90104
y.create.l HWIO_SPMI_PIC_IRQ_STATUS122_ADDR A:0xcda0104
y.create.l HWIO_SPMI_PIC_IRQ_STATUS123_ADDR A:0xcdb0104
y.create.l HWIO_SPMI_PIC_IRQ_STATUS124_ADDR A:0xcdc0104
y.create.l HWIO_SPMI_PIC_IRQ_STATUS125_ADDR A:0xcdd0104
y.create.l HWIO_SPMI_PIC_IRQ_STATUS126_ADDR A:0xcde0104
y.create.l HWIO_SPMI_PIC_IRQ_STATUS127_ADDR A:0xcdf0104
y.create.l HWIO_SPMI_PIC_IRQ_STATUS128_ADDR A:0xce00104
y.create.l HWIO_SPMI_PIC_IRQ_STATUS129_ADDR A:0xce10104
y.create.l HWIO_SPMI_PIC_IRQ_STATUS130_ADDR A:0xce20104
y.create.l HWIO_SPMI_PIC_IRQ_STATUS131_ADDR A:0xce30104
y.create.l HWIO_SPMI_PIC_IRQ_STATUS132_ADDR A:0xce40104
y.create.l HWIO_SPMI_PIC_IRQ_STATUS133_ADDR A:0xce50104
y.create.l HWIO_SPMI_PIC_IRQ_STATUS134_ADDR A:0xce60104
y.create.l HWIO_SPMI_PIC_IRQ_STATUS135_ADDR A:0xce70104
y.create.l HWIO_SPMI_PIC_IRQ_STATUS136_ADDR A:0xce80104
y.create.l HWIO_SPMI_PIC_IRQ_STATUS137_ADDR A:0xce90104
y.create.l HWIO_SPMI_PIC_IRQ_STATUS138_ADDR A:0xcea0104
y.create.l HWIO_SPMI_PIC_IRQ_STATUS139_ADDR A:0xceb0104
y.create.l HWIO_SPMI_PIC_IRQ_STATUS140_ADDR A:0xcec0104
y.create.l HWIO_SPMI_PIC_IRQ_STATUS141_ADDR A:0xced0104
y.create.l HWIO_SPMI_PIC_IRQ_STATUS142_ADDR A:0xcee0104
y.create.l HWIO_SPMI_PIC_IRQ_STATUS143_ADDR A:0xcef0104
y.create.l HWIO_SPMI_PIC_IRQ_STATUS144_ADDR A:0xcf00104
y.create.l HWIO_SPMI_PIC_IRQ_STATUS145_ADDR A:0xcf10104
y.create.l HWIO_SPMI_PIC_IRQ_STATUS146_ADDR A:0xcf20104
y.create.l HWIO_SPMI_PIC_IRQ_STATUS147_ADDR A:0xcf30104
y.create.l HWIO_SPMI_PIC_IRQ_STATUS148_ADDR A:0xcf40104
y.create.l HWIO_SPMI_PIC_IRQ_STATUS149_ADDR A:0xcf50104
y.create.l HWIO_SPMI_PIC_IRQ_STATUS150_ADDR A:0xcf60104
y.create.l HWIO_SPMI_PIC_IRQ_STATUS151_ADDR A:0xcf70104
y.create.l HWIO_SPMI_PIC_IRQ_STATUS152_ADDR A:0xcf80104
y.create.l HWIO_SPMI_PIC_IRQ_STATUS153_ADDR A:0xcf90104
y.create.l HWIO_SPMI_PIC_IRQ_STATUS154_ADDR A:0xcfa0104
y.create.l HWIO_SPMI_PIC_IRQ_STATUS155_ADDR A:0xcfb0104
y.create.l HWIO_SPMI_PIC_IRQ_STATUS156_ADDR A:0xcfc0104
y.create.l HWIO_SPMI_PIC_IRQ_STATUS157_ADDR A:0xcfd0104
y.create.l HWIO_SPMI_PIC_IRQ_STATUS158_ADDR A:0xcfe0104
y.create.l HWIO_SPMI_PIC_IRQ_STATUS159_ADDR A:0xcff0104
y.create.l HWIO_SPMI_PIC_IRQ_STATUS160_ADDR A:0xd000104
y.create.l HWIO_SPMI_PIC_IRQ_STATUS161_ADDR A:0xd010104
y.create.l HWIO_SPMI_PIC_IRQ_STATUS162_ADDR A:0xd020104
y.create.l HWIO_SPMI_PIC_IRQ_STATUS163_ADDR A:0xd030104
y.create.l HWIO_SPMI_PIC_IRQ_STATUS164_ADDR A:0xd040104
y.create.l HWIO_SPMI_PIC_IRQ_STATUS165_ADDR A:0xd050104
y.create.l HWIO_SPMI_PIC_IRQ_STATUS166_ADDR A:0xd060104
y.create.l HWIO_SPMI_PIC_IRQ_STATUS167_ADDR A:0xd070104
y.create.l HWIO_SPMI_PIC_IRQ_STATUS168_ADDR A:0xd080104
y.create.l HWIO_SPMI_PIC_IRQ_STATUS169_ADDR A:0xd090104
y.create.l HWIO_SPMI_PIC_IRQ_STATUS170_ADDR A:0xd0a0104
y.create.l HWIO_SPMI_PIC_IRQ_STATUS171_ADDR A:0xd0b0104
y.create.l HWIO_SPMI_PIC_IRQ_STATUS172_ADDR A:0xd0c0104
y.create.l HWIO_SPMI_PIC_IRQ_STATUS173_ADDR A:0xd0d0104
y.create.l HWIO_SPMI_PIC_IRQ_STATUS174_ADDR A:0xd0e0104
y.create.l HWIO_SPMI_PIC_IRQ_STATUS175_ADDR A:0xd0f0104
y.create.l HWIO_SPMI_PIC_IRQ_STATUS176_ADDR A:0xd100104
y.create.l HWIO_SPMI_PIC_IRQ_STATUS177_ADDR A:0xd110104
y.create.l HWIO_SPMI_PIC_IRQ_STATUS178_ADDR A:0xd120104
y.create.l HWIO_SPMI_PIC_IRQ_STATUS179_ADDR A:0xd130104
y.create.l HWIO_SPMI_PIC_IRQ_STATUS180_ADDR A:0xd140104
y.create.l HWIO_SPMI_PIC_IRQ_STATUS181_ADDR A:0xd150104
y.create.l HWIO_SPMI_PIC_IRQ_STATUS182_ADDR A:0xd160104
y.create.l HWIO_SPMI_PIC_IRQ_STATUS183_ADDR A:0xd170104
y.create.l HWIO_SPMI_PIC_IRQ_STATUS184_ADDR A:0xd180104
y.create.l HWIO_SPMI_PIC_IRQ_STATUS185_ADDR A:0xd190104
y.create.l HWIO_SPMI_PIC_IRQ_STATUS186_ADDR A:0xd1a0104
y.create.l HWIO_SPMI_PIC_IRQ_STATUS187_ADDR A:0xd1b0104
y.create.l HWIO_SPMI_PIC_IRQ_STATUS188_ADDR A:0xd1c0104
y.create.l HWIO_SPMI_PIC_IRQ_STATUS189_ADDR A:0xd1d0104
y.create.l HWIO_SPMI_PIC_IRQ_STATUS190_ADDR A:0xd1e0104
y.create.l HWIO_SPMI_PIC_IRQ_STATUS191_ADDR A:0xd1f0104
y.create.l HWIO_SPMI_PIC_IRQ_STATUS192_ADDR A:0xd200104
y.create.l HWIO_SPMI_PIC_IRQ_STATUS193_ADDR A:0xd210104
y.create.l HWIO_SPMI_PIC_IRQ_STATUS194_ADDR A:0xd220104
y.create.l HWIO_SPMI_PIC_IRQ_STATUS195_ADDR A:0xd230104
y.create.l HWIO_SPMI_PIC_IRQ_STATUS196_ADDR A:0xd240104
y.create.l HWIO_SPMI_PIC_IRQ_STATUS197_ADDR A:0xd250104
y.create.l HWIO_SPMI_PIC_IRQ_STATUS198_ADDR A:0xd260104
y.create.l HWIO_SPMI_PIC_IRQ_STATUS199_ADDR A:0xd270104
y.create.l HWIO_SPMI_PIC_IRQ_STATUS200_ADDR A:0xd280104
y.create.l HWIO_SPMI_PIC_IRQ_STATUS201_ADDR A:0xd290104
y.create.l HWIO_SPMI_PIC_IRQ_STATUS202_ADDR A:0xd2a0104
y.create.l HWIO_SPMI_PIC_IRQ_STATUS203_ADDR A:0xd2b0104
y.create.l HWIO_SPMI_PIC_IRQ_STATUS204_ADDR A:0xd2c0104
y.create.l HWIO_SPMI_PIC_IRQ_STATUS205_ADDR A:0xd2d0104
y.create.l HWIO_SPMI_PIC_IRQ_STATUS206_ADDR A:0xd2e0104
y.create.l HWIO_SPMI_PIC_IRQ_STATUS207_ADDR A:0xd2f0104
y.create.l HWIO_SPMI_PIC_IRQ_STATUS208_ADDR A:0xd300104
y.create.l HWIO_SPMI_PIC_IRQ_STATUS209_ADDR A:0xd310104
y.create.l HWIO_SPMI_PIC_IRQ_STATUS210_ADDR A:0xd320104
y.create.l HWIO_SPMI_PIC_IRQ_STATUS211_ADDR A:0xd330104
y.create.l HWIO_SPMI_PIC_IRQ_STATUS212_ADDR A:0xd340104
y.create.l HWIO_SPMI_PIC_IRQ_STATUS213_ADDR A:0xd350104
y.create.l HWIO_SPMI_PIC_IRQ_STATUS214_ADDR A:0xd360104
y.create.l HWIO_SPMI_PIC_IRQ_STATUS215_ADDR A:0xd370104
y.create.l HWIO_SPMI_PIC_IRQ_STATUS216_ADDR A:0xd380104
y.create.l HWIO_SPMI_PIC_IRQ_STATUS217_ADDR A:0xd390104
y.create.l HWIO_SPMI_PIC_IRQ_STATUS218_ADDR A:0xd3a0104
y.create.l HWIO_SPMI_PIC_IRQ_STATUS219_ADDR A:0xd3b0104
y.create.l HWIO_SPMI_PIC_IRQ_STATUS220_ADDR A:0xd3c0104
y.create.l HWIO_SPMI_PIC_IRQ_STATUS221_ADDR A:0xd3d0104
y.create.l HWIO_SPMI_PIC_IRQ_STATUS222_ADDR A:0xd3e0104
y.create.l HWIO_SPMI_PIC_IRQ_STATUS223_ADDR A:0xd3f0104
y.create.l HWIO_SPMI_PIC_IRQ_STATUS224_ADDR A:0xd400104
y.create.l HWIO_SPMI_PIC_IRQ_STATUS225_ADDR A:0xd410104
y.create.l HWIO_SPMI_PIC_IRQ_STATUS226_ADDR A:0xd420104
y.create.l HWIO_SPMI_PIC_IRQ_STATUS227_ADDR A:0xd430104
y.create.l HWIO_SPMI_PIC_IRQ_STATUS228_ADDR A:0xd440104
y.create.l HWIO_SPMI_PIC_IRQ_STATUS229_ADDR A:0xd450104
y.create.l HWIO_SPMI_PIC_IRQ_STATUS230_ADDR A:0xd460104
y.create.l HWIO_SPMI_PIC_IRQ_STATUS231_ADDR A:0xd470104
y.create.l HWIO_SPMI_PIC_IRQ_STATUS232_ADDR A:0xd480104
y.create.l HWIO_SPMI_PIC_IRQ_STATUS233_ADDR A:0xd490104
y.create.l HWIO_SPMI_PIC_IRQ_STATUS234_ADDR A:0xd4a0104
y.create.l HWIO_SPMI_PIC_IRQ_STATUS235_ADDR A:0xd4b0104
y.create.l HWIO_SPMI_PIC_IRQ_STATUS236_ADDR A:0xd4c0104
y.create.l HWIO_SPMI_PIC_IRQ_STATUS237_ADDR A:0xd4d0104
y.create.l HWIO_SPMI_PIC_IRQ_STATUS238_ADDR A:0xd4e0104
y.create.l HWIO_SPMI_PIC_IRQ_STATUS239_ADDR A:0xd4f0104
y.create.l HWIO_SPMI_PIC_IRQ_STATUS240_ADDR A:0xd500104
y.create.l HWIO_SPMI_PIC_IRQ_STATUS241_ADDR A:0xd510104
y.create.l HWIO_SPMI_PIC_IRQ_STATUS242_ADDR A:0xd520104
y.create.l HWIO_SPMI_PIC_IRQ_STATUS243_ADDR A:0xd530104
y.create.l HWIO_SPMI_PIC_IRQ_STATUS244_ADDR A:0xd540104
y.create.l HWIO_SPMI_PIC_IRQ_STATUS245_ADDR A:0xd550104
y.create.l HWIO_SPMI_PIC_IRQ_STATUS246_ADDR A:0xd560104
y.create.l HWIO_SPMI_PIC_IRQ_STATUS247_ADDR A:0xd570104
y.create.l HWIO_SPMI_PIC_IRQ_STATUS248_ADDR A:0xd580104
y.create.l HWIO_SPMI_PIC_IRQ_STATUS249_ADDR A:0xd590104
y.create.l HWIO_SPMI_PIC_IRQ_STATUS250_ADDR A:0xd5a0104
y.create.l HWIO_SPMI_PIC_IRQ_STATUS251_ADDR A:0xd5b0104
y.create.l HWIO_SPMI_PIC_IRQ_STATUS252_ADDR A:0xd5c0104
y.create.l HWIO_SPMI_PIC_IRQ_STATUS253_ADDR A:0xd5d0104
y.create.l HWIO_SPMI_PIC_IRQ_STATUS254_ADDR A:0xd5e0104
y.create.l HWIO_SPMI_PIC_IRQ_STATUS255_ADDR A:0xd5f0104
y.create.l HWIO_SPMI_PIC_IRQ_STATUS256_ADDR A:0xd600104
y.create.l HWIO_SPMI_PIC_IRQ_STATUS257_ADDR A:0xd610104
y.create.l HWIO_SPMI_PIC_IRQ_STATUS258_ADDR A:0xd620104
y.create.l HWIO_SPMI_PIC_IRQ_STATUS259_ADDR A:0xd630104
y.create.l HWIO_SPMI_PIC_IRQ_STATUS260_ADDR A:0xd640104
y.create.l HWIO_SPMI_PIC_IRQ_STATUS261_ADDR A:0xd650104
y.create.l HWIO_SPMI_PIC_IRQ_STATUS262_ADDR A:0xd660104
y.create.l HWIO_SPMI_PIC_IRQ_STATUS263_ADDR A:0xd670104
y.create.l HWIO_SPMI_PIC_IRQ_STATUS264_ADDR A:0xd680104
y.create.l HWIO_SPMI_PIC_IRQ_STATUS265_ADDR A:0xd690104
y.create.l HWIO_SPMI_PIC_IRQ_STATUS266_ADDR A:0xd6a0104
y.create.l HWIO_SPMI_PIC_IRQ_STATUS267_ADDR A:0xd6b0104
y.create.l HWIO_SPMI_PIC_IRQ_STATUS268_ADDR A:0xd6c0104
y.create.l HWIO_SPMI_PIC_IRQ_STATUS269_ADDR A:0xd6d0104
y.create.l HWIO_SPMI_PIC_IRQ_STATUS270_ADDR A:0xd6e0104
y.create.l HWIO_SPMI_PIC_IRQ_STATUS271_ADDR A:0xd6f0104
y.create.l HWIO_SPMI_PIC_IRQ_STATUS272_ADDR A:0xd700104
y.create.l HWIO_SPMI_PIC_IRQ_STATUS273_ADDR A:0xd710104
y.create.l HWIO_SPMI_PIC_IRQ_STATUS274_ADDR A:0xd720104
y.create.l HWIO_SPMI_PIC_IRQ_STATUS275_ADDR A:0xd730104
y.create.l HWIO_SPMI_PIC_IRQ_STATUS276_ADDR A:0xd740104
y.create.l HWIO_SPMI_PIC_IRQ_STATUS277_ADDR A:0xd750104
y.create.l HWIO_SPMI_PIC_IRQ_STATUS278_ADDR A:0xd760104
y.create.l HWIO_SPMI_PIC_IRQ_STATUS279_ADDR A:0xd770104
y.create.l HWIO_SPMI_PIC_IRQ_STATUS280_ADDR A:0xd780104
y.create.l HWIO_SPMI_PIC_IRQ_STATUS281_ADDR A:0xd790104
y.create.l HWIO_SPMI_PIC_IRQ_STATUS282_ADDR A:0xd7a0104
y.create.l HWIO_SPMI_PIC_IRQ_STATUS283_ADDR A:0xd7b0104
y.create.l HWIO_SPMI_PIC_IRQ_STATUS284_ADDR A:0xd7c0104
y.create.l HWIO_SPMI_PIC_IRQ_STATUS285_ADDR A:0xd7d0104
y.create.l HWIO_SPMI_PIC_IRQ_STATUS286_ADDR A:0xd7e0104
y.create.l HWIO_SPMI_PIC_IRQ_STATUS287_ADDR A:0xd7f0104
y.create.l HWIO_SPMI_PIC_IRQ_STATUS288_ADDR A:0xd800104
y.create.l HWIO_SPMI_PIC_IRQ_STATUS289_ADDR A:0xd810104
y.create.l HWIO_SPMI_PIC_IRQ_STATUS290_ADDR A:0xd820104
y.create.l HWIO_SPMI_PIC_IRQ_STATUS291_ADDR A:0xd830104
y.create.l HWIO_SPMI_PIC_IRQ_STATUS292_ADDR A:0xd840104
y.create.l HWIO_SPMI_PIC_IRQ_STATUS293_ADDR A:0xd850104
y.create.l HWIO_SPMI_PIC_IRQ_STATUS294_ADDR A:0xd860104
y.create.l HWIO_SPMI_PIC_IRQ_STATUS295_ADDR A:0xd870104
y.create.l HWIO_SPMI_PIC_IRQ_STATUS296_ADDR A:0xd880104
y.create.l HWIO_SPMI_PIC_IRQ_STATUS297_ADDR A:0xd890104
y.create.l HWIO_SPMI_PIC_IRQ_STATUS298_ADDR A:0xd8a0104
y.create.l HWIO_SPMI_PIC_IRQ_STATUS299_ADDR A:0xd8b0104
y.create.l HWIO_SPMI_PIC_IRQ_STATUS300_ADDR A:0xd8c0104
y.create.l HWIO_SPMI_PIC_IRQ_STATUS301_ADDR A:0xd8d0104
y.create.l HWIO_SPMI_PIC_IRQ_STATUS302_ADDR A:0xd8e0104
y.create.l HWIO_SPMI_PIC_IRQ_STATUS303_ADDR A:0xd8f0104
y.create.l HWIO_SPMI_PIC_IRQ_STATUS304_ADDR A:0xd900104
y.create.l HWIO_SPMI_PIC_IRQ_STATUS305_ADDR A:0xd910104
y.create.l HWIO_SPMI_PIC_IRQ_STATUS306_ADDR A:0xd920104
y.create.l HWIO_SPMI_PIC_IRQ_STATUS307_ADDR A:0xd930104
y.create.l HWIO_SPMI_PIC_IRQ_STATUS308_ADDR A:0xd940104
y.create.l HWIO_SPMI_PIC_IRQ_STATUS309_ADDR A:0xd950104
y.create.l HWIO_SPMI_PIC_IRQ_STATUS310_ADDR A:0xd960104
y.create.l HWIO_SPMI_PIC_IRQ_STATUS311_ADDR A:0xd970104
y.create.l HWIO_SPMI_PIC_IRQ_STATUS312_ADDR A:0xd980104
y.create.l HWIO_SPMI_PIC_IRQ_STATUS313_ADDR A:0xd990104
y.create.l HWIO_SPMI_PIC_IRQ_STATUS314_ADDR A:0xd9a0104
y.create.l HWIO_SPMI_PIC_IRQ_STATUS315_ADDR A:0xd9b0104
y.create.l HWIO_SPMI_PIC_IRQ_STATUS316_ADDR A:0xd9c0104
y.create.l HWIO_SPMI_PIC_IRQ_STATUS317_ADDR A:0xd9d0104
y.create.l HWIO_SPMI_PIC_IRQ_STATUS318_ADDR A:0xd9e0104
y.create.l HWIO_SPMI_PIC_IRQ_STATUS319_ADDR A:0xd9f0104
y.create.l HWIO_SPMI_PIC_IRQ_STATUS320_ADDR A:0xda00104
y.create.l HWIO_SPMI_PIC_IRQ_STATUS321_ADDR A:0xda10104
y.create.l HWIO_SPMI_PIC_IRQ_STATUS322_ADDR A:0xda20104
y.create.l HWIO_SPMI_PIC_IRQ_STATUS323_ADDR A:0xda30104
y.create.l HWIO_SPMI_PIC_IRQ_STATUS324_ADDR A:0xda40104
y.create.l HWIO_SPMI_PIC_IRQ_STATUS325_ADDR A:0xda50104
y.create.l HWIO_SPMI_PIC_IRQ_STATUS326_ADDR A:0xda60104
y.create.l HWIO_SPMI_PIC_IRQ_STATUS327_ADDR A:0xda70104
y.create.l HWIO_SPMI_PIC_IRQ_STATUS328_ADDR A:0xda80104
y.create.l HWIO_SPMI_PIC_IRQ_STATUS329_ADDR A:0xda90104
y.create.l HWIO_SPMI_PIC_IRQ_STATUS330_ADDR A:0xdaa0104
y.create.l HWIO_SPMI_PIC_IRQ_STATUS331_ADDR A:0xdab0104
y.create.l HWIO_SPMI_PIC_IRQ_STATUS332_ADDR A:0xdac0104
y.create.l HWIO_SPMI_PIC_IRQ_STATUS333_ADDR A:0xdad0104
y.create.l HWIO_SPMI_PIC_IRQ_STATUS334_ADDR A:0xdae0104
y.create.l HWIO_SPMI_PIC_IRQ_STATUS335_ADDR A:0xdaf0104
y.create.l HWIO_SPMI_PIC_IRQ_STATUS336_ADDR A:0xdb00104
y.create.l HWIO_SPMI_PIC_IRQ_STATUS337_ADDR A:0xdb10104
y.create.l HWIO_SPMI_PIC_IRQ_STATUS338_ADDR A:0xdb20104
y.create.l HWIO_SPMI_PIC_IRQ_STATUS339_ADDR A:0xdb30104
y.create.l HWIO_SPMI_PIC_IRQ_STATUS340_ADDR A:0xdb40104
y.create.l HWIO_SPMI_PIC_IRQ_STATUS341_ADDR A:0xdb50104
y.create.l HWIO_SPMI_PIC_IRQ_STATUS342_ADDR A:0xdb60104
y.create.l HWIO_SPMI_PIC_IRQ_STATUS343_ADDR A:0xdb70104
y.create.l HWIO_SPMI_PIC_IRQ_STATUS344_ADDR A:0xdb80104
y.create.l HWIO_SPMI_PIC_IRQ_STATUS345_ADDR A:0xdb90104
y.create.l HWIO_SPMI_PIC_IRQ_STATUS346_ADDR A:0xdba0104
y.create.l HWIO_SPMI_PIC_IRQ_STATUS347_ADDR A:0xdbb0104
y.create.l HWIO_SPMI_PIC_IRQ_STATUS348_ADDR A:0xdbc0104
y.create.l HWIO_SPMI_PIC_IRQ_STATUS349_ADDR A:0xdbd0104
y.create.l HWIO_SPMI_PIC_IRQ_STATUS350_ADDR A:0xdbe0104
y.create.l HWIO_SPMI_PIC_IRQ_STATUS351_ADDR A:0xdbf0104
y.create.l HWIO_SPMI_PIC_IRQ_STATUS352_ADDR A:0xdc00104
y.create.l HWIO_SPMI_PIC_IRQ_STATUS353_ADDR A:0xdc10104
y.create.l HWIO_SPMI_PIC_IRQ_STATUS354_ADDR A:0xdc20104
y.create.l HWIO_SPMI_PIC_IRQ_STATUS355_ADDR A:0xdc30104
y.create.l HWIO_SPMI_PIC_IRQ_STATUS356_ADDR A:0xdc40104
y.create.l HWIO_SPMI_PIC_IRQ_STATUS357_ADDR A:0xdc50104
y.create.l HWIO_SPMI_PIC_IRQ_STATUS358_ADDR A:0xdc60104
y.create.l HWIO_SPMI_PIC_IRQ_STATUS359_ADDR A:0xdc70104
y.create.l HWIO_SPMI_PIC_IRQ_STATUS360_ADDR A:0xdc80104
y.create.l HWIO_SPMI_PIC_IRQ_STATUS361_ADDR A:0xdc90104
y.create.l HWIO_SPMI_PIC_IRQ_STATUS362_ADDR A:0xdca0104
y.create.l HWIO_SPMI_PIC_IRQ_STATUS363_ADDR A:0xdcb0104
y.create.l HWIO_SPMI_PIC_IRQ_STATUS364_ADDR A:0xdcc0104
y.create.l HWIO_SPMI_PIC_IRQ_STATUS365_ADDR A:0xdcd0104
y.create.l HWIO_SPMI_PIC_IRQ_STATUS366_ADDR A:0xdce0104
y.create.l HWIO_SPMI_PIC_IRQ_STATUS367_ADDR A:0xdcf0104
y.create.l HWIO_SPMI_PIC_IRQ_STATUS368_ADDR A:0xdd00104
y.create.l HWIO_SPMI_PIC_IRQ_STATUS369_ADDR A:0xdd10104
y.create.l HWIO_SPMI_PIC_IRQ_STATUS370_ADDR A:0xdd20104
y.create.l HWIO_SPMI_PIC_IRQ_STATUS371_ADDR A:0xdd30104
y.create.l HWIO_SPMI_PIC_IRQ_STATUS372_ADDR A:0xdd40104
y.create.l HWIO_SPMI_PIC_IRQ_STATUS373_ADDR A:0xdd50104
y.create.l HWIO_SPMI_PIC_IRQ_STATUS374_ADDR A:0xdd60104
y.create.l HWIO_SPMI_PIC_IRQ_STATUS375_ADDR A:0xdd70104
y.create.l HWIO_SPMI_PIC_IRQ_STATUS376_ADDR A:0xdd80104
y.create.l HWIO_SPMI_PIC_IRQ_STATUS377_ADDR A:0xdd90104
y.create.l HWIO_SPMI_PIC_IRQ_STATUS378_ADDR A:0xdda0104
y.create.l HWIO_SPMI_PIC_IRQ_STATUS379_ADDR A:0xddb0104
y.create.l HWIO_SPMI_PIC_IRQ_STATUS380_ADDR A:0xddc0104
y.create.l HWIO_SPMI_PIC_IRQ_STATUS381_ADDR A:0xddd0104
y.create.l HWIO_SPMI_PIC_IRQ_STATUS382_ADDR A:0xdde0104
y.create.l HWIO_SPMI_PIC_IRQ_STATUS383_ADDR A:0xddf0104
y.create.l HWIO_SPMI_PIC_IRQ_STATUS384_ADDR A:0xde00104
y.create.l HWIO_SPMI_PIC_IRQ_STATUS385_ADDR A:0xde10104
y.create.l HWIO_SPMI_PIC_IRQ_STATUS386_ADDR A:0xde20104
y.create.l HWIO_SPMI_PIC_IRQ_STATUS387_ADDR A:0xde30104
y.create.l HWIO_SPMI_PIC_IRQ_STATUS388_ADDR A:0xde40104
y.create.l HWIO_SPMI_PIC_IRQ_STATUS389_ADDR A:0xde50104
y.create.l HWIO_SPMI_PIC_IRQ_STATUS390_ADDR A:0xde60104
y.create.l HWIO_SPMI_PIC_IRQ_STATUS391_ADDR A:0xde70104
y.create.l HWIO_SPMI_PIC_IRQ_STATUS392_ADDR A:0xde80104
y.create.l HWIO_SPMI_PIC_IRQ_STATUS393_ADDR A:0xde90104
y.create.l HWIO_SPMI_PIC_IRQ_STATUS394_ADDR A:0xdea0104
y.create.l HWIO_SPMI_PIC_IRQ_STATUS395_ADDR A:0xdeb0104
y.create.l HWIO_SPMI_PIC_IRQ_STATUS396_ADDR A:0xdec0104
y.create.l HWIO_SPMI_PIC_IRQ_STATUS397_ADDR A:0xded0104
y.create.l HWIO_SPMI_PIC_IRQ_STATUS398_ADDR A:0xdee0104
y.create.l HWIO_SPMI_PIC_IRQ_STATUS399_ADDR A:0xdef0104
y.create.l HWIO_SPMI_PIC_IRQ_STATUS400_ADDR A:0xdf00104
y.create.l HWIO_SPMI_PIC_IRQ_STATUS401_ADDR A:0xdf10104
y.create.l HWIO_SPMI_PIC_IRQ_STATUS402_ADDR A:0xdf20104
y.create.l HWIO_SPMI_PIC_IRQ_STATUS403_ADDR A:0xdf30104
y.create.l HWIO_SPMI_PIC_IRQ_STATUS404_ADDR A:0xdf40104
y.create.l HWIO_SPMI_PIC_IRQ_STATUS405_ADDR A:0xdf50104
y.create.l HWIO_SPMI_PIC_IRQ_STATUS406_ADDR A:0xdf60104
y.create.l HWIO_SPMI_PIC_IRQ_STATUS407_ADDR A:0xdf70104
y.create.l HWIO_SPMI_PIC_IRQ_STATUS408_ADDR A:0xdf80104
y.create.l HWIO_SPMI_PIC_IRQ_STATUS409_ADDR A:0xdf90104
y.create.l HWIO_SPMI_PIC_IRQ_STATUS410_ADDR A:0xdfa0104
y.create.l HWIO_SPMI_PIC_IRQ_STATUS411_ADDR A:0xdfb0104
y.create.l HWIO_SPMI_PIC_IRQ_STATUS412_ADDR A:0xdfc0104
y.create.l HWIO_SPMI_PIC_IRQ_STATUS413_ADDR A:0xdfd0104
y.create.l HWIO_SPMI_PIC_IRQ_STATUS414_ADDR A:0xdfe0104
y.create.l HWIO_SPMI_PIC_IRQ_STATUS415_ADDR A:0xdff0104
y.create.l HWIO_SPMI_PIC_IRQ_STATUS416_ADDR A:0xe000104
y.create.l HWIO_SPMI_PIC_IRQ_STATUS417_ADDR A:0xe010104
y.create.l HWIO_SPMI_PIC_IRQ_STATUS418_ADDR A:0xe020104
y.create.l HWIO_SPMI_PIC_IRQ_STATUS419_ADDR A:0xe030104
y.create.l HWIO_SPMI_PIC_IRQ_STATUS420_ADDR A:0xe040104
y.create.l HWIO_SPMI_PIC_IRQ_STATUS421_ADDR A:0xe050104
y.create.l HWIO_SPMI_PIC_IRQ_STATUS422_ADDR A:0xe060104
y.create.l HWIO_SPMI_PIC_IRQ_STATUS423_ADDR A:0xe070104
y.create.l HWIO_SPMI_PIC_IRQ_STATUS424_ADDR A:0xe080104
y.create.l HWIO_SPMI_PIC_IRQ_STATUS425_ADDR A:0xe090104
y.create.l HWIO_SPMI_PIC_IRQ_STATUS426_ADDR A:0xe0a0104
y.create.l HWIO_SPMI_PIC_IRQ_STATUS427_ADDR A:0xe0b0104
y.create.l HWIO_SPMI_PIC_IRQ_STATUS428_ADDR A:0xe0c0104
y.create.l HWIO_SPMI_PIC_IRQ_STATUS429_ADDR A:0xe0d0104
y.create.l HWIO_SPMI_PIC_IRQ_STATUS430_ADDR A:0xe0e0104
y.create.l HWIO_SPMI_PIC_IRQ_STATUS431_ADDR A:0xe0f0104
y.create.l HWIO_SPMI_PIC_IRQ_STATUS432_ADDR A:0xe100104
y.create.l HWIO_SPMI_PIC_IRQ_STATUS433_ADDR A:0xe110104
y.create.l HWIO_SPMI_PIC_IRQ_STATUS434_ADDR A:0xe120104
y.create.l HWIO_SPMI_PIC_IRQ_STATUS435_ADDR A:0xe130104
y.create.l HWIO_SPMI_PIC_IRQ_STATUS436_ADDR A:0xe140104
y.create.l HWIO_SPMI_PIC_IRQ_STATUS437_ADDR A:0xe150104
y.create.l HWIO_SPMI_PIC_IRQ_STATUS438_ADDR A:0xe160104
y.create.l HWIO_SPMI_PIC_IRQ_STATUS439_ADDR A:0xe170104
y.create.l HWIO_SPMI_PIC_IRQ_STATUS440_ADDR A:0xe180104
y.create.l HWIO_SPMI_PIC_IRQ_STATUS441_ADDR A:0xe190104
y.create.l HWIO_SPMI_PIC_IRQ_STATUS442_ADDR A:0xe1a0104
y.create.l HWIO_SPMI_PIC_IRQ_STATUS443_ADDR A:0xe1b0104
y.create.l HWIO_SPMI_PIC_IRQ_STATUS444_ADDR A:0xe1c0104
y.create.l HWIO_SPMI_PIC_IRQ_STATUS445_ADDR A:0xe1d0104
y.create.l HWIO_SPMI_PIC_IRQ_STATUS446_ADDR A:0xe1e0104
y.create.l HWIO_SPMI_PIC_IRQ_STATUS447_ADDR A:0xe1f0104
y.create.l HWIO_SPMI_PIC_IRQ_STATUS448_ADDR A:0xe200104
y.create.l HWIO_SPMI_PIC_IRQ_STATUS449_ADDR A:0xe210104
y.create.l HWIO_SPMI_PIC_IRQ_STATUS450_ADDR A:0xe220104
y.create.l HWIO_SPMI_PIC_IRQ_STATUS451_ADDR A:0xe230104
y.create.l HWIO_SPMI_PIC_IRQ_STATUS452_ADDR A:0xe240104
y.create.l HWIO_SPMI_PIC_IRQ_STATUS453_ADDR A:0xe250104
y.create.l HWIO_SPMI_PIC_IRQ_STATUS454_ADDR A:0xe260104
y.create.l HWIO_SPMI_PIC_IRQ_STATUS455_ADDR A:0xe270104
y.create.l HWIO_SPMI_PIC_IRQ_STATUS456_ADDR A:0xe280104
y.create.l HWIO_SPMI_PIC_IRQ_STATUS457_ADDR A:0xe290104
y.create.l HWIO_SPMI_PIC_IRQ_STATUS458_ADDR A:0xe2a0104
y.create.l HWIO_SPMI_PIC_IRQ_STATUS459_ADDR A:0xe2b0104
y.create.l HWIO_SPMI_PIC_IRQ_STATUS460_ADDR A:0xe2c0104
y.create.l HWIO_SPMI_PIC_IRQ_STATUS461_ADDR A:0xe2d0104
y.create.l HWIO_SPMI_PIC_IRQ_STATUS462_ADDR A:0xe2e0104
y.create.l HWIO_SPMI_PIC_IRQ_STATUS463_ADDR A:0xe2f0104
y.create.l HWIO_SPMI_PIC_IRQ_STATUS464_ADDR A:0xe300104
y.create.l HWIO_SPMI_PIC_IRQ_STATUS465_ADDR A:0xe310104
y.create.l HWIO_SPMI_PIC_IRQ_STATUS466_ADDR A:0xe320104
y.create.l HWIO_SPMI_PIC_IRQ_STATUS467_ADDR A:0xe330104
y.create.l HWIO_SPMI_PIC_IRQ_STATUS468_ADDR A:0xe340104
y.create.l HWIO_SPMI_PIC_IRQ_STATUS469_ADDR A:0xe350104
y.create.l HWIO_SPMI_PIC_IRQ_STATUS470_ADDR A:0xe360104
y.create.l HWIO_SPMI_PIC_IRQ_STATUS471_ADDR A:0xe370104
y.create.l HWIO_SPMI_PIC_IRQ_STATUS472_ADDR A:0xe380104
y.create.l HWIO_SPMI_PIC_IRQ_STATUS473_ADDR A:0xe390104
y.create.l HWIO_SPMI_PIC_IRQ_STATUS474_ADDR A:0xe3a0104
y.create.l HWIO_SPMI_PIC_IRQ_STATUS475_ADDR A:0xe3b0104
y.create.l HWIO_SPMI_PIC_IRQ_STATUS476_ADDR A:0xe3c0104
y.create.l HWIO_SPMI_PIC_IRQ_STATUS477_ADDR A:0xe3d0104
y.create.l HWIO_SPMI_PIC_IRQ_STATUS478_ADDR A:0xe3e0104
y.create.l HWIO_SPMI_PIC_IRQ_STATUS479_ADDR A:0xe3f0104
y.create.l HWIO_SPMI_PIC_IRQ_STATUS480_ADDR A:0xe400104
y.create.l HWIO_SPMI_PIC_IRQ_STATUS481_ADDR A:0xe410104
y.create.l HWIO_SPMI_PIC_IRQ_STATUS482_ADDR A:0xe420104
y.create.l HWIO_SPMI_PIC_IRQ_STATUS483_ADDR A:0xe430104
y.create.l HWIO_SPMI_PIC_IRQ_STATUS484_ADDR A:0xe440104
y.create.l HWIO_SPMI_PIC_IRQ_STATUS485_ADDR A:0xe450104
y.create.l HWIO_SPMI_PIC_IRQ_STATUS486_ADDR A:0xe460104
y.create.l HWIO_SPMI_PIC_IRQ_STATUS487_ADDR A:0xe470104
y.create.l HWIO_SPMI_PIC_IRQ_STATUS488_ADDR A:0xe480104
y.create.l HWIO_SPMI_PIC_IRQ_STATUS489_ADDR A:0xe490104
y.create.l HWIO_SPMI_PIC_IRQ_STATUS490_ADDR A:0xe4a0104
y.create.l HWIO_SPMI_PIC_IRQ_STATUS491_ADDR A:0xe4b0104
y.create.l HWIO_SPMI_PIC_IRQ_STATUS492_ADDR A:0xe4c0104
y.create.l HWIO_SPMI_PIC_IRQ_STATUS493_ADDR A:0xe4d0104
y.create.l HWIO_SPMI_PIC_IRQ_STATUS494_ADDR A:0xe4e0104
y.create.l HWIO_SPMI_PIC_IRQ_STATUS495_ADDR A:0xe4f0104
y.create.l HWIO_SPMI_PIC_IRQ_STATUS496_ADDR A:0xe500104
y.create.l HWIO_SPMI_PIC_IRQ_STATUS497_ADDR A:0xe510104
y.create.l HWIO_SPMI_PIC_IRQ_STATUS498_ADDR A:0xe520104
y.create.l HWIO_SPMI_PIC_IRQ_STATUS499_ADDR A:0xe530104
y.create.l HWIO_SPMI_PIC_IRQ_STATUS500_ADDR A:0xe540104
y.create.l HWIO_SPMI_PIC_IRQ_STATUS501_ADDR A:0xe550104
y.create.l HWIO_SPMI_PIC_IRQ_STATUS502_ADDR A:0xe560104
y.create.l HWIO_SPMI_PIC_IRQ_STATUS503_ADDR A:0xe570104
y.create.l HWIO_SPMI_PIC_IRQ_STATUS504_ADDR A:0xe580104
y.create.l HWIO_SPMI_PIC_IRQ_STATUS505_ADDR A:0xe590104
y.create.l HWIO_SPMI_PIC_IRQ_STATUS506_ADDR A:0xe5a0104
y.create.l HWIO_SPMI_PIC_IRQ_STATUS507_ADDR A:0xe5b0104
y.create.l HWIO_SPMI_PIC_IRQ_STATUS508_ADDR A:0xe5c0104
y.create.l HWIO_SPMI_PIC_IRQ_STATUS509_ADDR A:0xe5d0104
y.create.l HWIO_SPMI_PIC_IRQ_STATUS510_ADDR A:0xe5e0104
y.create.l HWIO_SPMI_PIC_IRQ_STATUS511_ADDR A:0xe5f0104
y.create.l HWIO_SPMI_PIC_IRQ_CLEAR0_ADDR A:0xc600108
y.create.l HWIO_SPMI_PIC_IRQ_CLEAR1_ADDR A:0xc610108
y.create.l HWIO_SPMI_PIC_IRQ_CLEAR2_ADDR A:0xc620108
y.create.l HWIO_SPMI_PIC_IRQ_CLEAR3_ADDR A:0xc630108
y.create.l HWIO_SPMI_PIC_IRQ_CLEAR4_ADDR A:0xc640108
y.create.l HWIO_SPMI_PIC_IRQ_CLEAR5_ADDR A:0xc650108
y.create.l HWIO_SPMI_PIC_IRQ_CLEAR6_ADDR A:0xc660108
y.create.l HWIO_SPMI_PIC_IRQ_CLEAR7_ADDR A:0xc670108
y.create.l HWIO_SPMI_PIC_IRQ_CLEAR8_ADDR A:0xc680108
y.create.l HWIO_SPMI_PIC_IRQ_CLEAR9_ADDR A:0xc690108
y.create.l HWIO_SPMI_PIC_IRQ_CLEAR10_ADDR A:0xc6a0108
y.create.l HWIO_SPMI_PIC_IRQ_CLEAR11_ADDR A:0xc6b0108
y.create.l HWIO_SPMI_PIC_IRQ_CLEAR12_ADDR A:0xc6c0108
y.create.l HWIO_SPMI_PIC_IRQ_CLEAR13_ADDR A:0xc6d0108
y.create.l HWIO_SPMI_PIC_IRQ_CLEAR14_ADDR A:0xc6e0108
y.create.l HWIO_SPMI_PIC_IRQ_CLEAR15_ADDR A:0xc6f0108
y.create.l HWIO_SPMI_PIC_IRQ_CLEAR16_ADDR A:0xc700108
y.create.l HWIO_SPMI_PIC_IRQ_CLEAR17_ADDR A:0xc710108
y.create.l HWIO_SPMI_PIC_IRQ_CLEAR18_ADDR A:0xc720108
y.create.l HWIO_SPMI_PIC_IRQ_CLEAR19_ADDR A:0xc730108
y.create.l HWIO_SPMI_PIC_IRQ_CLEAR20_ADDR A:0xc740108
y.create.l HWIO_SPMI_PIC_IRQ_CLEAR21_ADDR A:0xc750108
y.create.l HWIO_SPMI_PIC_IRQ_CLEAR22_ADDR A:0xc760108
y.create.l HWIO_SPMI_PIC_IRQ_CLEAR23_ADDR A:0xc770108
y.create.l HWIO_SPMI_PIC_IRQ_CLEAR24_ADDR A:0xc780108
y.create.l HWIO_SPMI_PIC_IRQ_CLEAR25_ADDR A:0xc790108
y.create.l HWIO_SPMI_PIC_IRQ_CLEAR26_ADDR A:0xc7a0108
y.create.l HWIO_SPMI_PIC_IRQ_CLEAR27_ADDR A:0xc7b0108
y.create.l HWIO_SPMI_PIC_IRQ_CLEAR28_ADDR A:0xc7c0108
y.create.l HWIO_SPMI_PIC_IRQ_CLEAR29_ADDR A:0xc7d0108
y.create.l HWIO_SPMI_PIC_IRQ_CLEAR30_ADDR A:0xc7e0108
y.create.l HWIO_SPMI_PIC_IRQ_CLEAR31_ADDR A:0xc7f0108
y.create.l HWIO_SPMI_PIC_IRQ_CLEAR32_ADDR A:0xc800108
y.create.l HWIO_SPMI_PIC_IRQ_CLEAR33_ADDR A:0xc810108
y.create.l HWIO_SPMI_PIC_IRQ_CLEAR34_ADDR A:0xc820108
y.create.l HWIO_SPMI_PIC_IRQ_CLEAR35_ADDR A:0xc830108
y.create.l HWIO_SPMI_PIC_IRQ_CLEAR36_ADDR A:0xc840108
y.create.l HWIO_SPMI_PIC_IRQ_CLEAR37_ADDR A:0xc850108
y.create.l HWIO_SPMI_PIC_IRQ_CLEAR38_ADDR A:0xc860108
y.create.l HWIO_SPMI_PIC_IRQ_CLEAR39_ADDR A:0xc870108
y.create.l HWIO_SPMI_PIC_IRQ_CLEAR40_ADDR A:0xc880108
y.create.l HWIO_SPMI_PIC_IRQ_CLEAR41_ADDR A:0xc890108
y.create.l HWIO_SPMI_PIC_IRQ_CLEAR42_ADDR A:0xc8a0108
y.create.l HWIO_SPMI_PIC_IRQ_CLEAR43_ADDR A:0xc8b0108
y.create.l HWIO_SPMI_PIC_IRQ_CLEAR44_ADDR A:0xc8c0108
y.create.l HWIO_SPMI_PIC_IRQ_CLEAR45_ADDR A:0xc8d0108
y.create.l HWIO_SPMI_PIC_IRQ_CLEAR46_ADDR A:0xc8e0108
y.create.l HWIO_SPMI_PIC_IRQ_CLEAR47_ADDR A:0xc8f0108
y.create.l HWIO_SPMI_PIC_IRQ_CLEAR48_ADDR A:0xc900108
y.create.l HWIO_SPMI_PIC_IRQ_CLEAR49_ADDR A:0xc910108
y.create.l HWIO_SPMI_PIC_IRQ_CLEAR50_ADDR A:0xc920108
y.create.l HWIO_SPMI_PIC_IRQ_CLEAR51_ADDR A:0xc930108
y.create.l HWIO_SPMI_PIC_IRQ_CLEAR52_ADDR A:0xc940108
y.create.l HWIO_SPMI_PIC_IRQ_CLEAR53_ADDR A:0xc950108
y.create.l HWIO_SPMI_PIC_IRQ_CLEAR54_ADDR A:0xc960108
y.create.l HWIO_SPMI_PIC_IRQ_CLEAR55_ADDR A:0xc970108
y.create.l HWIO_SPMI_PIC_IRQ_CLEAR56_ADDR A:0xc980108
y.create.l HWIO_SPMI_PIC_IRQ_CLEAR57_ADDR A:0xc990108
y.create.l HWIO_SPMI_PIC_IRQ_CLEAR58_ADDR A:0xc9a0108
y.create.l HWIO_SPMI_PIC_IRQ_CLEAR59_ADDR A:0xc9b0108
y.create.l HWIO_SPMI_PIC_IRQ_CLEAR60_ADDR A:0xc9c0108
y.create.l HWIO_SPMI_PIC_IRQ_CLEAR61_ADDR A:0xc9d0108
y.create.l HWIO_SPMI_PIC_IRQ_CLEAR62_ADDR A:0xc9e0108
y.create.l HWIO_SPMI_PIC_IRQ_CLEAR63_ADDR A:0xc9f0108
y.create.l HWIO_SPMI_PIC_IRQ_CLEAR64_ADDR A:0xca00108
y.create.l HWIO_SPMI_PIC_IRQ_CLEAR65_ADDR A:0xca10108
y.create.l HWIO_SPMI_PIC_IRQ_CLEAR66_ADDR A:0xca20108
y.create.l HWIO_SPMI_PIC_IRQ_CLEAR67_ADDR A:0xca30108
y.create.l HWIO_SPMI_PIC_IRQ_CLEAR68_ADDR A:0xca40108
y.create.l HWIO_SPMI_PIC_IRQ_CLEAR69_ADDR A:0xca50108
y.create.l HWIO_SPMI_PIC_IRQ_CLEAR70_ADDR A:0xca60108
y.create.l HWIO_SPMI_PIC_IRQ_CLEAR71_ADDR A:0xca70108
y.create.l HWIO_SPMI_PIC_IRQ_CLEAR72_ADDR A:0xca80108
y.create.l HWIO_SPMI_PIC_IRQ_CLEAR73_ADDR A:0xca90108
y.create.l HWIO_SPMI_PIC_IRQ_CLEAR74_ADDR A:0xcaa0108
y.create.l HWIO_SPMI_PIC_IRQ_CLEAR75_ADDR A:0xcab0108
y.create.l HWIO_SPMI_PIC_IRQ_CLEAR76_ADDR A:0xcac0108
y.create.l HWIO_SPMI_PIC_IRQ_CLEAR77_ADDR A:0xcad0108
y.create.l HWIO_SPMI_PIC_IRQ_CLEAR78_ADDR A:0xcae0108
y.create.l HWIO_SPMI_PIC_IRQ_CLEAR79_ADDR A:0xcaf0108
y.create.l HWIO_SPMI_PIC_IRQ_CLEAR80_ADDR A:0xcb00108
y.create.l HWIO_SPMI_PIC_IRQ_CLEAR81_ADDR A:0xcb10108
y.create.l HWIO_SPMI_PIC_IRQ_CLEAR82_ADDR A:0xcb20108
y.create.l HWIO_SPMI_PIC_IRQ_CLEAR83_ADDR A:0xcb30108
y.create.l HWIO_SPMI_PIC_IRQ_CLEAR84_ADDR A:0xcb40108
y.create.l HWIO_SPMI_PIC_IRQ_CLEAR85_ADDR A:0xcb50108
y.create.l HWIO_SPMI_PIC_IRQ_CLEAR86_ADDR A:0xcb60108
y.create.l HWIO_SPMI_PIC_IRQ_CLEAR87_ADDR A:0xcb70108
y.create.l HWIO_SPMI_PIC_IRQ_CLEAR88_ADDR A:0xcb80108
y.create.l HWIO_SPMI_PIC_IRQ_CLEAR89_ADDR A:0xcb90108
y.create.l HWIO_SPMI_PIC_IRQ_CLEAR90_ADDR A:0xcba0108
y.create.l HWIO_SPMI_PIC_IRQ_CLEAR91_ADDR A:0xcbb0108
y.create.l HWIO_SPMI_PIC_IRQ_CLEAR92_ADDR A:0xcbc0108
y.create.l HWIO_SPMI_PIC_IRQ_CLEAR93_ADDR A:0xcbd0108
y.create.l HWIO_SPMI_PIC_IRQ_CLEAR94_ADDR A:0xcbe0108
y.create.l HWIO_SPMI_PIC_IRQ_CLEAR95_ADDR A:0xcbf0108
y.create.l HWIO_SPMI_PIC_IRQ_CLEAR96_ADDR A:0xcc00108
y.create.l HWIO_SPMI_PIC_IRQ_CLEAR97_ADDR A:0xcc10108
y.create.l HWIO_SPMI_PIC_IRQ_CLEAR98_ADDR A:0xcc20108
y.create.l HWIO_SPMI_PIC_IRQ_CLEAR99_ADDR A:0xcc30108
y.create.l HWIO_SPMI_PIC_IRQ_CLEAR100_ADDR A:0xcc40108
y.create.l HWIO_SPMI_PIC_IRQ_CLEAR101_ADDR A:0xcc50108
y.create.l HWIO_SPMI_PIC_IRQ_CLEAR102_ADDR A:0xcc60108
y.create.l HWIO_SPMI_PIC_IRQ_CLEAR103_ADDR A:0xcc70108
y.create.l HWIO_SPMI_PIC_IRQ_CLEAR104_ADDR A:0xcc80108
y.create.l HWIO_SPMI_PIC_IRQ_CLEAR105_ADDR A:0xcc90108
y.create.l HWIO_SPMI_PIC_IRQ_CLEAR106_ADDR A:0xcca0108
y.create.l HWIO_SPMI_PIC_IRQ_CLEAR107_ADDR A:0xccb0108
y.create.l HWIO_SPMI_PIC_IRQ_CLEAR108_ADDR A:0xccc0108
y.create.l HWIO_SPMI_PIC_IRQ_CLEAR109_ADDR A:0xccd0108
y.create.l HWIO_SPMI_PIC_IRQ_CLEAR110_ADDR A:0xcce0108
y.create.l HWIO_SPMI_PIC_IRQ_CLEAR111_ADDR A:0xccf0108
y.create.l HWIO_SPMI_PIC_IRQ_CLEAR112_ADDR A:0xcd00108
y.create.l HWIO_SPMI_PIC_IRQ_CLEAR113_ADDR A:0xcd10108
y.create.l HWIO_SPMI_PIC_IRQ_CLEAR114_ADDR A:0xcd20108
y.create.l HWIO_SPMI_PIC_IRQ_CLEAR115_ADDR A:0xcd30108
y.create.l HWIO_SPMI_PIC_IRQ_CLEAR116_ADDR A:0xcd40108
y.create.l HWIO_SPMI_PIC_IRQ_CLEAR117_ADDR A:0xcd50108
y.create.l HWIO_SPMI_PIC_IRQ_CLEAR118_ADDR A:0xcd60108
y.create.l HWIO_SPMI_PIC_IRQ_CLEAR119_ADDR A:0xcd70108
y.create.l HWIO_SPMI_PIC_IRQ_CLEAR120_ADDR A:0xcd80108
y.create.l HWIO_SPMI_PIC_IRQ_CLEAR121_ADDR A:0xcd90108
y.create.l HWIO_SPMI_PIC_IRQ_CLEAR122_ADDR A:0xcda0108
y.create.l HWIO_SPMI_PIC_IRQ_CLEAR123_ADDR A:0xcdb0108
y.create.l HWIO_SPMI_PIC_IRQ_CLEAR124_ADDR A:0xcdc0108
y.create.l HWIO_SPMI_PIC_IRQ_CLEAR125_ADDR A:0xcdd0108
y.create.l HWIO_SPMI_PIC_IRQ_CLEAR126_ADDR A:0xcde0108
y.create.l HWIO_SPMI_PIC_IRQ_CLEAR127_ADDR A:0xcdf0108
y.create.l HWIO_SPMI_PIC_IRQ_CLEAR128_ADDR A:0xce00108
y.create.l HWIO_SPMI_PIC_IRQ_CLEAR129_ADDR A:0xce10108
y.create.l HWIO_SPMI_PIC_IRQ_CLEAR130_ADDR A:0xce20108
y.create.l HWIO_SPMI_PIC_IRQ_CLEAR131_ADDR A:0xce30108
y.create.l HWIO_SPMI_PIC_IRQ_CLEAR132_ADDR A:0xce40108
y.create.l HWIO_SPMI_PIC_IRQ_CLEAR133_ADDR A:0xce50108
y.create.l HWIO_SPMI_PIC_IRQ_CLEAR134_ADDR A:0xce60108
y.create.l HWIO_SPMI_PIC_IRQ_CLEAR135_ADDR A:0xce70108
y.create.l HWIO_SPMI_PIC_IRQ_CLEAR136_ADDR A:0xce80108
y.create.l HWIO_SPMI_PIC_IRQ_CLEAR137_ADDR A:0xce90108
y.create.l HWIO_SPMI_PIC_IRQ_CLEAR138_ADDR A:0xcea0108
y.create.l HWIO_SPMI_PIC_IRQ_CLEAR139_ADDR A:0xceb0108
y.create.l HWIO_SPMI_PIC_IRQ_CLEAR140_ADDR A:0xcec0108
y.create.l HWIO_SPMI_PIC_IRQ_CLEAR141_ADDR A:0xced0108
y.create.l HWIO_SPMI_PIC_IRQ_CLEAR142_ADDR A:0xcee0108
y.create.l HWIO_SPMI_PIC_IRQ_CLEAR143_ADDR A:0xcef0108
y.create.l HWIO_SPMI_PIC_IRQ_CLEAR144_ADDR A:0xcf00108
y.create.l HWIO_SPMI_PIC_IRQ_CLEAR145_ADDR A:0xcf10108
y.create.l HWIO_SPMI_PIC_IRQ_CLEAR146_ADDR A:0xcf20108
y.create.l HWIO_SPMI_PIC_IRQ_CLEAR147_ADDR A:0xcf30108
y.create.l HWIO_SPMI_PIC_IRQ_CLEAR148_ADDR A:0xcf40108
y.create.l HWIO_SPMI_PIC_IRQ_CLEAR149_ADDR A:0xcf50108
y.create.l HWIO_SPMI_PIC_IRQ_CLEAR150_ADDR A:0xcf60108
y.create.l HWIO_SPMI_PIC_IRQ_CLEAR151_ADDR A:0xcf70108
y.create.l HWIO_SPMI_PIC_IRQ_CLEAR152_ADDR A:0xcf80108
y.create.l HWIO_SPMI_PIC_IRQ_CLEAR153_ADDR A:0xcf90108
y.create.l HWIO_SPMI_PIC_IRQ_CLEAR154_ADDR A:0xcfa0108
y.create.l HWIO_SPMI_PIC_IRQ_CLEAR155_ADDR A:0xcfb0108
y.create.l HWIO_SPMI_PIC_IRQ_CLEAR156_ADDR A:0xcfc0108
y.create.l HWIO_SPMI_PIC_IRQ_CLEAR157_ADDR A:0xcfd0108
y.create.l HWIO_SPMI_PIC_IRQ_CLEAR158_ADDR A:0xcfe0108
y.create.l HWIO_SPMI_PIC_IRQ_CLEAR159_ADDR A:0xcff0108
y.create.l HWIO_SPMI_PIC_IRQ_CLEAR160_ADDR A:0xd000108
y.create.l HWIO_SPMI_PIC_IRQ_CLEAR161_ADDR A:0xd010108
y.create.l HWIO_SPMI_PIC_IRQ_CLEAR162_ADDR A:0xd020108
y.create.l HWIO_SPMI_PIC_IRQ_CLEAR163_ADDR A:0xd030108
y.create.l HWIO_SPMI_PIC_IRQ_CLEAR164_ADDR A:0xd040108
y.create.l HWIO_SPMI_PIC_IRQ_CLEAR165_ADDR A:0xd050108
y.create.l HWIO_SPMI_PIC_IRQ_CLEAR166_ADDR A:0xd060108
y.create.l HWIO_SPMI_PIC_IRQ_CLEAR167_ADDR A:0xd070108
y.create.l HWIO_SPMI_PIC_IRQ_CLEAR168_ADDR A:0xd080108
y.create.l HWIO_SPMI_PIC_IRQ_CLEAR169_ADDR A:0xd090108
y.create.l HWIO_SPMI_PIC_IRQ_CLEAR170_ADDR A:0xd0a0108
y.create.l HWIO_SPMI_PIC_IRQ_CLEAR171_ADDR A:0xd0b0108
y.create.l HWIO_SPMI_PIC_IRQ_CLEAR172_ADDR A:0xd0c0108
y.create.l HWIO_SPMI_PIC_IRQ_CLEAR173_ADDR A:0xd0d0108
y.create.l HWIO_SPMI_PIC_IRQ_CLEAR174_ADDR A:0xd0e0108
y.create.l HWIO_SPMI_PIC_IRQ_CLEAR175_ADDR A:0xd0f0108
y.create.l HWIO_SPMI_PIC_IRQ_CLEAR176_ADDR A:0xd100108
y.create.l HWIO_SPMI_PIC_IRQ_CLEAR177_ADDR A:0xd110108
y.create.l HWIO_SPMI_PIC_IRQ_CLEAR178_ADDR A:0xd120108
y.create.l HWIO_SPMI_PIC_IRQ_CLEAR179_ADDR A:0xd130108
y.create.l HWIO_SPMI_PIC_IRQ_CLEAR180_ADDR A:0xd140108
y.create.l HWIO_SPMI_PIC_IRQ_CLEAR181_ADDR A:0xd150108
y.create.l HWIO_SPMI_PIC_IRQ_CLEAR182_ADDR A:0xd160108
y.create.l HWIO_SPMI_PIC_IRQ_CLEAR183_ADDR A:0xd170108
y.create.l HWIO_SPMI_PIC_IRQ_CLEAR184_ADDR A:0xd180108
y.create.l HWIO_SPMI_PIC_IRQ_CLEAR185_ADDR A:0xd190108
y.create.l HWIO_SPMI_PIC_IRQ_CLEAR186_ADDR A:0xd1a0108
y.create.l HWIO_SPMI_PIC_IRQ_CLEAR187_ADDR A:0xd1b0108
y.create.l HWIO_SPMI_PIC_IRQ_CLEAR188_ADDR A:0xd1c0108
y.create.l HWIO_SPMI_PIC_IRQ_CLEAR189_ADDR A:0xd1d0108
y.create.l HWIO_SPMI_PIC_IRQ_CLEAR190_ADDR A:0xd1e0108
y.create.l HWIO_SPMI_PIC_IRQ_CLEAR191_ADDR A:0xd1f0108
y.create.l HWIO_SPMI_PIC_IRQ_CLEAR192_ADDR A:0xd200108
y.create.l HWIO_SPMI_PIC_IRQ_CLEAR193_ADDR A:0xd210108
y.create.l HWIO_SPMI_PIC_IRQ_CLEAR194_ADDR A:0xd220108
y.create.l HWIO_SPMI_PIC_IRQ_CLEAR195_ADDR A:0xd230108
y.create.l HWIO_SPMI_PIC_IRQ_CLEAR196_ADDR A:0xd240108
y.create.l HWIO_SPMI_PIC_IRQ_CLEAR197_ADDR A:0xd250108
y.create.l HWIO_SPMI_PIC_IRQ_CLEAR198_ADDR A:0xd260108
y.create.l HWIO_SPMI_PIC_IRQ_CLEAR199_ADDR A:0xd270108
y.create.l HWIO_SPMI_PIC_IRQ_CLEAR200_ADDR A:0xd280108
y.create.l HWIO_SPMI_PIC_IRQ_CLEAR201_ADDR A:0xd290108
y.create.l HWIO_SPMI_PIC_IRQ_CLEAR202_ADDR A:0xd2a0108
y.create.l HWIO_SPMI_PIC_IRQ_CLEAR203_ADDR A:0xd2b0108
y.create.l HWIO_SPMI_PIC_IRQ_CLEAR204_ADDR A:0xd2c0108
y.create.l HWIO_SPMI_PIC_IRQ_CLEAR205_ADDR A:0xd2d0108
y.create.l HWIO_SPMI_PIC_IRQ_CLEAR206_ADDR A:0xd2e0108
y.create.l HWIO_SPMI_PIC_IRQ_CLEAR207_ADDR A:0xd2f0108
y.create.l HWIO_SPMI_PIC_IRQ_CLEAR208_ADDR A:0xd300108
y.create.l HWIO_SPMI_PIC_IRQ_CLEAR209_ADDR A:0xd310108
y.create.l HWIO_SPMI_PIC_IRQ_CLEAR210_ADDR A:0xd320108
y.create.l HWIO_SPMI_PIC_IRQ_CLEAR211_ADDR A:0xd330108
y.create.l HWIO_SPMI_PIC_IRQ_CLEAR212_ADDR A:0xd340108
y.create.l HWIO_SPMI_PIC_IRQ_CLEAR213_ADDR A:0xd350108
y.create.l HWIO_SPMI_PIC_IRQ_CLEAR214_ADDR A:0xd360108
y.create.l HWIO_SPMI_PIC_IRQ_CLEAR215_ADDR A:0xd370108
y.create.l HWIO_SPMI_PIC_IRQ_CLEAR216_ADDR A:0xd380108
y.create.l HWIO_SPMI_PIC_IRQ_CLEAR217_ADDR A:0xd390108
y.create.l HWIO_SPMI_PIC_IRQ_CLEAR218_ADDR A:0xd3a0108
y.create.l HWIO_SPMI_PIC_IRQ_CLEAR219_ADDR A:0xd3b0108
y.create.l HWIO_SPMI_PIC_IRQ_CLEAR220_ADDR A:0xd3c0108
y.create.l HWIO_SPMI_PIC_IRQ_CLEAR221_ADDR A:0xd3d0108
y.create.l HWIO_SPMI_PIC_IRQ_CLEAR222_ADDR A:0xd3e0108
y.create.l HWIO_SPMI_PIC_IRQ_CLEAR223_ADDR A:0xd3f0108
y.create.l HWIO_SPMI_PIC_IRQ_CLEAR224_ADDR A:0xd400108
y.create.l HWIO_SPMI_PIC_IRQ_CLEAR225_ADDR A:0xd410108
y.create.l HWIO_SPMI_PIC_IRQ_CLEAR226_ADDR A:0xd420108
y.create.l HWIO_SPMI_PIC_IRQ_CLEAR227_ADDR A:0xd430108
y.create.l HWIO_SPMI_PIC_IRQ_CLEAR228_ADDR A:0xd440108
y.create.l HWIO_SPMI_PIC_IRQ_CLEAR229_ADDR A:0xd450108
y.create.l HWIO_SPMI_PIC_IRQ_CLEAR230_ADDR A:0xd460108
y.create.l HWIO_SPMI_PIC_IRQ_CLEAR231_ADDR A:0xd470108
y.create.l HWIO_SPMI_PIC_IRQ_CLEAR232_ADDR A:0xd480108
y.create.l HWIO_SPMI_PIC_IRQ_CLEAR233_ADDR A:0xd490108
y.create.l HWIO_SPMI_PIC_IRQ_CLEAR234_ADDR A:0xd4a0108
y.create.l HWIO_SPMI_PIC_IRQ_CLEAR235_ADDR A:0xd4b0108
y.create.l HWIO_SPMI_PIC_IRQ_CLEAR236_ADDR A:0xd4c0108
y.create.l HWIO_SPMI_PIC_IRQ_CLEAR237_ADDR A:0xd4d0108
y.create.l HWIO_SPMI_PIC_IRQ_CLEAR238_ADDR A:0xd4e0108
y.create.l HWIO_SPMI_PIC_IRQ_CLEAR239_ADDR A:0xd4f0108
y.create.l HWIO_SPMI_PIC_IRQ_CLEAR240_ADDR A:0xd500108
y.create.l HWIO_SPMI_PIC_IRQ_CLEAR241_ADDR A:0xd510108
y.create.l HWIO_SPMI_PIC_IRQ_CLEAR242_ADDR A:0xd520108
y.create.l HWIO_SPMI_PIC_IRQ_CLEAR243_ADDR A:0xd530108
y.create.l HWIO_SPMI_PIC_IRQ_CLEAR244_ADDR A:0xd540108
y.create.l HWIO_SPMI_PIC_IRQ_CLEAR245_ADDR A:0xd550108
y.create.l HWIO_SPMI_PIC_IRQ_CLEAR246_ADDR A:0xd560108
y.create.l HWIO_SPMI_PIC_IRQ_CLEAR247_ADDR A:0xd570108
y.create.l HWIO_SPMI_PIC_IRQ_CLEAR248_ADDR A:0xd580108
y.create.l HWIO_SPMI_PIC_IRQ_CLEAR249_ADDR A:0xd590108
y.create.l HWIO_SPMI_PIC_IRQ_CLEAR250_ADDR A:0xd5a0108
y.create.l HWIO_SPMI_PIC_IRQ_CLEAR251_ADDR A:0xd5b0108
y.create.l HWIO_SPMI_PIC_IRQ_CLEAR252_ADDR A:0xd5c0108
y.create.l HWIO_SPMI_PIC_IRQ_CLEAR253_ADDR A:0xd5d0108
y.create.l HWIO_SPMI_PIC_IRQ_CLEAR254_ADDR A:0xd5e0108
y.create.l HWIO_SPMI_PIC_IRQ_CLEAR255_ADDR A:0xd5f0108
y.create.l HWIO_SPMI_PIC_IRQ_CLEAR256_ADDR A:0xd600108
y.create.l HWIO_SPMI_PIC_IRQ_CLEAR257_ADDR A:0xd610108
y.create.l HWIO_SPMI_PIC_IRQ_CLEAR258_ADDR A:0xd620108
y.create.l HWIO_SPMI_PIC_IRQ_CLEAR259_ADDR A:0xd630108
y.create.l HWIO_SPMI_PIC_IRQ_CLEAR260_ADDR A:0xd640108
y.create.l HWIO_SPMI_PIC_IRQ_CLEAR261_ADDR A:0xd650108
y.create.l HWIO_SPMI_PIC_IRQ_CLEAR262_ADDR A:0xd660108
y.create.l HWIO_SPMI_PIC_IRQ_CLEAR263_ADDR A:0xd670108
y.create.l HWIO_SPMI_PIC_IRQ_CLEAR264_ADDR A:0xd680108
y.create.l HWIO_SPMI_PIC_IRQ_CLEAR265_ADDR A:0xd690108
y.create.l HWIO_SPMI_PIC_IRQ_CLEAR266_ADDR A:0xd6a0108
y.create.l HWIO_SPMI_PIC_IRQ_CLEAR267_ADDR A:0xd6b0108
y.create.l HWIO_SPMI_PIC_IRQ_CLEAR268_ADDR A:0xd6c0108
y.create.l HWIO_SPMI_PIC_IRQ_CLEAR269_ADDR A:0xd6d0108
y.create.l HWIO_SPMI_PIC_IRQ_CLEAR270_ADDR A:0xd6e0108
y.create.l HWIO_SPMI_PIC_IRQ_CLEAR271_ADDR A:0xd6f0108
y.create.l HWIO_SPMI_PIC_IRQ_CLEAR272_ADDR A:0xd700108
y.create.l HWIO_SPMI_PIC_IRQ_CLEAR273_ADDR A:0xd710108
y.create.l HWIO_SPMI_PIC_IRQ_CLEAR274_ADDR A:0xd720108
y.create.l HWIO_SPMI_PIC_IRQ_CLEAR275_ADDR A:0xd730108
y.create.l HWIO_SPMI_PIC_IRQ_CLEAR276_ADDR A:0xd740108
y.create.l HWIO_SPMI_PIC_IRQ_CLEAR277_ADDR A:0xd750108
y.create.l HWIO_SPMI_PIC_IRQ_CLEAR278_ADDR A:0xd760108
y.create.l HWIO_SPMI_PIC_IRQ_CLEAR279_ADDR A:0xd770108
y.create.l HWIO_SPMI_PIC_IRQ_CLEAR280_ADDR A:0xd780108
y.create.l HWIO_SPMI_PIC_IRQ_CLEAR281_ADDR A:0xd790108
y.create.l HWIO_SPMI_PIC_IRQ_CLEAR282_ADDR A:0xd7a0108
y.create.l HWIO_SPMI_PIC_IRQ_CLEAR283_ADDR A:0xd7b0108
y.create.l HWIO_SPMI_PIC_IRQ_CLEAR284_ADDR A:0xd7c0108
y.create.l HWIO_SPMI_PIC_IRQ_CLEAR285_ADDR A:0xd7d0108
y.create.l HWIO_SPMI_PIC_IRQ_CLEAR286_ADDR A:0xd7e0108
y.create.l HWIO_SPMI_PIC_IRQ_CLEAR287_ADDR A:0xd7f0108
y.create.l HWIO_SPMI_PIC_IRQ_CLEAR288_ADDR A:0xd800108
y.create.l HWIO_SPMI_PIC_IRQ_CLEAR289_ADDR A:0xd810108
y.create.l HWIO_SPMI_PIC_IRQ_CLEAR290_ADDR A:0xd820108
y.create.l HWIO_SPMI_PIC_IRQ_CLEAR291_ADDR A:0xd830108
y.create.l HWIO_SPMI_PIC_IRQ_CLEAR292_ADDR A:0xd840108
y.create.l HWIO_SPMI_PIC_IRQ_CLEAR293_ADDR A:0xd850108
y.create.l HWIO_SPMI_PIC_IRQ_CLEAR294_ADDR A:0xd860108
y.create.l HWIO_SPMI_PIC_IRQ_CLEAR295_ADDR A:0xd870108
y.create.l HWIO_SPMI_PIC_IRQ_CLEAR296_ADDR A:0xd880108
y.create.l HWIO_SPMI_PIC_IRQ_CLEAR297_ADDR A:0xd890108
y.create.l HWIO_SPMI_PIC_IRQ_CLEAR298_ADDR A:0xd8a0108
y.create.l HWIO_SPMI_PIC_IRQ_CLEAR299_ADDR A:0xd8b0108
y.create.l HWIO_SPMI_PIC_IRQ_CLEAR300_ADDR A:0xd8c0108
y.create.l HWIO_SPMI_PIC_IRQ_CLEAR301_ADDR A:0xd8d0108
y.create.l HWIO_SPMI_PIC_IRQ_CLEAR302_ADDR A:0xd8e0108
y.create.l HWIO_SPMI_PIC_IRQ_CLEAR303_ADDR A:0xd8f0108
y.create.l HWIO_SPMI_PIC_IRQ_CLEAR304_ADDR A:0xd900108
y.create.l HWIO_SPMI_PIC_IRQ_CLEAR305_ADDR A:0xd910108
y.create.l HWIO_SPMI_PIC_IRQ_CLEAR306_ADDR A:0xd920108
y.create.l HWIO_SPMI_PIC_IRQ_CLEAR307_ADDR A:0xd930108
y.create.l HWIO_SPMI_PIC_IRQ_CLEAR308_ADDR A:0xd940108
y.create.l HWIO_SPMI_PIC_IRQ_CLEAR309_ADDR A:0xd950108
y.create.l HWIO_SPMI_PIC_IRQ_CLEAR310_ADDR A:0xd960108
y.create.l HWIO_SPMI_PIC_IRQ_CLEAR311_ADDR A:0xd970108
y.create.l HWIO_SPMI_PIC_IRQ_CLEAR312_ADDR A:0xd980108
y.create.l HWIO_SPMI_PIC_IRQ_CLEAR313_ADDR A:0xd990108
y.create.l HWIO_SPMI_PIC_IRQ_CLEAR314_ADDR A:0xd9a0108
y.create.l HWIO_SPMI_PIC_IRQ_CLEAR315_ADDR A:0xd9b0108
y.create.l HWIO_SPMI_PIC_IRQ_CLEAR316_ADDR A:0xd9c0108
y.create.l HWIO_SPMI_PIC_IRQ_CLEAR317_ADDR A:0xd9d0108
y.create.l HWIO_SPMI_PIC_IRQ_CLEAR318_ADDR A:0xd9e0108
y.create.l HWIO_SPMI_PIC_IRQ_CLEAR319_ADDR A:0xd9f0108
y.create.l HWIO_SPMI_PIC_IRQ_CLEAR320_ADDR A:0xda00108
y.create.l HWIO_SPMI_PIC_IRQ_CLEAR321_ADDR A:0xda10108
y.create.l HWIO_SPMI_PIC_IRQ_CLEAR322_ADDR A:0xda20108
y.create.l HWIO_SPMI_PIC_IRQ_CLEAR323_ADDR A:0xda30108
y.create.l HWIO_SPMI_PIC_IRQ_CLEAR324_ADDR A:0xda40108
y.create.l HWIO_SPMI_PIC_IRQ_CLEAR325_ADDR A:0xda50108
y.create.l HWIO_SPMI_PIC_IRQ_CLEAR326_ADDR A:0xda60108
y.create.l HWIO_SPMI_PIC_IRQ_CLEAR327_ADDR A:0xda70108
y.create.l HWIO_SPMI_PIC_IRQ_CLEAR328_ADDR A:0xda80108
y.create.l HWIO_SPMI_PIC_IRQ_CLEAR329_ADDR A:0xda90108
y.create.l HWIO_SPMI_PIC_IRQ_CLEAR330_ADDR A:0xdaa0108
y.create.l HWIO_SPMI_PIC_IRQ_CLEAR331_ADDR A:0xdab0108
y.create.l HWIO_SPMI_PIC_IRQ_CLEAR332_ADDR A:0xdac0108
y.create.l HWIO_SPMI_PIC_IRQ_CLEAR333_ADDR A:0xdad0108
y.create.l HWIO_SPMI_PIC_IRQ_CLEAR334_ADDR A:0xdae0108
y.create.l HWIO_SPMI_PIC_IRQ_CLEAR335_ADDR A:0xdaf0108
y.create.l HWIO_SPMI_PIC_IRQ_CLEAR336_ADDR A:0xdb00108
y.create.l HWIO_SPMI_PIC_IRQ_CLEAR337_ADDR A:0xdb10108
y.create.l HWIO_SPMI_PIC_IRQ_CLEAR338_ADDR A:0xdb20108
y.create.l HWIO_SPMI_PIC_IRQ_CLEAR339_ADDR A:0xdb30108
y.create.l HWIO_SPMI_PIC_IRQ_CLEAR340_ADDR A:0xdb40108
y.create.l HWIO_SPMI_PIC_IRQ_CLEAR341_ADDR A:0xdb50108
y.create.l HWIO_SPMI_PIC_IRQ_CLEAR342_ADDR A:0xdb60108
y.create.l HWIO_SPMI_PIC_IRQ_CLEAR343_ADDR A:0xdb70108
y.create.l HWIO_SPMI_PIC_IRQ_CLEAR344_ADDR A:0xdb80108
y.create.l HWIO_SPMI_PIC_IRQ_CLEAR345_ADDR A:0xdb90108
y.create.l HWIO_SPMI_PIC_IRQ_CLEAR346_ADDR A:0xdba0108
y.create.l HWIO_SPMI_PIC_IRQ_CLEAR347_ADDR A:0xdbb0108
y.create.l HWIO_SPMI_PIC_IRQ_CLEAR348_ADDR A:0xdbc0108
y.create.l HWIO_SPMI_PIC_IRQ_CLEAR349_ADDR A:0xdbd0108
y.create.l HWIO_SPMI_PIC_IRQ_CLEAR350_ADDR A:0xdbe0108
y.create.l HWIO_SPMI_PIC_IRQ_CLEAR351_ADDR A:0xdbf0108
y.create.l HWIO_SPMI_PIC_IRQ_CLEAR352_ADDR A:0xdc00108
y.create.l HWIO_SPMI_PIC_IRQ_CLEAR353_ADDR A:0xdc10108
y.create.l HWIO_SPMI_PIC_IRQ_CLEAR354_ADDR A:0xdc20108
y.create.l HWIO_SPMI_PIC_IRQ_CLEAR355_ADDR A:0xdc30108
y.create.l HWIO_SPMI_PIC_IRQ_CLEAR356_ADDR A:0xdc40108
y.create.l HWIO_SPMI_PIC_IRQ_CLEAR357_ADDR A:0xdc50108
y.create.l HWIO_SPMI_PIC_IRQ_CLEAR358_ADDR A:0xdc60108
y.create.l HWIO_SPMI_PIC_IRQ_CLEAR359_ADDR A:0xdc70108
y.create.l HWIO_SPMI_PIC_IRQ_CLEAR360_ADDR A:0xdc80108
y.create.l HWIO_SPMI_PIC_IRQ_CLEAR361_ADDR A:0xdc90108
y.create.l HWIO_SPMI_PIC_IRQ_CLEAR362_ADDR A:0xdca0108
y.create.l HWIO_SPMI_PIC_IRQ_CLEAR363_ADDR A:0xdcb0108
y.create.l HWIO_SPMI_PIC_IRQ_CLEAR364_ADDR A:0xdcc0108
y.create.l HWIO_SPMI_PIC_IRQ_CLEAR365_ADDR A:0xdcd0108
y.create.l HWIO_SPMI_PIC_IRQ_CLEAR366_ADDR A:0xdce0108
y.create.l HWIO_SPMI_PIC_IRQ_CLEAR367_ADDR A:0xdcf0108
y.create.l HWIO_SPMI_PIC_IRQ_CLEAR368_ADDR A:0xdd00108
y.create.l HWIO_SPMI_PIC_IRQ_CLEAR369_ADDR A:0xdd10108
y.create.l HWIO_SPMI_PIC_IRQ_CLEAR370_ADDR A:0xdd20108
y.create.l HWIO_SPMI_PIC_IRQ_CLEAR371_ADDR A:0xdd30108
y.create.l HWIO_SPMI_PIC_IRQ_CLEAR372_ADDR A:0xdd40108
y.create.l HWIO_SPMI_PIC_IRQ_CLEAR373_ADDR A:0xdd50108
y.create.l HWIO_SPMI_PIC_IRQ_CLEAR374_ADDR A:0xdd60108
y.create.l HWIO_SPMI_PIC_IRQ_CLEAR375_ADDR A:0xdd70108
y.create.l HWIO_SPMI_PIC_IRQ_CLEAR376_ADDR A:0xdd80108
y.create.l HWIO_SPMI_PIC_IRQ_CLEAR377_ADDR A:0xdd90108
y.create.l HWIO_SPMI_PIC_IRQ_CLEAR378_ADDR A:0xdda0108
y.create.l HWIO_SPMI_PIC_IRQ_CLEAR379_ADDR A:0xddb0108
y.create.l HWIO_SPMI_PIC_IRQ_CLEAR380_ADDR A:0xddc0108
y.create.l HWIO_SPMI_PIC_IRQ_CLEAR381_ADDR A:0xddd0108
y.create.l HWIO_SPMI_PIC_IRQ_CLEAR382_ADDR A:0xdde0108
y.create.l HWIO_SPMI_PIC_IRQ_CLEAR383_ADDR A:0xddf0108
y.create.l HWIO_SPMI_PIC_IRQ_CLEAR384_ADDR A:0xde00108
y.create.l HWIO_SPMI_PIC_IRQ_CLEAR385_ADDR A:0xde10108
y.create.l HWIO_SPMI_PIC_IRQ_CLEAR386_ADDR A:0xde20108
y.create.l HWIO_SPMI_PIC_IRQ_CLEAR387_ADDR A:0xde30108
y.create.l HWIO_SPMI_PIC_IRQ_CLEAR388_ADDR A:0xde40108
y.create.l HWIO_SPMI_PIC_IRQ_CLEAR389_ADDR A:0xde50108
y.create.l HWIO_SPMI_PIC_IRQ_CLEAR390_ADDR A:0xde60108
y.create.l HWIO_SPMI_PIC_IRQ_CLEAR391_ADDR A:0xde70108
y.create.l HWIO_SPMI_PIC_IRQ_CLEAR392_ADDR A:0xde80108
y.create.l HWIO_SPMI_PIC_IRQ_CLEAR393_ADDR A:0xde90108
y.create.l HWIO_SPMI_PIC_IRQ_CLEAR394_ADDR A:0xdea0108
y.create.l HWIO_SPMI_PIC_IRQ_CLEAR395_ADDR A:0xdeb0108
y.create.l HWIO_SPMI_PIC_IRQ_CLEAR396_ADDR A:0xdec0108
y.create.l HWIO_SPMI_PIC_IRQ_CLEAR397_ADDR A:0xded0108
y.create.l HWIO_SPMI_PIC_IRQ_CLEAR398_ADDR A:0xdee0108
y.create.l HWIO_SPMI_PIC_IRQ_CLEAR399_ADDR A:0xdef0108
y.create.l HWIO_SPMI_PIC_IRQ_CLEAR400_ADDR A:0xdf00108
y.create.l HWIO_SPMI_PIC_IRQ_CLEAR401_ADDR A:0xdf10108
y.create.l HWIO_SPMI_PIC_IRQ_CLEAR402_ADDR A:0xdf20108
y.create.l HWIO_SPMI_PIC_IRQ_CLEAR403_ADDR A:0xdf30108
y.create.l HWIO_SPMI_PIC_IRQ_CLEAR404_ADDR A:0xdf40108
y.create.l HWIO_SPMI_PIC_IRQ_CLEAR405_ADDR A:0xdf50108
y.create.l HWIO_SPMI_PIC_IRQ_CLEAR406_ADDR A:0xdf60108
y.create.l HWIO_SPMI_PIC_IRQ_CLEAR407_ADDR A:0xdf70108
y.create.l HWIO_SPMI_PIC_IRQ_CLEAR408_ADDR A:0xdf80108
y.create.l HWIO_SPMI_PIC_IRQ_CLEAR409_ADDR A:0xdf90108
y.create.l HWIO_SPMI_PIC_IRQ_CLEAR410_ADDR A:0xdfa0108
y.create.l HWIO_SPMI_PIC_IRQ_CLEAR411_ADDR A:0xdfb0108
y.create.l HWIO_SPMI_PIC_IRQ_CLEAR412_ADDR A:0xdfc0108
y.create.l HWIO_SPMI_PIC_IRQ_CLEAR413_ADDR A:0xdfd0108
y.create.l HWIO_SPMI_PIC_IRQ_CLEAR414_ADDR A:0xdfe0108
y.create.l HWIO_SPMI_PIC_IRQ_CLEAR415_ADDR A:0xdff0108
y.create.l HWIO_SPMI_PIC_IRQ_CLEAR416_ADDR A:0xe000108
y.create.l HWIO_SPMI_PIC_IRQ_CLEAR417_ADDR A:0xe010108
y.create.l HWIO_SPMI_PIC_IRQ_CLEAR418_ADDR A:0xe020108
y.create.l HWIO_SPMI_PIC_IRQ_CLEAR419_ADDR A:0xe030108
y.create.l HWIO_SPMI_PIC_IRQ_CLEAR420_ADDR A:0xe040108
y.create.l HWIO_SPMI_PIC_IRQ_CLEAR421_ADDR A:0xe050108
y.create.l HWIO_SPMI_PIC_IRQ_CLEAR422_ADDR A:0xe060108
y.create.l HWIO_SPMI_PIC_IRQ_CLEAR423_ADDR A:0xe070108
y.create.l HWIO_SPMI_PIC_IRQ_CLEAR424_ADDR A:0xe080108
y.create.l HWIO_SPMI_PIC_IRQ_CLEAR425_ADDR A:0xe090108
y.create.l HWIO_SPMI_PIC_IRQ_CLEAR426_ADDR A:0xe0a0108
y.create.l HWIO_SPMI_PIC_IRQ_CLEAR427_ADDR A:0xe0b0108
y.create.l HWIO_SPMI_PIC_IRQ_CLEAR428_ADDR A:0xe0c0108
y.create.l HWIO_SPMI_PIC_IRQ_CLEAR429_ADDR A:0xe0d0108
y.create.l HWIO_SPMI_PIC_IRQ_CLEAR430_ADDR A:0xe0e0108
y.create.l HWIO_SPMI_PIC_IRQ_CLEAR431_ADDR A:0xe0f0108
y.create.l HWIO_SPMI_PIC_IRQ_CLEAR432_ADDR A:0xe100108
y.create.l HWIO_SPMI_PIC_IRQ_CLEAR433_ADDR A:0xe110108
y.create.l HWIO_SPMI_PIC_IRQ_CLEAR434_ADDR A:0xe120108
y.create.l HWIO_SPMI_PIC_IRQ_CLEAR435_ADDR A:0xe130108
y.create.l HWIO_SPMI_PIC_IRQ_CLEAR436_ADDR A:0xe140108
y.create.l HWIO_SPMI_PIC_IRQ_CLEAR437_ADDR A:0xe150108
y.create.l HWIO_SPMI_PIC_IRQ_CLEAR438_ADDR A:0xe160108
y.create.l HWIO_SPMI_PIC_IRQ_CLEAR439_ADDR A:0xe170108
y.create.l HWIO_SPMI_PIC_IRQ_CLEAR440_ADDR A:0xe180108
y.create.l HWIO_SPMI_PIC_IRQ_CLEAR441_ADDR A:0xe190108
y.create.l HWIO_SPMI_PIC_IRQ_CLEAR442_ADDR A:0xe1a0108
y.create.l HWIO_SPMI_PIC_IRQ_CLEAR443_ADDR A:0xe1b0108
y.create.l HWIO_SPMI_PIC_IRQ_CLEAR444_ADDR A:0xe1c0108
y.create.l HWIO_SPMI_PIC_IRQ_CLEAR445_ADDR A:0xe1d0108
y.create.l HWIO_SPMI_PIC_IRQ_CLEAR446_ADDR A:0xe1e0108
y.create.l HWIO_SPMI_PIC_IRQ_CLEAR447_ADDR A:0xe1f0108
y.create.l HWIO_SPMI_PIC_IRQ_CLEAR448_ADDR A:0xe200108
y.create.l HWIO_SPMI_PIC_IRQ_CLEAR449_ADDR A:0xe210108
y.create.l HWIO_SPMI_PIC_IRQ_CLEAR450_ADDR A:0xe220108
y.create.l HWIO_SPMI_PIC_IRQ_CLEAR451_ADDR A:0xe230108
y.create.l HWIO_SPMI_PIC_IRQ_CLEAR452_ADDR A:0xe240108
y.create.l HWIO_SPMI_PIC_IRQ_CLEAR453_ADDR A:0xe250108
y.create.l HWIO_SPMI_PIC_IRQ_CLEAR454_ADDR A:0xe260108
y.create.l HWIO_SPMI_PIC_IRQ_CLEAR455_ADDR A:0xe270108
y.create.l HWIO_SPMI_PIC_IRQ_CLEAR456_ADDR A:0xe280108
y.create.l HWIO_SPMI_PIC_IRQ_CLEAR457_ADDR A:0xe290108
y.create.l HWIO_SPMI_PIC_IRQ_CLEAR458_ADDR A:0xe2a0108
y.create.l HWIO_SPMI_PIC_IRQ_CLEAR459_ADDR A:0xe2b0108
y.create.l HWIO_SPMI_PIC_IRQ_CLEAR460_ADDR A:0xe2c0108
y.create.l HWIO_SPMI_PIC_IRQ_CLEAR461_ADDR A:0xe2d0108
y.create.l HWIO_SPMI_PIC_IRQ_CLEAR462_ADDR A:0xe2e0108
y.create.l HWIO_SPMI_PIC_IRQ_CLEAR463_ADDR A:0xe2f0108
y.create.l HWIO_SPMI_PIC_IRQ_CLEAR464_ADDR A:0xe300108
y.create.l HWIO_SPMI_PIC_IRQ_CLEAR465_ADDR A:0xe310108
y.create.l HWIO_SPMI_PIC_IRQ_CLEAR466_ADDR A:0xe320108
y.create.l HWIO_SPMI_PIC_IRQ_CLEAR467_ADDR A:0xe330108
y.create.l HWIO_SPMI_PIC_IRQ_CLEAR468_ADDR A:0xe340108
y.create.l HWIO_SPMI_PIC_IRQ_CLEAR469_ADDR A:0xe350108
y.create.l HWIO_SPMI_PIC_IRQ_CLEAR470_ADDR A:0xe360108
y.create.l HWIO_SPMI_PIC_IRQ_CLEAR471_ADDR A:0xe370108
y.create.l HWIO_SPMI_PIC_IRQ_CLEAR472_ADDR A:0xe380108
y.create.l HWIO_SPMI_PIC_IRQ_CLEAR473_ADDR A:0xe390108
y.create.l HWIO_SPMI_PIC_IRQ_CLEAR474_ADDR A:0xe3a0108
y.create.l HWIO_SPMI_PIC_IRQ_CLEAR475_ADDR A:0xe3b0108
y.create.l HWIO_SPMI_PIC_IRQ_CLEAR476_ADDR A:0xe3c0108
y.create.l HWIO_SPMI_PIC_IRQ_CLEAR477_ADDR A:0xe3d0108
y.create.l HWIO_SPMI_PIC_IRQ_CLEAR478_ADDR A:0xe3e0108
y.create.l HWIO_SPMI_PIC_IRQ_CLEAR479_ADDR A:0xe3f0108
y.create.l HWIO_SPMI_PIC_IRQ_CLEAR480_ADDR A:0xe400108
y.create.l HWIO_SPMI_PIC_IRQ_CLEAR481_ADDR A:0xe410108
y.create.l HWIO_SPMI_PIC_IRQ_CLEAR482_ADDR A:0xe420108
y.create.l HWIO_SPMI_PIC_IRQ_CLEAR483_ADDR A:0xe430108
y.create.l HWIO_SPMI_PIC_IRQ_CLEAR484_ADDR A:0xe440108
y.create.l HWIO_SPMI_PIC_IRQ_CLEAR485_ADDR A:0xe450108
y.create.l HWIO_SPMI_PIC_IRQ_CLEAR486_ADDR A:0xe460108
y.create.l HWIO_SPMI_PIC_IRQ_CLEAR487_ADDR A:0xe470108
y.create.l HWIO_SPMI_PIC_IRQ_CLEAR488_ADDR A:0xe480108
y.create.l HWIO_SPMI_PIC_IRQ_CLEAR489_ADDR A:0xe490108
y.create.l HWIO_SPMI_PIC_IRQ_CLEAR490_ADDR A:0xe4a0108
y.create.l HWIO_SPMI_PIC_IRQ_CLEAR491_ADDR A:0xe4b0108
y.create.l HWIO_SPMI_PIC_IRQ_CLEAR492_ADDR A:0xe4c0108
y.create.l HWIO_SPMI_PIC_IRQ_CLEAR493_ADDR A:0xe4d0108
y.create.l HWIO_SPMI_PIC_IRQ_CLEAR494_ADDR A:0xe4e0108
y.create.l HWIO_SPMI_PIC_IRQ_CLEAR495_ADDR A:0xe4f0108
y.create.l HWIO_SPMI_PIC_IRQ_CLEAR496_ADDR A:0xe500108
y.create.l HWIO_SPMI_PIC_IRQ_CLEAR497_ADDR A:0xe510108
y.create.l HWIO_SPMI_PIC_IRQ_CLEAR498_ADDR A:0xe520108
y.create.l HWIO_SPMI_PIC_IRQ_CLEAR499_ADDR A:0xe530108
y.create.l HWIO_SPMI_PIC_IRQ_CLEAR500_ADDR A:0xe540108
y.create.l HWIO_SPMI_PIC_IRQ_CLEAR501_ADDR A:0xe550108
y.create.l HWIO_SPMI_PIC_IRQ_CLEAR502_ADDR A:0xe560108
y.create.l HWIO_SPMI_PIC_IRQ_CLEAR503_ADDR A:0xe570108
y.create.l HWIO_SPMI_PIC_IRQ_CLEAR504_ADDR A:0xe580108
y.create.l HWIO_SPMI_PIC_IRQ_CLEAR505_ADDR A:0xe590108
y.create.l HWIO_SPMI_PIC_IRQ_CLEAR506_ADDR A:0xe5a0108
y.create.l HWIO_SPMI_PIC_IRQ_CLEAR507_ADDR A:0xe5b0108
y.create.l HWIO_SPMI_PIC_IRQ_CLEAR508_ADDR A:0xe5c0108
y.create.l HWIO_SPMI_PIC_IRQ_CLEAR509_ADDR A:0xe5d0108
y.create.l HWIO_SPMI_PIC_IRQ_CLEAR510_ADDR A:0xe5e0108
y.create.l HWIO_SPMI_PIC_IRQ_CLEAR511_ADDR A:0xe5f0108
y.create.l HWIO_PMIC_ARB_OBS0_CHNL0_CMD_ADDR A:0xe600000
y.create.l HWIO_PMIC_ARB_OBS0_CHNL1_CMD_ADDR A:0xe600080
y.create.l HWIO_PMIC_ARB_OBS0_CHNL2_CMD_ADDR A:0xe600100
y.create.l HWIO_PMIC_ARB_OBS0_CHNL3_CMD_ADDR A:0xe600180
y.create.l HWIO_PMIC_ARB_OBS0_CHNL4_CMD_ADDR A:0xe600200
y.create.l HWIO_PMIC_ARB_OBS0_CHNL5_CMD_ADDR A:0xe600280
y.create.l HWIO_PMIC_ARB_OBS0_CHNL6_CMD_ADDR A:0xe600300
y.create.l HWIO_PMIC_ARB_OBS0_CHNL7_CMD_ADDR A:0xe600380
y.create.l HWIO_PMIC_ARB_OBS0_CHNL8_CMD_ADDR A:0xe600400
y.create.l HWIO_PMIC_ARB_OBS0_CHNL9_CMD_ADDR A:0xe600480
y.create.l HWIO_PMIC_ARB_OBS0_CHNL10_CMD_ADDR A:0xe600500
y.create.l HWIO_PMIC_ARB_OBS0_CHNL11_CMD_ADDR A:0xe600580
y.create.l HWIO_PMIC_ARB_OBS0_CHNL12_CMD_ADDR A:0xe600600
y.create.l HWIO_PMIC_ARB_OBS0_CHNL13_CMD_ADDR A:0xe600680
y.create.l HWIO_PMIC_ARB_OBS0_CHNL14_CMD_ADDR A:0xe600700
y.create.l HWIO_PMIC_ARB_OBS0_CHNL15_CMD_ADDR A:0xe600780
y.create.l HWIO_PMIC_ARB_OBS0_CHNL16_CMD_ADDR A:0xe600800
y.create.l HWIO_PMIC_ARB_OBS0_CHNL17_CMD_ADDR A:0xe600880
y.create.l HWIO_PMIC_ARB_OBS0_CHNL18_CMD_ADDR A:0xe600900
y.create.l HWIO_PMIC_ARB_OBS0_CHNL19_CMD_ADDR A:0xe600980
y.create.l HWIO_PMIC_ARB_OBS0_CHNL20_CMD_ADDR A:0xe600a00
y.create.l HWIO_PMIC_ARB_OBS0_CHNL21_CMD_ADDR A:0xe600a80
y.create.l HWIO_PMIC_ARB_OBS0_CHNL22_CMD_ADDR A:0xe600b00
y.create.l HWIO_PMIC_ARB_OBS0_CHNL23_CMD_ADDR A:0xe600b80
y.create.l HWIO_PMIC_ARB_OBS0_CHNL24_CMD_ADDR A:0xe600c00
y.create.l HWIO_PMIC_ARB_OBS0_CHNL25_CMD_ADDR A:0xe600c80
y.create.l HWIO_PMIC_ARB_OBS0_CHNL26_CMD_ADDR A:0xe600d00
y.create.l HWIO_PMIC_ARB_OBS0_CHNL27_CMD_ADDR A:0xe600d80
y.create.l HWIO_PMIC_ARB_OBS0_CHNL28_CMD_ADDR A:0xe600e00
y.create.l HWIO_PMIC_ARB_OBS0_CHNL29_CMD_ADDR A:0xe600e80
y.create.l HWIO_PMIC_ARB_OBS0_CHNL30_CMD_ADDR A:0xe600f00
y.create.l HWIO_PMIC_ARB_OBS0_CHNL31_CMD_ADDR A:0xe600f80
y.create.l HWIO_PMIC_ARB_OBS0_CHNL32_CMD_ADDR A:0xe601000
y.create.l HWIO_PMIC_ARB_OBS0_CHNL33_CMD_ADDR A:0xe601080
y.create.l HWIO_PMIC_ARB_OBS0_CHNL34_CMD_ADDR A:0xe601100
y.create.l HWIO_PMIC_ARB_OBS0_CHNL35_CMD_ADDR A:0xe601180
y.create.l HWIO_PMIC_ARB_OBS0_CHNL36_CMD_ADDR A:0xe601200
y.create.l HWIO_PMIC_ARB_OBS0_CHNL37_CMD_ADDR A:0xe601280
y.create.l HWIO_PMIC_ARB_OBS0_CHNL38_CMD_ADDR A:0xe601300
y.create.l HWIO_PMIC_ARB_OBS0_CHNL39_CMD_ADDR A:0xe601380
y.create.l HWIO_PMIC_ARB_OBS0_CHNL40_CMD_ADDR A:0xe601400
y.create.l HWIO_PMIC_ARB_OBS0_CHNL41_CMD_ADDR A:0xe601480
y.create.l HWIO_PMIC_ARB_OBS0_CHNL42_CMD_ADDR A:0xe601500
y.create.l HWIO_PMIC_ARB_OBS0_CHNL43_CMD_ADDR A:0xe601580
y.create.l HWIO_PMIC_ARB_OBS0_CHNL44_CMD_ADDR A:0xe601600
y.create.l HWIO_PMIC_ARB_OBS0_CHNL45_CMD_ADDR A:0xe601680
y.create.l HWIO_PMIC_ARB_OBS0_CHNL46_CMD_ADDR A:0xe601700
y.create.l HWIO_PMIC_ARB_OBS0_CHNL47_CMD_ADDR A:0xe601780
y.create.l HWIO_PMIC_ARB_OBS0_CHNL48_CMD_ADDR A:0xe601800
y.create.l HWIO_PMIC_ARB_OBS0_CHNL49_CMD_ADDR A:0xe601880
y.create.l HWIO_PMIC_ARB_OBS0_CHNL50_CMD_ADDR A:0xe601900
y.create.l HWIO_PMIC_ARB_OBS0_CHNL51_CMD_ADDR A:0xe601980
y.create.l HWIO_PMIC_ARB_OBS0_CHNL52_CMD_ADDR A:0xe601a00
y.create.l HWIO_PMIC_ARB_OBS0_CHNL53_CMD_ADDR A:0xe601a80
y.create.l HWIO_PMIC_ARB_OBS0_CHNL54_CMD_ADDR A:0xe601b00
y.create.l HWIO_PMIC_ARB_OBS0_CHNL55_CMD_ADDR A:0xe601b80
y.create.l HWIO_PMIC_ARB_OBS0_CHNL56_CMD_ADDR A:0xe601c00
y.create.l HWIO_PMIC_ARB_OBS0_CHNL57_CMD_ADDR A:0xe601c80
y.create.l HWIO_PMIC_ARB_OBS0_CHNL58_CMD_ADDR A:0xe601d00
y.create.l HWIO_PMIC_ARB_OBS0_CHNL59_CMD_ADDR A:0xe601d80
y.create.l HWIO_PMIC_ARB_OBS0_CHNL60_CMD_ADDR A:0xe601e00
y.create.l HWIO_PMIC_ARB_OBS0_CHNL61_CMD_ADDR A:0xe601e80
y.create.l HWIO_PMIC_ARB_OBS0_CHNL62_CMD_ADDR A:0xe601f00
y.create.l HWIO_PMIC_ARB_OBS0_CHNL63_CMD_ADDR A:0xe601f80
y.create.l HWIO_PMIC_ARB_OBS0_CHNL64_CMD_ADDR A:0xe602000
y.create.l HWIO_PMIC_ARB_OBS0_CHNL65_CMD_ADDR A:0xe602080
y.create.l HWIO_PMIC_ARB_OBS0_CHNL66_CMD_ADDR A:0xe602100
y.create.l HWIO_PMIC_ARB_OBS0_CHNL67_CMD_ADDR A:0xe602180
y.create.l HWIO_PMIC_ARB_OBS0_CHNL68_CMD_ADDR A:0xe602200
y.create.l HWIO_PMIC_ARB_OBS0_CHNL69_CMD_ADDR A:0xe602280
y.create.l HWIO_PMIC_ARB_OBS0_CHNL70_CMD_ADDR A:0xe602300
y.create.l HWIO_PMIC_ARB_OBS0_CHNL71_CMD_ADDR A:0xe602380
y.create.l HWIO_PMIC_ARB_OBS0_CHNL72_CMD_ADDR A:0xe602400
y.create.l HWIO_PMIC_ARB_OBS0_CHNL73_CMD_ADDR A:0xe602480
y.create.l HWIO_PMIC_ARB_OBS0_CHNL74_CMD_ADDR A:0xe602500
y.create.l HWIO_PMIC_ARB_OBS0_CHNL75_CMD_ADDR A:0xe602580
y.create.l HWIO_PMIC_ARB_OBS0_CHNL76_CMD_ADDR A:0xe602600
y.create.l HWIO_PMIC_ARB_OBS0_CHNL77_CMD_ADDR A:0xe602680
y.create.l HWIO_PMIC_ARB_OBS0_CHNL78_CMD_ADDR A:0xe602700
y.create.l HWIO_PMIC_ARB_OBS0_CHNL79_CMD_ADDR A:0xe602780
y.create.l HWIO_PMIC_ARB_OBS0_CHNL80_CMD_ADDR A:0xe602800
y.create.l HWIO_PMIC_ARB_OBS0_CHNL81_CMD_ADDR A:0xe602880
y.create.l HWIO_PMIC_ARB_OBS0_CHNL82_CMD_ADDR A:0xe602900
y.create.l HWIO_PMIC_ARB_OBS0_CHNL83_CMD_ADDR A:0xe602980
y.create.l HWIO_PMIC_ARB_OBS0_CHNL84_CMD_ADDR A:0xe602a00
y.create.l HWIO_PMIC_ARB_OBS0_CHNL85_CMD_ADDR A:0xe602a80
y.create.l HWIO_PMIC_ARB_OBS0_CHNL86_CMD_ADDR A:0xe602b00
y.create.l HWIO_PMIC_ARB_OBS0_CHNL87_CMD_ADDR A:0xe602b80
y.create.l HWIO_PMIC_ARB_OBS0_CHNL88_CMD_ADDR A:0xe602c00
y.create.l HWIO_PMIC_ARB_OBS0_CHNL89_CMD_ADDR A:0xe602c80
y.create.l HWIO_PMIC_ARB_OBS0_CHNL90_CMD_ADDR A:0xe602d00
y.create.l HWIO_PMIC_ARB_OBS0_CHNL91_CMD_ADDR A:0xe602d80
y.create.l HWIO_PMIC_ARB_OBS0_CHNL92_CMD_ADDR A:0xe602e00
y.create.l HWIO_PMIC_ARB_OBS0_CHNL93_CMD_ADDR A:0xe602e80
y.create.l HWIO_PMIC_ARB_OBS0_CHNL94_CMD_ADDR A:0xe602f00
y.create.l HWIO_PMIC_ARB_OBS0_CHNL95_CMD_ADDR A:0xe602f80
y.create.l HWIO_PMIC_ARB_OBS0_CHNL96_CMD_ADDR A:0xe603000
y.create.l HWIO_PMIC_ARB_OBS0_CHNL97_CMD_ADDR A:0xe603080
y.create.l HWIO_PMIC_ARB_OBS0_CHNL98_CMD_ADDR A:0xe603100
y.create.l HWIO_PMIC_ARB_OBS0_CHNL99_CMD_ADDR A:0xe603180
y.create.l HWIO_PMIC_ARB_OBS0_CHNL100_CMD_ADDR A:0xe603200
y.create.l HWIO_PMIC_ARB_OBS0_CHNL101_CMD_ADDR A:0xe603280
y.create.l HWIO_PMIC_ARB_OBS0_CHNL102_CMD_ADDR A:0xe603300
y.create.l HWIO_PMIC_ARB_OBS0_CHNL103_CMD_ADDR A:0xe603380
y.create.l HWIO_PMIC_ARB_OBS0_CHNL104_CMD_ADDR A:0xe603400
y.create.l HWIO_PMIC_ARB_OBS0_CHNL105_CMD_ADDR A:0xe603480
y.create.l HWIO_PMIC_ARB_OBS0_CHNL106_CMD_ADDR A:0xe603500
y.create.l HWIO_PMIC_ARB_OBS0_CHNL107_CMD_ADDR A:0xe603580
y.create.l HWIO_PMIC_ARB_OBS0_CHNL108_CMD_ADDR A:0xe603600
y.create.l HWIO_PMIC_ARB_OBS0_CHNL109_CMD_ADDR A:0xe603680
y.create.l HWIO_PMIC_ARB_OBS0_CHNL110_CMD_ADDR A:0xe603700
y.create.l HWIO_PMIC_ARB_OBS0_CHNL111_CMD_ADDR A:0xe603780
y.create.l HWIO_PMIC_ARB_OBS0_CHNL112_CMD_ADDR A:0xe603800
y.create.l HWIO_PMIC_ARB_OBS0_CHNL113_CMD_ADDR A:0xe603880
y.create.l HWIO_PMIC_ARB_OBS0_CHNL114_CMD_ADDR A:0xe603900
y.create.l HWIO_PMIC_ARB_OBS0_CHNL115_CMD_ADDR A:0xe603980
y.create.l HWIO_PMIC_ARB_OBS0_CHNL116_CMD_ADDR A:0xe603a00
y.create.l HWIO_PMIC_ARB_OBS0_CHNL117_CMD_ADDR A:0xe603a80
y.create.l HWIO_PMIC_ARB_OBS0_CHNL118_CMD_ADDR A:0xe603b00
y.create.l HWIO_PMIC_ARB_OBS0_CHNL119_CMD_ADDR A:0xe603b80
y.create.l HWIO_PMIC_ARB_OBS0_CHNL120_CMD_ADDR A:0xe603c00
y.create.l HWIO_PMIC_ARB_OBS0_CHNL121_CMD_ADDR A:0xe603c80
y.create.l HWIO_PMIC_ARB_OBS0_CHNL122_CMD_ADDR A:0xe603d00
y.create.l HWIO_PMIC_ARB_OBS0_CHNL123_CMD_ADDR A:0xe603d80
y.create.l HWIO_PMIC_ARB_OBS0_CHNL124_CMD_ADDR A:0xe603e00
y.create.l HWIO_PMIC_ARB_OBS0_CHNL125_CMD_ADDR A:0xe603e80
y.create.l HWIO_PMIC_ARB_OBS0_CHNL126_CMD_ADDR A:0xe603f00
y.create.l HWIO_PMIC_ARB_OBS0_CHNL127_CMD_ADDR A:0xe603f80
y.create.l HWIO_PMIC_ARB_OBS0_CHNL128_CMD_ADDR A:0xe604000
y.create.l HWIO_PMIC_ARB_OBS0_CHNL129_CMD_ADDR A:0xe604080
y.create.l HWIO_PMIC_ARB_OBS0_CHNL130_CMD_ADDR A:0xe604100
y.create.l HWIO_PMIC_ARB_OBS0_CHNL131_CMD_ADDR A:0xe604180
y.create.l HWIO_PMIC_ARB_OBS0_CHNL132_CMD_ADDR A:0xe604200
y.create.l HWIO_PMIC_ARB_OBS0_CHNL133_CMD_ADDR A:0xe604280
y.create.l HWIO_PMIC_ARB_OBS0_CHNL134_CMD_ADDR A:0xe604300
y.create.l HWIO_PMIC_ARB_OBS0_CHNL135_CMD_ADDR A:0xe604380
y.create.l HWIO_PMIC_ARB_OBS0_CHNL136_CMD_ADDR A:0xe604400
y.create.l HWIO_PMIC_ARB_OBS0_CHNL137_CMD_ADDR A:0xe604480
y.create.l HWIO_PMIC_ARB_OBS0_CHNL138_CMD_ADDR A:0xe604500
y.create.l HWIO_PMIC_ARB_OBS0_CHNL139_CMD_ADDR A:0xe604580
y.create.l HWIO_PMIC_ARB_OBS0_CHNL140_CMD_ADDR A:0xe604600
y.create.l HWIO_PMIC_ARB_OBS0_CHNL141_CMD_ADDR A:0xe604680
y.create.l HWIO_PMIC_ARB_OBS0_CHNL142_CMD_ADDR A:0xe604700
y.create.l HWIO_PMIC_ARB_OBS0_CHNL143_CMD_ADDR A:0xe604780
y.create.l HWIO_PMIC_ARB_OBS0_CHNL144_CMD_ADDR A:0xe604800
y.create.l HWIO_PMIC_ARB_OBS0_CHNL145_CMD_ADDR A:0xe604880
y.create.l HWIO_PMIC_ARB_OBS0_CHNL146_CMD_ADDR A:0xe604900
y.create.l HWIO_PMIC_ARB_OBS0_CHNL147_CMD_ADDR A:0xe604980
y.create.l HWIO_PMIC_ARB_OBS0_CHNL148_CMD_ADDR A:0xe604a00
y.create.l HWIO_PMIC_ARB_OBS0_CHNL149_CMD_ADDR A:0xe604a80
y.create.l HWIO_PMIC_ARB_OBS0_CHNL150_CMD_ADDR A:0xe604b00
y.create.l HWIO_PMIC_ARB_OBS0_CHNL151_CMD_ADDR A:0xe604b80
y.create.l HWIO_PMIC_ARB_OBS0_CHNL152_CMD_ADDR A:0xe604c00
y.create.l HWIO_PMIC_ARB_OBS0_CHNL153_CMD_ADDR A:0xe604c80
y.create.l HWIO_PMIC_ARB_OBS0_CHNL154_CMD_ADDR A:0xe604d00
y.create.l HWIO_PMIC_ARB_OBS0_CHNL155_CMD_ADDR A:0xe604d80
y.create.l HWIO_PMIC_ARB_OBS0_CHNL156_CMD_ADDR A:0xe604e00
y.create.l HWIO_PMIC_ARB_OBS0_CHNL157_CMD_ADDR A:0xe604e80
y.create.l HWIO_PMIC_ARB_OBS0_CHNL158_CMD_ADDR A:0xe604f00
y.create.l HWIO_PMIC_ARB_OBS0_CHNL159_CMD_ADDR A:0xe604f80
y.create.l HWIO_PMIC_ARB_OBS0_CHNL160_CMD_ADDR A:0xe605000
y.create.l HWIO_PMIC_ARB_OBS0_CHNL161_CMD_ADDR A:0xe605080
y.create.l HWIO_PMIC_ARB_OBS0_CHNL162_CMD_ADDR A:0xe605100
y.create.l HWIO_PMIC_ARB_OBS0_CHNL163_CMD_ADDR A:0xe605180
y.create.l HWIO_PMIC_ARB_OBS0_CHNL164_CMD_ADDR A:0xe605200
y.create.l HWIO_PMIC_ARB_OBS0_CHNL165_CMD_ADDR A:0xe605280
y.create.l HWIO_PMIC_ARB_OBS0_CHNL166_CMD_ADDR A:0xe605300
y.create.l HWIO_PMIC_ARB_OBS0_CHNL167_CMD_ADDR A:0xe605380
y.create.l HWIO_PMIC_ARB_OBS0_CHNL168_CMD_ADDR A:0xe605400
y.create.l HWIO_PMIC_ARB_OBS0_CHNL169_CMD_ADDR A:0xe605480
y.create.l HWIO_PMIC_ARB_OBS0_CHNL170_CMD_ADDR A:0xe605500
y.create.l HWIO_PMIC_ARB_OBS0_CHNL171_CMD_ADDR A:0xe605580
y.create.l HWIO_PMIC_ARB_OBS0_CHNL172_CMD_ADDR A:0xe605600
y.create.l HWIO_PMIC_ARB_OBS0_CHNL173_CMD_ADDR A:0xe605680
y.create.l HWIO_PMIC_ARB_OBS0_CHNL174_CMD_ADDR A:0xe605700
y.create.l HWIO_PMIC_ARB_OBS0_CHNL175_CMD_ADDR A:0xe605780
y.create.l HWIO_PMIC_ARB_OBS0_CHNL176_CMD_ADDR A:0xe605800
y.create.l HWIO_PMIC_ARB_OBS0_CHNL177_CMD_ADDR A:0xe605880
y.create.l HWIO_PMIC_ARB_OBS0_CHNL178_CMD_ADDR A:0xe605900
y.create.l HWIO_PMIC_ARB_OBS0_CHNL179_CMD_ADDR A:0xe605980
y.create.l HWIO_PMIC_ARB_OBS0_CHNL180_CMD_ADDR A:0xe605a00
y.create.l HWIO_PMIC_ARB_OBS0_CHNL181_CMD_ADDR A:0xe605a80
y.create.l HWIO_PMIC_ARB_OBS0_CHNL182_CMD_ADDR A:0xe605b00
y.create.l HWIO_PMIC_ARB_OBS0_CHNL183_CMD_ADDR A:0xe605b80
y.create.l HWIO_PMIC_ARB_OBS0_CHNL184_CMD_ADDR A:0xe605c00
y.create.l HWIO_PMIC_ARB_OBS0_CHNL185_CMD_ADDR A:0xe605c80
y.create.l HWIO_PMIC_ARB_OBS0_CHNL186_CMD_ADDR A:0xe605d00
y.create.l HWIO_PMIC_ARB_OBS0_CHNL187_CMD_ADDR A:0xe605d80
y.create.l HWIO_PMIC_ARB_OBS0_CHNL188_CMD_ADDR A:0xe605e00
y.create.l HWIO_PMIC_ARB_OBS0_CHNL189_CMD_ADDR A:0xe605e80
y.create.l HWIO_PMIC_ARB_OBS0_CHNL190_CMD_ADDR A:0xe605f00
y.create.l HWIO_PMIC_ARB_OBS0_CHNL191_CMD_ADDR A:0xe605f80
y.create.l HWIO_PMIC_ARB_OBS0_CHNL192_CMD_ADDR A:0xe606000
y.create.l HWIO_PMIC_ARB_OBS0_CHNL193_CMD_ADDR A:0xe606080
y.create.l HWIO_PMIC_ARB_OBS0_CHNL194_CMD_ADDR A:0xe606100
y.create.l HWIO_PMIC_ARB_OBS0_CHNL195_CMD_ADDR A:0xe606180
y.create.l HWIO_PMIC_ARB_OBS0_CHNL196_CMD_ADDR A:0xe606200
y.create.l HWIO_PMIC_ARB_OBS0_CHNL197_CMD_ADDR A:0xe606280
y.create.l HWIO_PMIC_ARB_OBS0_CHNL198_CMD_ADDR A:0xe606300
y.create.l HWIO_PMIC_ARB_OBS0_CHNL199_CMD_ADDR A:0xe606380
y.create.l HWIO_PMIC_ARB_OBS0_CHNL200_CMD_ADDR A:0xe606400
y.create.l HWIO_PMIC_ARB_OBS0_CHNL201_CMD_ADDR A:0xe606480
y.create.l HWIO_PMIC_ARB_OBS0_CHNL202_CMD_ADDR A:0xe606500
y.create.l HWIO_PMIC_ARB_OBS0_CHNL203_CMD_ADDR A:0xe606580
y.create.l HWIO_PMIC_ARB_OBS0_CHNL204_CMD_ADDR A:0xe606600
y.create.l HWIO_PMIC_ARB_OBS0_CHNL205_CMD_ADDR A:0xe606680
y.create.l HWIO_PMIC_ARB_OBS0_CHNL206_CMD_ADDR A:0xe606700
y.create.l HWIO_PMIC_ARB_OBS0_CHNL207_CMD_ADDR A:0xe606780
y.create.l HWIO_PMIC_ARB_OBS0_CHNL208_CMD_ADDR A:0xe606800
y.create.l HWIO_PMIC_ARB_OBS0_CHNL209_CMD_ADDR A:0xe606880
y.create.l HWIO_PMIC_ARB_OBS0_CHNL210_CMD_ADDR A:0xe606900
y.create.l HWIO_PMIC_ARB_OBS0_CHNL211_CMD_ADDR A:0xe606980
y.create.l HWIO_PMIC_ARB_OBS0_CHNL212_CMD_ADDR A:0xe606a00
y.create.l HWIO_PMIC_ARB_OBS0_CHNL213_CMD_ADDR A:0xe606a80
y.create.l HWIO_PMIC_ARB_OBS0_CHNL214_CMD_ADDR A:0xe606b00
y.create.l HWIO_PMIC_ARB_OBS0_CHNL215_CMD_ADDR A:0xe606b80
y.create.l HWIO_PMIC_ARB_OBS0_CHNL216_CMD_ADDR A:0xe606c00
y.create.l HWIO_PMIC_ARB_OBS0_CHNL217_CMD_ADDR A:0xe606c80
y.create.l HWIO_PMIC_ARB_OBS0_CHNL218_CMD_ADDR A:0xe606d00
y.create.l HWIO_PMIC_ARB_OBS0_CHNL219_CMD_ADDR A:0xe606d80
y.create.l HWIO_PMIC_ARB_OBS0_CHNL220_CMD_ADDR A:0xe606e00
y.create.l HWIO_PMIC_ARB_OBS0_CHNL221_CMD_ADDR A:0xe606e80
y.create.l HWIO_PMIC_ARB_OBS0_CHNL222_CMD_ADDR A:0xe606f00
y.create.l HWIO_PMIC_ARB_OBS0_CHNL223_CMD_ADDR A:0xe606f80
y.create.l HWIO_PMIC_ARB_OBS0_CHNL224_CMD_ADDR A:0xe607000
y.create.l HWIO_PMIC_ARB_OBS0_CHNL225_CMD_ADDR A:0xe607080
y.create.l HWIO_PMIC_ARB_OBS0_CHNL226_CMD_ADDR A:0xe607100
y.create.l HWIO_PMIC_ARB_OBS0_CHNL227_CMD_ADDR A:0xe607180
y.create.l HWIO_PMIC_ARB_OBS0_CHNL228_CMD_ADDR A:0xe607200
y.create.l HWIO_PMIC_ARB_OBS0_CHNL229_CMD_ADDR A:0xe607280
y.create.l HWIO_PMIC_ARB_OBS0_CHNL230_CMD_ADDR A:0xe607300
y.create.l HWIO_PMIC_ARB_OBS0_CHNL231_CMD_ADDR A:0xe607380
y.create.l HWIO_PMIC_ARB_OBS0_CHNL232_CMD_ADDR A:0xe607400
y.create.l HWIO_PMIC_ARB_OBS0_CHNL233_CMD_ADDR A:0xe607480
y.create.l HWIO_PMIC_ARB_OBS0_CHNL234_CMD_ADDR A:0xe607500
y.create.l HWIO_PMIC_ARB_OBS0_CHNL235_CMD_ADDR A:0xe607580
y.create.l HWIO_PMIC_ARB_OBS0_CHNL236_CMD_ADDR A:0xe607600
y.create.l HWIO_PMIC_ARB_OBS0_CHNL237_CMD_ADDR A:0xe607680
y.create.l HWIO_PMIC_ARB_OBS0_CHNL238_CMD_ADDR A:0xe607700
y.create.l HWIO_PMIC_ARB_OBS0_CHNL239_CMD_ADDR A:0xe607780
y.create.l HWIO_PMIC_ARB_OBS0_CHNL240_CMD_ADDR A:0xe607800
y.create.l HWIO_PMIC_ARB_OBS0_CHNL241_CMD_ADDR A:0xe607880
y.create.l HWIO_PMIC_ARB_OBS0_CHNL242_CMD_ADDR A:0xe607900
y.create.l HWIO_PMIC_ARB_OBS0_CHNL243_CMD_ADDR A:0xe607980
y.create.l HWIO_PMIC_ARB_OBS0_CHNL244_CMD_ADDR A:0xe607a00
y.create.l HWIO_PMIC_ARB_OBS0_CHNL245_CMD_ADDR A:0xe607a80
y.create.l HWIO_PMIC_ARB_OBS0_CHNL246_CMD_ADDR A:0xe607b00
y.create.l HWIO_PMIC_ARB_OBS0_CHNL247_CMD_ADDR A:0xe607b80
y.create.l HWIO_PMIC_ARB_OBS0_CHNL248_CMD_ADDR A:0xe607c00
y.create.l HWIO_PMIC_ARB_OBS0_CHNL249_CMD_ADDR A:0xe607c80
y.create.l HWIO_PMIC_ARB_OBS0_CHNL250_CMD_ADDR A:0xe607d00
y.create.l HWIO_PMIC_ARB_OBS0_CHNL251_CMD_ADDR A:0xe607d80
y.create.l HWIO_PMIC_ARB_OBS0_CHNL252_CMD_ADDR A:0xe607e00
y.create.l HWIO_PMIC_ARB_OBS0_CHNL253_CMD_ADDR A:0xe607e80
y.create.l HWIO_PMIC_ARB_OBS0_CHNL254_CMD_ADDR A:0xe607f00
y.create.l HWIO_PMIC_ARB_OBS0_CHNL255_CMD_ADDR A:0xe607f80
y.create.l HWIO_PMIC_ARB_OBS0_CHNL256_CMD_ADDR A:0xe608000
y.create.l HWIO_PMIC_ARB_OBS0_CHNL257_CMD_ADDR A:0xe608080
y.create.l HWIO_PMIC_ARB_OBS0_CHNL258_CMD_ADDR A:0xe608100
y.create.l HWIO_PMIC_ARB_OBS0_CHNL259_CMD_ADDR A:0xe608180
y.create.l HWIO_PMIC_ARB_OBS0_CHNL260_CMD_ADDR A:0xe608200
y.create.l HWIO_PMIC_ARB_OBS0_CHNL261_CMD_ADDR A:0xe608280
y.create.l HWIO_PMIC_ARB_OBS0_CHNL262_CMD_ADDR A:0xe608300
y.create.l HWIO_PMIC_ARB_OBS0_CHNL263_CMD_ADDR A:0xe608380
y.create.l HWIO_PMIC_ARB_OBS0_CHNL264_CMD_ADDR A:0xe608400
y.create.l HWIO_PMIC_ARB_OBS0_CHNL265_CMD_ADDR A:0xe608480
y.create.l HWIO_PMIC_ARB_OBS0_CHNL266_CMD_ADDR A:0xe608500
y.create.l HWIO_PMIC_ARB_OBS0_CHNL267_CMD_ADDR A:0xe608580
y.create.l HWIO_PMIC_ARB_OBS0_CHNL268_CMD_ADDR A:0xe608600
y.create.l HWIO_PMIC_ARB_OBS0_CHNL269_CMD_ADDR A:0xe608680
y.create.l HWIO_PMIC_ARB_OBS0_CHNL270_CMD_ADDR A:0xe608700
y.create.l HWIO_PMIC_ARB_OBS0_CHNL271_CMD_ADDR A:0xe608780
y.create.l HWIO_PMIC_ARB_OBS0_CHNL272_CMD_ADDR A:0xe608800
y.create.l HWIO_PMIC_ARB_OBS0_CHNL273_CMD_ADDR A:0xe608880
y.create.l HWIO_PMIC_ARB_OBS0_CHNL274_CMD_ADDR A:0xe608900
y.create.l HWIO_PMIC_ARB_OBS0_CHNL275_CMD_ADDR A:0xe608980
y.create.l HWIO_PMIC_ARB_OBS0_CHNL276_CMD_ADDR A:0xe608a00
y.create.l HWIO_PMIC_ARB_OBS0_CHNL277_CMD_ADDR A:0xe608a80
y.create.l HWIO_PMIC_ARB_OBS0_CHNL278_CMD_ADDR A:0xe608b00
y.create.l HWIO_PMIC_ARB_OBS0_CHNL279_CMD_ADDR A:0xe608b80
y.create.l HWIO_PMIC_ARB_OBS0_CHNL280_CMD_ADDR A:0xe608c00
y.create.l HWIO_PMIC_ARB_OBS0_CHNL281_CMD_ADDR A:0xe608c80
y.create.l HWIO_PMIC_ARB_OBS0_CHNL282_CMD_ADDR A:0xe608d00
y.create.l HWIO_PMIC_ARB_OBS0_CHNL283_CMD_ADDR A:0xe608d80
y.create.l HWIO_PMIC_ARB_OBS0_CHNL284_CMD_ADDR A:0xe608e00
y.create.l HWIO_PMIC_ARB_OBS0_CHNL285_CMD_ADDR A:0xe608e80
y.create.l HWIO_PMIC_ARB_OBS0_CHNL286_CMD_ADDR A:0xe608f00
y.create.l HWIO_PMIC_ARB_OBS0_CHNL287_CMD_ADDR A:0xe608f80
y.create.l HWIO_PMIC_ARB_OBS0_CHNL288_CMD_ADDR A:0xe609000
y.create.l HWIO_PMIC_ARB_OBS0_CHNL289_CMD_ADDR A:0xe609080
y.create.l HWIO_PMIC_ARB_OBS0_CHNL290_CMD_ADDR A:0xe609100
y.create.l HWIO_PMIC_ARB_OBS0_CHNL291_CMD_ADDR A:0xe609180
y.create.l HWIO_PMIC_ARB_OBS0_CHNL292_CMD_ADDR A:0xe609200
y.create.l HWIO_PMIC_ARB_OBS0_CHNL293_CMD_ADDR A:0xe609280
y.create.l HWIO_PMIC_ARB_OBS0_CHNL294_CMD_ADDR A:0xe609300
y.create.l HWIO_PMIC_ARB_OBS0_CHNL295_CMD_ADDR A:0xe609380
y.create.l HWIO_PMIC_ARB_OBS0_CHNL296_CMD_ADDR A:0xe609400
y.create.l HWIO_PMIC_ARB_OBS0_CHNL297_CMD_ADDR A:0xe609480
y.create.l HWIO_PMIC_ARB_OBS0_CHNL298_CMD_ADDR A:0xe609500
y.create.l HWIO_PMIC_ARB_OBS0_CHNL299_CMD_ADDR A:0xe609580
y.create.l HWIO_PMIC_ARB_OBS0_CHNL300_CMD_ADDR A:0xe609600
y.create.l HWIO_PMIC_ARB_OBS0_CHNL301_CMD_ADDR A:0xe609680
y.create.l HWIO_PMIC_ARB_OBS0_CHNL302_CMD_ADDR A:0xe609700
y.create.l HWIO_PMIC_ARB_OBS0_CHNL303_CMD_ADDR A:0xe609780
y.create.l HWIO_PMIC_ARB_OBS0_CHNL304_CMD_ADDR A:0xe609800
y.create.l HWIO_PMIC_ARB_OBS0_CHNL305_CMD_ADDR A:0xe609880
y.create.l HWIO_PMIC_ARB_OBS0_CHNL306_CMD_ADDR A:0xe609900
y.create.l HWIO_PMIC_ARB_OBS0_CHNL307_CMD_ADDR A:0xe609980
y.create.l HWIO_PMIC_ARB_OBS0_CHNL308_CMD_ADDR A:0xe609a00
y.create.l HWIO_PMIC_ARB_OBS0_CHNL309_CMD_ADDR A:0xe609a80
y.create.l HWIO_PMIC_ARB_OBS0_CHNL310_CMD_ADDR A:0xe609b00
y.create.l HWIO_PMIC_ARB_OBS0_CHNL311_CMD_ADDR A:0xe609b80
y.create.l HWIO_PMIC_ARB_OBS0_CHNL312_CMD_ADDR A:0xe609c00
y.create.l HWIO_PMIC_ARB_OBS0_CHNL313_CMD_ADDR A:0xe609c80
y.create.l HWIO_PMIC_ARB_OBS0_CHNL314_CMD_ADDR A:0xe609d00
y.create.l HWIO_PMIC_ARB_OBS0_CHNL315_CMD_ADDR A:0xe609d80
y.create.l HWIO_PMIC_ARB_OBS0_CHNL316_CMD_ADDR A:0xe609e00
y.create.l HWIO_PMIC_ARB_OBS0_CHNL317_CMD_ADDR A:0xe609e80
y.create.l HWIO_PMIC_ARB_OBS0_CHNL318_CMD_ADDR A:0xe609f00
y.create.l HWIO_PMIC_ARB_OBS0_CHNL319_CMD_ADDR A:0xe609f80
y.create.l HWIO_PMIC_ARB_OBS0_CHNL320_CMD_ADDR A:0xe60a000
y.create.l HWIO_PMIC_ARB_OBS0_CHNL321_CMD_ADDR A:0xe60a080
y.create.l HWIO_PMIC_ARB_OBS0_CHNL322_CMD_ADDR A:0xe60a100
y.create.l HWIO_PMIC_ARB_OBS0_CHNL323_CMD_ADDR A:0xe60a180
y.create.l HWIO_PMIC_ARB_OBS0_CHNL324_CMD_ADDR A:0xe60a200
y.create.l HWIO_PMIC_ARB_OBS0_CHNL325_CMD_ADDR A:0xe60a280
y.create.l HWIO_PMIC_ARB_OBS0_CHNL326_CMD_ADDR A:0xe60a300
y.create.l HWIO_PMIC_ARB_OBS0_CHNL327_CMD_ADDR A:0xe60a380
y.create.l HWIO_PMIC_ARB_OBS0_CHNL328_CMD_ADDR A:0xe60a400
y.create.l HWIO_PMIC_ARB_OBS0_CHNL329_CMD_ADDR A:0xe60a480
y.create.l HWIO_PMIC_ARB_OBS0_CHNL330_CMD_ADDR A:0xe60a500
y.create.l HWIO_PMIC_ARB_OBS0_CHNL331_CMD_ADDR A:0xe60a580
y.create.l HWIO_PMIC_ARB_OBS0_CHNL332_CMD_ADDR A:0xe60a600
y.create.l HWIO_PMIC_ARB_OBS0_CHNL333_CMD_ADDR A:0xe60a680
y.create.l HWIO_PMIC_ARB_OBS0_CHNL334_CMD_ADDR A:0xe60a700
y.create.l HWIO_PMIC_ARB_OBS0_CHNL335_CMD_ADDR A:0xe60a780
y.create.l HWIO_PMIC_ARB_OBS0_CHNL336_CMD_ADDR A:0xe60a800
y.create.l HWIO_PMIC_ARB_OBS0_CHNL337_CMD_ADDR A:0xe60a880
y.create.l HWIO_PMIC_ARB_OBS0_CHNL338_CMD_ADDR A:0xe60a900
y.create.l HWIO_PMIC_ARB_OBS0_CHNL339_CMD_ADDR A:0xe60a980
y.create.l HWIO_PMIC_ARB_OBS0_CHNL340_CMD_ADDR A:0xe60aa00
y.create.l HWIO_PMIC_ARB_OBS0_CHNL341_CMD_ADDR A:0xe60aa80
y.create.l HWIO_PMIC_ARB_OBS0_CHNL342_CMD_ADDR A:0xe60ab00
y.create.l HWIO_PMIC_ARB_OBS0_CHNL343_CMD_ADDR A:0xe60ab80
y.create.l HWIO_PMIC_ARB_OBS0_CHNL344_CMD_ADDR A:0xe60ac00
y.create.l HWIO_PMIC_ARB_OBS0_CHNL345_CMD_ADDR A:0xe60ac80
y.create.l HWIO_PMIC_ARB_OBS0_CHNL346_CMD_ADDR A:0xe60ad00
y.create.l HWIO_PMIC_ARB_OBS0_CHNL347_CMD_ADDR A:0xe60ad80
y.create.l HWIO_PMIC_ARB_OBS0_CHNL348_CMD_ADDR A:0xe60ae00
y.create.l HWIO_PMIC_ARB_OBS0_CHNL349_CMD_ADDR A:0xe60ae80
y.create.l HWIO_PMIC_ARB_OBS0_CHNL350_CMD_ADDR A:0xe60af00
y.create.l HWIO_PMIC_ARB_OBS0_CHNL351_CMD_ADDR A:0xe60af80
y.create.l HWIO_PMIC_ARB_OBS0_CHNL352_CMD_ADDR A:0xe60b000
y.create.l HWIO_PMIC_ARB_OBS0_CHNL353_CMD_ADDR A:0xe60b080
y.create.l HWIO_PMIC_ARB_OBS0_CHNL354_CMD_ADDR A:0xe60b100
y.create.l HWIO_PMIC_ARB_OBS0_CHNL355_CMD_ADDR A:0xe60b180
y.create.l HWIO_PMIC_ARB_OBS0_CHNL356_CMD_ADDR A:0xe60b200
y.create.l HWIO_PMIC_ARB_OBS0_CHNL357_CMD_ADDR A:0xe60b280
y.create.l HWIO_PMIC_ARB_OBS0_CHNL358_CMD_ADDR A:0xe60b300
y.create.l HWIO_PMIC_ARB_OBS0_CHNL359_CMD_ADDR A:0xe60b380
y.create.l HWIO_PMIC_ARB_OBS0_CHNL360_CMD_ADDR A:0xe60b400
y.create.l HWIO_PMIC_ARB_OBS0_CHNL361_CMD_ADDR A:0xe60b480
y.create.l HWIO_PMIC_ARB_OBS0_CHNL362_CMD_ADDR A:0xe60b500
y.create.l HWIO_PMIC_ARB_OBS0_CHNL363_CMD_ADDR A:0xe60b580
y.create.l HWIO_PMIC_ARB_OBS0_CHNL364_CMD_ADDR A:0xe60b600
y.create.l HWIO_PMIC_ARB_OBS0_CHNL365_CMD_ADDR A:0xe60b680
y.create.l HWIO_PMIC_ARB_OBS0_CHNL366_CMD_ADDR A:0xe60b700
y.create.l HWIO_PMIC_ARB_OBS0_CHNL367_CMD_ADDR A:0xe60b780
y.create.l HWIO_PMIC_ARB_OBS0_CHNL368_CMD_ADDR A:0xe60b800
y.create.l HWIO_PMIC_ARB_OBS0_CHNL369_CMD_ADDR A:0xe60b880
y.create.l HWIO_PMIC_ARB_OBS0_CHNL370_CMD_ADDR A:0xe60b900
y.create.l HWIO_PMIC_ARB_OBS0_CHNL371_CMD_ADDR A:0xe60b980
y.create.l HWIO_PMIC_ARB_OBS0_CHNL372_CMD_ADDR A:0xe60ba00
y.create.l HWIO_PMIC_ARB_OBS0_CHNL373_CMD_ADDR A:0xe60ba80
y.create.l HWIO_PMIC_ARB_OBS0_CHNL374_CMD_ADDR A:0xe60bb00
y.create.l HWIO_PMIC_ARB_OBS0_CHNL375_CMD_ADDR A:0xe60bb80
y.create.l HWIO_PMIC_ARB_OBS0_CHNL376_CMD_ADDR A:0xe60bc00
y.create.l HWIO_PMIC_ARB_OBS0_CHNL377_CMD_ADDR A:0xe60bc80
y.create.l HWIO_PMIC_ARB_OBS0_CHNL378_CMD_ADDR A:0xe60bd00
y.create.l HWIO_PMIC_ARB_OBS0_CHNL379_CMD_ADDR A:0xe60bd80
y.create.l HWIO_PMIC_ARB_OBS0_CHNL380_CMD_ADDR A:0xe60be00
y.create.l HWIO_PMIC_ARB_OBS0_CHNL381_CMD_ADDR A:0xe60be80
y.create.l HWIO_PMIC_ARB_OBS0_CHNL382_CMD_ADDR A:0xe60bf00
y.create.l HWIO_PMIC_ARB_OBS0_CHNL383_CMD_ADDR A:0xe60bf80
y.create.l HWIO_PMIC_ARB_OBS0_CHNL384_CMD_ADDR A:0xe60c000
y.create.l HWIO_PMIC_ARB_OBS0_CHNL385_CMD_ADDR A:0xe60c080
y.create.l HWIO_PMIC_ARB_OBS0_CHNL386_CMD_ADDR A:0xe60c100
y.create.l HWIO_PMIC_ARB_OBS0_CHNL387_CMD_ADDR A:0xe60c180
y.create.l HWIO_PMIC_ARB_OBS0_CHNL388_CMD_ADDR A:0xe60c200
y.create.l HWIO_PMIC_ARB_OBS0_CHNL389_CMD_ADDR A:0xe60c280
y.create.l HWIO_PMIC_ARB_OBS0_CHNL390_CMD_ADDR A:0xe60c300
y.create.l HWIO_PMIC_ARB_OBS0_CHNL391_CMD_ADDR A:0xe60c380
y.create.l HWIO_PMIC_ARB_OBS0_CHNL392_CMD_ADDR A:0xe60c400
y.create.l HWIO_PMIC_ARB_OBS0_CHNL393_CMD_ADDR A:0xe60c480
y.create.l HWIO_PMIC_ARB_OBS0_CHNL394_CMD_ADDR A:0xe60c500
y.create.l HWIO_PMIC_ARB_OBS0_CHNL395_CMD_ADDR A:0xe60c580
y.create.l HWIO_PMIC_ARB_OBS0_CHNL396_CMD_ADDR A:0xe60c600
y.create.l HWIO_PMIC_ARB_OBS0_CHNL397_CMD_ADDR A:0xe60c680
y.create.l HWIO_PMIC_ARB_OBS0_CHNL398_CMD_ADDR A:0xe60c700
y.create.l HWIO_PMIC_ARB_OBS0_CHNL399_CMD_ADDR A:0xe60c780
y.create.l HWIO_PMIC_ARB_OBS0_CHNL400_CMD_ADDR A:0xe60c800
y.create.l HWIO_PMIC_ARB_OBS0_CHNL401_CMD_ADDR A:0xe60c880
y.create.l HWIO_PMIC_ARB_OBS0_CHNL402_CMD_ADDR A:0xe60c900
y.create.l HWIO_PMIC_ARB_OBS0_CHNL403_CMD_ADDR A:0xe60c980
y.create.l HWIO_PMIC_ARB_OBS0_CHNL404_CMD_ADDR A:0xe60ca00
y.create.l HWIO_PMIC_ARB_OBS0_CHNL405_CMD_ADDR A:0xe60ca80
y.create.l HWIO_PMIC_ARB_OBS0_CHNL406_CMD_ADDR A:0xe60cb00
y.create.l HWIO_PMIC_ARB_OBS0_CHNL407_CMD_ADDR A:0xe60cb80
y.create.l HWIO_PMIC_ARB_OBS0_CHNL408_CMD_ADDR A:0xe60cc00
y.create.l HWIO_PMIC_ARB_OBS0_CHNL409_CMD_ADDR A:0xe60cc80
y.create.l HWIO_PMIC_ARB_OBS0_CHNL410_CMD_ADDR A:0xe60cd00
y.create.l HWIO_PMIC_ARB_OBS0_CHNL411_CMD_ADDR A:0xe60cd80
y.create.l HWIO_PMIC_ARB_OBS0_CHNL412_CMD_ADDR A:0xe60ce00
y.create.l HWIO_PMIC_ARB_OBS0_CHNL413_CMD_ADDR A:0xe60ce80
y.create.l HWIO_PMIC_ARB_OBS0_CHNL414_CMD_ADDR A:0xe60cf00
y.create.l HWIO_PMIC_ARB_OBS0_CHNL415_CMD_ADDR A:0xe60cf80
y.create.l HWIO_PMIC_ARB_OBS0_CHNL416_CMD_ADDR A:0xe60d000
y.create.l HWIO_PMIC_ARB_OBS0_CHNL417_CMD_ADDR A:0xe60d080
y.create.l HWIO_PMIC_ARB_OBS0_CHNL418_CMD_ADDR A:0xe60d100
y.create.l HWIO_PMIC_ARB_OBS0_CHNL419_CMD_ADDR A:0xe60d180
y.create.l HWIO_PMIC_ARB_OBS0_CHNL420_CMD_ADDR A:0xe60d200
y.create.l HWIO_PMIC_ARB_OBS0_CHNL421_CMD_ADDR A:0xe60d280
y.create.l HWIO_PMIC_ARB_OBS0_CHNL422_CMD_ADDR A:0xe60d300
y.create.l HWIO_PMIC_ARB_OBS0_CHNL423_CMD_ADDR A:0xe60d380
y.create.l HWIO_PMIC_ARB_OBS0_CHNL424_CMD_ADDR A:0xe60d400
y.create.l HWIO_PMIC_ARB_OBS0_CHNL425_CMD_ADDR A:0xe60d480
y.create.l HWIO_PMIC_ARB_OBS0_CHNL426_CMD_ADDR A:0xe60d500
y.create.l HWIO_PMIC_ARB_OBS0_CHNL427_CMD_ADDR A:0xe60d580
y.create.l HWIO_PMIC_ARB_OBS0_CHNL428_CMD_ADDR A:0xe60d600
y.create.l HWIO_PMIC_ARB_OBS0_CHNL429_CMD_ADDR A:0xe60d680
y.create.l HWIO_PMIC_ARB_OBS0_CHNL430_CMD_ADDR A:0xe60d700
y.create.l HWIO_PMIC_ARB_OBS0_CHNL431_CMD_ADDR A:0xe60d780
y.create.l HWIO_PMIC_ARB_OBS0_CHNL432_CMD_ADDR A:0xe60d800
y.create.l HWIO_PMIC_ARB_OBS0_CHNL433_CMD_ADDR A:0xe60d880
y.create.l HWIO_PMIC_ARB_OBS0_CHNL434_CMD_ADDR A:0xe60d900
y.create.l HWIO_PMIC_ARB_OBS0_CHNL435_CMD_ADDR A:0xe60d980
y.create.l HWIO_PMIC_ARB_OBS0_CHNL436_CMD_ADDR A:0xe60da00
y.create.l HWIO_PMIC_ARB_OBS0_CHNL437_CMD_ADDR A:0xe60da80
y.create.l HWIO_PMIC_ARB_OBS0_CHNL438_CMD_ADDR A:0xe60db00
y.create.l HWIO_PMIC_ARB_OBS0_CHNL439_CMD_ADDR A:0xe60db80
y.create.l HWIO_PMIC_ARB_OBS0_CHNL440_CMD_ADDR A:0xe60dc00
y.create.l HWIO_PMIC_ARB_OBS0_CHNL441_CMD_ADDR A:0xe60dc80
y.create.l HWIO_PMIC_ARB_OBS0_CHNL442_CMD_ADDR A:0xe60dd00
y.create.l HWIO_PMIC_ARB_OBS0_CHNL443_CMD_ADDR A:0xe60dd80
y.create.l HWIO_PMIC_ARB_OBS0_CHNL444_CMD_ADDR A:0xe60de00
y.create.l HWIO_PMIC_ARB_OBS0_CHNL445_CMD_ADDR A:0xe60de80
y.create.l HWIO_PMIC_ARB_OBS0_CHNL446_CMD_ADDR A:0xe60df00
y.create.l HWIO_PMIC_ARB_OBS0_CHNL447_CMD_ADDR A:0xe60df80
y.create.l HWIO_PMIC_ARB_OBS0_CHNL448_CMD_ADDR A:0xe60e000
y.create.l HWIO_PMIC_ARB_OBS0_CHNL449_CMD_ADDR A:0xe60e080
y.create.l HWIO_PMIC_ARB_OBS0_CHNL450_CMD_ADDR A:0xe60e100
y.create.l HWIO_PMIC_ARB_OBS0_CHNL451_CMD_ADDR A:0xe60e180
y.create.l HWIO_PMIC_ARB_OBS0_CHNL452_CMD_ADDR A:0xe60e200
y.create.l HWIO_PMIC_ARB_OBS0_CHNL453_CMD_ADDR A:0xe60e280
y.create.l HWIO_PMIC_ARB_OBS0_CHNL454_CMD_ADDR A:0xe60e300
y.create.l HWIO_PMIC_ARB_OBS0_CHNL455_CMD_ADDR A:0xe60e380
y.create.l HWIO_PMIC_ARB_OBS0_CHNL456_CMD_ADDR A:0xe60e400
y.create.l HWIO_PMIC_ARB_OBS0_CHNL457_CMD_ADDR A:0xe60e480
y.create.l HWIO_PMIC_ARB_OBS0_CHNL458_CMD_ADDR A:0xe60e500
y.create.l HWIO_PMIC_ARB_OBS0_CHNL459_CMD_ADDR A:0xe60e580
y.create.l HWIO_PMIC_ARB_OBS0_CHNL460_CMD_ADDR A:0xe60e600
y.create.l HWIO_PMIC_ARB_OBS0_CHNL461_CMD_ADDR A:0xe60e680
y.create.l HWIO_PMIC_ARB_OBS0_CHNL462_CMD_ADDR A:0xe60e700
y.create.l HWIO_PMIC_ARB_OBS0_CHNL463_CMD_ADDR A:0xe60e780
y.create.l HWIO_PMIC_ARB_OBS0_CHNL464_CMD_ADDR A:0xe60e800
y.create.l HWIO_PMIC_ARB_OBS0_CHNL465_CMD_ADDR A:0xe60e880
y.create.l HWIO_PMIC_ARB_OBS0_CHNL466_CMD_ADDR A:0xe60e900
y.create.l HWIO_PMIC_ARB_OBS0_CHNL467_CMD_ADDR A:0xe60e980
y.create.l HWIO_PMIC_ARB_OBS0_CHNL468_CMD_ADDR A:0xe60ea00
y.create.l HWIO_PMIC_ARB_OBS0_CHNL469_CMD_ADDR A:0xe60ea80
y.create.l HWIO_PMIC_ARB_OBS0_CHNL470_CMD_ADDR A:0xe60eb00
y.create.l HWIO_PMIC_ARB_OBS0_CHNL471_CMD_ADDR A:0xe60eb80
y.create.l HWIO_PMIC_ARB_OBS0_CHNL472_CMD_ADDR A:0xe60ec00
y.create.l HWIO_PMIC_ARB_OBS0_CHNL473_CMD_ADDR A:0xe60ec80
y.create.l HWIO_PMIC_ARB_OBS0_CHNL474_CMD_ADDR A:0xe60ed00
y.create.l HWIO_PMIC_ARB_OBS0_CHNL475_CMD_ADDR A:0xe60ed80
y.create.l HWIO_PMIC_ARB_OBS0_CHNL476_CMD_ADDR A:0xe60ee00
y.create.l HWIO_PMIC_ARB_OBS0_CHNL477_CMD_ADDR A:0xe60ee80
y.create.l HWIO_PMIC_ARB_OBS0_CHNL478_CMD_ADDR A:0xe60ef00
y.create.l HWIO_PMIC_ARB_OBS0_CHNL479_CMD_ADDR A:0xe60ef80
y.create.l HWIO_PMIC_ARB_OBS0_CHNL480_CMD_ADDR A:0xe60f000
y.create.l HWIO_PMIC_ARB_OBS0_CHNL481_CMD_ADDR A:0xe60f080
y.create.l HWIO_PMIC_ARB_OBS0_CHNL482_CMD_ADDR A:0xe60f100
y.create.l HWIO_PMIC_ARB_OBS0_CHNL483_CMD_ADDR A:0xe60f180
y.create.l HWIO_PMIC_ARB_OBS0_CHNL484_CMD_ADDR A:0xe60f200
y.create.l HWIO_PMIC_ARB_OBS0_CHNL485_CMD_ADDR A:0xe60f280
y.create.l HWIO_PMIC_ARB_OBS0_CHNL486_CMD_ADDR A:0xe60f300
y.create.l HWIO_PMIC_ARB_OBS0_CHNL487_CMD_ADDR A:0xe60f380
y.create.l HWIO_PMIC_ARB_OBS0_CHNL488_CMD_ADDR A:0xe60f400
y.create.l HWIO_PMIC_ARB_OBS0_CHNL489_CMD_ADDR A:0xe60f480
y.create.l HWIO_PMIC_ARB_OBS0_CHNL490_CMD_ADDR A:0xe60f500
y.create.l HWIO_PMIC_ARB_OBS0_CHNL491_CMD_ADDR A:0xe60f580
y.create.l HWIO_PMIC_ARB_OBS0_CHNL492_CMD_ADDR A:0xe60f600
y.create.l HWIO_PMIC_ARB_OBS0_CHNL493_CMD_ADDR A:0xe60f680
y.create.l HWIO_PMIC_ARB_OBS0_CHNL494_CMD_ADDR A:0xe60f700
y.create.l HWIO_PMIC_ARB_OBS0_CHNL495_CMD_ADDR A:0xe60f780
y.create.l HWIO_PMIC_ARB_OBS0_CHNL496_CMD_ADDR A:0xe60f800
y.create.l HWIO_PMIC_ARB_OBS0_CHNL497_CMD_ADDR A:0xe60f880
y.create.l HWIO_PMIC_ARB_OBS0_CHNL498_CMD_ADDR A:0xe60f900
y.create.l HWIO_PMIC_ARB_OBS0_CHNL499_CMD_ADDR A:0xe60f980
y.create.l HWIO_PMIC_ARB_OBS0_CHNL500_CMD_ADDR A:0xe60fa00
y.create.l HWIO_PMIC_ARB_OBS0_CHNL501_CMD_ADDR A:0xe60fa80
y.create.l HWIO_PMIC_ARB_OBS0_CHNL502_CMD_ADDR A:0xe60fb00
y.create.l HWIO_PMIC_ARB_OBS0_CHNL503_CMD_ADDR A:0xe60fb80
y.create.l HWIO_PMIC_ARB_OBS0_CHNL504_CMD_ADDR A:0xe60fc00
y.create.l HWIO_PMIC_ARB_OBS0_CHNL505_CMD_ADDR A:0xe60fc80
y.create.l HWIO_PMIC_ARB_OBS0_CHNL506_CMD_ADDR A:0xe60fd00
y.create.l HWIO_PMIC_ARB_OBS0_CHNL507_CMD_ADDR A:0xe60fd80
y.create.l HWIO_PMIC_ARB_OBS0_CHNL508_CMD_ADDR A:0xe60fe00
y.create.l HWIO_PMIC_ARB_OBS0_CHNL509_CMD_ADDR A:0xe60fe80
y.create.l HWIO_PMIC_ARB_OBS0_CHNL510_CMD_ADDR A:0xe60ff00
y.create.l HWIO_PMIC_ARB_OBS0_CHNL511_CMD_ADDR A:0xe60ff80
y.create.l HWIO_PMIC_ARB_OBS1_CHNL0_CMD_ADDR A:0xe610000
y.create.l HWIO_PMIC_ARB_OBS1_CHNL1_CMD_ADDR A:0xe610080
y.create.l HWIO_PMIC_ARB_OBS1_CHNL2_CMD_ADDR A:0xe610100
y.create.l HWIO_PMIC_ARB_OBS1_CHNL3_CMD_ADDR A:0xe610180
y.create.l HWIO_PMIC_ARB_OBS1_CHNL4_CMD_ADDR A:0xe610200
y.create.l HWIO_PMIC_ARB_OBS1_CHNL5_CMD_ADDR A:0xe610280
y.create.l HWIO_PMIC_ARB_OBS1_CHNL6_CMD_ADDR A:0xe610300
y.create.l HWIO_PMIC_ARB_OBS1_CHNL7_CMD_ADDR A:0xe610380
y.create.l HWIO_PMIC_ARB_OBS1_CHNL8_CMD_ADDR A:0xe610400
y.create.l HWIO_PMIC_ARB_OBS1_CHNL9_CMD_ADDR A:0xe610480
y.create.l HWIO_PMIC_ARB_OBS1_CHNL10_CMD_ADDR A:0xe610500
y.create.l HWIO_PMIC_ARB_OBS1_CHNL11_CMD_ADDR A:0xe610580
y.create.l HWIO_PMIC_ARB_OBS1_CHNL12_CMD_ADDR A:0xe610600
y.create.l HWIO_PMIC_ARB_OBS1_CHNL13_CMD_ADDR A:0xe610680
y.create.l HWIO_PMIC_ARB_OBS1_CHNL14_CMD_ADDR A:0xe610700
y.create.l HWIO_PMIC_ARB_OBS1_CHNL15_CMD_ADDR A:0xe610780
y.create.l HWIO_PMIC_ARB_OBS1_CHNL16_CMD_ADDR A:0xe610800
y.create.l HWIO_PMIC_ARB_OBS1_CHNL17_CMD_ADDR A:0xe610880
y.create.l HWIO_PMIC_ARB_OBS1_CHNL18_CMD_ADDR A:0xe610900
y.create.l HWIO_PMIC_ARB_OBS1_CHNL19_CMD_ADDR A:0xe610980
y.create.l HWIO_PMIC_ARB_OBS1_CHNL20_CMD_ADDR A:0xe610a00
y.create.l HWIO_PMIC_ARB_OBS1_CHNL21_CMD_ADDR A:0xe610a80
y.create.l HWIO_PMIC_ARB_OBS1_CHNL22_CMD_ADDR A:0xe610b00
y.create.l HWIO_PMIC_ARB_OBS1_CHNL23_CMD_ADDR A:0xe610b80
y.create.l HWIO_PMIC_ARB_OBS1_CHNL24_CMD_ADDR A:0xe610c00
y.create.l HWIO_PMIC_ARB_OBS1_CHNL25_CMD_ADDR A:0xe610c80
y.create.l HWIO_PMIC_ARB_OBS1_CHNL26_CMD_ADDR A:0xe610d00
y.create.l HWIO_PMIC_ARB_OBS1_CHNL27_CMD_ADDR A:0xe610d80
y.create.l HWIO_PMIC_ARB_OBS1_CHNL28_CMD_ADDR A:0xe610e00
y.create.l HWIO_PMIC_ARB_OBS1_CHNL29_CMD_ADDR A:0xe610e80
y.create.l HWIO_PMIC_ARB_OBS1_CHNL30_CMD_ADDR A:0xe610f00
y.create.l HWIO_PMIC_ARB_OBS1_CHNL31_CMD_ADDR A:0xe610f80
y.create.l HWIO_PMIC_ARB_OBS1_CHNL32_CMD_ADDR A:0xe611000
y.create.l HWIO_PMIC_ARB_OBS1_CHNL33_CMD_ADDR A:0xe611080
y.create.l HWIO_PMIC_ARB_OBS1_CHNL34_CMD_ADDR A:0xe611100
y.create.l HWIO_PMIC_ARB_OBS1_CHNL35_CMD_ADDR A:0xe611180
y.create.l HWIO_PMIC_ARB_OBS1_CHNL36_CMD_ADDR A:0xe611200
y.create.l HWIO_PMIC_ARB_OBS1_CHNL37_CMD_ADDR A:0xe611280
y.create.l HWIO_PMIC_ARB_OBS1_CHNL38_CMD_ADDR A:0xe611300
y.create.l HWIO_PMIC_ARB_OBS1_CHNL39_CMD_ADDR A:0xe611380
y.create.l HWIO_PMIC_ARB_OBS1_CHNL40_CMD_ADDR A:0xe611400
y.create.l HWIO_PMIC_ARB_OBS1_CHNL41_CMD_ADDR A:0xe611480
y.create.l HWIO_PMIC_ARB_OBS1_CHNL42_CMD_ADDR A:0xe611500
y.create.l HWIO_PMIC_ARB_OBS1_CHNL43_CMD_ADDR A:0xe611580
y.create.l HWIO_PMIC_ARB_OBS1_CHNL44_CMD_ADDR A:0xe611600
y.create.l HWIO_PMIC_ARB_OBS1_CHNL45_CMD_ADDR A:0xe611680
y.create.l HWIO_PMIC_ARB_OBS1_CHNL46_CMD_ADDR A:0xe611700
y.create.l HWIO_PMIC_ARB_OBS1_CHNL47_CMD_ADDR A:0xe611780
y.create.l HWIO_PMIC_ARB_OBS1_CHNL48_CMD_ADDR A:0xe611800
y.create.l HWIO_PMIC_ARB_OBS1_CHNL49_CMD_ADDR A:0xe611880
y.create.l HWIO_PMIC_ARB_OBS1_CHNL50_CMD_ADDR A:0xe611900
y.create.l HWIO_PMIC_ARB_OBS1_CHNL51_CMD_ADDR A:0xe611980
y.create.l HWIO_PMIC_ARB_OBS1_CHNL52_CMD_ADDR A:0xe611a00
y.create.l HWIO_PMIC_ARB_OBS1_CHNL53_CMD_ADDR A:0xe611a80
y.create.l HWIO_PMIC_ARB_OBS1_CHNL54_CMD_ADDR A:0xe611b00
y.create.l HWIO_PMIC_ARB_OBS1_CHNL55_CMD_ADDR A:0xe611b80
y.create.l HWIO_PMIC_ARB_OBS1_CHNL56_CMD_ADDR A:0xe611c00
y.create.l HWIO_PMIC_ARB_OBS1_CHNL57_CMD_ADDR A:0xe611c80
y.create.l HWIO_PMIC_ARB_OBS1_CHNL58_CMD_ADDR A:0xe611d00
y.create.l HWIO_PMIC_ARB_OBS1_CHNL59_CMD_ADDR A:0xe611d80
y.create.l HWIO_PMIC_ARB_OBS1_CHNL60_CMD_ADDR A:0xe611e00
y.create.l HWIO_PMIC_ARB_OBS1_CHNL61_CMD_ADDR A:0xe611e80
y.create.l HWIO_PMIC_ARB_OBS1_CHNL62_CMD_ADDR A:0xe611f00
y.create.l HWIO_PMIC_ARB_OBS1_CHNL63_CMD_ADDR A:0xe611f80
y.create.l HWIO_PMIC_ARB_OBS1_CHNL64_CMD_ADDR A:0xe612000
y.create.l HWIO_PMIC_ARB_OBS1_CHNL65_CMD_ADDR A:0xe612080
y.create.l HWIO_PMIC_ARB_OBS1_CHNL66_CMD_ADDR A:0xe612100
y.create.l HWIO_PMIC_ARB_OBS1_CHNL67_CMD_ADDR A:0xe612180
y.create.l HWIO_PMIC_ARB_OBS1_CHNL68_CMD_ADDR A:0xe612200
y.create.l HWIO_PMIC_ARB_OBS1_CHNL69_CMD_ADDR A:0xe612280
y.create.l HWIO_PMIC_ARB_OBS1_CHNL70_CMD_ADDR A:0xe612300
y.create.l HWIO_PMIC_ARB_OBS1_CHNL71_CMD_ADDR A:0xe612380
y.create.l HWIO_PMIC_ARB_OBS1_CHNL72_CMD_ADDR A:0xe612400
y.create.l HWIO_PMIC_ARB_OBS1_CHNL73_CMD_ADDR A:0xe612480
y.create.l HWIO_PMIC_ARB_OBS1_CHNL74_CMD_ADDR A:0xe612500
y.create.l HWIO_PMIC_ARB_OBS1_CHNL75_CMD_ADDR A:0xe612580
y.create.l HWIO_PMIC_ARB_OBS1_CHNL76_CMD_ADDR A:0xe612600
y.create.l HWIO_PMIC_ARB_OBS1_CHNL77_CMD_ADDR A:0xe612680
y.create.l HWIO_PMIC_ARB_OBS1_CHNL78_CMD_ADDR A:0xe612700
y.create.l HWIO_PMIC_ARB_OBS1_CHNL79_CMD_ADDR A:0xe612780
y.create.l HWIO_PMIC_ARB_OBS1_CHNL80_CMD_ADDR A:0xe612800
y.create.l HWIO_PMIC_ARB_OBS1_CHNL81_CMD_ADDR A:0xe612880
y.create.l HWIO_PMIC_ARB_OBS1_CHNL82_CMD_ADDR A:0xe612900
y.create.l HWIO_PMIC_ARB_OBS1_CHNL83_CMD_ADDR A:0xe612980
y.create.l HWIO_PMIC_ARB_OBS1_CHNL84_CMD_ADDR A:0xe612a00
y.create.l HWIO_PMIC_ARB_OBS1_CHNL85_CMD_ADDR A:0xe612a80
y.create.l HWIO_PMIC_ARB_OBS1_CHNL86_CMD_ADDR A:0xe612b00
y.create.l HWIO_PMIC_ARB_OBS1_CHNL87_CMD_ADDR A:0xe612b80
y.create.l HWIO_PMIC_ARB_OBS1_CHNL88_CMD_ADDR A:0xe612c00
y.create.l HWIO_PMIC_ARB_OBS1_CHNL89_CMD_ADDR A:0xe612c80
y.create.l HWIO_PMIC_ARB_OBS1_CHNL90_CMD_ADDR A:0xe612d00
y.create.l HWIO_PMIC_ARB_OBS1_CHNL91_CMD_ADDR A:0xe612d80
y.create.l HWIO_PMIC_ARB_OBS1_CHNL92_CMD_ADDR A:0xe612e00
y.create.l HWIO_PMIC_ARB_OBS1_CHNL93_CMD_ADDR A:0xe612e80
y.create.l HWIO_PMIC_ARB_OBS1_CHNL94_CMD_ADDR A:0xe612f00
y.create.l HWIO_PMIC_ARB_OBS1_CHNL95_CMD_ADDR A:0xe612f80
y.create.l HWIO_PMIC_ARB_OBS1_CHNL96_CMD_ADDR A:0xe613000
y.create.l HWIO_PMIC_ARB_OBS1_CHNL97_CMD_ADDR A:0xe613080
y.create.l HWIO_PMIC_ARB_OBS1_CHNL98_CMD_ADDR A:0xe613100
y.create.l HWIO_PMIC_ARB_OBS1_CHNL99_CMD_ADDR A:0xe613180
y.create.l HWIO_PMIC_ARB_OBS1_CHNL100_CMD_ADDR A:0xe613200
y.create.l HWIO_PMIC_ARB_OBS1_CHNL101_CMD_ADDR A:0xe613280
y.create.l HWIO_PMIC_ARB_OBS1_CHNL102_CMD_ADDR A:0xe613300
y.create.l HWIO_PMIC_ARB_OBS1_CHNL103_CMD_ADDR A:0xe613380
y.create.l HWIO_PMIC_ARB_OBS1_CHNL104_CMD_ADDR A:0xe613400
y.create.l HWIO_PMIC_ARB_OBS1_CHNL105_CMD_ADDR A:0xe613480
y.create.l HWIO_PMIC_ARB_OBS1_CHNL106_CMD_ADDR A:0xe613500
y.create.l HWIO_PMIC_ARB_OBS1_CHNL107_CMD_ADDR A:0xe613580
y.create.l HWIO_PMIC_ARB_OBS1_CHNL108_CMD_ADDR A:0xe613600
y.create.l HWIO_PMIC_ARB_OBS1_CHNL109_CMD_ADDR A:0xe613680
y.create.l HWIO_PMIC_ARB_OBS1_CHNL110_CMD_ADDR A:0xe613700
y.create.l HWIO_PMIC_ARB_OBS1_CHNL111_CMD_ADDR A:0xe613780
y.create.l HWIO_PMIC_ARB_OBS1_CHNL112_CMD_ADDR A:0xe613800
y.create.l HWIO_PMIC_ARB_OBS1_CHNL113_CMD_ADDR A:0xe613880
y.create.l HWIO_PMIC_ARB_OBS1_CHNL114_CMD_ADDR A:0xe613900
y.create.l HWIO_PMIC_ARB_OBS1_CHNL115_CMD_ADDR A:0xe613980
y.create.l HWIO_PMIC_ARB_OBS1_CHNL116_CMD_ADDR A:0xe613a00
y.create.l HWIO_PMIC_ARB_OBS1_CHNL117_CMD_ADDR A:0xe613a80
y.create.l HWIO_PMIC_ARB_OBS1_CHNL118_CMD_ADDR A:0xe613b00
y.create.l HWIO_PMIC_ARB_OBS1_CHNL119_CMD_ADDR A:0xe613b80
y.create.l HWIO_PMIC_ARB_OBS1_CHNL120_CMD_ADDR A:0xe613c00
y.create.l HWIO_PMIC_ARB_OBS1_CHNL121_CMD_ADDR A:0xe613c80
y.create.l HWIO_PMIC_ARB_OBS1_CHNL122_CMD_ADDR A:0xe613d00
y.create.l HWIO_PMIC_ARB_OBS1_CHNL123_CMD_ADDR A:0xe613d80
y.create.l HWIO_PMIC_ARB_OBS1_CHNL124_CMD_ADDR A:0xe613e00
y.create.l HWIO_PMIC_ARB_OBS1_CHNL125_CMD_ADDR A:0xe613e80
y.create.l HWIO_PMIC_ARB_OBS1_CHNL126_CMD_ADDR A:0xe613f00
y.create.l HWIO_PMIC_ARB_OBS1_CHNL127_CMD_ADDR A:0xe613f80
y.create.l HWIO_PMIC_ARB_OBS1_CHNL128_CMD_ADDR A:0xe614000
y.create.l HWIO_PMIC_ARB_OBS1_CHNL129_CMD_ADDR A:0xe614080
y.create.l HWIO_PMIC_ARB_OBS1_CHNL130_CMD_ADDR A:0xe614100
y.create.l HWIO_PMIC_ARB_OBS1_CHNL131_CMD_ADDR A:0xe614180
y.create.l HWIO_PMIC_ARB_OBS1_CHNL132_CMD_ADDR A:0xe614200
y.create.l HWIO_PMIC_ARB_OBS1_CHNL133_CMD_ADDR A:0xe614280
y.create.l HWIO_PMIC_ARB_OBS1_CHNL134_CMD_ADDR A:0xe614300
y.create.l HWIO_PMIC_ARB_OBS1_CHNL135_CMD_ADDR A:0xe614380
y.create.l HWIO_PMIC_ARB_OBS1_CHNL136_CMD_ADDR A:0xe614400
y.create.l HWIO_PMIC_ARB_OBS1_CHNL137_CMD_ADDR A:0xe614480
y.create.l HWIO_PMIC_ARB_OBS1_CHNL138_CMD_ADDR A:0xe614500
y.create.l HWIO_PMIC_ARB_OBS1_CHNL139_CMD_ADDR A:0xe614580
y.create.l HWIO_PMIC_ARB_OBS1_CHNL140_CMD_ADDR A:0xe614600
y.create.l HWIO_PMIC_ARB_OBS1_CHNL141_CMD_ADDR A:0xe614680
y.create.l HWIO_PMIC_ARB_OBS1_CHNL142_CMD_ADDR A:0xe614700
y.create.l HWIO_PMIC_ARB_OBS1_CHNL143_CMD_ADDR A:0xe614780
y.create.l HWIO_PMIC_ARB_OBS1_CHNL144_CMD_ADDR A:0xe614800
y.create.l HWIO_PMIC_ARB_OBS1_CHNL145_CMD_ADDR A:0xe614880
y.create.l HWIO_PMIC_ARB_OBS1_CHNL146_CMD_ADDR A:0xe614900
y.create.l HWIO_PMIC_ARB_OBS1_CHNL147_CMD_ADDR A:0xe614980
y.create.l HWIO_PMIC_ARB_OBS1_CHNL148_CMD_ADDR A:0xe614a00
y.create.l HWIO_PMIC_ARB_OBS1_CHNL149_CMD_ADDR A:0xe614a80
y.create.l HWIO_PMIC_ARB_OBS1_CHNL150_CMD_ADDR A:0xe614b00
y.create.l HWIO_PMIC_ARB_OBS1_CHNL151_CMD_ADDR A:0xe614b80
y.create.l HWIO_PMIC_ARB_OBS1_CHNL152_CMD_ADDR A:0xe614c00
y.create.l HWIO_PMIC_ARB_OBS1_CHNL153_CMD_ADDR A:0xe614c80
y.create.l HWIO_PMIC_ARB_OBS1_CHNL154_CMD_ADDR A:0xe614d00
y.create.l HWIO_PMIC_ARB_OBS1_CHNL155_CMD_ADDR A:0xe614d80
y.create.l HWIO_PMIC_ARB_OBS1_CHNL156_CMD_ADDR A:0xe614e00
y.create.l HWIO_PMIC_ARB_OBS1_CHNL157_CMD_ADDR A:0xe614e80
y.create.l HWIO_PMIC_ARB_OBS1_CHNL158_CMD_ADDR A:0xe614f00
y.create.l HWIO_PMIC_ARB_OBS1_CHNL159_CMD_ADDR A:0xe614f80
y.create.l HWIO_PMIC_ARB_OBS1_CHNL160_CMD_ADDR A:0xe615000
y.create.l HWIO_PMIC_ARB_OBS1_CHNL161_CMD_ADDR A:0xe615080
y.create.l HWIO_PMIC_ARB_OBS1_CHNL162_CMD_ADDR A:0xe615100
y.create.l HWIO_PMIC_ARB_OBS1_CHNL163_CMD_ADDR A:0xe615180
y.create.l HWIO_PMIC_ARB_OBS1_CHNL164_CMD_ADDR A:0xe615200
y.create.l HWIO_PMIC_ARB_OBS1_CHNL165_CMD_ADDR A:0xe615280
y.create.l HWIO_PMIC_ARB_OBS1_CHNL166_CMD_ADDR A:0xe615300
y.create.l HWIO_PMIC_ARB_OBS1_CHNL167_CMD_ADDR A:0xe615380
y.create.l HWIO_PMIC_ARB_OBS1_CHNL168_CMD_ADDR A:0xe615400
y.create.l HWIO_PMIC_ARB_OBS1_CHNL169_CMD_ADDR A:0xe615480
y.create.l HWIO_PMIC_ARB_OBS1_CHNL170_CMD_ADDR A:0xe615500
y.create.l HWIO_PMIC_ARB_OBS1_CHNL171_CMD_ADDR A:0xe615580
y.create.l HWIO_PMIC_ARB_OBS1_CHNL172_CMD_ADDR A:0xe615600
y.create.l HWIO_PMIC_ARB_OBS1_CHNL173_CMD_ADDR A:0xe615680
y.create.l HWIO_PMIC_ARB_OBS1_CHNL174_CMD_ADDR A:0xe615700
y.create.l HWIO_PMIC_ARB_OBS1_CHNL175_CMD_ADDR A:0xe615780
y.create.l HWIO_PMIC_ARB_OBS1_CHNL176_CMD_ADDR A:0xe615800
y.create.l HWIO_PMIC_ARB_OBS1_CHNL177_CMD_ADDR A:0xe615880
y.create.l HWIO_PMIC_ARB_OBS1_CHNL178_CMD_ADDR A:0xe615900
y.create.l HWIO_PMIC_ARB_OBS1_CHNL179_CMD_ADDR A:0xe615980
y.create.l HWIO_PMIC_ARB_OBS1_CHNL180_CMD_ADDR A:0xe615a00
y.create.l HWIO_PMIC_ARB_OBS1_CHNL181_CMD_ADDR A:0xe615a80
y.create.l HWIO_PMIC_ARB_OBS1_CHNL182_CMD_ADDR A:0xe615b00
y.create.l HWIO_PMIC_ARB_OBS1_CHNL183_CMD_ADDR A:0xe615b80
y.create.l HWIO_PMIC_ARB_OBS1_CHNL184_CMD_ADDR A:0xe615c00
y.create.l HWIO_PMIC_ARB_OBS1_CHNL185_CMD_ADDR A:0xe615c80
y.create.l HWIO_PMIC_ARB_OBS1_CHNL186_CMD_ADDR A:0xe615d00
y.create.l HWIO_PMIC_ARB_OBS1_CHNL187_CMD_ADDR A:0xe615d80
y.create.l HWIO_PMIC_ARB_OBS1_CHNL188_CMD_ADDR A:0xe615e00
y.create.l HWIO_PMIC_ARB_OBS1_CHNL189_CMD_ADDR A:0xe615e80
y.create.l HWIO_PMIC_ARB_OBS1_CHNL190_CMD_ADDR A:0xe615f00
y.create.l HWIO_PMIC_ARB_OBS1_CHNL191_CMD_ADDR A:0xe615f80
y.create.l HWIO_PMIC_ARB_OBS1_CHNL192_CMD_ADDR A:0xe616000
y.create.l HWIO_PMIC_ARB_OBS1_CHNL193_CMD_ADDR A:0xe616080
y.create.l HWIO_PMIC_ARB_OBS1_CHNL194_CMD_ADDR A:0xe616100
y.create.l HWIO_PMIC_ARB_OBS1_CHNL195_CMD_ADDR A:0xe616180
y.create.l HWIO_PMIC_ARB_OBS1_CHNL196_CMD_ADDR A:0xe616200
y.create.l HWIO_PMIC_ARB_OBS1_CHNL197_CMD_ADDR A:0xe616280
y.create.l HWIO_PMIC_ARB_OBS1_CHNL198_CMD_ADDR A:0xe616300
y.create.l HWIO_PMIC_ARB_OBS1_CHNL199_CMD_ADDR A:0xe616380
y.create.l HWIO_PMIC_ARB_OBS1_CHNL200_CMD_ADDR A:0xe616400
y.create.l HWIO_PMIC_ARB_OBS1_CHNL201_CMD_ADDR A:0xe616480
y.create.l HWIO_PMIC_ARB_OBS1_CHNL202_CMD_ADDR A:0xe616500
y.create.l HWIO_PMIC_ARB_OBS1_CHNL203_CMD_ADDR A:0xe616580
y.create.l HWIO_PMIC_ARB_OBS1_CHNL204_CMD_ADDR A:0xe616600
y.create.l HWIO_PMIC_ARB_OBS1_CHNL205_CMD_ADDR A:0xe616680
y.create.l HWIO_PMIC_ARB_OBS1_CHNL206_CMD_ADDR A:0xe616700
y.create.l HWIO_PMIC_ARB_OBS1_CHNL207_CMD_ADDR A:0xe616780
y.create.l HWIO_PMIC_ARB_OBS1_CHNL208_CMD_ADDR A:0xe616800
y.create.l HWIO_PMIC_ARB_OBS1_CHNL209_CMD_ADDR A:0xe616880
y.create.l HWIO_PMIC_ARB_OBS1_CHNL210_CMD_ADDR A:0xe616900
y.create.l HWIO_PMIC_ARB_OBS1_CHNL211_CMD_ADDR A:0xe616980
y.create.l HWIO_PMIC_ARB_OBS1_CHNL212_CMD_ADDR A:0xe616a00
y.create.l HWIO_PMIC_ARB_OBS1_CHNL213_CMD_ADDR A:0xe616a80
y.create.l HWIO_PMIC_ARB_OBS1_CHNL214_CMD_ADDR A:0xe616b00
y.create.l HWIO_PMIC_ARB_OBS1_CHNL215_CMD_ADDR A:0xe616b80
y.create.l HWIO_PMIC_ARB_OBS1_CHNL216_CMD_ADDR A:0xe616c00
y.create.l HWIO_PMIC_ARB_OBS1_CHNL217_CMD_ADDR A:0xe616c80
y.create.l HWIO_PMIC_ARB_OBS1_CHNL218_CMD_ADDR A:0xe616d00
y.create.l HWIO_PMIC_ARB_OBS1_CHNL219_CMD_ADDR A:0xe616d80
y.create.l HWIO_PMIC_ARB_OBS1_CHNL220_CMD_ADDR A:0xe616e00
y.create.l HWIO_PMIC_ARB_OBS1_CHNL221_CMD_ADDR A:0xe616e80
y.create.l HWIO_PMIC_ARB_OBS1_CHNL222_CMD_ADDR A:0xe616f00
y.create.l HWIO_PMIC_ARB_OBS1_CHNL223_CMD_ADDR A:0xe616f80
y.create.l HWIO_PMIC_ARB_OBS1_CHNL224_CMD_ADDR A:0xe617000
y.create.l HWIO_PMIC_ARB_OBS1_CHNL225_CMD_ADDR A:0xe617080
y.create.l HWIO_PMIC_ARB_OBS1_CHNL226_CMD_ADDR A:0xe617100
y.create.l HWIO_PMIC_ARB_OBS1_CHNL227_CMD_ADDR A:0xe617180
y.create.l HWIO_PMIC_ARB_OBS1_CHNL228_CMD_ADDR A:0xe617200
y.create.l HWIO_PMIC_ARB_OBS1_CHNL229_CMD_ADDR A:0xe617280
y.create.l HWIO_PMIC_ARB_OBS1_CHNL230_CMD_ADDR A:0xe617300
y.create.l HWIO_PMIC_ARB_OBS1_CHNL231_CMD_ADDR A:0xe617380
y.create.l HWIO_PMIC_ARB_OBS1_CHNL232_CMD_ADDR A:0xe617400
y.create.l HWIO_PMIC_ARB_OBS1_CHNL233_CMD_ADDR A:0xe617480
y.create.l HWIO_PMIC_ARB_OBS1_CHNL234_CMD_ADDR A:0xe617500
y.create.l HWIO_PMIC_ARB_OBS1_CHNL235_CMD_ADDR A:0xe617580
y.create.l HWIO_PMIC_ARB_OBS1_CHNL236_CMD_ADDR A:0xe617600
y.create.l HWIO_PMIC_ARB_OBS1_CHNL237_CMD_ADDR A:0xe617680
y.create.l HWIO_PMIC_ARB_OBS1_CHNL238_CMD_ADDR A:0xe617700
y.create.l HWIO_PMIC_ARB_OBS1_CHNL239_CMD_ADDR A:0xe617780
y.create.l HWIO_PMIC_ARB_OBS1_CHNL240_CMD_ADDR A:0xe617800
y.create.l HWIO_PMIC_ARB_OBS1_CHNL241_CMD_ADDR A:0xe617880
y.create.l HWIO_PMIC_ARB_OBS1_CHNL242_CMD_ADDR A:0xe617900
y.create.l HWIO_PMIC_ARB_OBS1_CHNL243_CMD_ADDR A:0xe617980
y.create.l HWIO_PMIC_ARB_OBS1_CHNL244_CMD_ADDR A:0xe617a00
y.create.l HWIO_PMIC_ARB_OBS1_CHNL245_CMD_ADDR A:0xe617a80
y.create.l HWIO_PMIC_ARB_OBS1_CHNL246_CMD_ADDR A:0xe617b00
y.create.l HWIO_PMIC_ARB_OBS1_CHNL247_CMD_ADDR A:0xe617b80
y.create.l HWIO_PMIC_ARB_OBS1_CHNL248_CMD_ADDR A:0xe617c00
y.create.l HWIO_PMIC_ARB_OBS1_CHNL249_CMD_ADDR A:0xe617c80
y.create.l HWIO_PMIC_ARB_OBS1_CHNL250_CMD_ADDR A:0xe617d00
y.create.l HWIO_PMIC_ARB_OBS1_CHNL251_CMD_ADDR A:0xe617d80
y.create.l HWIO_PMIC_ARB_OBS1_CHNL252_CMD_ADDR A:0xe617e00
y.create.l HWIO_PMIC_ARB_OBS1_CHNL253_CMD_ADDR A:0xe617e80
y.create.l HWIO_PMIC_ARB_OBS1_CHNL254_CMD_ADDR A:0xe617f00
y.create.l HWIO_PMIC_ARB_OBS1_CHNL255_CMD_ADDR A:0xe617f80
y.create.l HWIO_PMIC_ARB_OBS1_CHNL256_CMD_ADDR A:0xe618000
y.create.l HWIO_PMIC_ARB_OBS1_CHNL257_CMD_ADDR A:0xe618080
y.create.l HWIO_PMIC_ARB_OBS1_CHNL258_CMD_ADDR A:0xe618100
y.create.l HWIO_PMIC_ARB_OBS1_CHNL259_CMD_ADDR A:0xe618180
y.create.l HWIO_PMIC_ARB_OBS1_CHNL260_CMD_ADDR A:0xe618200
y.create.l HWIO_PMIC_ARB_OBS1_CHNL261_CMD_ADDR A:0xe618280
y.create.l HWIO_PMIC_ARB_OBS1_CHNL262_CMD_ADDR A:0xe618300
y.create.l HWIO_PMIC_ARB_OBS1_CHNL263_CMD_ADDR A:0xe618380
y.create.l HWIO_PMIC_ARB_OBS1_CHNL264_CMD_ADDR A:0xe618400
y.create.l HWIO_PMIC_ARB_OBS1_CHNL265_CMD_ADDR A:0xe618480
y.create.l HWIO_PMIC_ARB_OBS1_CHNL266_CMD_ADDR A:0xe618500
y.create.l HWIO_PMIC_ARB_OBS1_CHNL267_CMD_ADDR A:0xe618580
y.create.l HWIO_PMIC_ARB_OBS1_CHNL268_CMD_ADDR A:0xe618600
y.create.l HWIO_PMIC_ARB_OBS1_CHNL269_CMD_ADDR A:0xe618680
y.create.l HWIO_PMIC_ARB_OBS1_CHNL270_CMD_ADDR A:0xe618700
y.create.l HWIO_PMIC_ARB_OBS1_CHNL271_CMD_ADDR A:0xe618780
y.create.l HWIO_PMIC_ARB_OBS1_CHNL272_CMD_ADDR A:0xe618800
y.create.l HWIO_PMIC_ARB_OBS1_CHNL273_CMD_ADDR A:0xe618880
y.create.l HWIO_PMIC_ARB_OBS1_CHNL274_CMD_ADDR A:0xe618900
y.create.l HWIO_PMIC_ARB_OBS1_CHNL275_CMD_ADDR A:0xe618980
y.create.l HWIO_PMIC_ARB_OBS1_CHNL276_CMD_ADDR A:0xe618a00
y.create.l HWIO_PMIC_ARB_OBS1_CHNL277_CMD_ADDR A:0xe618a80
y.create.l HWIO_PMIC_ARB_OBS1_CHNL278_CMD_ADDR A:0xe618b00
y.create.l HWIO_PMIC_ARB_OBS1_CHNL279_CMD_ADDR A:0xe618b80
y.create.l HWIO_PMIC_ARB_OBS1_CHNL280_CMD_ADDR A:0xe618c00
y.create.l HWIO_PMIC_ARB_OBS1_CHNL281_CMD_ADDR A:0xe618c80
y.create.l HWIO_PMIC_ARB_OBS1_CHNL282_CMD_ADDR A:0xe618d00
y.create.l HWIO_PMIC_ARB_OBS1_CHNL283_CMD_ADDR A:0xe618d80
y.create.l HWIO_PMIC_ARB_OBS1_CHNL284_CMD_ADDR A:0xe618e00
y.create.l HWIO_PMIC_ARB_OBS1_CHNL285_CMD_ADDR A:0xe618e80
y.create.l HWIO_PMIC_ARB_OBS1_CHNL286_CMD_ADDR A:0xe618f00
y.create.l HWIO_PMIC_ARB_OBS1_CHNL287_CMD_ADDR A:0xe618f80
y.create.l HWIO_PMIC_ARB_OBS1_CHNL288_CMD_ADDR A:0xe619000
y.create.l HWIO_PMIC_ARB_OBS1_CHNL289_CMD_ADDR A:0xe619080
y.create.l HWIO_PMIC_ARB_OBS1_CHNL290_CMD_ADDR A:0xe619100
y.create.l HWIO_PMIC_ARB_OBS1_CHNL291_CMD_ADDR A:0xe619180
y.create.l HWIO_PMIC_ARB_OBS1_CHNL292_CMD_ADDR A:0xe619200
y.create.l HWIO_PMIC_ARB_OBS1_CHNL293_CMD_ADDR A:0xe619280
y.create.l HWIO_PMIC_ARB_OBS1_CHNL294_CMD_ADDR A:0xe619300
y.create.l HWIO_PMIC_ARB_OBS1_CHNL295_CMD_ADDR A:0xe619380
y.create.l HWIO_PMIC_ARB_OBS1_CHNL296_CMD_ADDR A:0xe619400
y.create.l HWIO_PMIC_ARB_OBS1_CHNL297_CMD_ADDR A:0xe619480
y.create.l HWIO_PMIC_ARB_OBS1_CHNL298_CMD_ADDR A:0xe619500
y.create.l HWIO_PMIC_ARB_OBS1_CHNL299_CMD_ADDR A:0xe619580
y.create.l HWIO_PMIC_ARB_OBS1_CHNL300_CMD_ADDR A:0xe619600
y.create.l HWIO_PMIC_ARB_OBS1_CHNL301_CMD_ADDR A:0xe619680
y.create.l HWIO_PMIC_ARB_OBS1_CHNL302_CMD_ADDR A:0xe619700
y.create.l HWIO_PMIC_ARB_OBS1_CHNL303_CMD_ADDR A:0xe619780
y.create.l HWIO_PMIC_ARB_OBS1_CHNL304_CMD_ADDR A:0xe619800
y.create.l HWIO_PMIC_ARB_OBS1_CHNL305_CMD_ADDR A:0xe619880
y.create.l HWIO_PMIC_ARB_OBS1_CHNL306_CMD_ADDR A:0xe619900
y.create.l HWIO_PMIC_ARB_OBS1_CHNL307_CMD_ADDR A:0xe619980
y.create.l HWIO_PMIC_ARB_OBS1_CHNL308_CMD_ADDR A:0xe619a00
y.create.l HWIO_PMIC_ARB_OBS1_CHNL309_CMD_ADDR A:0xe619a80
y.create.l HWIO_PMIC_ARB_OBS1_CHNL310_CMD_ADDR A:0xe619b00
y.create.l HWIO_PMIC_ARB_OBS1_CHNL311_CMD_ADDR A:0xe619b80
y.create.l HWIO_PMIC_ARB_OBS1_CHNL312_CMD_ADDR A:0xe619c00
y.create.l HWIO_PMIC_ARB_OBS1_CHNL313_CMD_ADDR A:0xe619c80
y.create.l HWIO_PMIC_ARB_OBS1_CHNL314_CMD_ADDR A:0xe619d00
y.create.l HWIO_PMIC_ARB_OBS1_CHNL315_CMD_ADDR A:0xe619d80
y.create.l HWIO_PMIC_ARB_OBS1_CHNL316_CMD_ADDR A:0xe619e00
y.create.l HWIO_PMIC_ARB_OBS1_CHNL317_CMD_ADDR A:0xe619e80
y.create.l HWIO_PMIC_ARB_OBS1_CHNL318_CMD_ADDR A:0xe619f00
y.create.l HWIO_PMIC_ARB_OBS1_CHNL319_CMD_ADDR A:0xe619f80
y.create.l HWIO_PMIC_ARB_OBS1_CHNL320_CMD_ADDR A:0xe61a000
y.create.l HWIO_PMIC_ARB_OBS1_CHNL321_CMD_ADDR A:0xe61a080
y.create.l HWIO_PMIC_ARB_OBS1_CHNL322_CMD_ADDR A:0xe61a100
y.create.l HWIO_PMIC_ARB_OBS1_CHNL323_CMD_ADDR A:0xe61a180
y.create.l HWIO_PMIC_ARB_OBS1_CHNL324_CMD_ADDR A:0xe61a200
y.create.l HWIO_PMIC_ARB_OBS1_CHNL325_CMD_ADDR A:0xe61a280
y.create.l HWIO_PMIC_ARB_OBS1_CHNL326_CMD_ADDR A:0xe61a300
y.create.l HWIO_PMIC_ARB_OBS1_CHNL327_CMD_ADDR A:0xe61a380
y.create.l HWIO_PMIC_ARB_OBS1_CHNL328_CMD_ADDR A:0xe61a400
y.create.l HWIO_PMIC_ARB_OBS1_CHNL329_CMD_ADDR A:0xe61a480
y.create.l HWIO_PMIC_ARB_OBS1_CHNL330_CMD_ADDR A:0xe61a500
y.create.l HWIO_PMIC_ARB_OBS1_CHNL331_CMD_ADDR A:0xe61a580
y.create.l HWIO_PMIC_ARB_OBS1_CHNL332_CMD_ADDR A:0xe61a600
y.create.l HWIO_PMIC_ARB_OBS1_CHNL333_CMD_ADDR A:0xe61a680
y.create.l HWIO_PMIC_ARB_OBS1_CHNL334_CMD_ADDR A:0xe61a700
y.create.l HWIO_PMIC_ARB_OBS1_CHNL335_CMD_ADDR A:0xe61a780
y.create.l HWIO_PMIC_ARB_OBS1_CHNL336_CMD_ADDR A:0xe61a800
y.create.l HWIO_PMIC_ARB_OBS1_CHNL337_CMD_ADDR A:0xe61a880
y.create.l HWIO_PMIC_ARB_OBS1_CHNL338_CMD_ADDR A:0xe61a900
y.create.l HWIO_PMIC_ARB_OBS1_CHNL339_CMD_ADDR A:0xe61a980
y.create.l HWIO_PMIC_ARB_OBS1_CHNL340_CMD_ADDR A:0xe61aa00
y.create.l HWIO_PMIC_ARB_OBS1_CHNL341_CMD_ADDR A:0xe61aa80
y.create.l HWIO_PMIC_ARB_OBS1_CHNL342_CMD_ADDR A:0xe61ab00
y.create.l HWIO_PMIC_ARB_OBS1_CHNL343_CMD_ADDR A:0xe61ab80
y.create.l HWIO_PMIC_ARB_OBS1_CHNL344_CMD_ADDR A:0xe61ac00
y.create.l HWIO_PMIC_ARB_OBS1_CHNL345_CMD_ADDR A:0xe61ac80
y.create.l HWIO_PMIC_ARB_OBS1_CHNL346_CMD_ADDR A:0xe61ad00
y.create.l HWIO_PMIC_ARB_OBS1_CHNL347_CMD_ADDR A:0xe61ad80
y.create.l HWIO_PMIC_ARB_OBS1_CHNL348_CMD_ADDR A:0xe61ae00
y.create.l HWIO_PMIC_ARB_OBS1_CHNL349_CMD_ADDR A:0xe61ae80
y.create.l HWIO_PMIC_ARB_OBS1_CHNL350_CMD_ADDR A:0xe61af00
y.create.l HWIO_PMIC_ARB_OBS1_CHNL351_CMD_ADDR A:0xe61af80
y.create.l HWIO_PMIC_ARB_OBS1_CHNL352_CMD_ADDR A:0xe61b000
y.create.l HWIO_PMIC_ARB_OBS1_CHNL353_CMD_ADDR A:0xe61b080
y.create.l HWIO_PMIC_ARB_OBS1_CHNL354_CMD_ADDR A:0xe61b100
y.create.l HWIO_PMIC_ARB_OBS1_CHNL355_CMD_ADDR A:0xe61b180
y.create.l HWIO_PMIC_ARB_OBS1_CHNL356_CMD_ADDR A:0xe61b200
y.create.l HWIO_PMIC_ARB_OBS1_CHNL357_CMD_ADDR A:0xe61b280
y.create.l HWIO_PMIC_ARB_OBS1_CHNL358_CMD_ADDR A:0xe61b300
y.create.l HWIO_PMIC_ARB_OBS1_CHNL359_CMD_ADDR A:0xe61b380
y.create.l HWIO_PMIC_ARB_OBS1_CHNL360_CMD_ADDR A:0xe61b400
y.create.l HWIO_PMIC_ARB_OBS1_CHNL361_CMD_ADDR A:0xe61b480
y.create.l HWIO_PMIC_ARB_OBS1_CHNL362_CMD_ADDR A:0xe61b500
y.create.l HWIO_PMIC_ARB_OBS1_CHNL363_CMD_ADDR A:0xe61b580
y.create.l HWIO_PMIC_ARB_OBS1_CHNL364_CMD_ADDR A:0xe61b600
y.create.l HWIO_PMIC_ARB_OBS1_CHNL365_CMD_ADDR A:0xe61b680
y.create.l HWIO_PMIC_ARB_OBS1_CHNL366_CMD_ADDR A:0xe61b700
y.create.l HWIO_PMIC_ARB_OBS1_CHNL367_CMD_ADDR A:0xe61b780
y.create.l HWIO_PMIC_ARB_OBS1_CHNL368_CMD_ADDR A:0xe61b800
y.create.l HWIO_PMIC_ARB_OBS1_CHNL369_CMD_ADDR A:0xe61b880
y.create.l HWIO_PMIC_ARB_OBS1_CHNL370_CMD_ADDR A:0xe61b900
y.create.l HWIO_PMIC_ARB_OBS1_CHNL371_CMD_ADDR A:0xe61b980
y.create.l HWIO_PMIC_ARB_OBS1_CHNL372_CMD_ADDR A:0xe61ba00
y.create.l HWIO_PMIC_ARB_OBS1_CHNL373_CMD_ADDR A:0xe61ba80
y.create.l HWIO_PMIC_ARB_OBS1_CHNL374_CMD_ADDR A:0xe61bb00
y.create.l HWIO_PMIC_ARB_OBS1_CHNL375_CMD_ADDR A:0xe61bb80
y.create.l HWIO_PMIC_ARB_OBS1_CHNL376_CMD_ADDR A:0xe61bc00
y.create.l HWIO_PMIC_ARB_OBS1_CHNL377_CMD_ADDR A:0xe61bc80
y.create.l HWIO_PMIC_ARB_OBS1_CHNL378_CMD_ADDR A:0xe61bd00
y.create.l HWIO_PMIC_ARB_OBS1_CHNL379_CMD_ADDR A:0xe61bd80
y.create.l HWIO_PMIC_ARB_OBS1_CHNL380_CMD_ADDR A:0xe61be00
y.create.l HWIO_PMIC_ARB_OBS1_CHNL381_CMD_ADDR A:0xe61be80
y.create.l HWIO_PMIC_ARB_OBS1_CHNL382_CMD_ADDR A:0xe61bf00
y.create.l HWIO_PMIC_ARB_OBS1_CHNL383_CMD_ADDR A:0xe61bf80
y.create.l HWIO_PMIC_ARB_OBS1_CHNL384_CMD_ADDR A:0xe61c000
y.create.l HWIO_PMIC_ARB_OBS1_CHNL385_CMD_ADDR A:0xe61c080
y.create.l HWIO_PMIC_ARB_OBS1_CHNL386_CMD_ADDR A:0xe61c100
y.create.l HWIO_PMIC_ARB_OBS1_CHNL387_CMD_ADDR A:0xe61c180
y.create.l HWIO_PMIC_ARB_OBS1_CHNL388_CMD_ADDR A:0xe61c200
y.create.l HWIO_PMIC_ARB_OBS1_CHNL389_CMD_ADDR A:0xe61c280
y.create.l HWIO_PMIC_ARB_OBS1_CHNL390_CMD_ADDR A:0xe61c300
y.create.l HWIO_PMIC_ARB_OBS1_CHNL391_CMD_ADDR A:0xe61c380
y.create.l HWIO_PMIC_ARB_OBS1_CHNL392_CMD_ADDR A:0xe61c400
y.create.l HWIO_PMIC_ARB_OBS1_CHNL393_CMD_ADDR A:0xe61c480
y.create.l HWIO_PMIC_ARB_OBS1_CHNL394_CMD_ADDR A:0xe61c500
y.create.l HWIO_PMIC_ARB_OBS1_CHNL395_CMD_ADDR A:0xe61c580
y.create.l HWIO_PMIC_ARB_OBS1_CHNL396_CMD_ADDR A:0xe61c600
y.create.l HWIO_PMIC_ARB_OBS1_CHNL397_CMD_ADDR A:0xe61c680
y.create.l HWIO_PMIC_ARB_OBS1_CHNL398_CMD_ADDR A:0xe61c700
y.create.l HWIO_PMIC_ARB_OBS1_CHNL399_CMD_ADDR A:0xe61c780
y.create.l HWIO_PMIC_ARB_OBS1_CHNL400_CMD_ADDR A:0xe61c800
y.create.l HWIO_PMIC_ARB_OBS1_CHNL401_CMD_ADDR A:0xe61c880
y.create.l HWIO_PMIC_ARB_OBS1_CHNL402_CMD_ADDR A:0xe61c900
y.create.l HWIO_PMIC_ARB_OBS1_CHNL403_CMD_ADDR A:0xe61c980
y.create.l HWIO_PMIC_ARB_OBS1_CHNL404_CMD_ADDR A:0xe61ca00
y.create.l HWIO_PMIC_ARB_OBS1_CHNL405_CMD_ADDR A:0xe61ca80
y.create.l HWIO_PMIC_ARB_OBS1_CHNL406_CMD_ADDR A:0xe61cb00
y.create.l HWIO_PMIC_ARB_OBS1_CHNL407_CMD_ADDR A:0xe61cb80
y.create.l HWIO_PMIC_ARB_OBS1_CHNL408_CMD_ADDR A:0xe61cc00
y.create.l HWIO_PMIC_ARB_OBS1_CHNL409_CMD_ADDR A:0xe61cc80
y.create.l HWIO_PMIC_ARB_OBS1_CHNL410_CMD_ADDR A:0xe61cd00
y.create.l HWIO_PMIC_ARB_OBS1_CHNL411_CMD_ADDR A:0xe61cd80
y.create.l HWIO_PMIC_ARB_OBS1_CHNL412_CMD_ADDR A:0xe61ce00
y.create.l HWIO_PMIC_ARB_OBS1_CHNL413_CMD_ADDR A:0xe61ce80
y.create.l HWIO_PMIC_ARB_OBS1_CHNL414_CMD_ADDR A:0xe61cf00
y.create.l HWIO_PMIC_ARB_OBS1_CHNL415_CMD_ADDR A:0xe61cf80
y.create.l HWIO_PMIC_ARB_OBS1_CHNL416_CMD_ADDR A:0xe61d000
y.create.l HWIO_PMIC_ARB_OBS1_CHNL417_CMD_ADDR A:0xe61d080
y.create.l HWIO_PMIC_ARB_OBS1_CHNL418_CMD_ADDR A:0xe61d100
y.create.l HWIO_PMIC_ARB_OBS1_CHNL419_CMD_ADDR A:0xe61d180
y.create.l HWIO_PMIC_ARB_OBS1_CHNL420_CMD_ADDR A:0xe61d200
y.create.l HWIO_PMIC_ARB_OBS1_CHNL421_CMD_ADDR A:0xe61d280
y.create.l HWIO_PMIC_ARB_OBS1_CHNL422_CMD_ADDR A:0xe61d300
y.create.l HWIO_PMIC_ARB_OBS1_CHNL423_CMD_ADDR A:0xe61d380
y.create.l HWIO_PMIC_ARB_OBS1_CHNL424_CMD_ADDR A:0xe61d400
y.create.l HWIO_PMIC_ARB_OBS1_CHNL425_CMD_ADDR A:0xe61d480
y.create.l HWIO_PMIC_ARB_OBS1_CHNL426_CMD_ADDR A:0xe61d500
y.create.l HWIO_PMIC_ARB_OBS1_CHNL427_CMD_ADDR A:0xe61d580
y.create.l HWIO_PMIC_ARB_OBS1_CHNL428_CMD_ADDR A:0xe61d600
y.create.l HWIO_PMIC_ARB_OBS1_CHNL429_CMD_ADDR A:0xe61d680
y.create.l HWIO_PMIC_ARB_OBS1_CHNL430_CMD_ADDR A:0xe61d700
y.create.l HWIO_PMIC_ARB_OBS1_CHNL431_CMD_ADDR A:0xe61d780
y.create.l HWIO_PMIC_ARB_OBS1_CHNL432_CMD_ADDR A:0xe61d800
y.create.l HWIO_PMIC_ARB_OBS1_CHNL433_CMD_ADDR A:0xe61d880
y.create.l HWIO_PMIC_ARB_OBS1_CHNL434_CMD_ADDR A:0xe61d900
y.create.l HWIO_PMIC_ARB_OBS1_CHNL435_CMD_ADDR A:0xe61d980
y.create.l HWIO_PMIC_ARB_OBS1_CHNL436_CMD_ADDR A:0xe61da00
y.create.l HWIO_PMIC_ARB_OBS1_CHNL437_CMD_ADDR A:0xe61da80
y.create.l HWIO_PMIC_ARB_OBS1_CHNL438_CMD_ADDR A:0xe61db00
y.create.l HWIO_PMIC_ARB_OBS1_CHNL439_CMD_ADDR A:0xe61db80
y.create.l HWIO_PMIC_ARB_OBS1_CHNL440_CMD_ADDR A:0xe61dc00
y.create.l HWIO_PMIC_ARB_OBS1_CHNL441_CMD_ADDR A:0xe61dc80
y.create.l HWIO_PMIC_ARB_OBS1_CHNL442_CMD_ADDR A:0xe61dd00
y.create.l HWIO_PMIC_ARB_OBS1_CHNL443_CMD_ADDR A:0xe61dd80
y.create.l HWIO_PMIC_ARB_OBS1_CHNL444_CMD_ADDR A:0xe61de00
y.create.l HWIO_PMIC_ARB_OBS1_CHNL445_CMD_ADDR A:0xe61de80
y.create.l HWIO_PMIC_ARB_OBS1_CHNL446_CMD_ADDR A:0xe61df00
y.create.l HWIO_PMIC_ARB_OBS1_CHNL447_CMD_ADDR A:0xe61df80
y.create.l HWIO_PMIC_ARB_OBS1_CHNL448_CMD_ADDR A:0xe61e000
y.create.l HWIO_PMIC_ARB_OBS1_CHNL449_CMD_ADDR A:0xe61e080
y.create.l HWIO_PMIC_ARB_OBS1_CHNL450_CMD_ADDR A:0xe61e100
y.create.l HWIO_PMIC_ARB_OBS1_CHNL451_CMD_ADDR A:0xe61e180
y.create.l HWIO_PMIC_ARB_OBS1_CHNL452_CMD_ADDR A:0xe61e200
y.create.l HWIO_PMIC_ARB_OBS1_CHNL453_CMD_ADDR A:0xe61e280
y.create.l HWIO_PMIC_ARB_OBS1_CHNL454_CMD_ADDR A:0xe61e300
y.create.l HWIO_PMIC_ARB_OBS1_CHNL455_CMD_ADDR A:0xe61e380
y.create.l HWIO_PMIC_ARB_OBS1_CHNL456_CMD_ADDR A:0xe61e400
y.create.l HWIO_PMIC_ARB_OBS1_CHNL457_CMD_ADDR A:0xe61e480
y.create.l HWIO_PMIC_ARB_OBS1_CHNL458_CMD_ADDR A:0xe61e500
y.create.l HWIO_PMIC_ARB_OBS1_CHNL459_CMD_ADDR A:0xe61e580
y.create.l HWIO_PMIC_ARB_OBS1_CHNL460_CMD_ADDR A:0xe61e600
y.create.l HWIO_PMIC_ARB_OBS1_CHNL461_CMD_ADDR A:0xe61e680
y.create.l HWIO_PMIC_ARB_OBS1_CHNL462_CMD_ADDR A:0xe61e700
y.create.l HWIO_PMIC_ARB_OBS1_CHNL463_CMD_ADDR A:0xe61e780
y.create.l HWIO_PMIC_ARB_OBS1_CHNL464_CMD_ADDR A:0xe61e800
y.create.l HWIO_PMIC_ARB_OBS1_CHNL465_CMD_ADDR A:0xe61e880
y.create.l HWIO_PMIC_ARB_OBS1_CHNL466_CMD_ADDR A:0xe61e900
y.create.l HWIO_PMIC_ARB_OBS1_CHNL467_CMD_ADDR A:0xe61e980
y.create.l HWIO_PMIC_ARB_OBS1_CHNL468_CMD_ADDR A:0xe61ea00
y.create.l HWIO_PMIC_ARB_OBS1_CHNL469_CMD_ADDR A:0xe61ea80
y.create.l HWIO_PMIC_ARB_OBS1_CHNL470_CMD_ADDR A:0xe61eb00
y.create.l HWIO_PMIC_ARB_OBS1_CHNL471_CMD_ADDR A:0xe61eb80
y.create.l HWIO_PMIC_ARB_OBS1_CHNL472_CMD_ADDR A:0xe61ec00
y.create.l HWIO_PMIC_ARB_OBS1_CHNL473_CMD_ADDR A:0xe61ec80
y.create.l HWIO_PMIC_ARB_OBS1_CHNL474_CMD_ADDR A:0xe61ed00
y.create.l HWIO_PMIC_ARB_OBS1_CHNL475_CMD_ADDR A:0xe61ed80
y.create.l HWIO_PMIC_ARB_OBS1_CHNL476_CMD_ADDR A:0xe61ee00
y.create.l HWIO_PMIC_ARB_OBS1_CHNL477_CMD_ADDR A:0xe61ee80
y.create.l HWIO_PMIC_ARB_OBS1_CHNL478_CMD_ADDR A:0xe61ef00
y.create.l HWIO_PMIC_ARB_OBS1_CHNL479_CMD_ADDR A:0xe61ef80
y.create.l HWIO_PMIC_ARB_OBS1_CHNL480_CMD_ADDR A:0xe61f000
y.create.l HWIO_PMIC_ARB_OBS1_CHNL481_CMD_ADDR A:0xe61f080
y.create.l HWIO_PMIC_ARB_OBS1_CHNL482_CMD_ADDR A:0xe61f100
y.create.l HWIO_PMIC_ARB_OBS1_CHNL483_CMD_ADDR A:0xe61f180
y.create.l HWIO_PMIC_ARB_OBS1_CHNL484_CMD_ADDR A:0xe61f200
y.create.l HWIO_PMIC_ARB_OBS1_CHNL485_CMD_ADDR A:0xe61f280
y.create.l HWIO_PMIC_ARB_OBS1_CHNL486_CMD_ADDR A:0xe61f300
y.create.l HWIO_PMIC_ARB_OBS1_CHNL487_CMD_ADDR A:0xe61f380
y.create.l HWIO_PMIC_ARB_OBS1_CHNL488_CMD_ADDR A:0xe61f400
y.create.l HWIO_PMIC_ARB_OBS1_CHNL489_CMD_ADDR A:0xe61f480
y.create.l HWIO_PMIC_ARB_OBS1_CHNL490_CMD_ADDR A:0xe61f500
y.create.l HWIO_PMIC_ARB_OBS1_CHNL491_CMD_ADDR A:0xe61f580
y.create.l HWIO_PMIC_ARB_OBS1_CHNL492_CMD_ADDR A:0xe61f600
y.create.l HWIO_PMIC_ARB_OBS1_CHNL493_CMD_ADDR A:0xe61f680
y.create.l HWIO_PMIC_ARB_OBS1_CHNL494_CMD_ADDR A:0xe61f700
y.create.l HWIO_PMIC_ARB_OBS1_CHNL495_CMD_ADDR A:0xe61f780
y.create.l HWIO_PMIC_ARB_OBS1_CHNL496_CMD_ADDR A:0xe61f800
y.create.l HWIO_PMIC_ARB_OBS1_CHNL497_CMD_ADDR A:0xe61f880
y.create.l HWIO_PMIC_ARB_OBS1_CHNL498_CMD_ADDR A:0xe61f900
y.create.l HWIO_PMIC_ARB_OBS1_CHNL499_CMD_ADDR A:0xe61f980
y.create.l HWIO_PMIC_ARB_OBS1_CHNL500_CMD_ADDR A:0xe61fa00
y.create.l HWIO_PMIC_ARB_OBS1_CHNL501_CMD_ADDR A:0xe61fa80
y.create.l HWIO_PMIC_ARB_OBS1_CHNL502_CMD_ADDR A:0xe61fb00
y.create.l HWIO_PMIC_ARB_OBS1_CHNL503_CMD_ADDR A:0xe61fb80
y.create.l HWIO_PMIC_ARB_OBS1_CHNL504_CMD_ADDR A:0xe61fc00
y.create.l HWIO_PMIC_ARB_OBS1_CHNL505_CMD_ADDR A:0xe61fc80
y.create.l HWIO_PMIC_ARB_OBS1_CHNL506_CMD_ADDR A:0xe61fd00
y.create.l HWIO_PMIC_ARB_OBS1_CHNL507_CMD_ADDR A:0xe61fd80
y.create.l HWIO_PMIC_ARB_OBS1_CHNL508_CMD_ADDR A:0xe61fe00
y.create.l HWIO_PMIC_ARB_OBS1_CHNL509_CMD_ADDR A:0xe61fe80
y.create.l HWIO_PMIC_ARB_OBS1_CHNL510_CMD_ADDR A:0xe61ff00
y.create.l HWIO_PMIC_ARB_OBS1_CHNL511_CMD_ADDR A:0xe61ff80
y.create.l HWIO_PMIC_ARB_OBS2_CHNL0_CMD_ADDR A:0xe620000
y.create.l HWIO_PMIC_ARB_OBS2_CHNL1_CMD_ADDR A:0xe620080
y.create.l HWIO_PMIC_ARB_OBS2_CHNL2_CMD_ADDR A:0xe620100
y.create.l HWIO_PMIC_ARB_OBS2_CHNL3_CMD_ADDR A:0xe620180
y.create.l HWIO_PMIC_ARB_OBS2_CHNL4_CMD_ADDR A:0xe620200
y.create.l HWIO_PMIC_ARB_OBS2_CHNL5_CMD_ADDR A:0xe620280
y.create.l HWIO_PMIC_ARB_OBS2_CHNL6_CMD_ADDR A:0xe620300
y.create.l HWIO_PMIC_ARB_OBS2_CHNL7_CMD_ADDR A:0xe620380
y.create.l HWIO_PMIC_ARB_OBS2_CHNL8_CMD_ADDR A:0xe620400
y.create.l HWIO_PMIC_ARB_OBS2_CHNL9_CMD_ADDR A:0xe620480
y.create.l HWIO_PMIC_ARB_OBS2_CHNL10_CMD_ADDR A:0xe620500
y.create.l HWIO_PMIC_ARB_OBS2_CHNL11_CMD_ADDR A:0xe620580
y.create.l HWIO_PMIC_ARB_OBS2_CHNL12_CMD_ADDR A:0xe620600
y.create.l HWIO_PMIC_ARB_OBS2_CHNL13_CMD_ADDR A:0xe620680
y.create.l HWIO_PMIC_ARB_OBS2_CHNL14_CMD_ADDR A:0xe620700
y.create.l HWIO_PMIC_ARB_OBS2_CHNL15_CMD_ADDR A:0xe620780
y.create.l HWIO_PMIC_ARB_OBS2_CHNL16_CMD_ADDR A:0xe620800
y.create.l HWIO_PMIC_ARB_OBS2_CHNL17_CMD_ADDR A:0xe620880
y.create.l HWIO_PMIC_ARB_OBS2_CHNL18_CMD_ADDR A:0xe620900
y.create.l HWIO_PMIC_ARB_OBS2_CHNL19_CMD_ADDR A:0xe620980
y.create.l HWIO_PMIC_ARB_OBS2_CHNL20_CMD_ADDR A:0xe620a00
y.create.l HWIO_PMIC_ARB_OBS2_CHNL21_CMD_ADDR A:0xe620a80
y.create.l HWIO_PMIC_ARB_OBS2_CHNL22_CMD_ADDR A:0xe620b00
y.create.l HWIO_PMIC_ARB_OBS2_CHNL23_CMD_ADDR A:0xe620b80
y.create.l HWIO_PMIC_ARB_OBS2_CHNL24_CMD_ADDR A:0xe620c00
y.create.l HWIO_PMIC_ARB_OBS2_CHNL25_CMD_ADDR A:0xe620c80
y.create.l HWIO_PMIC_ARB_OBS2_CHNL26_CMD_ADDR A:0xe620d00
y.create.l HWIO_PMIC_ARB_OBS2_CHNL27_CMD_ADDR A:0xe620d80
y.create.l HWIO_PMIC_ARB_OBS2_CHNL28_CMD_ADDR A:0xe620e00
y.create.l HWIO_PMIC_ARB_OBS2_CHNL29_CMD_ADDR A:0xe620e80
y.create.l HWIO_PMIC_ARB_OBS2_CHNL30_CMD_ADDR A:0xe620f00
y.create.l HWIO_PMIC_ARB_OBS2_CHNL31_CMD_ADDR A:0xe620f80
y.create.l HWIO_PMIC_ARB_OBS2_CHNL32_CMD_ADDR A:0xe621000
y.create.l HWIO_PMIC_ARB_OBS2_CHNL33_CMD_ADDR A:0xe621080
y.create.l HWIO_PMIC_ARB_OBS2_CHNL34_CMD_ADDR A:0xe621100
y.create.l HWIO_PMIC_ARB_OBS2_CHNL35_CMD_ADDR A:0xe621180
y.create.l HWIO_PMIC_ARB_OBS2_CHNL36_CMD_ADDR A:0xe621200
y.create.l HWIO_PMIC_ARB_OBS2_CHNL37_CMD_ADDR A:0xe621280
y.create.l HWIO_PMIC_ARB_OBS2_CHNL38_CMD_ADDR A:0xe621300
y.create.l HWIO_PMIC_ARB_OBS2_CHNL39_CMD_ADDR A:0xe621380
y.create.l HWIO_PMIC_ARB_OBS2_CHNL40_CMD_ADDR A:0xe621400
y.create.l HWIO_PMIC_ARB_OBS2_CHNL41_CMD_ADDR A:0xe621480
y.create.l HWIO_PMIC_ARB_OBS2_CHNL42_CMD_ADDR A:0xe621500
y.create.l HWIO_PMIC_ARB_OBS2_CHNL43_CMD_ADDR A:0xe621580
y.create.l HWIO_PMIC_ARB_OBS2_CHNL44_CMD_ADDR A:0xe621600
y.create.l HWIO_PMIC_ARB_OBS2_CHNL45_CMD_ADDR A:0xe621680
y.create.l HWIO_PMIC_ARB_OBS2_CHNL46_CMD_ADDR A:0xe621700
y.create.l HWIO_PMIC_ARB_OBS2_CHNL47_CMD_ADDR A:0xe621780
y.create.l HWIO_PMIC_ARB_OBS2_CHNL48_CMD_ADDR A:0xe621800
y.create.l HWIO_PMIC_ARB_OBS2_CHNL49_CMD_ADDR A:0xe621880
y.create.l HWIO_PMIC_ARB_OBS2_CHNL50_CMD_ADDR A:0xe621900
y.create.l HWIO_PMIC_ARB_OBS2_CHNL51_CMD_ADDR A:0xe621980
y.create.l HWIO_PMIC_ARB_OBS2_CHNL52_CMD_ADDR A:0xe621a00
y.create.l HWIO_PMIC_ARB_OBS2_CHNL53_CMD_ADDR A:0xe621a80
y.create.l HWIO_PMIC_ARB_OBS2_CHNL54_CMD_ADDR A:0xe621b00
y.create.l HWIO_PMIC_ARB_OBS2_CHNL55_CMD_ADDR A:0xe621b80
y.create.l HWIO_PMIC_ARB_OBS2_CHNL56_CMD_ADDR A:0xe621c00
y.create.l HWIO_PMIC_ARB_OBS2_CHNL57_CMD_ADDR A:0xe621c80
y.create.l HWIO_PMIC_ARB_OBS2_CHNL58_CMD_ADDR A:0xe621d00
y.create.l HWIO_PMIC_ARB_OBS2_CHNL59_CMD_ADDR A:0xe621d80
y.create.l HWIO_PMIC_ARB_OBS2_CHNL60_CMD_ADDR A:0xe621e00
y.create.l HWIO_PMIC_ARB_OBS2_CHNL61_CMD_ADDR A:0xe621e80
y.create.l HWIO_PMIC_ARB_OBS2_CHNL62_CMD_ADDR A:0xe621f00
y.create.l HWIO_PMIC_ARB_OBS2_CHNL63_CMD_ADDR A:0xe621f80
y.create.l HWIO_PMIC_ARB_OBS2_CHNL64_CMD_ADDR A:0xe622000
y.create.l HWIO_PMIC_ARB_OBS2_CHNL65_CMD_ADDR A:0xe622080
y.create.l HWIO_PMIC_ARB_OBS2_CHNL66_CMD_ADDR A:0xe622100
y.create.l HWIO_PMIC_ARB_OBS2_CHNL67_CMD_ADDR A:0xe622180
y.create.l HWIO_PMIC_ARB_OBS2_CHNL68_CMD_ADDR A:0xe622200
y.create.l HWIO_PMIC_ARB_OBS2_CHNL69_CMD_ADDR A:0xe622280
y.create.l HWIO_PMIC_ARB_OBS2_CHNL70_CMD_ADDR A:0xe622300
y.create.l HWIO_PMIC_ARB_OBS2_CHNL71_CMD_ADDR A:0xe622380
y.create.l HWIO_PMIC_ARB_OBS2_CHNL72_CMD_ADDR A:0xe622400
y.create.l HWIO_PMIC_ARB_OBS2_CHNL73_CMD_ADDR A:0xe622480
y.create.l HWIO_PMIC_ARB_OBS2_CHNL74_CMD_ADDR A:0xe622500
y.create.l HWIO_PMIC_ARB_OBS2_CHNL75_CMD_ADDR A:0xe622580
y.create.l HWIO_PMIC_ARB_OBS2_CHNL76_CMD_ADDR A:0xe622600
y.create.l HWIO_PMIC_ARB_OBS2_CHNL77_CMD_ADDR A:0xe622680
y.create.l HWIO_PMIC_ARB_OBS2_CHNL78_CMD_ADDR A:0xe622700
y.create.l HWIO_PMIC_ARB_OBS2_CHNL79_CMD_ADDR A:0xe622780
y.create.l HWIO_PMIC_ARB_OBS2_CHNL80_CMD_ADDR A:0xe622800
y.create.l HWIO_PMIC_ARB_OBS2_CHNL81_CMD_ADDR A:0xe622880
y.create.l HWIO_PMIC_ARB_OBS2_CHNL82_CMD_ADDR A:0xe622900
y.create.l HWIO_PMIC_ARB_OBS2_CHNL83_CMD_ADDR A:0xe622980
y.create.l HWIO_PMIC_ARB_OBS2_CHNL84_CMD_ADDR A:0xe622a00
y.create.l HWIO_PMIC_ARB_OBS2_CHNL85_CMD_ADDR A:0xe622a80
y.create.l HWIO_PMIC_ARB_OBS2_CHNL86_CMD_ADDR A:0xe622b00
y.create.l HWIO_PMIC_ARB_OBS2_CHNL87_CMD_ADDR A:0xe622b80
y.create.l HWIO_PMIC_ARB_OBS2_CHNL88_CMD_ADDR A:0xe622c00
y.create.l HWIO_PMIC_ARB_OBS2_CHNL89_CMD_ADDR A:0xe622c80
y.create.l HWIO_PMIC_ARB_OBS2_CHNL90_CMD_ADDR A:0xe622d00
y.create.l HWIO_PMIC_ARB_OBS2_CHNL91_CMD_ADDR A:0xe622d80
y.create.l HWIO_PMIC_ARB_OBS2_CHNL92_CMD_ADDR A:0xe622e00
y.create.l HWIO_PMIC_ARB_OBS2_CHNL93_CMD_ADDR A:0xe622e80
y.create.l HWIO_PMIC_ARB_OBS2_CHNL94_CMD_ADDR A:0xe622f00
y.create.l HWIO_PMIC_ARB_OBS2_CHNL95_CMD_ADDR A:0xe622f80
y.create.l HWIO_PMIC_ARB_OBS2_CHNL96_CMD_ADDR A:0xe623000
y.create.l HWIO_PMIC_ARB_OBS2_CHNL97_CMD_ADDR A:0xe623080
y.create.l HWIO_PMIC_ARB_OBS2_CHNL98_CMD_ADDR A:0xe623100
y.create.l HWIO_PMIC_ARB_OBS2_CHNL99_CMD_ADDR A:0xe623180
y.create.l HWIO_PMIC_ARB_OBS2_CHNL100_CMD_ADDR A:0xe623200
y.create.l HWIO_PMIC_ARB_OBS2_CHNL101_CMD_ADDR A:0xe623280
y.create.l HWIO_PMIC_ARB_OBS2_CHNL102_CMD_ADDR A:0xe623300
y.create.l HWIO_PMIC_ARB_OBS2_CHNL103_CMD_ADDR A:0xe623380
y.create.l HWIO_PMIC_ARB_OBS2_CHNL104_CMD_ADDR A:0xe623400
y.create.l HWIO_PMIC_ARB_OBS2_CHNL105_CMD_ADDR A:0xe623480
y.create.l HWIO_PMIC_ARB_OBS2_CHNL106_CMD_ADDR A:0xe623500
y.create.l HWIO_PMIC_ARB_OBS2_CHNL107_CMD_ADDR A:0xe623580
y.create.l HWIO_PMIC_ARB_OBS2_CHNL108_CMD_ADDR A:0xe623600
y.create.l HWIO_PMIC_ARB_OBS2_CHNL109_CMD_ADDR A:0xe623680
y.create.l HWIO_PMIC_ARB_OBS2_CHNL110_CMD_ADDR A:0xe623700
y.create.l HWIO_PMIC_ARB_OBS2_CHNL111_CMD_ADDR A:0xe623780
y.create.l HWIO_PMIC_ARB_OBS2_CHNL112_CMD_ADDR A:0xe623800
y.create.l HWIO_PMIC_ARB_OBS2_CHNL113_CMD_ADDR A:0xe623880
y.create.l HWIO_PMIC_ARB_OBS2_CHNL114_CMD_ADDR A:0xe623900
y.create.l HWIO_PMIC_ARB_OBS2_CHNL115_CMD_ADDR A:0xe623980
y.create.l HWIO_PMIC_ARB_OBS2_CHNL116_CMD_ADDR A:0xe623a00
y.create.l HWIO_PMIC_ARB_OBS2_CHNL117_CMD_ADDR A:0xe623a80
y.create.l HWIO_PMIC_ARB_OBS2_CHNL118_CMD_ADDR A:0xe623b00
y.create.l HWIO_PMIC_ARB_OBS2_CHNL119_CMD_ADDR A:0xe623b80
y.create.l HWIO_PMIC_ARB_OBS2_CHNL120_CMD_ADDR A:0xe623c00
y.create.l HWIO_PMIC_ARB_OBS2_CHNL121_CMD_ADDR A:0xe623c80
y.create.l HWIO_PMIC_ARB_OBS2_CHNL122_CMD_ADDR A:0xe623d00
y.create.l HWIO_PMIC_ARB_OBS2_CHNL123_CMD_ADDR A:0xe623d80
y.create.l HWIO_PMIC_ARB_OBS2_CHNL124_CMD_ADDR A:0xe623e00
y.create.l HWIO_PMIC_ARB_OBS2_CHNL125_CMD_ADDR A:0xe623e80
y.create.l HWIO_PMIC_ARB_OBS2_CHNL126_CMD_ADDR A:0xe623f00
y.create.l HWIO_PMIC_ARB_OBS2_CHNL127_CMD_ADDR A:0xe623f80
y.create.l HWIO_PMIC_ARB_OBS2_CHNL128_CMD_ADDR A:0xe624000
y.create.l HWIO_PMIC_ARB_OBS2_CHNL129_CMD_ADDR A:0xe624080
y.create.l HWIO_PMIC_ARB_OBS2_CHNL130_CMD_ADDR A:0xe624100
y.create.l HWIO_PMIC_ARB_OBS2_CHNL131_CMD_ADDR A:0xe624180
y.create.l HWIO_PMIC_ARB_OBS2_CHNL132_CMD_ADDR A:0xe624200
y.create.l HWIO_PMIC_ARB_OBS2_CHNL133_CMD_ADDR A:0xe624280
y.create.l HWIO_PMIC_ARB_OBS2_CHNL134_CMD_ADDR A:0xe624300
y.create.l HWIO_PMIC_ARB_OBS2_CHNL135_CMD_ADDR A:0xe624380
y.create.l HWIO_PMIC_ARB_OBS2_CHNL136_CMD_ADDR A:0xe624400
y.create.l HWIO_PMIC_ARB_OBS2_CHNL137_CMD_ADDR A:0xe624480
y.create.l HWIO_PMIC_ARB_OBS2_CHNL138_CMD_ADDR A:0xe624500
y.create.l HWIO_PMIC_ARB_OBS2_CHNL139_CMD_ADDR A:0xe624580
y.create.l HWIO_PMIC_ARB_OBS2_CHNL140_CMD_ADDR A:0xe624600
y.create.l HWIO_PMIC_ARB_OBS2_CHNL141_CMD_ADDR A:0xe624680
y.create.l HWIO_PMIC_ARB_OBS2_CHNL142_CMD_ADDR A:0xe624700
y.create.l HWIO_PMIC_ARB_OBS2_CHNL143_CMD_ADDR A:0xe624780
y.create.l HWIO_PMIC_ARB_OBS2_CHNL144_CMD_ADDR A:0xe624800
y.create.l HWIO_PMIC_ARB_OBS2_CHNL145_CMD_ADDR A:0xe624880
y.create.l HWIO_PMIC_ARB_OBS2_CHNL146_CMD_ADDR A:0xe624900
y.create.l HWIO_PMIC_ARB_OBS2_CHNL147_CMD_ADDR A:0xe624980
y.create.l HWIO_PMIC_ARB_OBS2_CHNL148_CMD_ADDR A:0xe624a00
y.create.l HWIO_PMIC_ARB_OBS2_CHNL149_CMD_ADDR A:0xe624a80
y.create.l HWIO_PMIC_ARB_OBS2_CHNL150_CMD_ADDR A:0xe624b00
y.create.l HWIO_PMIC_ARB_OBS2_CHNL151_CMD_ADDR A:0xe624b80
y.create.l HWIO_PMIC_ARB_OBS2_CHNL152_CMD_ADDR A:0xe624c00
y.create.l HWIO_PMIC_ARB_OBS2_CHNL153_CMD_ADDR A:0xe624c80
y.create.l HWIO_PMIC_ARB_OBS2_CHNL154_CMD_ADDR A:0xe624d00
y.create.l HWIO_PMIC_ARB_OBS2_CHNL155_CMD_ADDR A:0xe624d80
y.create.l HWIO_PMIC_ARB_OBS2_CHNL156_CMD_ADDR A:0xe624e00
y.create.l HWIO_PMIC_ARB_OBS2_CHNL157_CMD_ADDR A:0xe624e80
y.create.l HWIO_PMIC_ARB_OBS2_CHNL158_CMD_ADDR A:0xe624f00
y.create.l HWIO_PMIC_ARB_OBS2_CHNL159_CMD_ADDR A:0xe624f80
y.create.l HWIO_PMIC_ARB_OBS2_CHNL160_CMD_ADDR A:0xe625000
y.create.l HWIO_PMIC_ARB_OBS2_CHNL161_CMD_ADDR A:0xe625080
y.create.l HWIO_PMIC_ARB_OBS2_CHNL162_CMD_ADDR A:0xe625100
y.create.l HWIO_PMIC_ARB_OBS2_CHNL163_CMD_ADDR A:0xe625180
y.create.l HWIO_PMIC_ARB_OBS2_CHNL164_CMD_ADDR A:0xe625200
y.create.l HWIO_PMIC_ARB_OBS2_CHNL165_CMD_ADDR A:0xe625280
y.create.l HWIO_PMIC_ARB_OBS2_CHNL166_CMD_ADDR A:0xe625300
y.create.l HWIO_PMIC_ARB_OBS2_CHNL167_CMD_ADDR A:0xe625380
y.create.l HWIO_PMIC_ARB_OBS2_CHNL168_CMD_ADDR A:0xe625400
y.create.l HWIO_PMIC_ARB_OBS2_CHNL169_CMD_ADDR A:0xe625480
y.create.l HWIO_PMIC_ARB_OBS2_CHNL170_CMD_ADDR A:0xe625500
y.create.l HWIO_PMIC_ARB_OBS2_CHNL171_CMD_ADDR A:0xe625580
y.create.l HWIO_PMIC_ARB_OBS2_CHNL172_CMD_ADDR A:0xe625600
y.create.l HWIO_PMIC_ARB_OBS2_CHNL173_CMD_ADDR A:0xe625680
y.create.l HWIO_PMIC_ARB_OBS2_CHNL174_CMD_ADDR A:0xe625700
y.create.l HWIO_PMIC_ARB_OBS2_CHNL175_CMD_ADDR A:0xe625780
y.create.l HWIO_PMIC_ARB_OBS2_CHNL176_CMD_ADDR A:0xe625800
y.create.l HWIO_PMIC_ARB_OBS2_CHNL177_CMD_ADDR A:0xe625880
y.create.l HWIO_PMIC_ARB_OBS2_CHNL178_CMD_ADDR A:0xe625900
y.create.l HWIO_PMIC_ARB_OBS2_CHNL179_CMD_ADDR A:0xe625980
y.create.l HWIO_PMIC_ARB_OBS2_CHNL180_CMD_ADDR A:0xe625a00
y.create.l HWIO_PMIC_ARB_OBS2_CHNL181_CMD_ADDR A:0xe625a80
y.create.l HWIO_PMIC_ARB_OBS2_CHNL182_CMD_ADDR A:0xe625b00
y.create.l HWIO_PMIC_ARB_OBS2_CHNL183_CMD_ADDR A:0xe625b80
y.create.l HWIO_PMIC_ARB_OBS2_CHNL184_CMD_ADDR A:0xe625c00
y.create.l HWIO_PMIC_ARB_OBS2_CHNL185_CMD_ADDR A:0xe625c80
y.create.l HWIO_PMIC_ARB_OBS2_CHNL186_CMD_ADDR A:0xe625d00
y.create.l HWIO_PMIC_ARB_OBS2_CHNL187_CMD_ADDR A:0xe625d80
y.create.l HWIO_PMIC_ARB_OBS2_CHNL188_CMD_ADDR A:0xe625e00
y.create.l HWIO_PMIC_ARB_OBS2_CHNL189_CMD_ADDR A:0xe625e80
y.create.l HWIO_PMIC_ARB_OBS2_CHNL190_CMD_ADDR A:0xe625f00
y.create.l HWIO_PMIC_ARB_OBS2_CHNL191_CMD_ADDR A:0xe625f80
y.create.l HWIO_PMIC_ARB_OBS2_CHNL192_CMD_ADDR A:0xe626000
y.create.l HWIO_PMIC_ARB_OBS2_CHNL193_CMD_ADDR A:0xe626080
y.create.l HWIO_PMIC_ARB_OBS2_CHNL194_CMD_ADDR A:0xe626100
y.create.l HWIO_PMIC_ARB_OBS2_CHNL195_CMD_ADDR A:0xe626180
y.create.l HWIO_PMIC_ARB_OBS2_CHNL196_CMD_ADDR A:0xe626200
y.create.l HWIO_PMIC_ARB_OBS2_CHNL197_CMD_ADDR A:0xe626280
y.create.l HWIO_PMIC_ARB_OBS2_CHNL198_CMD_ADDR A:0xe626300
y.create.l HWIO_PMIC_ARB_OBS2_CHNL199_CMD_ADDR A:0xe626380
y.create.l HWIO_PMIC_ARB_OBS2_CHNL200_CMD_ADDR A:0xe626400
y.create.l HWIO_PMIC_ARB_OBS2_CHNL201_CMD_ADDR A:0xe626480
y.create.l HWIO_PMIC_ARB_OBS2_CHNL202_CMD_ADDR A:0xe626500
y.create.l HWIO_PMIC_ARB_OBS2_CHNL203_CMD_ADDR A:0xe626580
y.create.l HWIO_PMIC_ARB_OBS2_CHNL204_CMD_ADDR A:0xe626600
y.create.l HWIO_PMIC_ARB_OBS2_CHNL205_CMD_ADDR A:0xe626680
y.create.l HWIO_PMIC_ARB_OBS2_CHNL206_CMD_ADDR A:0xe626700
y.create.l HWIO_PMIC_ARB_OBS2_CHNL207_CMD_ADDR A:0xe626780
y.create.l HWIO_PMIC_ARB_OBS2_CHNL208_CMD_ADDR A:0xe626800
y.create.l HWIO_PMIC_ARB_OBS2_CHNL209_CMD_ADDR A:0xe626880
y.create.l HWIO_PMIC_ARB_OBS2_CHNL210_CMD_ADDR A:0xe626900
y.create.l HWIO_PMIC_ARB_OBS2_CHNL211_CMD_ADDR A:0xe626980
y.create.l HWIO_PMIC_ARB_OBS2_CHNL212_CMD_ADDR A:0xe626a00
y.create.l HWIO_PMIC_ARB_OBS2_CHNL213_CMD_ADDR A:0xe626a80
y.create.l HWIO_PMIC_ARB_OBS2_CHNL214_CMD_ADDR A:0xe626b00
y.create.l HWIO_PMIC_ARB_OBS2_CHNL215_CMD_ADDR A:0xe626b80
y.create.l HWIO_PMIC_ARB_OBS2_CHNL216_CMD_ADDR A:0xe626c00
y.create.l HWIO_PMIC_ARB_OBS2_CHNL217_CMD_ADDR A:0xe626c80
y.create.l HWIO_PMIC_ARB_OBS2_CHNL218_CMD_ADDR A:0xe626d00
y.create.l HWIO_PMIC_ARB_OBS2_CHNL219_CMD_ADDR A:0xe626d80
y.create.l HWIO_PMIC_ARB_OBS2_CHNL220_CMD_ADDR A:0xe626e00
y.create.l HWIO_PMIC_ARB_OBS2_CHNL221_CMD_ADDR A:0xe626e80
y.create.l HWIO_PMIC_ARB_OBS2_CHNL222_CMD_ADDR A:0xe626f00
y.create.l HWIO_PMIC_ARB_OBS2_CHNL223_CMD_ADDR A:0xe626f80
y.create.l HWIO_PMIC_ARB_OBS2_CHNL224_CMD_ADDR A:0xe627000
y.create.l HWIO_PMIC_ARB_OBS2_CHNL225_CMD_ADDR A:0xe627080
y.create.l HWIO_PMIC_ARB_OBS2_CHNL226_CMD_ADDR A:0xe627100
y.create.l HWIO_PMIC_ARB_OBS2_CHNL227_CMD_ADDR A:0xe627180
y.create.l HWIO_PMIC_ARB_OBS2_CHNL228_CMD_ADDR A:0xe627200
y.create.l HWIO_PMIC_ARB_OBS2_CHNL229_CMD_ADDR A:0xe627280
y.create.l HWIO_PMIC_ARB_OBS2_CHNL230_CMD_ADDR A:0xe627300
y.create.l HWIO_PMIC_ARB_OBS2_CHNL231_CMD_ADDR A:0xe627380
y.create.l HWIO_PMIC_ARB_OBS2_CHNL232_CMD_ADDR A:0xe627400
y.create.l HWIO_PMIC_ARB_OBS2_CHNL233_CMD_ADDR A:0xe627480
y.create.l HWIO_PMIC_ARB_OBS2_CHNL234_CMD_ADDR A:0xe627500
y.create.l HWIO_PMIC_ARB_OBS2_CHNL235_CMD_ADDR A:0xe627580
y.create.l HWIO_PMIC_ARB_OBS2_CHNL236_CMD_ADDR A:0xe627600
y.create.l HWIO_PMIC_ARB_OBS2_CHNL237_CMD_ADDR A:0xe627680
y.create.l HWIO_PMIC_ARB_OBS2_CHNL238_CMD_ADDR A:0xe627700
y.create.l HWIO_PMIC_ARB_OBS2_CHNL239_CMD_ADDR A:0xe627780
y.create.l HWIO_PMIC_ARB_OBS2_CHNL240_CMD_ADDR A:0xe627800
y.create.l HWIO_PMIC_ARB_OBS2_CHNL241_CMD_ADDR A:0xe627880
y.create.l HWIO_PMIC_ARB_OBS2_CHNL242_CMD_ADDR A:0xe627900
y.create.l HWIO_PMIC_ARB_OBS2_CHNL243_CMD_ADDR A:0xe627980
y.create.l HWIO_PMIC_ARB_OBS2_CHNL244_CMD_ADDR A:0xe627a00
y.create.l HWIO_PMIC_ARB_OBS2_CHNL245_CMD_ADDR A:0xe627a80
y.create.l HWIO_PMIC_ARB_OBS2_CHNL246_CMD_ADDR A:0xe627b00
y.create.l HWIO_PMIC_ARB_OBS2_CHNL247_CMD_ADDR A:0xe627b80
y.create.l HWIO_PMIC_ARB_OBS2_CHNL248_CMD_ADDR A:0xe627c00
y.create.l HWIO_PMIC_ARB_OBS2_CHNL249_CMD_ADDR A:0xe627c80
y.create.l HWIO_PMIC_ARB_OBS2_CHNL250_CMD_ADDR A:0xe627d00
y.create.l HWIO_PMIC_ARB_OBS2_CHNL251_CMD_ADDR A:0xe627d80
y.create.l HWIO_PMIC_ARB_OBS2_CHNL252_CMD_ADDR A:0xe627e00
y.create.l HWIO_PMIC_ARB_OBS2_CHNL253_CMD_ADDR A:0xe627e80
y.create.l HWIO_PMIC_ARB_OBS2_CHNL254_CMD_ADDR A:0xe627f00
y.create.l HWIO_PMIC_ARB_OBS2_CHNL255_CMD_ADDR A:0xe627f80
y.create.l HWIO_PMIC_ARB_OBS2_CHNL256_CMD_ADDR A:0xe628000
y.create.l HWIO_PMIC_ARB_OBS2_CHNL257_CMD_ADDR A:0xe628080
y.create.l HWIO_PMIC_ARB_OBS2_CHNL258_CMD_ADDR A:0xe628100
y.create.l HWIO_PMIC_ARB_OBS2_CHNL259_CMD_ADDR A:0xe628180
y.create.l HWIO_PMIC_ARB_OBS2_CHNL260_CMD_ADDR A:0xe628200
y.create.l HWIO_PMIC_ARB_OBS2_CHNL261_CMD_ADDR A:0xe628280
y.create.l HWIO_PMIC_ARB_OBS2_CHNL262_CMD_ADDR A:0xe628300
y.create.l HWIO_PMIC_ARB_OBS2_CHNL263_CMD_ADDR A:0xe628380
y.create.l HWIO_PMIC_ARB_OBS2_CHNL264_CMD_ADDR A:0xe628400
y.create.l HWIO_PMIC_ARB_OBS2_CHNL265_CMD_ADDR A:0xe628480
y.create.l HWIO_PMIC_ARB_OBS2_CHNL266_CMD_ADDR A:0xe628500
y.create.l HWIO_PMIC_ARB_OBS2_CHNL267_CMD_ADDR A:0xe628580
y.create.l HWIO_PMIC_ARB_OBS2_CHNL268_CMD_ADDR A:0xe628600
y.create.l HWIO_PMIC_ARB_OBS2_CHNL269_CMD_ADDR A:0xe628680
y.create.l HWIO_PMIC_ARB_OBS2_CHNL270_CMD_ADDR A:0xe628700
y.create.l HWIO_PMIC_ARB_OBS2_CHNL271_CMD_ADDR A:0xe628780
y.create.l HWIO_PMIC_ARB_OBS2_CHNL272_CMD_ADDR A:0xe628800
y.create.l HWIO_PMIC_ARB_OBS2_CHNL273_CMD_ADDR A:0xe628880
y.create.l HWIO_PMIC_ARB_OBS2_CHNL274_CMD_ADDR A:0xe628900
y.create.l HWIO_PMIC_ARB_OBS2_CHNL275_CMD_ADDR A:0xe628980
y.create.l HWIO_PMIC_ARB_OBS2_CHNL276_CMD_ADDR A:0xe628a00
y.create.l HWIO_PMIC_ARB_OBS2_CHNL277_CMD_ADDR A:0xe628a80
y.create.l HWIO_PMIC_ARB_OBS2_CHNL278_CMD_ADDR A:0xe628b00
y.create.l HWIO_PMIC_ARB_OBS2_CHNL279_CMD_ADDR A:0xe628b80
y.create.l HWIO_PMIC_ARB_OBS2_CHNL280_CMD_ADDR A:0xe628c00
y.create.l HWIO_PMIC_ARB_OBS2_CHNL281_CMD_ADDR A:0xe628c80
y.create.l HWIO_PMIC_ARB_OBS2_CHNL282_CMD_ADDR A:0xe628d00
y.create.l HWIO_PMIC_ARB_OBS2_CHNL283_CMD_ADDR A:0xe628d80
y.create.l HWIO_PMIC_ARB_OBS2_CHNL284_CMD_ADDR A:0xe628e00
y.create.l HWIO_PMIC_ARB_OBS2_CHNL285_CMD_ADDR A:0xe628e80
y.create.l HWIO_PMIC_ARB_OBS2_CHNL286_CMD_ADDR A:0xe628f00
y.create.l HWIO_PMIC_ARB_OBS2_CHNL287_CMD_ADDR A:0xe628f80
y.create.l HWIO_PMIC_ARB_OBS2_CHNL288_CMD_ADDR A:0xe629000
y.create.l HWIO_PMIC_ARB_OBS2_CHNL289_CMD_ADDR A:0xe629080
y.create.l HWIO_PMIC_ARB_OBS2_CHNL290_CMD_ADDR A:0xe629100
y.create.l HWIO_PMIC_ARB_OBS2_CHNL291_CMD_ADDR A:0xe629180
y.create.l HWIO_PMIC_ARB_OBS2_CHNL292_CMD_ADDR A:0xe629200
y.create.l HWIO_PMIC_ARB_OBS2_CHNL293_CMD_ADDR A:0xe629280
y.create.l HWIO_PMIC_ARB_OBS2_CHNL294_CMD_ADDR A:0xe629300
y.create.l HWIO_PMIC_ARB_OBS2_CHNL295_CMD_ADDR A:0xe629380
y.create.l HWIO_PMIC_ARB_OBS2_CHNL296_CMD_ADDR A:0xe629400
y.create.l HWIO_PMIC_ARB_OBS2_CHNL297_CMD_ADDR A:0xe629480
y.create.l HWIO_PMIC_ARB_OBS2_CHNL298_CMD_ADDR A:0xe629500
y.create.l HWIO_PMIC_ARB_OBS2_CHNL299_CMD_ADDR A:0xe629580
y.create.l HWIO_PMIC_ARB_OBS2_CHNL300_CMD_ADDR A:0xe629600
y.create.l HWIO_PMIC_ARB_OBS2_CHNL301_CMD_ADDR A:0xe629680
y.create.l HWIO_PMIC_ARB_OBS2_CHNL302_CMD_ADDR A:0xe629700
y.create.l HWIO_PMIC_ARB_OBS2_CHNL303_CMD_ADDR A:0xe629780
y.create.l HWIO_PMIC_ARB_OBS2_CHNL304_CMD_ADDR A:0xe629800
y.create.l HWIO_PMIC_ARB_OBS2_CHNL305_CMD_ADDR A:0xe629880
y.create.l HWIO_PMIC_ARB_OBS2_CHNL306_CMD_ADDR A:0xe629900
y.create.l HWIO_PMIC_ARB_OBS2_CHNL307_CMD_ADDR A:0xe629980
y.create.l HWIO_PMIC_ARB_OBS2_CHNL308_CMD_ADDR A:0xe629a00
y.create.l HWIO_PMIC_ARB_OBS2_CHNL309_CMD_ADDR A:0xe629a80
y.create.l HWIO_PMIC_ARB_OBS2_CHNL310_CMD_ADDR A:0xe629b00
y.create.l HWIO_PMIC_ARB_OBS2_CHNL311_CMD_ADDR A:0xe629b80
y.create.l HWIO_PMIC_ARB_OBS2_CHNL312_CMD_ADDR A:0xe629c00
y.create.l HWIO_PMIC_ARB_OBS2_CHNL313_CMD_ADDR A:0xe629c80
y.create.l HWIO_PMIC_ARB_OBS2_CHNL314_CMD_ADDR A:0xe629d00
y.create.l HWIO_PMIC_ARB_OBS2_CHNL315_CMD_ADDR A:0xe629d80
y.create.l HWIO_PMIC_ARB_OBS2_CHNL316_CMD_ADDR A:0xe629e00
y.create.l HWIO_PMIC_ARB_OBS2_CHNL317_CMD_ADDR A:0xe629e80
y.create.l HWIO_PMIC_ARB_OBS2_CHNL318_CMD_ADDR A:0xe629f00
y.create.l HWIO_PMIC_ARB_OBS2_CHNL319_CMD_ADDR A:0xe629f80
y.create.l HWIO_PMIC_ARB_OBS2_CHNL320_CMD_ADDR A:0xe62a000
y.create.l HWIO_PMIC_ARB_OBS2_CHNL321_CMD_ADDR A:0xe62a080
y.create.l HWIO_PMIC_ARB_OBS2_CHNL322_CMD_ADDR A:0xe62a100
y.create.l HWIO_PMIC_ARB_OBS2_CHNL323_CMD_ADDR A:0xe62a180
y.create.l HWIO_PMIC_ARB_OBS2_CHNL324_CMD_ADDR A:0xe62a200
y.create.l HWIO_PMIC_ARB_OBS2_CHNL325_CMD_ADDR A:0xe62a280
y.create.l HWIO_PMIC_ARB_OBS2_CHNL326_CMD_ADDR A:0xe62a300
y.create.l HWIO_PMIC_ARB_OBS2_CHNL327_CMD_ADDR A:0xe62a380
y.create.l HWIO_PMIC_ARB_OBS2_CHNL328_CMD_ADDR A:0xe62a400
y.create.l HWIO_PMIC_ARB_OBS2_CHNL329_CMD_ADDR A:0xe62a480
y.create.l HWIO_PMIC_ARB_OBS2_CHNL330_CMD_ADDR A:0xe62a500
y.create.l HWIO_PMIC_ARB_OBS2_CHNL331_CMD_ADDR A:0xe62a580
y.create.l HWIO_PMIC_ARB_OBS2_CHNL332_CMD_ADDR A:0xe62a600
y.create.l HWIO_PMIC_ARB_OBS2_CHNL333_CMD_ADDR A:0xe62a680
y.create.l HWIO_PMIC_ARB_OBS2_CHNL334_CMD_ADDR A:0xe62a700
y.create.l HWIO_PMIC_ARB_OBS2_CHNL335_CMD_ADDR A:0xe62a780
y.create.l HWIO_PMIC_ARB_OBS2_CHNL336_CMD_ADDR A:0xe62a800
y.create.l HWIO_PMIC_ARB_OBS2_CHNL337_CMD_ADDR A:0xe62a880
y.create.l HWIO_PMIC_ARB_OBS2_CHNL338_CMD_ADDR A:0xe62a900
y.create.l HWIO_PMIC_ARB_OBS2_CHNL339_CMD_ADDR A:0xe62a980
y.create.l HWIO_PMIC_ARB_OBS2_CHNL340_CMD_ADDR A:0xe62aa00
y.create.l HWIO_PMIC_ARB_OBS2_CHNL341_CMD_ADDR A:0xe62aa80
y.create.l HWIO_PMIC_ARB_OBS2_CHNL342_CMD_ADDR A:0xe62ab00
y.create.l HWIO_PMIC_ARB_OBS2_CHNL343_CMD_ADDR A:0xe62ab80
y.create.l HWIO_PMIC_ARB_OBS2_CHNL344_CMD_ADDR A:0xe62ac00
y.create.l HWIO_PMIC_ARB_OBS2_CHNL345_CMD_ADDR A:0xe62ac80
y.create.l HWIO_PMIC_ARB_OBS2_CHNL346_CMD_ADDR A:0xe62ad00
y.create.l HWIO_PMIC_ARB_OBS2_CHNL347_CMD_ADDR A:0xe62ad80
y.create.l HWIO_PMIC_ARB_OBS2_CHNL348_CMD_ADDR A:0xe62ae00
y.create.l HWIO_PMIC_ARB_OBS2_CHNL349_CMD_ADDR A:0xe62ae80
y.create.l HWIO_PMIC_ARB_OBS2_CHNL350_CMD_ADDR A:0xe62af00
y.create.l HWIO_PMIC_ARB_OBS2_CHNL351_CMD_ADDR A:0xe62af80
y.create.l HWIO_PMIC_ARB_OBS2_CHNL352_CMD_ADDR A:0xe62b000
y.create.l HWIO_PMIC_ARB_OBS2_CHNL353_CMD_ADDR A:0xe62b080
y.create.l HWIO_PMIC_ARB_OBS2_CHNL354_CMD_ADDR A:0xe62b100
y.create.l HWIO_PMIC_ARB_OBS2_CHNL355_CMD_ADDR A:0xe62b180
y.create.l HWIO_PMIC_ARB_OBS2_CHNL356_CMD_ADDR A:0xe62b200
y.create.l HWIO_PMIC_ARB_OBS2_CHNL357_CMD_ADDR A:0xe62b280
y.create.l HWIO_PMIC_ARB_OBS2_CHNL358_CMD_ADDR A:0xe62b300
y.create.l HWIO_PMIC_ARB_OBS2_CHNL359_CMD_ADDR A:0xe62b380
y.create.l HWIO_PMIC_ARB_OBS2_CHNL360_CMD_ADDR A:0xe62b400
y.create.l HWIO_PMIC_ARB_OBS2_CHNL361_CMD_ADDR A:0xe62b480
y.create.l HWIO_PMIC_ARB_OBS2_CHNL362_CMD_ADDR A:0xe62b500
y.create.l HWIO_PMIC_ARB_OBS2_CHNL363_CMD_ADDR A:0xe62b580
y.create.l HWIO_PMIC_ARB_OBS2_CHNL364_CMD_ADDR A:0xe62b600
y.create.l HWIO_PMIC_ARB_OBS2_CHNL365_CMD_ADDR A:0xe62b680
y.create.l HWIO_PMIC_ARB_OBS2_CHNL366_CMD_ADDR A:0xe62b700
y.create.l HWIO_PMIC_ARB_OBS2_CHNL367_CMD_ADDR A:0xe62b780
y.create.l HWIO_PMIC_ARB_OBS2_CHNL368_CMD_ADDR A:0xe62b800
y.create.l HWIO_PMIC_ARB_OBS2_CHNL369_CMD_ADDR A:0xe62b880
y.create.l HWIO_PMIC_ARB_OBS2_CHNL370_CMD_ADDR A:0xe62b900
y.create.l HWIO_PMIC_ARB_OBS2_CHNL371_CMD_ADDR A:0xe62b980
y.create.l HWIO_PMIC_ARB_OBS2_CHNL372_CMD_ADDR A:0xe62ba00
y.create.l HWIO_PMIC_ARB_OBS2_CHNL373_CMD_ADDR A:0xe62ba80
y.create.l HWIO_PMIC_ARB_OBS2_CHNL374_CMD_ADDR A:0xe62bb00
y.create.l HWIO_PMIC_ARB_OBS2_CHNL375_CMD_ADDR A:0xe62bb80
y.create.l HWIO_PMIC_ARB_OBS2_CHNL376_CMD_ADDR A:0xe62bc00
y.create.l HWIO_PMIC_ARB_OBS2_CHNL377_CMD_ADDR A:0xe62bc80
y.create.l HWIO_PMIC_ARB_OBS2_CHNL378_CMD_ADDR A:0xe62bd00
y.create.l HWIO_PMIC_ARB_OBS2_CHNL379_CMD_ADDR A:0xe62bd80
y.create.l HWIO_PMIC_ARB_OBS2_CHNL380_CMD_ADDR A:0xe62be00
y.create.l HWIO_PMIC_ARB_OBS2_CHNL381_CMD_ADDR A:0xe62be80
y.create.l HWIO_PMIC_ARB_OBS2_CHNL382_CMD_ADDR A:0xe62bf00
y.create.l HWIO_PMIC_ARB_OBS2_CHNL383_CMD_ADDR A:0xe62bf80
y.create.l HWIO_PMIC_ARB_OBS2_CHNL384_CMD_ADDR A:0xe62c000
y.create.l HWIO_PMIC_ARB_OBS2_CHNL385_CMD_ADDR A:0xe62c080
y.create.l HWIO_PMIC_ARB_OBS2_CHNL386_CMD_ADDR A:0xe62c100
y.create.l HWIO_PMIC_ARB_OBS2_CHNL387_CMD_ADDR A:0xe62c180
y.create.l HWIO_PMIC_ARB_OBS2_CHNL388_CMD_ADDR A:0xe62c200
y.create.l HWIO_PMIC_ARB_OBS2_CHNL389_CMD_ADDR A:0xe62c280
y.create.l HWIO_PMIC_ARB_OBS2_CHNL390_CMD_ADDR A:0xe62c300
y.create.l HWIO_PMIC_ARB_OBS2_CHNL391_CMD_ADDR A:0xe62c380
y.create.l HWIO_PMIC_ARB_OBS2_CHNL392_CMD_ADDR A:0xe62c400
y.create.l HWIO_PMIC_ARB_OBS2_CHNL393_CMD_ADDR A:0xe62c480
y.create.l HWIO_PMIC_ARB_OBS2_CHNL394_CMD_ADDR A:0xe62c500
y.create.l HWIO_PMIC_ARB_OBS2_CHNL395_CMD_ADDR A:0xe62c580
y.create.l HWIO_PMIC_ARB_OBS2_CHNL396_CMD_ADDR A:0xe62c600
y.create.l HWIO_PMIC_ARB_OBS2_CHNL397_CMD_ADDR A:0xe62c680
y.create.l HWIO_PMIC_ARB_OBS2_CHNL398_CMD_ADDR A:0xe62c700
y.create.l HWIO_PMIC_ARB_OBS2_CHNL399_CMD_ADDR A:0xe62c780
y.create.l HWIO_PMIC_ARB_OBS2_CHNL400_CMD_ADDR A:0xe62c800
y.create.l HWIO_PMIC_ARB_OBS2_CHNL401_CMD_ADDR A:0xe62c880
y.create.l HWIO_PMIC_ARB_OBS2_CHNL402_CMD_ADDR A:0xe62c900
y.create.l HWIO_PMIC_ARB_OBS2_CHNL403_CMD_ADDR A:0xe62c980
y.create.l HWIO_PMIC_ARB_OBS2_CHNL404_CMD_ADDR A:0xe62ca00
y.create.l HWIO_PMIC_ARB_OBS2_CHNL405_CMD_ADDR A:0xe62ca80
y.create.l HWIO_PMIC_ARB_OBS2_CHNL406_CMD_ADDR A:0xe62cb00
y.create.l HWIO_PMIC_ARB_OBS2_CHNL407_CMD_ADDR A:0xe62cb80
y.create.l HWIO_PMIC_ARB_OBS2_CHNL408_CMD_ADDR A:0xe62cc00
y.create.l HWIO_PMIC_ARB_OBS2_CHNL409_CMD_ADDR A:0xe62cc80
y.create.l HWIO_PMIC_ARB_OBS2_CHNL410_CMD_ADDR A:0xe62cd00
y.create.l HWIO_PMIC_ARB_OBS2_CHNL411_CMD_ADDR A:0xe62cd80
y.create.l HWIO_PMIC_ARB_OBS2_CHNL412_CMD_ADDR A:0xe62ce00
y.create.l HWIO_PMIC_ARB_OBS2_CHNL413_CMD_ADDR A:0xe62ce80
y.create.l HWIO_PMIC_ARB_OBS2_CHNL414_CMD_ADDR A:0xe62cf00
y.create.l HWIO_PMIC_ARB_OBS2_CHNL415_CMD_ADDR A:0xe62cf80
y.create.l HWIO_PMIC_ARB_OBS2_CHNL416_CMD_ADDR A:0xe62d000
y.create.l HWIO_PMIC_ARB_OBS2_CHNL417_CMD_ADDR A:0xe62d080
y.create.l HWIO_PMIC_ARB_OBS2_CHNL418_CMD_ADDR A:0xe62d100
y.create.l HWIO_PMIC_ARB_OBS2_CHNL419_CMD_ADDR A:0xe62d180
y.create.l HWIO_PMIC_ARB_OBS2_CHNL420_CMD_ADDR A:0xe62d200
y.create.l HWIO_PMIC_ARB_OBS2_CHNL421_CMD_ADDR A:0xe62d280
y.create.l HWIO_PMIC_ARB_OBS2_CHNL422_CMD_ADDR A:0xe62d300
y.create.l HWIO_PMIC_ARB_OBS2_CHNL423_CMD_ADDR A:0xe62d380
y.create.l HWIO_PMIC_ARB_OBS2_CHNL424_CMD_ADDR A:0xe62d400
y.create.l HWIO_PMIC_ARB_OBS2_CHNL425_CMD_ADDR A:0xe62d480
y.create.l HWIO_PMIC_ARB_OBS2_CHNL426_CMD_ADDR A:0xe62d500
y.create.l HWIO_PMIC_ARB_OBS2_CHNL427_CMD_ADDR A:0xe62d580
y.create.l HWIO_PMIC_ARB_OBS2_CHNL428_CMD_ADDR A:0xe62d600
y.create.l HWIO_PMIC_ARB_OBS2_CHNL429_CMD_ADDR A:0xe62d680
y.create.l HWIO_PMIC_ARB_OBS2_CHNL430_CMD_ADDR A:0xe62d700
y.create.l HWIO_PMIC_ARB_OBS2_CHNL431_CMD_ADDR A:0xe62d780
y.create.l HWIO_PMIC_ARB_OBS2_CHNL432_CMD_ADDR A:0xe62d800
y.create.l HWIO_PMIC_ARB_OBS2_CHNL433_CMD_ADDR A:0xe62d880
y.create.l HWIO_PMIC_ARB_OBS2_CHNL434_CMD_ADDR A:0xe62d900
y.create.l HWIO_PMIC_ARB_OBS2_CHNL435_CMD_ADDR A:0xe62d980
y.create.l HWIO_PMIC_ARB_OBS2_CHNL436_CMD_ADDR A:0xe62da00
y.create.l HWIO_PMIC_ARB_OBS2_CHNL437_CMD_ADDR A:0xe62da80
y.create.l HWIO_PMIC_ARB_OBS2_CHNL438_CMD_ADDR A:0xe62db00
y.create.l HWIO_PMIC_ARB_OBS2_CHNL439_CMD_ADDR A:0xe62db80
y.create.l HWIO_PMIC_ARB_OBS2_CHNL440_CMD_ADDR A:0xe62dc00
y.create.l HWIO_PMIC_ARB_OBS2_CHNL441_CMD_ADDR A:0xe62dc80
y.create.l HWIO_PMIC_ARB_OBS2_CHNL442_CMD_ADDR A:0xe62dd00
y.create.l HWIO_PMIC_ARB_OBS2_CHNL443_CMD_ADDR A:0xe62dd80
y.create.l HWIO_PMIC_ARB_OBS2_CHNL444_CMD_ADDR A:0xe62de00
y.create.l HWIO_PMIC_ARB_OBS2_CHNL445_CMD_ADDR A:0xe62de80
y.create.l HWIO_PMIC_ARB_OBS2_CHNL446_CMD_ADDR A:0xe62df00
y.create.l HWIO_PMIC_ARB_OBS2_CHNL447_CMD_ADDR A:0xe62df80
y.create.l HWIO_PMIC_ARB_OBS2_CHNL448_CMD_ADDR A:0xe62e000
y.create.l HWIO_PMIC_ARB_OBS2_CHNL449_CMD_ADDR A:0xe62e080
y.create.l HWIO_PMIC_ARB_OBS2_CHNL450_CMD_ADDR A:0xe62e100
y.create.l HWIO_PMIC_ARB_OBS2_CHNL451_CMD_ADDR A:0xe62e180
y.create.l HWIO_PMIC_ARB_OBS2_CHNL452_CMD_ADDR A:0xe62e200
y.create.l HWIO_PMIC_ARB_OBS2_CHNL453_CMD_ADDR A:0xe62e280
y.create.l HWIO_PMIC_ARB_OBS2_CHNL454_CMD_ADDR A:0xe62e300
y.create.l HWIO_PMIC_ARB_OBS2_CHNL455_CMD_ADDR A:0xe62e380
y.create.l HWIO_PMIC_ARB_OBS2_CHNL456_CMD_ADDR A:0xe62e400
y.create.l HWIO_PMIC_ARB_OBS2_CHNL457_CMD_ADDR A:0xe62e480
y.create.l HWIO_PMIC_ARB_OBS2_CHNL458_CMD_ADDR A:0xe62e500
y.create.l HWIO_PMIC_ARB_OBS2_CHNL459_CMD_ADDR A:0xe62e580
y.create.l HWIO_PMIC_ARB_OBS2_CHNL460_CMD_ADDR A:0xe62e600
y.create.l HWIO_PMIC_ARB_OBS2_CHNL461_CMD_ADDR A:0xe62e680
y.create.l HWIO_PMIC_ARB_OBS2_CHNL462_CMD_ADDR A:0xe62e700
y.create.l HWIO_PMIC_ARB_OBS2_CHNL463_CMD_ADDR A:0xe62e780
y.create.l HWIO_PMIC_ARB_OBS2_CHNL464_CMD_ADDR A:0xe62e800
y.create.l HWIO_PMIC_ARB_OBS2_CHNL465_CMD_ADDR A:0xe62e880
y.create.l HWIO_PMIC_ARB_OBS2_CHNL466_CMD_ADDR A:0xe62e900
y.create.l HWIO_PMIC_ARB_OBS2_CHNL467_CMD_ADDR A:0xe62e980
y.create.l HWIO_PMIC_ARB_OBS2_CHNL468_CMD_ADDR A:0xe62ea00
y.create.l HWIO_PMIC_ARB_OBS2_CHNL469_CMD_ADDR A:0xe62ea80
y.create.l HWIO_PMIC_ARB_OBS2_CHNL470_CMD_ADDR A:0xe62eb00
y.create.l HWIO_PMIC_ARB_OBS2_CHNL471_CMD_ADDR A:0xe62eb80
y.create.l HWIO_PMIC_ARB_OBS2_CHNL472_CMD_ADDR A:0xe62ec00
y.create.l HWIO_PMIC_ARB_OBS2_CHNL473_CMD_ADDR A:0xe62ec80
y.create.l HWIO_PMIC_ARB_OBS2_CHNL474_CMD_ADDR A:0xe62ed00
y.create.l HWIO_PMIC_ARB_OBS2_CHNL475_CMD_ADDR A:0xe62ed80
y.create.l HWIO_PMIC_ARB_OBS2_CHNL476_CMD_ADDR A:0xe62ee00
y.create.l HWIO_PMIC_ARB_OBS2_CHNL477_CMD_ADDR A:0xe62ee80
y.create.l HWIO_PMIC_ARB_OBS2_CHNL478_CMD_ADDR A:0xe62ef00
y.create.l HWIO_PMIC_ARB_OBS2_CHNL479_CMD_ADDR A:0xe62ef80
y.create.l HWIO_PMIC_ARB_OBS2_CHNL480_CMD_ADDR A:0xe62f000
y.create.l HWIO_PMIC_ARB_OBS2_CHNL481_CMD_ADDR A:0xe62f080
y.create.l HWIO_PMIC_ARB_OBS2_CHNL482_CMD_ADDR A:0xe62f100
y.create.l HWIO_PMIC_ARB_OBS2_CHNL483_CMD_ADDR A:0xe62f180
y.create.l HWIO_PMIC_ARB_OBS2_CHNL484_CMD_ADDR A:0xe62f200
y.create.l HWIO_PMIC_ARB_OBS2_CHNL485_CMD_ADDR A:0xe62f280
y.create.l HWIO_PMIC_ARB_OBS2_CHNL486_CMD_ADDR A:0xe62f300
y.create.l HWIO_PMIC_ARB_OBS2_CHNL487_CMD_ADDR A:0xe62f380
y.create.l HWIO_PMIC_ARB_OBS2_CHNL488_CMD_ADDR A:0xe62f400
y.create.l HWIO_PMIC_ARB_OBS2_CHNL489_CMD_ADDR A:0xe62f480
y.create.l HWIO_PMIC_ARB_OBS2_CHNL490_CMD_ADDR A:0xe62f500
y.create.l HWIO_PMIC_ARB_OBS2_CHNL491_CMD_ADDR A:0xe62f580
y.create.l HWIO_PMIC_ARB_OBS2_CHNL492_CMD_ADDR A:0xe62f600
y.create.l HWIO_PMIC_ARB_OBS2_CHNL493_CMD_ADDR A:0xe62f680
y.create.l HWIO_PMIC_ARB_OBS2_CHNL494_CMD_ADDR A:0xe62f700
y.create.l HWIO_PMIC_ARB_OBS2_CHNL495_CMD_ADDR A:0xe62f780
y.create.l HWIO_PMIC_ARB_OBS2_CHNL496_CMD_ADDR A:0xe62f800
y.create.l HWIO_PMIC_ARB_OBS2_CHNL497_CMD_ADDR A:0xe62f880
y.create.l HWIO_PMIC_ARB_OBS2_CHNL498_CMD_ADDR A:0xe62f900
y.create.l HWIO_PMIC_ARB_OBS2_CHNL499_CMD_ADDR A:0xe62f980
y.create.l HWIO_PMIC_ARB_OBS2_CHNL500_CMD_ADDR A:0xe62fa00
y.create.l HWIO_PMIC_ARB_OBS2_CHNL501_CMD_ADDR A:0xe62fa80
y.create.l HWIO_PMIC_ARB_OBS2_CHNL502_CMD_ADDR A:0xe62fb00
y.create.l HWIO_PMIC_ARB_OBS2_CHNL503_CMD_ADDR A:0xe62fb80
y.create.l HWIO_PMIC_ARB_OBS2_CHNL504_CMD_ADDR A:0xe62fc00
y.create.l HWIO_PMIC_ARB_OBS2_CHNL505_CMD_ADDR A:0xe62fc80
y.create.l HWIO_PMIC_ARB_OBS2_CHNL506_CMD_ADDR A:0xe62fd00
y.create.l HWIO_PMIC_ARB_OBS2_CHNL507_CMD_ADDR A:0xe62fd80
y.create.l HWIO_PMIC_ARB_OBS2_CHNL508_CMD_ADDR A:0xe62fe00
y.create.l HWIO_PMIC_ARB_OBS2_CHNL509_CMD_ADDR A:0xe62fe80
y.create.l HWIO_PMIC_ARB_OBS2_CHNL510_CMD_ADDR A:0xe62ff00
y.create.l HWIO_PMIC_ARB_OBS2_CHNL511_CMD_ADDR A:0xe62ff80
y.create.l HWIO_PMIC_ARB_OBS3_CHNL0_CMD_ADDR A:0xe630000
y.create.l HWIO_PMIC_ARB_OBS3_CHNL1_CMD_ADDR A:0xe630080
y.create.l HWIO_PMIC_ARB_OBS3_CHNL2_CMD_ADDR A:0xe630100
y.create.l HWIO_PMIC_ARB_OBS3_CHNL3_CMD_ADDR A:0xe630180
y.create.l HWIO_PMIC_ARB_OBS3_CHNL4_CMD_ADDR A:0xe630200
y.create.l HWIO_PMIC_ARB_OBS3_CHNL5_CMD_ADDR A:0xe630280
y.create.l HWIO_PMIC_ARB_OBS3_CHNL6_CMD_ADDR A:0xe630300
y.create.l HWIO_PMIC_ARB_OBS3_CHNL7_CMD_ADDR A:0xe630380
y.create.l HWIO_PMIC_ARB_OBS3_CHNL8_CMD_ADDR A:0xe630400
y.create.l HWIO_PMIC_ARB_OBS3_CHNL9_CMD_ADDR A:0xe630480
y.create.l HWIO_PMIC_ARB_OBS3_CHNL10_CMD_ADDR A:0xe630500
y.create.l HWIO_PMIC_ARB_OBS3_CHNL11_CMD_ADDR A:0xe630580
y.create.l HWIO_PMIC_ARB_OBS3_CHNL12_CMD_ADDR A:0xe630600
y.create.l HWIO_PMIC_ARB_OBS3_CHNL13_CMD_ADDR A:0xe630680
y.create.l HWIO_PMIC_ARB_OBS3_CHNL14_CMD_ADDR A:0xe630700
y.create.l HWIO_PMIC_ARB_OBS3_CHNL15_CMD_ADDR A:0xe630780
y.create.l HWIO_PMIC_ARB_OBS3_CHNL16_CMD_ADDR A:0xe630800
y.create.l HWIO_PMIC_ARB_OBS3_CHNL17_CMD_ADDR A:0xe630880
y.create.l HWIO_PMIC_ARB_OBS3_CHNL18_CMD_ADDR A:0xe630900
y.create.l HWIO_PMIC_ARB_OBS3_CHNL19_CMD_ADDR A:0xe630980
y.create.l HWIO_PMIC_ARB_OBS3_CHNL20_CMD_ADDR A:0xe630a00
y.create.l HWIO_PMIC_ARB_OBS3_CHNL21_CMD_ADDR A:0xe630a80
y.create.l HWIO_PMIC_ARB_OBS3_CHNL22_CMD_ADDR A:0xe630b00
y.create.l HWIO_PMIC_ARB_OBS3_CHNL23_CMD_ADDR A:0xe630b80
y.create.l HWIO_PMIC_ARB_OBS3_CHNL24_CMD_ADDR A:0xe630c00
y.create.l HWIO_PMIC_ARB_OBS3_CHNL25_CMD_ADDR A:0xe630c80
y.create.l HWIO_PMIC_ARB_OBS3_CHNL26_CMD_ADDR A:0xe630d00
y.create.l HWIO_PMIC_ARB_OBS3_CHNL27_CMD_ADDR A:0xe630d80
y.create.l HWIO_PMIC_ARB_OBS3_CHNL28_CMD_ADDR A:0xe630e00
y.create.l HWIO_PMIC_ARB_OBS3_CHNL29_CMD_ADDR A:0xe630e80
y.create.l HWIO_PMIC_ARB_OBS3_CHNL30_CMD_ADDR A:0xe630f00
y.create.l HWIO_PMIC_ARB_OBS3_CHNL31_CMD_ADDR A:0xe630f80
y.create.l HWIO_PMIC_ARB_OBS3_CHNL32_CMD_ADDR A:0xe631000
y.create.l HWIO_PMIC_ARB_OBS3_CHNL33_CMD_ADDR A:0xe631080
y.create.l HWIO_PMIC_ARB_OBS3_CHNL34_CMD_ADDR A:0xe631100
y.create.l HWIO_PMIC_ARB_OBS3_CHNL35_CMD_ADDR A:0xe631180
y.create.l HWIO_PMIC_ARB_OBS3_CHNL36_CMD_ADDR A:0xe631200
y.create.l HWIO_PMIC_ARB_OBS3_CHNL37_CMD_ADDR A:0xe631280
y.create.l HWIO_PMIC_ARB_OBS3_CHNL38_CMD_ADDR A:0xe631300
y.create.l HWIO_PMIC_ARB_OBS3_CHNL39_CMD_ADDR A:0xe631380
y.create.l HWIO_PMIC_ARB_OBS3_CHNL40_CMD_ADDR A:0xe631400
y.create.l HWIO_PMIC_ARB_OBS3_CHNL41_CMD_ADDR A:0xe631480
y.create.l HWIO_PMIC_ARB_OBS3_CHNL42_CMD_ADDR A:0xe631500
y.create.l HWIO_PMIC_ARB_OBS3_CHNL43_CMD_ADDR A:0xe631580
y.create.l HWIO_PMIC_ARB_OBS3_CHNL44_CMD_ADDR A:0xe631600
y.create.l HWIO_PMIC_ARB_OBS3_CHNL45_CMD_ADDR A:0xe631680
y.create.l HWIO_PMIC_ARB_OBS3_CHNL46_CMD_ADDR A:0xe631700
y.create.l HWIO_PMIC_ARB_OBS3_CHNL47_CMD_ADDR A:0xe631780
y.create.l HWIO_PMIC_ARB_OBS3_CHNL48_CMD_ADDR A:0xe631800
y.create.l HWIO_PMIC_ARB_OBS3_CHNL49_CMD_ADDR A:0xe631880
y.create.l HWIO_PMIC_ARB_OBS3_CHNL50_CMD_ADDR A:0xe631900
y.create.l HWIO_PMIC_ARB_OBS3_CHNL51_CMD_ADDR A:0xe631980
y.create.l HWIO_PMIC_ARB_OBS3_CHNL52_CMD_ADDR A:0xe631a00
y.create.l HWIO_PMIC_ARB_OBS3_CHNL53_CMD_ADDR A:0xe631a80
y.create.l HWIO_PMIC_ARB_OBS3_CHNL54_CMD_ADDR A:0xe631b00
y.create.l HWIO_PMIC_ARB_OBS3_CHNL55_CMD_ADDR A:0xe631b80
y.create.l HWIO_PMIC_ARB_OBS3_CHNL56_CMD_ADDR A:0xe631c00
y.create.l HWIO_PMIC_ARB_OBS3_CHNL57_CMD_ADDR A:0xe631c80
y.create.l HWIO_PMIC_ARB_OBS3_CHNL58_CMD_ADDR A:0xe631d00
y.create.l HWIO_PMIC_ARB_OBS3_CHNL59_CMD_ADDR A:0xe631d80
y.create.l HWIO_PMIC_ARB_OBS3_CHNL60_CMD_ADDR A:0xe631e00
y.create.l HWIO_PMIC_ARB_OBS3_CHNL61_CMD_ADDR A:0xe631e80
y.create.l HWIO_PMIC_ARB_OBS3_CHNL62_CMD_ADDR A:0xe631f00
y.create.l HWIO_PMIC_ARB_OBS3_CHNL63_CMD_ADDR A:0xe631f80
y.create.l HWIO_PMIC_ARB_OBS3_CHNL64_CMD_ADDR A:0xe632000
y.create.l HWIO_PMIC_ARB_OBS3_CHNL65_CMD_ADDR A:0xe632080
y.create.l HWIO_PMIC_ARB_OBS3_CHNL66_CMD_ADDR A:0xe632100
y.create.l HWIO_PMIC_ARB_OBS3_CHNL67_CMD_ADDR A:0xe632180
y.create.l HWIO_PMIC_ARB_OBS3_CHNL68_CMD_ADDR A:0xe632200
y.create.l HWIO_PMIC_ARB_OBS3_CHNL69_CMD_ADDR A:0xe632280
y.create.l HWIO_PMIC_ARB_OBS3_CHNL70_CMD_ADDR A:0xe632300
y.create.l HWIO_PMIC_ARB_OBS3_CHNL71_CMD_ADDR A:0xe632380
y.create.l HWIO_PMIC_ARB_OBS3_CHNL72_CMD_ADDR A:0xe632400
y.create.l HWIO_PMIC_ARB_OBS3_CHNL73_CMD_ADDR A:0xe632480
y.create.l HWIO_PMIC_ARB_OBS3_CHNL74_CMD_ADDR A:0xe632500
y.create.l HWIO_PMIC_ARB_OBS3_CHNL75_CMD_ADDR A:0xe632580
y.create.l HWIO_PMIC_ARB_OBS3_CHNL76_CMD_ADDR A:0xe632600
y.create.l HWIO_PMIC_ARB_OBS3_CHNL77_CMD_ADDR A:0xe632680
y.create.l HWIO_PMIC_ARB_OBS3_CHNL78_CMD_ADDR A:0xe632700
y.create.l HWIO_PMIC_ARB_OBS3_CHNL79_CMD_ADDR A:0xe632780
y.create.l HWIO_PMIC_ARB_OBS3_CHNL80_CMD_ADDR A:0xe632800
y.create.l HWIO_PMIC_ARB_OBS3_CHNL81_CMD_ADDR A:0xe632880
y.create.l HWIO_PMIC_ARB_OBS3_CHNL82_CMD_ADDR A:0xe632900
y.create.l HWIO_PMIC_ARB_OBS3_CHNL83_CMD_ADDR A:0xe632980
y.create.l HWIO_PMIC_ARB_OBS3_CHNL84_CMD_ADDR A:0xe632a00
y.create.l HWIO_PMIC_ARB_OBS3_CHNL85_CMD_ADDR A:0xe632a80
y.create.l HWIO_PMIC_ARB_OBS3_CHNL86_CMD_ADDR A:0xe632b00
y.create.l HWIO_PMIC_ARB_OBS3_CHNL87_CMD_ADDR A:0xe632b80
y.create.l HWIO_PMIC_ARB_OBS3_CHNL88_CMD_ADDR A:0xe632c00
y.create.l HWIO_PMIC_ARB_OBS3_CHNL89_CMD_ADDR A:0xe632c80
y.create.l HWIO_PMIC_ARB_OBS3_CHNL90_CMD_ADDR A:0xe632d00
y.create.l HWIO_PMIC_ARB_OBS3_CHNL91_CMD_ADDR A:0xe632d80
y.create.l HWIO_PMIC_ARB_OBS3_CHNL92_CMD_ADDR A:0xe632e00
y.create.l HWIO_PMIC_ARB_OBS3_CHNL93_CMD_ADDR A:0xe632e80
y.create.l HWIO_PMIC_ARB_OBS3_CHNL94_CMD_ADDR A:0xe632f00
y.create.l HWIO_PMIC_ARB_OBS3_CHNL95_CMD_ADDR A:0xe632f80
y.create.l HWIO_PMIC_ARB_OBS3_CHNL96_CMD_ADDR A:0xe633000
y.create.l HWIO_PMIC_ARB_OBS3_CHNL97_CMD_ADDR A:0xe633080
y.create.l HWIO_PMIC_ARB_OBS3_CHNL98_CMD_ADDR A:0xe633100
y.create.l HWIO_PMIC_ARB_OBS3_CHNL99_CMD_ADDR A:0xe633180
y.create.l HWIO_PMIC_ARB_OBS3_CHNL100_CMD_ADDR A:0xe633200
y.create.l HWIO_PMIC_ARB_OBS3_CHNL101_CMD_ADDR A:0xe633280
y.create.l HWIO_PMIC_ARB_OBS3_CHNL102_CMD_ADDR A:0xe633300
y.create.l HWIO_PMIC_ARB_OBS3_CHNL103_CMD_ADDR A:0xe633380
y.create.l HWIO_PMIC_ARB_OBS3_CHNL104_CMD_ADDR A:0xe633400
y.create.l HWIO_PMIC_ARB_OBS3_CHNL105_CMD_ADDR A:0xe633480
y.create.l HWIO_PMIC_ARB_OBS3_CHNL106_CMD_ADDR A:0xe633500
y.create.l HWIO_PMIC_ARB_OBS3_CHNL107_CMD_ADDR A:0xe633580
y.create.l HWIO_PMIC_ARB_OBS3_CHNL108_CMD_ADDR A:0xe633600
y.create.l HWIO_PMIC_ARB_OBS3_CHNL109_CMD_ADDR A:0xe633680
y.create.l HWIO_PMIC_ARB_OBS3_CHNL110_CMD_ADDR A:0xe633700
y.create.l HWIO_PMIC_ARB_OBS3_CHNL111_CMD_ADDR A:0xe633780
y.create.l HWIO_PMIC_ARB_OBS3_CHNL112_CMD_ADDR A:0xe633800
y.create.l HWIO_PMIC_ARB_OBS3_CHNL113_CMD_ADDR A:0xe633880
y.create.l HWIO_PMIC_ARB_OBS3_CHNL114_CMD_ADDR A:0xe633900
y.create.l HWIO_PMIC_ARB_OBS3_CHNL115_CMD_ADDR A:0xe633980
y.create.l HWIO_PMIC_ARB_OBS3_CHNL116_CMD_ADDR A:0xe633a00
y.create.l HWIO_PMIC_ARB_OBS3_CHNL117_CMD_ADDR A:0xe633a80
y.create.l HWIO_PMIC_ARB_OBS3_CHNL118_CMD_ADDR A:0xe633b00
y.create.l HWIO_PMIC_ARB_OBS3_CHNL119_CMD_ADDR A:0xe633b80
y.create.l HWIO_PMIC_ARB_OBS3_CHNL120_CMD_ADDR A:0xe633c00
y.create.l HWIO_PMIC_ARB_OBS3_CHNL121_CMD_ADDR A:0xe633c80
y.create.l HWIO_PMIC_ARB_OBS3_CHNL122_CMD_ADDR A:0xe633d00
y.create.l HWIO_PMIC_ARB_OBS3_CHNL123_CMD_ADDR A:0xe633d80
y.create.l HWIO_PMIC_ARB_OBS3_CHNL124_CMD_ADDR A:0xe633e00
y.create.l HWIO_PMIC_ARB_OBS3_CHNL125_CMD_ADDR A:0xe633e80
y.create.l HWIO_PMIC_ARB_OBS3_CHNL126_CMD_ADDR A:0xe633f00
y.create.l HWIO_PMIC_ARB_OBS3_CHNL127_CMD_ADDR A:0xe633f80
y.create.l HWIO_PMIC_ARB_OBS3_CHNL128_CMD_ADDR A:0xe634000
y.create.l HWIO_PMIC_ARB_OBS3_CHNL129_CMD_ADDR A:0xe634080
y.create.l HWIO_PMIC_ARB_OBS3_CHNL130_CMD_ADDR A:0xe634100
y.create.l HWIO_PMIC_ARB_OBS3_CHNL131_CMD_ADDR A:0xe634180
y.create.l HWIO_PMIC_ARB_OBS3_CHNL132_CMD_ADDR A:0xe634200
y.create.l HWIO_PMIC_ARB_OBS3_CHNL133_CMD_ADDR A:0xe634280
y.create.l HWIO_PMIC_ARB_OBS3_CHNL134_CMD_ADDR A:0xe634300
y.create.l HWIO_PMIC_ARB_OBS3_CHNL135_CMD_ADDR A:0xe634380
y.create.l HWIO_PMIC_ARB_OBS3_CHNL136_CMD_ADDR A:0xe634400
y.create.l HWIO_PMIC_ARB_OBS3_CHNL137_CMD_ADDR A:0xe634480
y.create.l HWIO_PMIC_ARB_OBS3_CHNL138_CMD_ADDR A:0xe634500
y.create.l HWIO_PMIC_ARB_OBS3_CHNL139_CMD_ADDR A:0xe634580
y.create.l HWIO_PMIC_ARB_OBS3_CHNL140_CMD_ADDR A:0xe634600
y.create.l HWIO_PMIC_ARB_OBS3_CHNL141_CMD_ADDR A:0xe634680
y.create.l HWIO_PMIC_ARB_OBS3_CHNL142_CMD_ADDR A:0xe634700
y.create.l HWIO_PMIC_ARB_OBS3_CHNL143_CMD_ADDR A:0xe634780
y.create.l HWIO_PMIC_ARB_OBS3_CHNL144_CMD_ADDR A:0xe634800
y.create.l HWIO_PMIC_ARB_OBS3_CHNL145_CMD_ADDR A:0xe634880
y.create.l HWIO_PMIC_ARB_OBS3_CHNL146_CMD_ADDR A:0xe634900
y.create.l HWIO_PMIC_ARB_OBS3_CHNL147_CMD_ADDR A:0xe634980
y.create.l HWIO_PMIC_ARB_OBS3_CHNL148_CMD_ADDR A:0xe634a00
y.create.l HWIO_PMIC_ARB_OBS3_CHNL149_CMD_ADDR A:0xe634a80
y.create.l HWIO_PMIC_ARB_OBS3_CHNL150_CMD_ADDR A:0xe634b00
y.create.l HWIO_PMIC_ARB_OBS3_CHNL151_CMD_ADDR A:0xe634b80
y.create.l HWIO_PMIC_ARB_OBS3_CHNL152_CMD_ADDR A:0xe634c00
y.create.l HWIO_PMIC_ARB_OBS3_CHNL153_CMD_ADDR A:0xe634c80
y.create.l HWIO_PMIC_ARB_OBS3_CHNL154_CMD_ADDR A:0xe634d00
y.create.l HWIO_PMIC_ARB_OBS3_CHNL155_CMD_ADDR A:0xe634d80
y.create.l HWIO_PMIC_ARB_OBS3_CHNL156_CMD_ADDR A:0xe634e00
y.create.l HWIO_PMIC_ARB_OBS3_CHNL157_CMD_ADDR A:0xe634e80
y.create.l HWIO_PMIC_ARB_OBS3_CHNL158_CMD_ADDR A:0xe634f00
y.create.l HWIO_PMIC_ARB_OBS3_CHNL159_CMD_ADDR A:0xe634f80
y.create.l HWIO_PMIC_ARB_OBS3_CHNL160_CMD_ADDR A:0xe635000
y.create.l HWIO_PMIC_ARB_OBS3_CHNL161_CMD_ADDR A:0xe635080
y.create.l HWIO_PMIC_ARB_OBS3_CHNL162_CMD_ADDR A:0xe635100
y.create.l HWIO_PMIC_ARB_OBS3_CHNL163_CMD_ADDR A:0xe635180
y.create.l HWIO_PMIC_ARB_OBS3_CHNL164_CMD_ADDR A:0xe635200
y.create.l HWIO_PMIC_ARB_OBS3_CHNL165_CMD_ADDR A:0xe635280
y.create.l HWIO_PMIC_ARB_OBS3_CHNL166_CMD_ADDR A:0xe635300
y.create.l HWIO_PMIC_ARB_OBS3_CHNL167_CMD_ADDR A:0xe635380
y.create.l HWIO_PMIC_ARB_OBS3_CHNL168_CMD_ADDR A:0xe635400
y.create.l HWIO_PMIC_ARB_OBS3_CHNL169_CMD_ADDR A:0xe635480
y.create.l HWIO_PMIC_ARB_OBS3_CHNL170_CMD_ADDR A:0xe635500
y.create.l HWIO_PMIC_ARB_OBS3_CHNL171_CMD_ADDR A:0xe635580
y.create.l HWIO_PMIC_ARB_OBS3_CHNL172_CMD_ADDR A:0xe635600
y.create.l HWIO_PMIC_ARB_OBS3_CHNL173_CMD_ADDR A:0xe635680
y.create.l HWIO_PMIC_ARB_OBS3_CHNL174_CMD_ADDR A:0xe635700
y.create.l HWIO_PMIC_ARB_OBS3_CHNL175_CMD_ADDR A:0xe635780
y.create.l HWIO_PMIC_ARB_OBS3_CHNL176_CMD_ADDR A:0xe635800
y.create.l HWIO_PMIC_ARB_OBS3_CHNL177_CMD_ADDR A:0xe635880
y.create.l HWIO_PMIC_ARB_OBS3_CHNL178_CMD_ADDR A:0xe635900
y.create.l HWIO_PMIC_ARB_OBS3_CHNL179_CMD_ADDR A:0xe635980
y.create.l HWIO_PMIC_ARB_OBS3_CHNL180_CMD_ADDR A:0xe635a00
y.create.l HWIO_PMIC_ARB_OBS3_CHNL181_CMD_ADDR A:0xe635a80
y.create.l HWIO_PMIC_ARB_OBS3_CHNL182_CMD_ADDR A:0xe635b00
y.create.l HWIO_PMIC_ARB_OBS3_CHNL183_CMD_ADDR A:0xe635b80
y.create.l HWIO_PMIC_ARB_OBS3_CHNL184_CMD_ADDR A:0xe635c00
y.create.l HWIO_PMIC_ARB_OBS3_CHNL185_CMD_ADDR A:0xe635c80
y.create.l HWIO_PMIC_ARB_OBS3_CHNL186_CMD_ADDR A:0xe635d00
y.create.l HWIO_PMIC_ARB_OBS3_CHNL187_CMD_ADDR A:0xe635d80
y.create.l HWIO_PMIC_ARB_OBS3_CHNL188_CMD_ADDR A:0xe635e00
y.create.l HWIO_PMIC_ARB_OBS3_CHNL189_CMD_ADDR A:0xe635e80
y.create.l HWIO_PMIC_ARB_OBS3_CHNL190_CMD_ADDR A:0xe635f00
y.create.l HWIO_PMIC_ARB_OBS3_CHNL191_CMD_ADDR A:0xe635f80
y.create.l HWIO_PMIC_ARB_OBS3_CHNL192_CMD_ADDR A:0xe636000
y.create.l HWIO_PMIC_ARB_OBS3_CHNL193_CMD_ADDR A:0xe636080
y.create.l HWIO_PMIC_ARB_OBS3_CHNL194_CMD_ADDR A:0xe636100
y.create.l HWIO_PMIC_ARB_OBS3_CHNL195_CMD_ADDR A:0xe636180
y.create.l HWIO_PMIC_ARB_OBS3_CHNL196_CMD_ADDR A:0xe636200
y.create.l HWIO_PMIC_ARB_OBS3_CHNL197_CMD_ADDR A:0xe636280
y.create.l HWIO_PMIC_ARB_OBS3_CHNL198_CMD_ADDR A:0xe636300
y.create.l HWIO_PMIC_ARB_OBS3_CHNL199_CMD_ADDR A:0xe636380
y.create.l HWIO_PMIC_ARB_OBS3_CHNL200_CMD_ADDR A:0xe636400
y.create.l HWIO_PMIC_ARB_OBS3_CHNL201_CMD_ADDR A:0xe636480
y.create.l HWIO_PMIC_ARB_OBS3_CHNL202_CMD_ADDR A:0xe636500
y.create.l HWIO_PMIC_ARB_OBS3_CHNL203_CMD_ADDR A:0xe636580
y.create.l HWIO_PMIC_ARB_OBS3_CHNL204_CMD_ADDR A:0xe636600
y.create.l HWIO_PMIC_ARB_OBS3_CHNL205_CMD_ADDR A:0xe636680
y.create.l HWIO_PMIC_ARB_OBS3_CHNL206_CMD_ADDR A:0xe636700
y.create.l HWIO_PMIC_ARB_OBS3_CHNL207_CMD_ADDR A:0xe636780
y.create.l HWIO_PMIC_ARB_OBS3_CHNL208_CMD_ADDR A:0xe636800
y.create.l HWIO_PMIC_ARB_OBS3_CHNL209_CMD_ADDR A:0xe636880
y.create.l HWIO_PMIC_ARB_OBS3_CHNL210_CMD_ADDR A:0xe636900
y.create.l HWIO_PMIC_ARB_OBS3_CHNL211_CMD_ADDR A:0xe636980
y.create.l HWIO_PMIC_ARB_OBS3_CHNL212_CMD_ADDR A:0xe636a00
y.create.l HWIO_PMIC_ARB_OBS3_CHNL213_CMD_ADDR A:0xe636a80
y.create.l HWIO_PMIC_ARB_OBS3_CHNL214_CMD_ADDR A:0xe636b00
y.create.l HWIO_PMIC_ARB_OBS3_CHNL215_CMD_ADDR A:0xe636b80
y.create.l HWIO_PMIC_ARB_OBS3_CHNL216_CMD_ADDR A:0xe636c00
y.create.l HWIO_PMIC_ARB_OBS3_CHNL217_CMD_ADDR A:0xe636c80
y.create.l HWIO_PMIC_ARB_OBS3_CHNL218_CMD_ADDR A:0xe636d00
y.create.l HWIO_PMIC_ARB_OBS3_CHNL219_CMD_ADDR A:0xe636d80
y.create.l HWIO_PMIC_ARB_OBS3_CHNL220_CMD_ADDR A:0xe636e00
y.create.l HWIO_PMIC_ARB_OBS3_CHNL221_CMD_ADDR A:0xe636e80
y.create.l HWIO_PMIC_ARB_OBS3_CHNL222_CMD_ADDR A:0xe636f00
y.create.l HWIO_PMIC_ARB_OBS3_CHNL223_CMD_ADDR A:0xe636f80
y.create.l HWIO_PMIC_ARB_OBS3_CHNL224_CMD_ADDR A:0xe637000
y.create.l HWIO_PMIC_ARB_OBS3_CHNL225_CMD_ADDR A:0xe637080
y.create.l HWIO_PMIC_ARB_OBS3_CHNL226_CMD_ADDR A:0xe637100
y.create.l HWIO_PMIC_ARB_OBS3_CHNL227_CMD_ADDR A:0xe637180
y.create.l HWIO_PMIC_ARB_OBS3_CHNL228_CMD_ADDR A:0xe637200
y.create.l HWIO_PMIC_ARB_OBS3_CHNL229_CMD_ADDR A:0xe637280
y.create.l HWIO_PMIC_ARB_OBS3_CHNL230_CMD_ADDR A:0xe637300
y.create.l HWIO_PMIC_ARB_OBS3_CHNL231_CMD_ADDR A:0xe637380
y.create.l HWIO_PMIC_ARB_OBS3_CHNL232_CMD_ADDR A:0xe637400
y.create.l HWIO_PMIC_ARB_OBS3_CHNL233_CMD_ADDR A:0xe637480
y.create.l HWIO_PMIC_ARB_OBS3_CHNL234_CMD_ADDR A:0xe637500
y.create.l HWIO_PMIC_ARB_OBS3_CHNL235_CMD_ADDR A:0xe637580
y.create.l HWIO_PMIC_ARB_OBS3_CHNL236_CMD_ADDR A:0xe637600
y.create.l HWIO_PMIC_ARB_OBS3_CHNL237_CMD_ADDR A:0xe637680
y.create.l HWIO_PMIC_ARB_OBS3_CHNL238_CMD_ADDR A:0xe637700
y.create.l HWIO_PMIC_ARB_OBS3_CHNL239_CMD_ADDR A:0xe637780
y.create.l HWIO_PMIC_ARB_OBS3_CHNL240_CMD_ADDR A:0xe637800
y.create.l HWIO_PMIC_ARB_OBS3_CHNL241_CMD_ADDR A:0xe637880
y.create.l HWIO_PMIC_ARB_OBS3_CHNL242_CMD_ADDR A:0xe637900
y.create.l HWIO_PMIC_ARB_OBS3_CHNL243_CMD_ADDR A:0xe637980
y.create.l HWIO_PMIC_ARB_OBS3_CHNL244_CMD_ADDR A:0xe637a00
y.create.l HWIO_PMIC_ARB_OBS3_CHNL245_CMD_ADDR A:0xe637a80
y.create.l HWIO_PMIC_ARB_OBS3_CHNL246_CMD_ADDR A:0xe637b00
y.create.l HWIO_PMIC_ARB_OBS3_CHNL247_CMD_ADDR A:0xe637b80
y.create.l HWIO_PMIC_ARB_OBS3_CHNL248_CMD_ADDR A:0xe637c00
y.create.l HWIO_PMIC_ARB_OBS3_CHNL249_CMD_ADDR A:0xe637c80
y.create.l HWIO_PMIC_ARB_OBS3_CHNL250_CMD_ADDR A:0xe637d00
y.create.l HWIO_PMIC_ARB_OBS3_CHNL251_CMD_ADDR A:0xe637d80
y.create.l HWIO_PMIC_ARB_OBS3_CHNL252_CMD_ADDR A:0xe637e00
y.create.l HWIO_PMIC_ARB_OBS3_CHNL253_CMD_ADDR A:0xe637e80
y.create.l HWIO_PMIC_ARB_OBS3_CHNL254_CMD_ADDR A:0xe637f00
y.create.l HWIO_PMIC_ARB_OBS3_CHNL255_CMD_ADDR A:0xe637f80
y.create.l HWIO_PMIC_ARB_OBS3_CHNL256_CMD_ADDR A:0xe638000
y.create.l HWIO_PMIC_ARB_OBS3_CHNL257_CMD_ADDR A:0xe638080
y.create.l HWIO_PMIC_ARB_OBS3_CHNL258_CMD_ADDR A:0xe638100
y.create.l HWIO_PMIC_ARB_OBS3_CHNL259_CMD_ADDR A:0xe638180
y.create.l HWIO_PMIC_ARB_OBS3_CHNL260_CMD_ADDR A:0xe638200
y.create.l HWIO_PMIC_ARB_OBS3_CHNL261_CMD_ADDR A:0xe638280
y.create.l HWIO_PMIC_ARB_OBS3_CHNL262_CMD_ADDR A:0xe638300
y.create.l HWIO_PMIC_ARB_OBS3_CHNL263_CMD_ADDR A:0xe638380
y.create.l HWIO_PMIC_ARB_OBS3_CHNL264_CMD_ADDR A:0xe638400
y.create.l HWIO_PMIC_ARB_OBS3_CHNL265_CMD_ADDR A:0xe638480
y.create.l HWIO_PMIC_ARB_OBS3_CHNL266_CMD_ADDR A:0xe638500
y.create.l HWIO_PMIC_ARB_OBS3_CHNL267_CMD_ADDR A:0xe638580
y.create.l HWIO_PMIC_ARB_OBS3_CHNL268_CMD_ADDR A:0xe638600
y.create.l HWIO_PMIC_ARB_OBS3_CHNL269_CMD_ADDR A:0xe638680
y.create.l HWIO_PMIC_ARB_OBS3_CHNL270_CMD_ADDR A:0xe638700
y.create.l HWIO_PMIC_ARB_OBS3_CHNL271_CMD_ADDR A:0xe638780
y.create.l HWIO_PMIC_ARB_OBS3_CHNL272_CMD_ADDR A:0xe638800
y.create.l HWIO_PMIC_ARB_OBS3_CHNL273_CMD_ADDR A:0xe638880
y.create.l HWIO_PMIC_ARB_OBS3_CHNL274_CMD_ADDR A:0xe638900
y.create.l HWIO_PMIC_ARB_OBS3_CHNL275_CMD_ADDR A:0xe638980
y.create.l HWIO_PMIC_ARB_OBS3_CHNL276_CMD_ADDR A:0xe638a00
y.create.l HWIO_PMIC_ARB_OBS3_CHNL277_CMD_ADDR A:0xe638a80
y.create.l HWIO_PMIC_ARB_OBS3_CHNL278_CMD_ADDR A:0xe638b00
y.create.l HWIO_PMIC_ARB_OBS3_CHNL279_CMD_ADDR A:0xe638b80
y.create.l HWIO_PMIC_ARB_OBS3_CHNL280_CMD_ADDR A:0xe638c00
y.create.l HWIO_PMIC_ARB_OBS3_CHNL281_CMD_ADDR A:0xe638c80
y.create.l HWIO_PMIC_ARB_OBS3_CHNL282_CMD_ADDR A:0xe638d00
y.create.l HWIO_PMIC_ARB_OBS3_CHNL283_CMD_ADDR A:0xe638d80
y.create.l HWIO_PMIC_ARB_OBS3_CHNL284_CMD_ADDR A:0xe638e00
y.create.l HWIO_PMIC_ARB_OBS3_CHNL285_CMD_ADDR A:0xe638e80
y.create.l HWIO_PMIC_ARB_OBS3_CHNL286_CMD_ADDR A:0xe638f00
y.create.l HWIO_PMIC_ARB_OBS3_CHNL287_CMD_ADDR A:0xe638f80
y.create.l HWIO_PMIC_ARB_OBS3_CHNL288_CMD_ADDR A:0xe639000
y.create.l HWIO_PMIC_ARB_OBS3_CHNL289_CMD_ADDR A:0xe639080
y.create.l HWIO_PMIC_ARB_OBS3_CHNL290_CMD_ADDR A:0xe639100
y.create.l HWIO_PMIC_ARB_OBS3_CHNL291_CMD_ADDR A:0xe639180
y.create.l HWIO_PMIC_ARB_OBS3_CHNL292_CMD_ADDR A:0xe639200
y.create.l HWIO_PMIC_ARB_OBS3_CHNL293_CMD_ADDR A:0xe639280
y.create.l HWIO_PMIC_ARB_OBS3_CHNL294_CMD_ADDR A:0xe639300
y.create.l HWIO_PMIC_ARB_OBS3_CHNL295_CMD_ADDR A:0xe639380
y.create.l HWIO_PMIC_ARB_OBS3_CHNL296_CMD_ADDR A:0xe639400
y.create.l HWIO_PMIC_ARB_OBS3_CHNL297_CMD_ADDR A:0xe639480
y.create.l HWIO_PMIC_ARB_OBS3_CHNL298_CMD_ADDR A:0xe639500
y.create.l HWIO_PMIC_ARB_OBS3_CHNL299_CMD_ADDR A:0xe639580
y.create.l HWIO_PMIC_ARB_OBS3_CHNL300_CMD_ADDR A:0xe639600
y.create.l HWIO_PMIC_ARB_OBS3_CHNL301_CMD_ADDR A:0xe639680
y.create.l HWIO_PMIC_ARB_OBS3_CHNL302_CMD_ADDR A:0xe639700
y.create.l HWIO_PMIC_ARB_OBS3_CHNL303_CMD_ADDR A:0xe639780
y.create.l HWIO_PMIC_ARB_OBS3_CHNL304_CMD_ADDR A:0xe639800
y.create.l HWIO_PMIC_ARB_OBS3_CHNL305_CMD_ADDR A:0xe639880
y.create.l HWIO_PMIC_ARB_OBS3_CHNL306_CMD_ADDR A:0xe639900
y.create.l HWIO_PMIC_ARB_OBS3_CHNL307_CMD_ADDR A:0xe639980
y.create.l HWIO_PMIC_ARB_OBS3_CHNL308_CMD_ADDR A:0xe639a00
y.create.l HWIO_PMIC_ARB_OBS3_CHNL309_CMD_ADDR A:0xe639a80
y.create.l HWIO_PMIC_ARB_OBS3_CHNL310_CMD_ADDR A:0xe639b00
y.create.l HWIO_PMIC_ARB_OBS3_CHNL311_CMD_ADDR A:0xe639b80
y.create.l HWIO_PMIC_ARB_OBS3_CHNL312_CMD_ADDR A:0xe639c00
y.create.l HWIO_PMIC_ARB_OBS3_CHNL313_CMD_ADDR A:0xe639c80
y.create.l HWIO_PMIC_ARB_OBS3_CHNL314_CMD_ADDR A:0xe639d00
y.create.l HWIO_PMIC_ARB_OBS3_CHNL315_CMD_ADDR A:0xe639d80
y.create.l HWIO_PMIC_ARB_OBS3_CHNL316_CMD_ADDR A:0xe639e00
y.create.l HWIO_PMIC_ARB_OBS3_CHNL317_CMD_ADDR A:0xe639e80
y.create.l HWIO_PMIC_ARB_OBS3_CHNL318_CMD_ADDR A:0xe639f00
y.create.l HWIO_PMIC_ARB_OBS3_CHNL319_CMD_ADDR A:0xe639f80
y.create.l HWIO_PMIC_ARB_OBS3_CHNL320_CMD_ADDR A:0xe63a000
y.create.l HWIO_PMIC_ARB_OBS3_CHNL321_CMD_ADDR A:0xe63a080
y.create.l HWIO_PMIC_ARB_OBS3_CHNL322_CMD_ADDR A:0xe63a100
y.create.l HWIO_PMIC_ARB_OBS3_CHNL323_CMD_ADDR A:0xe63a180
y.create.l HWIO_PMIC_ARB_OBS3_CHNL324_CMD_ADDR A:0xe63a200
y.create.l HWIO_PMIC_ARB_OBS3_CHNL325_CMD_ADDR A:0xe63a280
y.create.l HWIO_PMIC_ARB_OBS3_CHNL326_CMD_ADDR A:0xe63a300
y.create.l HWIO_PMIC_ARB_OBS3_CHNL327_CMD_ADDR A:0xe63a380
y.create.l HWIO_PMIC_ARB_OBS3_CHNL328_CMD_ADDR A:0xe63a400
y.create.l HWIO_PMIC_ARB_OBS3_CHNL329_CMD_ADDR A:0xe63a480
y.create.l HWIO_PMIC_ARB_OBS3_CHNL330_CMD_ADDR A:0xe63a500
y.create.l HWIO_PMIC_ARB_OBS3_CHNL331_CMD_ADDR A:0xe63a580
y.create.l HWIO_PMIC_ARB_OBS3_CHNL332_CMD_ADDR A:0xe63a600
y.create.l HWIO_PMIC_ARB_OBS3_CHNL333_CMD_ADDR A:0xe63a680
y.create.l HWIO_PMIC_ARB_OBS3_CHNL334_CMD_ADDR A:0xe63a700
y.create.l HWIO_PMIC_ARB_OBS3_CHNL335_CMD_ADDR A:0xe63a780
y.create.l HWIO_PMIC_ARB_OBS3_CHNL336_CMD_ADDR A:0xe63a800
y.create.l HWIO_PMIC_ARB_OBS3_CHNL337_CMD_ADDR A:0xe63a880
y.create.l HWIO_PMIC_ARB_OBS3_CHNL338_CMD_ADDR A:0xe63a900
y.create.l HWIO_PMIC_ARB_OBS3_CHNL339_CMD_ADDR A:0xe63a980
y.create.l HWIO_PMIC_ARB_OBS3_CHNL340_CMD_ADDR A:0xe63aa00
y.create.l HWIO_PMIC_ARB_OBS3_CHNL341_CMD_ADDR A:0xe63aa80
y.create.l HWIO_PMIC_ARB_OBS3_CHNL342_CMD_ADDR A:0xe63ab00
y.create.l HWIO_PMIC_ARB_OBS3_CHNL343_CMD_ADDR A:0xe63ab80
y.create.l HWIO_PMIC_ARB_OBS3_CHNL344_CMD_ADDR A:0xe63ac00
y.create.l HWIO_PMIC_ARB_OBS3_CHNL345_CMD_ADDR A:0xe63ac80
y.create.l HWIO_PMIC_ARB_OBS3_CHNL346_CMD_ADDR A:0xe63ad00
y.create.l HWIO_PMIC_ARB_OBS3_CHNL347_CMD_ADDR A:0xe63ad80
y.create.l HWIO_PMIC_ARB_OBS3_CHNL348_CMD_ADDR A:0xe63ae00
y.create.l HWIO_PMIC_ARB_OBS3_CHNL349_CMD_ADDR A:0xe63ae80
y.create.l HWIO_PMIC_ARB_OBS3_CHNL350_CMD_ADDR A:0xe63af00
y.create.l HWIO_PMIC_ARB_OBS3_CHNL351_CMD_ADDR A:0xe63af80
y.create.l HWIO_PMIC_ARB_OBS3_CHNL352_CMD_ADDR A:0xe63b000
y.create.l HWIO_PMIC_ARB_OBS3_CHNL353_CMD_ADDR A:0xe63b080
y.create.l HWIO_PMIC_ARB_OBS3_CHNL354_CMD_ADDR A:0xe63b100
y.create.l HWIO_PMIC_ARB_OBS3_CHNL355_CMD_ADDR A:0xe63b180
y.create.l HWIO_PMIC_ARB_OBS3_CHNL356_CMD_ADDR A:0xe63b200
y.create.l HWIO_PMIC_ARB_OBS3_CHNL357_CMD_ADDR A:0xe63b280
y.create.l HWIO_PMIC_ARB_OBS3_CHNL358_CMD_ADDR A:0xe63b300
y.create.l HWIO_PMIC_ARB_OBS3_CHNL359_CMD_ADDR A:0xe63b380
y.create.l HWIO_PMIC_ARB_OBS3_CHNL360_CMD_ADDR A:0xe63b400
y.create.l HWIO_PMIC_ARB_OBS3_CHNL361_CMD_ADDR A:0xe63b480
y.create.l HWIO_PMIC_ARB_OBS3_CHNL362_CMD_ADDR A:0xe63b500
y.create.l HWIO_PMIC_ARB_OBS3_CHNL363_CMD_ADDR A:0xe63b580
y.create.l HWIO_PMIC_ARB_OBS3_CHNL364_CMD_ADDR A:0xe63b600
y.create.l HWIO_PMIC_ARB_OBS3_CHNL365_CMD_ADDR A:0xe63b680
y.create.l HWIO_PMIC_ARB_OBS3_CHNL366_CMD_ADDR A:0xe63b700
y.create.l HWIO_PMIC_ARB_OBS3_CHNL367_CMD_ADDR A:0xe63b780
y.create.l HWIO_PMIC_ARB_OBS3_CHNL368_CMD_ADDR A:0xe63b800
y.create.l HWIO_PMIC_ARB_OBS3_CHNL369_CMD_ADDR A:0xe63b880
y.create.l HWIO_PMIC_ARB_OBS3_CHNL370_CMD_ADDR A:0xe63b900
y.create.l HWIO_PMIC_ARB_OBS3_CHNL371_CMD_ADDR A:0xe63b980
y.create.l HWIO_PMIC_ARB_OBS3_CHNL372_CMD_ADDR A:0xe63ba00
y.create.l HWIO_PMIC_ARB_OBS3_CHNL373_CMD_ADDR A:0xe63ba80
y.create.l HWIO_PMIC_ARB_OBS3_CHNL374_CMD_ADDR A:0xe63bb00
y.create.l HWIO_PMIC_ARB_OBS3_CHNL375_CMD_ADDR A:0xe63bb80
y.create.l HWIO_PMIC_ARB_OBS3_CHNL376_CMD_ADDR A:0xe63bc00
y.create.l HWIO_PMIC_ARB_OBS3_CHNL377_CMD_ADDR A:0xe63bc80
y.create.l HWIO_PMIC_ARB_OBS3_CHNL378_CMD_ADDR A:0xe63bd00
y.create.l HWIO_PMIC_ARB_OBS3_CHNL379_CMD_ADDR A:0xe63bd80
y.create.l HWIO_PMIC_ARB_OBS3_CHNL380_CMD_ADDR A:0xe63be00
y.create.l HWIO_PMIC_ARB_OBS3_CHNL381_CMD_ADDR A:0xe63be80
y.create.l HWIO_PMIC_ARB_OBS3_CHNL382_CMD_ADDR A:0xe63bf00
y.create.l HWIO_PMIC_ARB_OBS3_CHNL383_CMD_ADDR A:0xe63bf80
y.create.l HWIO_PMIC_ARB_OBS3_CHNL384_CMD_ADDR A:0xe63c000
y.create.l HWIO_PMIC_ARB_OBS3_CHNL385_CMD_ADDR A:0xe63c080
y.create.l HWIO_PMIC_ARB_OBS3_CHNL386_CMD_ADDR A:0xe63c100
y.create.l HWIO_PMIC_ARB_OBS3_CHNL387_CMD_ADDR A:0xe63c180
y.create.l HWIO_PMIC_ARB_OBS3_CHNL388_CMD_ADDR A:0xe63c200
y.create.l HWIO_PMIC_ARB_OBS3_CHNL389_CMD_ADDR A:0xe63c280
y.create.l HWIO_PMIC_ARB_OBS3_CHNL390_CMD_ADDR A:0xe63c300
y.create.l HWIO_PMIC_ARB_OBS3_CHNL391_CMD_ADDR A:0xe63c380
y.create.l HWIO_PMIC_ARB_OBS3_CHNL392_CMD_ADDR A:0xe63c400
y.create.l HWIO_PMIC_ARB_OBS3_CHNL393_CMD_ADDR A:0xe63c480
y.create.l HWIO_PMIC_ARB_OBS3_CHNL394_CMD_ADDR A:0xe63c500
y.create.l HWIO_PMIC_ARB_OBS3_CHNL395_CMD_ADDR A:0xe63c580
y.create.l HWIO_PMIC_ARB_OBS3_CHNL396_CMD_ADDR A:0xe63c600
y.create.l HWIO_PMIC_ARB_OBS3_CHNL397_CMD_ADDR A:0xe63c680
y.create.l HWIO_PMIC_ARB_OBS3_CHNL398_CMD_ADDR A:0xe63c700
y.create.l HWIO_PMIC_ARB_OBS3_CHNL399_CMD_ADDR A:0xe63c780
y.create.l HWIO_PMIC_ARB_OBS3_CHNL400_CMD_ADDR A:0xe63c800
y.create.l HWIO_PMIC_ARB_OBS3_CHNL401_CMD_ADDR A:0xe63c880
y.create.l HWIO_PMIC_ARB_OBS3_CHNL402_CMD_ADDR A:0xe63c900
y.create.l HWIO_PMIC_ARB_OBS3_CHNL403_CMD_ADDR A:0xe63c980
y.create.l HWIO_PMIC_ARB_OBS3_CHNL404_CMD_ADDR A:0xe63ca00
y.create.l HWIO_PMIC_ARB_OBS3_CHNL405_CMD_ADDR A:0xe63ca80
y.create.l HWIO_PMIC_ARB_OBS3_CHNL406_CMD_ADDR A:0xe63cb00
y.create.l HWIO_PMIC_ARB_OBS3_CHNL407_CMD_ADDR A:0xe63cb80
y.create.l HWIO_PMIC_ARB_OBS3_CHNL408_CMD_ADDR A:0xe63cc00
y.create.l HWIO_PMIC_ARB_OBS3_CHNL409_CMD_ADDR A:0xe63cc80
y.create.l HWIO_PMIC_ARB_OBS3_CHNL410_CMD_ADDR A:0xe63cd00
y.create.l HWIO_PMIC_ARB_OBS3_CHNL411_CMD_ADDR A:0xe63cd80
y.create.l HWIO_PMIC_ARB_OBS3_CHNL412_CMD_ADDR A:0xe63ce00
y.create.l HWIO_PMIC_ARB_OBS3_CHNL413_CMD_ADDR A:0xe63ce80
y.create.l HWIO_PMIC_ARB_OBS3_CHNL414_CMD_ADDR A:0xe63cf00
y.create.l HWIO_PMIC_ARB_OBS3_CHNL415_CMD_ADDR A:0xe63cf80
y.create.l HWIO_PMIC_ARB_OBS3_CHNL416_CMD_ADDR A:0xe63d000
y.create.l HWIO_PMIC_ARB_OBS3_CHNL417_CMD_ADDR A:0xe63d080
y.create.l HWIO_PMIC_ARB_OBS3_CHNL418_CMD_ADDR A:0xe63d100
y.create.l HWIO_PMIC_ARB_OBS3_CHNL419_CMD_ADDR A:0xe63d180
y.create.l HWIO_PMIC_ARB_OBS3_CHNL420_CMD_ADDR A:0xe63d200
y.create.l HWIO_PMIC_ARB_OBS3_CHNL421_CMD_ADDR A:0xe63d280
y.create.l HWIO_PMIC_ARB_OBS3_CHNL422_CMD_ADDR A:0xe63d300
y.create.l HWIO_PMIC_ARB_OBS3_CHNL423_CMD_ADDR A:0xe63d380
y.create.l HWIO_PMIC_ARB_OBS3_CHNL424_CMD_ADDR A:0xe63d400
y.create.l HWIO_PMIC_ARB_OBS3_CHNL425_CMD_ADDR A:0xe63d480
y.create.l HWIO_PMIC_ARB_OBS3_CHNL426_CMD_ADDR A:0xe63d500
y.create.l HWIO_PMIC_ARB_OBS3_CHNL427_CMD_ADDR A:0xe63d580
y.create.l HWIO_PMIC_ARB_OBS3_CHNL428_CMD_ADDR A:0xe63d600
y.create.l HWIO_PMIC_ARB_OBS3_CHNL429_CMD_ADDR A:0xe63d680
y.create.l HWIO_PMIC_ARB_OBS3_CHNL430_CMD_ADDR A:0xe63d700
y.create.l HWIO_PMIC_ARB_OBS3_CHNL431_CMD_ADDR A:0xe63d780
y.create.l HWIO_PMIC_ARB_OBS3_CHNL432_CMD_ADDR A:0xe63d800
y.create.l HWIO_PMIC_ARB_OBS3_CHNL433_CMD_ADDR A:0xe63d880
y.create.l HWIO_PMIC_ARB_OBS3_CHNL434_CMD_ADDR A:0xe63d900
y.create.l HWIO_PMIC_ARB_OBS3_CHNL435_CMD_ADDR A:0xe63d980
y.create.l HWIO_PMIC_ARB_OBS3_CHNL436_CMD_ADDR A:0xe63da00
y.create.l HWIO_PMIC_ARB_OBS3_CHNL437_CMD_ADDR A:0xe63da80
y.create.l HWIO_PMIC_ARB_OBS3_CHNL438_CMD_ADDR A:0xe63db00
y.create.l HWIO_PMIC_ARB_OBS3_CHNL439_CMD_ADDR A:0xe63db80
y.create.l HWIO_PMIC_ARB_OBS3_CHNL440_CMD_ADDR A:0xe63dc00
y.create.l HWIO_PMIC_ARB_OBS3_CHNL441_CMD_ADDR A:0xe63dc80
y.create.l HWIO_PMIC_ARB_OBS3_CHNL442_CMD_ADDR A:0xe63dd00
y.create.l HWIO_PMIC_ARB_OBS3_CHNL443_CMD_ADDR A:0xe63dd80
y.create.l HWIO_PMIC_ARB_OBS3_CHNL444_CMD_ADDR A:0xe63de00
y.create.l HWIO_PMIC_ARB_OBS3_CHNL445_CMD_ADDR A:0xe63de80
y.create.l HWIO_PMIC_ARB_OBS3_CHNL446_CMD_ADDR A:0xe63df00
y.create.l HWIO_PMIC_ARB_OBS3_CHNL447_CMD_ADDR A:0xe63df80
y.create.l HWIO_PMIC_ARB_OBS3_CHNL448_CMD_ADDR A:0xe63e000
y.create.l HWIO_PMIC_ARB_OBS3_CHNL449_CMD_ADDR A:0xe63e080
y.create.l HWIO_PMIC_ARB_OBS3_CHNL450_CMD_ADDR A:0xe63e100
y.create.l HWIO_PMIC_ARB_OBS3_CHNL451_CMD_ADDR A:0xe63e180
y.create.l HWIO_PMIC_ARB_OBS3_CHNL452_CMD_ADDR A:0xe63e200
y.create.l HWIO_PMIC_ARB_OBS3_CHNL453_CMD_ADDR A:0xe63e280
y.create.l HWIO_PMIC_ARB_OBS3_CHNL454_CMD_ADDR A:0xe63e300
y.create.l HWIO_PMIC_ARB_OBS3_CHNL455_CMD_ADDR A:0xe63e380
y.create.l HWIO_PMIC_ARB_OBS3_CHNL456_CMD_ADDR A:0xe63e400
y.create.l HWIO_PMIC_ARB_OBS3_CHNL457_CMD_ADDR A:0xe63e480
y.create.l HWIO_PMIC_ARB_OBS3_CHNL458_CMD_ADDR A:0xe63e500
y.create.l HWIO_PMIC_ARB_OBS3_CHNL459_CMD_ADDR A:0xe63e580
y.create.l HWIO_PMIC_ARB_OBS3_CHNL460_CMD_ADDR A:0xe63e600
y.create.l HWIO_PMIC_ARB_OBS3_CHNL461_CMD_ADDR A:0xe63e680
y.create.l HWIO_PMIC_ARB_OBS3_CHNL462_CMD_ADDR A:0xe63e700
y.create.l HWIO_PMIC_ARB_OBS3_CHNL463_CMD_ADDR A:0xe63e780
y.create.l HWIO_PMIC_ARB_OBS3_CHNL464_CMD_ADDR A:0xe63e800
y.create.l HWIO_PMIC_ARB_OBS3_CHNL465_CMD_ADDR A:0xe63e880
y.create.l HWIO_PMIC_ARB_OBS3_CHNL466_CMD_ADDR A:0xe63e900
y.create.l HWIO_PMIC_ARB_OBS3_CHNL467_CMD_ADDR A:0xe63e980
y.create.l HWIO_PMIC_ARB_OBS3_CHNL468_CMD_ADDR A:0xe63ea00
y.create.l HWIO_PMIC_ARB_OBS3_CHNL469_CMD_ADDR A:0xe63ea80
y.create.l HWIO_PMIC_ARB_OBS3_CHNL470_CMD_ADDR A:0xe63eb00
y.create.l HWIO_PMIC_ARB_OBS3_CHNL471_CMD_ADDR A:0xe63eb80
y.create.l HWIO_PMIC_ARB_OBS3_CHNL472_CMD_ADDR A:0xe63ec00
y.create.l HWIO_PMIC_ARB_OBS3_CHNL473_CMD_ADDR A:0xe63ec80
y.create.l HWIO_PMIC_ARB_OBS3_CHNL474_CMD_ADDR A:0xe63ed00
y.create.l HWIO_PMIC_ARB_OBS3_CHNL475_CMD_ADDR A:0xe63ed80
y.create.l HWIO_PMIC_ARB_OBS3_CHNL476_CMD_ADDR A:0xe63ee00
y.create.l HWIO_PMIC_ARB_OBS3_CHNL477_CMD_ADDR A:0xe63ee80
y.create.l HWIO_PMIC_ARB_OBS3_CHNL478_CMD_ADDR A:0xe63ef00
y.create.l HWIO_PMIC_ARB_OBS3_CHNL479_CMD_ADDR A:0xe63ef80
y.create.l HWIO_PMIC_ARB_OBS3_CHNL480_CMD_ADDR A:0xe63f000
y.create.l HWIO_PMIC_ARB_OBS3_CHNL481_CMD_ADDR A:0xe63f080
y.create.l HWIO_PMIC_ARB_OBS3_CHNL482_CMD_ADDR A:0xe63f100
y.create.l HWIO_PMIC_ARB_OBS3_CHNL483_CMD_ADDR A:0xe63f180
y.create.l HWIO_PMIC_ARB_OBS3_CHNL484_CMD_ADDR A:0xe63f200
y.create.l HWIO_PMIC_ARB_OBS3_CHNL485_CMD_ADDR A:0xe63f280
y.create.l HWIO_PMIC_ARB_OBS3_CHNL486_CMD_ADDR A:0xe63f300
y.create.l HWIO_PMIC_ARB_OBS3_CHNL487_CMD_ADDR A:0xe63f380
y.create.l HWIO_PMIC_ARB_OBS3_CHNL488_CMD_ADDR A:0xe63f400
y.create.l HWIO_PMIC_ARB_OBS3_CHNL489_CMD_ADDR A:0xe63f480
y.create.l HWIO_PMIC_ARB_OBS3_CHNL490_CMD_ADDR A:0xe63f500
y.create.l HWIO_PMIC_ARB_OBS3_CHNL491_CMD_ADDR A:0xe63f580
y.create.l HWIO_PMIC_ARB_OBS3_CHNL492_CMD_ADDR A:0xe63f600
y.create.l HWIO_PMIC_ARB_OBS3_CHNL493_CMD_ADDR A:0xe63f680
y.create.l HWIO_PMIC_ARB_OBS3_CHNL494_CMD_ADDR A:0xe63f700
y.create.l HWIO_PMIC_ARB_OBS3_CHNL495_CMD_ADDR A:0xe63f780
y.create.l HWIO_PMIC_ARB_OBS3_CHNL496_CMD_ADDR A:0xe63f800
y.create.l HWIO_PMIC_ARB_OBS3_CHNL497_CMD_ADDR A:0xe63f880
y.create.l HWIO_PMIC_ARB_OBS3_CHNL498_CMD_ADDR A:0xe63f900
y.create.l HWIO_PMIC_ARB_OBS3_CHNL499_CMD_ADDR A:0xe63f980
y.create.l HWIO_PMIC_ARB_OBS3_CHNL500_CMD_ADDR A:0xe63fa00
y.create.l HWIO_PMIC_ARB_OBS3_CHNL501_CMD_ADDR A:0xe63fa80
y.create.l HWIO_PMIC_ARB_OBS3_CHNL502_CMD_ADDR A:0xe63fb00
y.create.l HWIO_PMIC_ARB_OBS3_CHNL503_CMD_ADDR A:0xe63fb80
y.create.l HWIO_PMIC_ARB_OBS3_CHNL504_CMD_ADDR A:0xe63fc00
y.create.l HWIO_PMIC_ARB_OBS3_CHNL505_CMD_ADDR A:0xe63fc80
y.create.l HWIO_PMIC_ARB_OBS3_CHNL506_CMD_ADDR A:0xe63fd00
y.create.l HWIO_PMIC_ARB_OBS3_CHNL507_CMD_ADDR A:0xe63fd80
y.create.l HWIO_PMIC_ARB_OBS3_CHNL508_CMD_ADDR A:0xe63fe00
y.create.l HWIO_PMIC_ARB_OBS3_CHNL509_CMD_ADDR A:0xe63fe80
y.create.l HWIO_PMIC_ARB_OBS3_CHNL510_CMD_ADDR A:0xe63ff00
y.create.l HWIO_PMIC_ARB_OBS3_CHNL511_CMD_ADDR A:0xe63ff80
y.create.l HWIO_PMIC_ARB_OBS4_CHNL0_CMD_ADDR A:0xe640000
y.create.l HWIO_PMIC_ARB_OBS4_CHNL1_CMD_ADDR A:0xe640080
y.create.l HWIO_PMIC_ARB_OBS4_CHNL2_CMD_ADDR A:0xe640100
y.create.l HWIO_PMIC_ARB_OBS4_CHNL3_CMD_ADDR A:0xe640180
y.create.l HWIO_PMIC_ARB_OBS4_CHNL4_CMD_ADDR A:0xe640200
y.create.l HWIO_PMIC_ARB_OBS4_CHNL5_CMD_ADDR A:0xe640280
y.create.l HWIO_PMIC_ARB_OBS4_CHNL6_CMD_ADDR A:0xe640300
y.create.l HWIO_PMIC_ARB_OBS4_CHNL7_CMD_ADDR A:0xe640380
y.create.l HWIO_PMIC_ARB_OBS4_CHNL8_CMD_ADDR A:0xe640400
y.create.l HWIO_PMIC_ARB_OBS4_CHNL9_CMD_ADDR A:0xe640480
y.create.l HWIO_PMIC_ARB_OBS4_CHNL10_CMD_ADDR A:0xe640500
y.create.l HWIO_PMIC_ARB_OBS4_CHNL11_CMD_ADDR A:0xe640580
y.create.l HWIO_PMIC_ARB_OBS4_CHNL12_CMD_ADDR A:0xe640600
y.create.l HWIO_PMIC_ARB_OBS4_CHNL13_CMD_ADDR A:0xe640680
y.create.l HWIO_PMIC_ARB_OBS4_CHNL14_CMD_ADDR A:0xe640700
y.create.l HWIO_PMIC_ARB_OBS4_CHNL15_CMD_ADDR A:0xe640780
y.create.l HWIO_PMIC_ARB_OBS4_CHNL16_CMD_ADDR A:0xe640800
y.create.l HWIO_PMIC_ARB_OBS4_CHNL17_CMD_ADDR A:0xe640880
y.create.l HWIO_PMIC_ARB_OBS4_CHNL18_CMD_ADDR A:0xe640900
y.create.l HWIO_PMIC_ARB_OBS4_CHNL19_CMD_ADDR A:0xe640980
y.create.l HWIO_PMIC_ARB_OBS4_CHNL20_CMD_ADDR A:0xe640a00
y.create.l HWIO_PMIC_ARB_OBS4_CHNL21_CMD_ADDR A:0xe640a80
y.create.l HWIO_PMIC_ARB_OBS4_CHNL22_CMD_ADDR A:0xe640b00
y.create.l HWIO_PMIC_ARB_OBS4_CHNL23_CMD_ADDR A:0xe640b80
y.create.l HWIO_PMIC_ARB_OBS4_CHNL24_CMD_ADDR A:0xe640c00
y.create.l HWIO_PMIC_ARB_OBS4_CHNL25_CMD_ADDR A:0xe640c80
y.create.l HWIO_PMIC_ARB_OBS4_CHNL26_CMD_ADDR A:0xe640d00
y.create.l HWIO_PMIC_ARB_OBS4_CHNL27_CMD_ADDR A:0xe640d80
y.create.l HWIO_PMIC_ARB_OBS4_CHNL28_CMD_ADDR A:0xe640e00
y.create.l HWIO_PMIC_ARB_OBS4_CHNL29_CMD_ADDR A:0xe640e80
y.create.l HWIO_PMIC_ARB_OBS4_CHNL30_CMD_ADDR A:0xe640f00
y.create.l HWIO_PMIC_ARB_OBS4_CHNL31_CMD_ADDR A:0xe640f80
y.create.l HWIO_PMIC_ARB_OBS4_CHNL32_CMD_ADDR A:0xe641000
y.create.l HWIO_PMIC_ARB_OBS4_CHNL33_CMD_ADDR A:0xe641080
y.create.l HWIO_PMIC_ARB_OBS4_CHNL34_CMD_ADDR A:0xe641100
y.create.l HWIO_PMIC_ARB_OBS4_CHNL35_CMD_ADDR A:0xe641180
y.create.l HWIO_PMIC_ARB_OBS4_CHNL36_CMD_ADDR A:0xe641200
y.create.l HWIO_PMIC_ARB_OBS4_CHNL37_CMD_ADDR A:0xe641280
y.create.l HWIO_PMIC_ARB_OBS4_CHNL38_CMD_ADDR A:0xe641300
y.create.l HWIO_PMIC_ARB_OBS4_CHNL39_CMD_ADDR A:0xe641380
y.create.l HWIO_PMIC_ARB_OBS4_CHNL40_CMD_ADDR A:0xe641400
y.create.l HWIO_PMIC_ARB_OBS4_CHNL41_CMD_ADDR A:0xe641480
y.create.l HWIO_PMIC_ARB_OBS4_CHNL42_CMD_ADDR A:0xe641500
y.create.l HWIO_PMIC_ARB_OBS4_CHNL43_CMD_ADDR A:0xe641580
y.create.l HWIO_PMIC_ARB_OBS4_CHNL44_CMD_ADDR A:0xe641600
y.create.l HWIO_PMIC_ARB_OBS4_CHNL45_CMD_ADDR A:0xe641680
y.create.l HWIO_PMIC_ARB_OBS4_CHNL46_CMD_ADDR A:0xe641700
y.create.l HWIO_PMIC_ARB_OBS4_CHNL47_CMD_ADDR A:0xe641780
y.create.l HWIO_PMIC_ARB_OBS4_CHNL48_CMD_ADDR A:0xe641800
y.create.l HWIO_PMIC_ARB_OBS4_CHNL49_CMD_ADDR A:0xe641880
y.create.l HWIO_PMIC_ARB_OBS4_CHNL50_CMD_ADDR A:0xe641900
y.create.l HWIO_PMIC_ARB_OBS4_CHNL51_CMD_ADDR A:0xe641980
y.create.l HWIO_PMIC_ARB_OBS4_CHNL52_CMD_ADDR A:0xe641a00
y.create.l HWIO_PMIC_ARB_OBS4_CHNL53_CMD_ADDR A:0xe641a80
y.create.l HWIO_PMIC_ARB_OBS4_CHNL54_CMD_ADDR A:0xe641b00
y.create.l HWIO_PMIC_ARB_OBS4_CHNL55_CMD_ADDR A:0xe641b80
y.create.l HWIO_PMIC_ARB_OBS4_CHNL56_CMD_ADDR A:0xe641c00
y.create.l HWIO_PMIC_ARB_OBS4_CHNL57_CMD_ADDR A:0xe641c80
y.create.l HWIO_PMIC_ARB_OBS4_CHNL58_CMD_ADDR A:0xe641d00
y.create.l HWIO_PMIC_ARB_OBS4_CHNL59_CMD_ADDR A:0xe641d80
y.create.l HWIO_PMIC_ARB_OBS4_CHNL60_CMD_ADDR A:0xe641e00
y.create.l HWIO_PMIC_ARB_OBS4_CHNL61_CMD_ADDR A:0xe641e80
y.create.l HWIO_PMIC_ARB_OBS4_CHNL62_CMD_ADDR A:0xe641f00
y.create.l HWIO_PMIC_ARB_OBS4_CHNL63_CMD_ADDR A:0xe641f80
y.create.l HWIO_PMIC_ARB_OBS4_CHNL64_CMD_ADDR A:0xe642000
y.create.l HWIO_PMIC_ARB_OBS4_CHNL65_CMD_ADDR A:0xe642080
y.create.l HWIO_PMIC_ARB_OBS4_CHNL66_CMD_ADDR A:0xe642100
y.create.l HWIO_PMIC_ARB_OBS4_CHNL67_CMD_ADDR A:0xe642180
y.create.l HWIO_PMIC_ARB_OBS4_CHNL68_CMD_ADDR A:0xe642200
y.create.l HWIO_PMIC_ARB_OBS4_CHNL69_CMD_ADDR A:0xe642280
y.create.l HWIO_PMIC_ARB_OBS4_CHNL70_CMD_ADDR A:0xe642300
y.create.l HWIO_PMIC_ARB_OBS4_CHNL71_CMD_ADDR A:0xe642380
y.create.l HWIO_PMIC_ARB_OBS4_CHNL72_CMD_ADDR A:0xe642400
y.create.l HWIO_PMIC_ARB_OBS4_CHNL73_CMD_ADDR A:0xe642480
y.create.l HWIO_PMIC_ARB_OBS4_CHNL74_CMD_ADDR A:0xe642500
y.create.l HWIO_PMIC_ARB_OBS4_CHNL75_CMD_ADDR A:0xe642580
y.create.l HWIO_PMIC_ARB_OBS4_CHNL76_CMD_ADDR A:0xe642600
y.create.l HWIO_PMIC_ARB_OBS4_CHNL77_CMD_ADDR A:0xe642680
y.create.l HWIO_PMIC_ARB_OBS4_CHNL78_CMD_ADDR A:0xe642700
y.create.l HWIO_PMIC_ARB_OBS4_CHNL79_CMD_ADDR A:0xe642780
y.create.l HWIO_PMIC_ARB_OBS4_CHNL80_CMD_ADDR A:0xe642800
y.create.l HWIO_PMIC_ARB_OBS4_CHNL81_CMD_ADDR A:0xe642880
y.create.l HWIO_PMIC_ARB_OBS4_CHNL82_CMD_ADDR A:0xe642900
y.create.l HWIO_PMIC_ARB_OBS4_CHNL83_CMD_ADDR A:0xe642980
y.create.l HWIO_PMIC_ARB_OBS4_CHNL84_CMD_ADDR A:0xe642a00
y.create.l HWIO_PMIC_ARB_OBS4_CHNL85_CMD_ADDR A:0xe642a80
y.create.l HWIO_PMIC_ARB_OBS4_CHNL86_CMD_ADDR A:0xe642b00
y.create.l HWIO_PMIC_ARB_OBS4_CHNL87_CMD_ADDR A:0xe642b80
y.create.l HWIO_PMIC_ARB_OBS4_CHNL88_CMD_ADDR A:0xe642c00
y.create.l HWIO_PMIC_ARB_OBS4_CHNL89_CMD_ADDR A:0xe642c80
y.create.l HWIO_PMIC_ARB_OBS4_CHNL90_CMD_ADDR A:0xe642d00
y.create.l HWIO_PMIC_ARB_OBS4_CHNL91_CMD_ADDR A:0xe642d80
y.create.l HWIO_PMIC_ARB_OBS4_CHNL92_CMD_ADDR A:0xe642e00
y.create.l HWIO_PMIC_ARB_OBS4_CHNL93_CMD_ADDR A:0xe642e80
y.create.l HWIO_PMIC_ARB_OBS4_CHNL94_CMD_ADDR A:0xe642f00
y.create.l HWIO_PMIC_ARB_OBS4_CHNL95_CMD_ADDR A:0xe642f80
y.create.l HWIO_PMIC_ARB_OBS4_CHNL96_CMD_ADDR A:0xe643000
y.create.l HWIO_PMIC_ARB_OBS4_CHNL97_CMD_ADDR A:0xe643080
y.create.l HWIO_PMIC_ARB_OBS4_CHNL98_CMD_ADDR A:0xe643100
y.create.l HWIO_PMIC_ARB_OBS4_CHNL99_CMD_ADDR A:0xe643180
y.create.l HWIO_PMIC_ARB_OBS4_CHNL100_CMD_ADDR A:0xe643200
y.create.l HWIO_PMIC_ARB_OBS4_CHNL101_CMD_ADDR A:0xe643280
y.create.l HWIO_PMIC_ARB_OBS4_CHNL102_CMD_ADDR A:0xe643300
y.create.l HWIO_PMIC_ARB_OBS4_CHNL103_CMD_ADDR A:0xe643380
y.create.l HWIO_PMIC_ARB_OBS4_CHNL104_CMD_ADDR A:0xe643400
y.create.l HWIO_PMIC_ARB_OBS4_CHNL105_CMD_ADDR A:0xe643480
y.create.l HWIO_PMIC_ARB_OBS4_CHNL106_CMD_ADDR A:0xe643500
y.create.l HWIO_PMIC_ARB_OBS4_CHNL107_CMD_ADDR A:0xe643580
y.create.l HWIO_PMIC_ARB_OBS4_CHNL108_CMD_ADDR A:0xe643600
y.create.l HWIO_PMIC_ARB_OBS4_CHNL109_CMD_ADDR A:0xe643680
y.create.l HWIO_PMIC_ARB_OBS4_CHNL110_CMD_ADDR A:0xe643700
y.create.l HWIO_PMIC_ARB_OBS4_CHNL111_CMD_ADDR A:0xe643780
y.create.l HWIO_PMIC_ARB_OBS4_CHNL112_CMD_ADDR A:0xe643800
y.create.l HWIO_PMIC_ARB_OBS4_CHNL113_CMD_ADDR A:0xe643880
y.create.l HWIO_PMIC_ARB_OBS4_CHNL114_CMD_ADDR A:0xe643900
y.create.l HWIO_PMIC_ARB_OBS4_CHNL115_CMD_ADDR A:0xe643980
y.create.l HWIO_PMIC_ARB_OBS4_CHNL116_CMD_ADDR A:0xe643a00
y.create.l HWIO_PMIC_ARB_OBS4_CHNL117_CMD_ADDR A:0xe643a80
y.create.l HWIO_PMIC_ARB_OBS4_CHNL118_CMD_ADDR A:0xe643b00
y.create.l HWIO_PMIC_ARB_OBS4_CHNL119_CMD_ADDR A:0xe643b80
y.create.l HWIO_PMIC_ARB_OBS4_CHNL120_CMD_ADDR A:0xe643c00
y.create.l HWIO_PMIC_ARB_OBS4_CHNL121_CMD_ADDR A:0xe643c80
y.create.l HWIO_PMIC_ARB_OBS4_CHNL122_CMD_ADDR A:0xe643d00
y.create.l HWIO_PMIC_ARB_OBS4_CHNL123_CMD_ADDR A:0xe643d80
y.create.l HWIO_PMIC_ARB_OBS4_CHNL124_CMD_ADDR A:0xe643e00
y.create.l HWIO_PMIC_ARB_OBS4_CHNL125_CMD_ADDR A:0xe643e80
y.create.l HWIO_PMIC_ARB_OBS4_CHNL126_CMD_ADDR A:0xe643f00
y.create.l HWIO_PMIC_ARB_OBS4_CHNL127_CMD_ADDR A:0xe643f80
y.create.l HWIO_PMIC_ARB_OBS4_CHNL128_CMD_ADDR A:0xe644000
y.create.l HWIO_PMIC_ARB_OBS4_CHNL129_CMD_ADDR A:0xe644080
y.create.l HWIO_PMIC_ARB_OBS4_CHNL130_CMD_ADDR A:0xe644100
y.create.l HWIO_PMIC_ARB_OBS4_CHNL131_CMD_ADDR A:0xe644180
y.create.l HWIO_PMIC_ARB_OBS4_CHNL132_CMD_ADDR A:0xe644200
y.create.l HWIO_PMIC_ARB_OBS4_CHNL133_CMD_ADDR A:0xe644280
y.create.l HWIO_PMIC_ARB_OBS4_CHNL134_CMD_ADDR A:0xe644300
y.create.l HWIO_PMIC_ARB_OBS4_CHNL135_CMD_ADDR A:0xe644380
y.create.l HWIO_PMIC_ARB_OBS4_CHNL136_CMD_ADDR A:0xe644400
y.create.l HWIO_PMIC_ARB_OBS4_CHNL137_CMD_ADDR A:0xe644480
y.create.l HWIO_PMIC_ARB_OBS4_CHNL138_CMD_ADDR A:0xe644500
y.create.l HWIO_PMIC_ARB_OBS4_CHNL139_CMD_ADDR A:0xe644580
y.create.l HWIO_PMIC_ARB_OBS4_CHNL140_CMD_ADDR A:0xe644600
y.create.l HWIO_PMIC_ARB_OBS4_CHNL141_CMD_ADDR A:0xe644680
y.create.l HWIO_PMIC_ARB_OBS4_CHNL142_CMD_ADDR A:0xe644700
y.create.l HWIO_PMIC_ARB_OBS4_CHNL143_CMD_ADDR A:0xe644780
y.create.l HWIO_PMIC_ARB_OBS4_CHNL144_CMD_ADDR A:0xe644800
y.create.l HWIO_PMIC_ARB_OBS4_CHNL145_CMD_ADDR A:0xe644880
y.create.l HWIO_PMIC_ARB_OBS4_CHNL146_CMD_ADDR A:0xe644900
y.create.l HWIO_PMIC_ARB_OBS4_CHNL147_CMD_ADDR A:0xe644980
y.create.l HWIO_PMIC_ARB_OBS4_CHNL148_CMD_ADDR A:0xe644a00
y.create.l HWIO_PMIC_ARB_OBS4_CHNL149_CMD_ADDR A:0xe644a80
y.create.l HWIO_PMIC_ARB_OBS4_CHNL150_CMD_ADDR A:0xe644b00
y.create.l HWIO_PMIC_ARB_OBS4_CHNL151_CMD_ADDR A:0xe644b80
y.create.l HWIO_PMIC_ARB_OBS4_CHNL152_CMD_ADDR A:0xe644c00
y.create.l HWIO_PMIC_ARB_OBS4_CHNL153_CMD_ADDR A:0xe644c80
y.create.l HWIO_PMIC_ARB_OBS4_CHNL154_CMD_ADDR A:0xe644d00
y.create.l HWIO_PMIC_ARB_OBS4_CHNL155_CMD_ADDR A:0xe644d80
y.create.l HWIO_PMIC_ARB_OBS4_CHNL156_CMD_ADDR A:0xe644e00
y.create.l HWIO_PMIC_ARB_OBS4_CHNL157_CMD_ADDR A:0xe644e80
y.create.l HWIO_PMIC_ARB_OBS4_CHNL158_CMD_ADDR A:0xe644f00
y.create.l HWIO_PMIC_ARB_OBS4_CHNL159_CMD_ADDR A:0xe644f80
y.create.l HWIO_PMIC_ARB_OBS4_CHNL160_CMD_ADDR A:0xe645000
y.create.l HWIO_PMIC_ARB_OBS4_CHNL161_CMD_ADDR A:0xe645080
y.create.l HWIO_PMIC_ARB_OBS4_CHNL162_CMD_ADDR A:0xe645100
y.create.l HWIO_PMIC_ARB_OBS4_CHNL163_CMD_ADDR A:0xe645180
y.create.l HWIO_PMIC_ARB_OBS4_CHNL164_CMD_ADDR A:0xe645200
y.create.l HWIO_PMIC_ARB_OBS4_CHNL165_CMD_ADDR A:0xe645280
y.create.l HWIO_PMIC_ARB_OBS4_CHNL166_CMD_ADDR A:0xe645300
y.create.l HWIO_PMIC_ARB_OBS4_CHNL167_CMD_ADDR A:0xe645380
y.create.l HWIO_PMIC_ARB_OBS4_CHNL168_CMD_ADDR A:0xe645400
y.create.l HWIO_PMIC_ARB_OBS4_CHNL169_CMD_ADDR A:0xe645480
y.create.l HWIO_PMIC_ARB_OBS4_CHNL170_CMD_ADDR A:0xe645500
y.create.l HWIO_PMIC_ARB_OBS4_CHNL171_CMD_ADDR A:0xe645580
y.create.l HWIO_PMIC_ARB_OBS4_CHNL172_CMD_ADDR A:0xe645600
y.create.l HWIO_PMIC_ARB_OBS4_CHNL173_CMD_ADDR A:0xe645680
y.create.l HWIO_PMIC_ARB_OBS4_CHNL174_CMD_ADDR A:0xe645700
y.create.l HWIO_PMIC_ARB_OBS4_CHNL175_CMD_ADDR A:0xe645780
y.create.l HWIO_PMIC_ARB_OBS4_CHNL176_CMD_ADDR A:0xe645800
y.create.l HWIO_PMIC_ARB_OBS4_CHNL177_CMD_ADDR A:0xe645880
y.create.l HWIO_PMIC_ARB_OBS4_CHNL178_CMD_ADDR A:0xe645900
y.create.l HWIO_PMIC_ARB_OBS4_CHNL179_CMD_ADDR A:0xe645980
y.create.l HWIO_PMIC_ARB_OBS4_CHNL180_CMD_ADDR A:0xe645a00
y.create.l HWIO_PMIC_ARB_OBS4_CHNL181_CMD_ADDR A:0xe645a80
y.create.l HWIO_PMIC_ARB_OBS4_CHNL182_CMD_ADDR A:0xe645b00
y.create.l HWIO_PMIC_ARB_OBS4_CHNL183_CMD_ADDR A:0xe645b80
y.create.l HWIO_PMIC_ARB_OBS4_CHNL184_CMD_ADDR A:0xe645c00
y.create.l HWIO_PMIC_ARB_OBS4_CHNL185_CMD_ADDR A:0xe645c80
y.create.l HWIO_PMIC_ARB_OBS4_CHNL186_CMD_ADDR A:0xe645d00
y.create.l HWIO_PMIC_ARB_OBS4_CHNL187_CMD_ADDR A:0xe645d80
y.create.l HWIO_PMIC_ARB_OBS4_CHNL188_CMD_ADDR A:0xe645e00
y.create.l HWIO_PMIC_ARB_OBS4_CHNL189_CMD_ADDR A:0xe645e80
y.create.l HWIO_PMIC_ARB_OBS4_CHNL190_CMD_ADDR A:0xe645f00
y.create.l HWIO_PMIC_ARB_OBS4_CHNL191_CMD_ADDR A:0xe645f80
y.create.l HWIO_PMIC_ARB_OBS4_CHNL192_CMD_ADDR A:0xe646000
y.create.l HWIO_PMIC_ARB_OBS4_CHNL193_CMD_ADDR A:0xe646080
y.create.l HWIO_PMIC_ARB_OBS4_CHNL194_CMD_ADDR A:0xe646100
y.create.l HWIO_PMIC_ARB_OBS4_CHNL195_CMD_ADDR A:0xe646180
y.create.l HWIO_PMIC_ARB_OBS4_CHNL196_CMD_ADDR A:0xe646200
y.create.l HWIO_PMIC_ARB_OBS4_CHNL197_CMD_ADDR A:0xe646280
y.create.l HWIO_PMIC_ARB_OBS4_CHNL198_CMD_ADDR A:0xe646300
y.create.l HWIO_PMIC_ARB_OBS4_CHNL199_CMD_ADDR A:0xe646380
y.create.l HWIO_PMIC_ARB_OBS4_CHNL200_CMD_ADDR A:0xe646400
y.create.l HWIO_PMIC_ARB_OBS4_CHNL201_CMD_ADDR A:0xe646480
y.create.l HWIO_PMIC_ARB_OBS4_CHNL202_CMD_ADDR A:0xe646500
y.create.l HWIO_PMIC_ARB_OBS4_CHNL203_CMD_ADDR A:0xe646580
y.create.l HWIO_PMIC_ARB_OBS4_CHNL204_CMD_ADDR A:0xe646600
y.create.l HWIO_PMIC_ARB_OBS4_CHNL205_CMD_ADDR A:0xe646680
y.create.l HWIO_PMIC_ARB_OBS4_CHNL206_CMD_ADDR A:0xe646700
y.create.l HWIO_PMIC_ARB_OBS4_CHNL207_CMD_ADDR A:0xe646780
y.create.l HWIO_PMIC_ARB_OBS4_CHNL208_CMD_ADDR A:0xe646800
y.create.l HWIO_PMIC_ARB_OBS4_CHNL209_CMD_ADDR A:0xe646880
y.create.l HWIO_PMIC_ARB_OBS4_CHNL210_CMD_ADDR A:0xe646900
y.create.l HWIO_PMIC_ARB_OBS4_CHNL211_CMD_ADDR A:0xe646980
y.create.l HWIO_PMIC_ARB_OBS4_CHNL212_CMD_ADDR A:0xe646a00
y.create.l HWIO_PMIC_ARB_OBS4_CHNL213_CMD_ADDR A:0xe646a80
y.create.l HWIO_PMIC_ARB_OBS4_CHNL214_CMD_ADDR A:0xe646b00
y.create.l HWIO_PMIC_ARB_OBS4_CHNL215_CMD_ADDR A:0xe646b80
y.create.l HWIO_PMIC_ARB_OBS4_CHNL216_CMD_ADDR A:0xe646c00
y.create.l HWIO_PMIC_ARB_OBS4_CHNL217_CMD_ADDR A:0xe646c80
y.create.l HWIO_PMIC_ARB_OBS4_CHNL218_CMD_ADDR A:0xe646d00
y.create.l HWIO_PMIC_ARB_OBS4_CHNL219_CMD_ADDR A:0xe646d80
y.create.l HWIO_PMIC_ARB_OBS4_CHNL220_CMD_ADDR A:0xe646e00
y.create.l HWIO_PMIC_ARB_OBS4_CHNL221_CMD_ADDR A:0xe646e80
y.create.l HWIO_PMIC_ARB_OBS4_CHNL222_CMD_ADDR A:0xe646f00
y.create.l HWIO_PMIC_ARB_OBS4_CHNL223_CMD_ADDR A:0xe646f80
y.create.l HWIO_PMIC_ARB_OBS4_CHNL224_CMD_ADDR A:0xe647000
y.create.l HWIO_PMIC_ARB_OBS4_CHNL225_CMD_ADDR A:0xe647080
y.create.l HWIO_PMIC_ARB_OBS4_CHNL226_CMD_ADDR A:0xe647100
y.create.l HWIO_PMIC_ARB_OBS4_CHNL227_CMD_ADDR A:0xe647180
y.create.l HWIO_PMIC_ARB_OBS4_CHNL228_CMD_ADDR A:0xe647200
y.create.l HWIO_PMIC_ARB_OBS4_CHNL229_CMD_ADDR A:0xe647280
y.create.l HWIO_PMIC_ARB_OBS4_CHNL230_CMD_ADDR A:0xe647300
y.create.l HWIO_PMIC_ARB_OBS4_CHNL231_CMD_ADDR A:0xe647380
y.create.l HWIO_PMIC_ARB_OBS4_CHNL232_CMD_ADDR A:0xe647400
y.create.l HWIO_PMIC_ARB_OBS4_CHNL233_CMD_ADDR A:0xe647480
y.create.l HWIO_PMIC_ARB_OBS4_CHNL234_CMD_ADDR A:0xe647500
y.create.l HWIO_PMIC_ARB_OBS4_CHNL235_CMD_ADDR A:0xe647580
y.create.l HWIO_PMIC_ARB_OBS4_CHNL236_CMD_ADDR A:0xe647600
y.create.l HWIO_PMIC_ARB_OBS4_CHNL237_CMD_ADDR A:0xe647680
y.create.l HWIO_PMIC_ARB_OBS4_CHNL238_CMD_ADDR A:0xe647700
y.create.l HWIO_PMIC_ARB_OBS4_CHNL239_CMD_ADDR A:0xe647780
y.create.l HWIO_PMIC_ARB_OBS4_CHNL240_CMD_ADDR A:0xe647800
y.create.l HWIO_PMIC_ARB_OBS4_CHNL241_CMD_ADDR A:0xe647880
y.create.l HWIO_PMIC_ARB_OBS4_CHNL242_CMD_ADDR A:0xe647900
y.create.l HWIO_PMIC_ARB_OBS4_CHNL243_CMD_ADDR A:0xe647980
y.create.l HWIO_PMIC_ARB_OBS4_CHNL244_CMD_ADDR A:0xe647a00
y.create.l HWIO_PMIC_ARB_OBS4_CHNL245_CMD_ADDR A:0xe647a80
y.create.l HWIO_PMIC_ARB_OBS4_CHNL246_CMD_ADDR A:0xe647b00
y.create.l HWIO_PMIC_ARB_OBS4_CHNL247_CMD_ADDR A:0xe647b80
y.create.l HWIO_PMIC_ARB_OBS4_CHNL248_CMD_ADDR A:0xe647c00
y.create.l HWIO_PMIC_ARB_OBS4_CHNL249_CMD_ADDR A:0xe647c80
y.create.l HWIO_PMIC_ARB_OBS4_CHNL250_CMD_ADDR A:0xe647d00
y.create.l HWIO_PMIC_ARB_OBS4_CHNL251_CMD_ADDR A:0xe647d80
y.create.l HWIO_PMIC_ARB_OBS4_CHNL252_CMD_ADDR A:0xe647e00
y.create.l HWIO_PMIC_ARB_OBS4_CHNL253_CMD_ADDR A:0xe647e80
y.create.l HWIO_PMIC_ARB_OBS4_CHNL254_CMD_ADDR A:0xe647f00
y.create.l HWIO_PMIC_ARB_OBS4_CHNL255_CMD_ADDR A:0xe647f80
y.create.l HWIO_PMIC_ARB_OBS4_CHNL256_CMD_ADDR A:0xe648000
y.create.l HWIO_PMIC_ARB_OBS4_CHNL257_CMD_ADDR A:0xe648080
y.create.l HWIO_PMIC_ARB_OBS4_CHNL258_CMD_ADDR A:0xe648100
y.create.l HWIO_PMIC_ARB_OBS4_CHNL259_CMD_ADDR A:0xe648180
y.create.l HWIO_PMIC_ARB_OBS4_CHNL260_CMD_ADDR A:0xe648200
y.create.l HWIO_PMIC_ARB_OBS4_CHNL261_CMD_ADDR A:0xe648280
y.create.l HWIO_PMIC_ARB_OBS4_CHNL262_CMD_ADDR A:0xe648300
y.create.l HWIO_PMIC_ARB_OBS4_CHNL263_CMD_ADDR A:0xe648380
y.create.l HWIO_PMIC_ARB_OBS4_CHNL264_CMD_ADDR A:0xe648400
y.create.l HWIO_PMIC_ARB_OBS4_CHNL265_CMD_ADDR A:0xe648480
y.create.l HWIO_PMIC_ARB_OBS4_CHNL266_CMD_ADDR A:0xe648500
y.create.l HWIO_PMIC_ARB_OBS4_CHNL267_CMD_ADDR A:0xe648580
y.create.l HWIO_PMIC_ARB_OBS4_CHNL268_CMD_ADDR A:0xe648600
y.create.l HWIO_PMIC_ARB_OBS4_CHNL269_CMD_ADDR A:0xe648680
y.create.l HWIO_PMIC_ARB_OBS4_CHNL270_CMD_ADDR A:0xe648700
y.create.l HWIO_PMIC_ARB_OBS4_CHNL271_CMD_ADDR A:0xe648780
y.create.l HWIO_PMIC_ARB_OBS4_CHNL272_CMD_ADDR A:0xe648800
y.create.l HWIO_PMIC_ARB_OBS4_CHNL273_CMD_ADDR A:0xe648880
y.create.l HWIO_PMIC_ARB_OBS4_CHNL274_CMD_ADDR A:0xe648900
y.create.l HWIO_PMIC_ARB_OBS4_CHNL275_CMD_ADDR A:0xe648980
y.create.l HWIO_PMIC_ARB_OBS4_CHNL276_CMD_ADDR A:0xe648a00
y.create.l HWIO_PMIC_ARB_OBS4_CHNL277_CMD_ADDR A:0xe648a80
y.create.l HWIO_PMIC_ARB_OBS4_CHNL278_CMD_ADDR A:0xe648b00
y.create.l HWIO_PMIC_ARB_OBS4_CHNL279_CMD_ADDR A:0xe648b80
y.create.l HWIO_PMIC_ARB_OBS4_CHNL280_CMD_ADDR A:0xe648c00
y.create.l HWIO_PMIC_ARB_OBS4_CHNL281_CMD_ADDR A:0xe648c80
y.create.l HWIO_PMIC_ARB_OBS4_CHNL282_CMD_ADDR A:0xe648d00
y.create.l HWIO_PMIC_ARB_OBS4_CHNL283_CMD_ADDR A:0xe648d80
y.create.l HWIO_PMIC_ARB_OBS4_CHNL284_CMD_ADDR A:0xe648e00
y.create.l HWIO_PMIC_ARB_OBS4_CHNL285_CMD_ADDR A:0xe648e80
y.create.l HWIO_PMIC_ARB_OBS4_CHNL286_CMD_ADDR A:0xe648f00
y.create.l HWIO_PMIC_ARB_OBS4_CHNL287_CMD_ADDR A:0xe648f80
y.create.l HWIO_PMIC_ARB_OBS4_CHNL288_CMD_ADDR A:0xe649000
y.create.l HWIO_PMIC_ARB_OBS4_CHNL289_CMD_ADDR A:0xe649080
y.create.l HWIO_PMIC_ARB_OBS4_CHNL290_CMD_ADDR A:0xe649100
y.create.l HWIO_PMIC_ARB_OBS4_CHNL291_CMD_ADDR A:0xe649180
y.create.l HWIO_PMIC_ARB_OBS4_CHNL292_CMD_ADDR A:0xe649200
y.create.l HWIO_PMIC_ARB_OBS4_CHNL293_CMD_ADDR A:0xe649280
y.create.l HWIO_PMIC_ARB_OBS4_CHNL294_CMD_ADDR A:0xe649300
y.create.l HWIO_PMIC_ARB_OBS4_CHNL295_CMD_ADDR A:0xe649380
y.create.l HWIO_PMIC_ARB_OBS4_CHNL296_CMD_ADDR A:0xe649400
y.create.l HWIO_PMIC_ARB_OBS4_CHNL297_CMD_ADDR A:0xe649480
y.create.l HWIO_PMIC_ARB_OBS4_CHNL298_CMD_ADDR A:0xe649500
y.create.l HWIO_PMIC_ARB_OBS4_CHNL299_CMD_ADDR A:0xe649580
y.create.l HWIO_PMIC_ARB_OBS4_CHNL300_CMD_ADDR A:0xe649600
y.create.l HWIO_PMIC_ARB_OBS4_CHNL301_CMD_ADDR A:0xe649680
y.create.l HWIO_PMIC_ARB_OBS4_CHNL302_CMD_ADDR A:0xe649700
y.create.l HWIO_PMIC_ARB_OBS4_CHNL303_CMD_ADDR A:0xe649780
y.create.l HWIO_PMIC_ARB_OBS4_CHNL304_CMD_ADDR A:0xe649800
y.create.l HWIO_PMIC_ARB_OBS4_CHNL305_CMD_ADDR A:0xe649880
y.create.l HWIO_PMIC_ARB_OBS4_CHNL306_CMD_ADDR A:0xe649900
y.create.l HWIO_PMIC_ARB_OBS4_CHNL307_CMD_ADDR A:0xe649980
y.create.l HWIO_PMIC_ARB_OBS4_CHNL308_CMD_ADDR A:0xe649a00
y.create.l HWIO_PMIC_ARB_OBS4_CHNL309_CMD_ADDR A:0xe649a80
y.create.l HWIO_PMIC_ARB_OBS4_CHNL310_CMD_ADDR A:0xe649b00
y.create.l HWIO_PMIC_ARB_OBS4_CHNL311_CMD_ADDR A:0xe649b80
y.create.l HWIO_PMIC_ARB_OBS4_CHNL312_CMD_ADDR A:0xe649c00
y.create.l HWIO_PMIC_ARB_OBS4_CHNL313_CMD_ADDR A:0xe649c80
y.create.l HWIO_PMIC_ARB_OBS4_CHNL314_CMD_ADDR A:0xe649d00
y.create.l HWIO_PMIC_ARB_OBS4_CHNL315_CMD_ADDR A:0xe649d80
y.create.l HWIO_PMIC_ARB_OBS4_CHNL316_CMD_ADDR A:0xe649e00
y.create.l HWIO_PMIC_ARB_OBS4_CHNL317_CMD_ADDR A:0xe649e80
y.create.l HWIO_PMIC_ARB_OBS4_CHNL318_CMD_ADDR A:0xe649f00
y.create.l HWIO_PMIC_ARB_OBS4_CHNL319_CMD_ADDR A:0xe649f80
y.create.l HWIO_PMIC_ARB_OBS4_CHNL320_CMD_ADDR A:0xe64a000
y.create.l HWIO_PMIC_ARB_OBS4_CHNL321_CMD_ADDR A:0xe64a080
y.create.l HWIO_PMIC_ARB_OBS4_CHNL322_CMD_ADDR A:0xe64a100
y.create.l HWIO_PMIC_ARB_OBS4_CHNL323_CMD_ADDR A:0xe64a180
y.create.l HWIO_PMIC_ARB_OBS4_CHNL324_CMD_ADDR A:0xe64a200
y.create.l HWIO_PMIC_ARB_OBS4_CHNL325_CMD_ADDR A:0xe64a280
y.create.l HWIO_PMIC_ARB_OBS4_CHNL326_CMD_ADDR A:0xe64a300
y.create.l HWIO_PMIC_ARB_OBS4_CHNL327_CMD_ADDR A:0xe64a380
y.create.l HWIO_PMIC_ARB_OBS4_CHNL328_CMD_ADDR A:0xe64a400
y.create.l HWIO_PMIC_ARB_OBS4_CHNL329_CMD_ADDR A:0xe64a480
y.create.l HWIO_PMIC_ARB_OBS4_CHNL330_CMD_ADDR A:0xe64a500
y.create.l HWIO_PMIC_ARB_OBS4_CHNL331_CMD_ADDR A:0xe64a580
y.create.l HWIO_PMIC_ARB_OBS4_CHNL332_CMD_ADDR A:0xe64a600
y.create.l HWIO_PMIC_ARB_OBS4_CHNL333_CMD_ADDR A:0xe64a680
y.create.l HWIO_PMIC_ARB_OBS4_CHNL334_CMD_ADDR A:0xe64a700
y.create.l HWIO_PMIC_ARB_OBS4_CHNL335_CMD_ADDR A:0xe64a780
y.create.l HWIO_PMIC_ARB_OBS4_CHNL336_CMD_ADDR A:0xe64a800
y.create.l HWIO_PMIC_ARB_OBS4_CHNL337_CMD_ADDR A:0xe64a880
y.create.l HWIO_PMIC_ARB_OBS4_CHNL338_CMD_ADDR A:0xe64a900
y.create.l HWIO_PMIC_ARB_OBS4_CHNL339_CMD_ADDR A:0xe64a980
y.create.l HWIO_PMIC_ARB_OBS4_CHNL340_CMD_ADDR A:0xe64aa00
y.create.l HWIO_PMIC_ARB_OBS4_CHNL341_CMD_ADDR A:0xe64aa80
y.create.l HWIO_PMIC_ARB_OBS4_CHNL342_CMD_ADDR A:0xe64ab00
y.create.l HWIO_PMIC_ARB_OBS4_CHNL343_CMD_ADDR A:0xe64ab80
y.create.l HWIO_PMIC_ARB_OBS4_CHNL344_CMD_ADDR A:0xe64ac00
y.create.l HWIO_PMIC_ARB_OBS4_CHNL345_CMD_ADDR A:0xe64ac80
y.create.l HWIO_PMIC_ARB_OBS4_CHNL346_CMD_ADDR A:0xe64ad00
y.create.l HWIO_PMIC_ARB_OBS4_CHNL347_CMD_ADDR A:0xe64ad80
y.create.l HWIO_PMIC_ARB_OBS4_CHNL348_CMD_ADDR A:0xe64ae00
y.create.l HWIO_PMIC_ARB_OBS4_CHNL349_CMD_ADDR A:0xe64ae80
y.create.l HWIO_PMIC_ARB_OBS4_CHNL350_CMD_ADDR A:0xe64af00
y.create.l HWIO_PMIC_ARB_OBS4_CHNL351_CMD_ADDR A:0xe64af80
y.create.l HWIO_PMIC_ARB_OBS4_CHNL352_CMD_ADDR A:0xe64b000
y.create.l HWIO_PMIC_ARB_OBS4_CHNL353_CMD_ADDR A:0xe64b080
y.create.l HWIO_PMIC_ARB_OBS4_CHNL354_CMD_ADDR A:0xe64b100
y.create.l HWIO_PMIC_ARB_OBS4_CHNL355_CMD_ADDR A:0xe64b180
y.create.l HWIO_PMIC_ARB_OBS4_CHNL356_CMD_ADDR A:0xe64b200
y.create.l HWIO_PMIC_ARB_OBS4_CHNL357_CMD_ADDR A:0xe64b280
y.create.l HWIO_PMIC_ARB_OBS4_CHNL358_CMD_ADDR A:0xe64b300
y.create.l HWIO_PMIC_ARB_OBS4_CHNL359_CMD_ADDR A:0xe64b380
y.create.l HWIO_PMIC_ARB_OBS4_CHNL360_CMD_ADDR A:0xe64b400
y.create.l HWIO_PMIC_ARB_OBS4_CHNL361_CMD_ADDR A:0xe64b480
y.create.l HWIO_PMIC_ARB_OBS4_CHNL362_CMD_ADDR A:0xe64b500
y.create.l HWIO_PMIC_ARB_OBS4_CHNL363_CMD_ADDR A:0xe64b580
y.create.l HWIO_PMIC_ARB_OBS4_CHNL364_CMD_ADDR A:0xe64b600
y.create.l HWIO_PMIC_ARB_OBS4_CHNL365_CMD_ADDR A:0xe64b680
y.create.l HWIO_PMIC_ARB_OBS4_CHNL366_CMD_ADDR A:0xe64b700
y.create.l HWIO_PMIC_ARB_OBS4_CHNL367_CMD_ADDR A:0xe64b780
y.create.l HWIO_PMIC_ARB_OBS4_CHNL368_CMD_ADDR A:0xe64b800
y.create.l HWIO_PMIC_ARB_OBS4_CHNL369_CMD_ADDR A:0xe64b880
y.create.l HWIO_PMIC_ARB_OBS4_CHNL370_CMD_ADDR A:0xe64b900
y.create.l HWIO_PMIC_ARB_OBS4_CHNL371_CMD_ADDR A:0xe64b980
y.create.l HWIO_PMIC_ARB_OBS4_CHNL372_CMD_ADDR A:0xe64ba00
y.create.l HWIO_PMIC_ARB_OBS4_CHNL373_CMD_ADDR A:0xe64ba80
y.create.l HWIO_PMIC_ARB_OBS4_CHNL374_CMD_ADDR A:0xe64bb00
y.create.l HWIO_PMIC_ARB_OBS4_CHNL375_CMD_ADDR A:0xe64bb80
y.create.l HWIO_PMIC_ARB_OBS4_CHNL376_CMD_ADDR A:0xe64bc00
y.create.l HWIO_PMIC_ARB_OBS4_CHNL377_CMD_ADDR A:0xe64bc80
y.create.l HWIO_PMIC_ARB_OBS4_CHNL378_CMD_ADDR A:0xe64bd00
y.create.l HWIO_PMIC_ARB_OBS4_CHNL379_CMD_ADDR A:0xe64bd80
y.create.l HWIO_PMIC_ARB_OBS4_CHNL380_CMD_ADDR A:0xe64be00
y.create.l HWIO_PMIC_ARB_OBS4_CHNL381_CMD_ADDR A:0xe64be80
y.create.l HWIO_PMIC_ARB_OBS4_CHNL382_CMD_ADDR A:0xe64bf00
y.create.l HWIO_PMIC_ARB_OBS4_CHNL383_CMD_ADDR A:0xe64bf80
y.create.l HWIO_PMIC_ARB_OBS4_CHNL384_CMD_ADDR A:0xe64c000
y.create.l HWIO_PMIC_ARB_OBS4_CHNL385_CMD_ADDR A:0xe64c080
y.create.l HWIO_PMIC_ARB_OBS4_CHNL386_CMD_ADDR A:0xe64c100
y.create.l HWIO_PMIC_ARB_OBS4_CHNL387_CMD_ADDR A:0xe64c180
y.create.l HWIO_PMIC_ARB_OBS4_CHNL388_CMD_ADDR A:0xe64c200
y.create.l HWIO_PMIC_ARB_OBS4_CHNL389_CMD_ADDR A:0xe64c280
y.create.l HWIO_PMIC_ARB_OBS4_CHNL390_CMD_ADDR A:0xe64c300
y.create.l HWIO_PMIC_ARB_OBS4_CHNL391_CMD_ADDR A:0xe64c380
y.create.l HWIO_PMIC_ARB_OBS4_CHNL392_CMD_ADDR A:0xe64c400
y.create.l HWIO_PMIC_ARB_OBS4_CHNL393_CMD_ADDR A:0xe64c480
y.create.l HWIO_PMIC_ARB_OBS4_CHNL394_CMD_ADDR A:0xe64c500
y.create.l HWIO_PMIC_ARB_OBS4_CHNL395_CMD_ADDR A:0xe64c580
y.create.l HWIO_PMIC_ARB_OBS4_CHNL396_CMD_ADDR A:0xe64c600
y.create.l HWIO_PMIC_ARB_OBS4_CHNL397_CMD_ADDR A:0xe64c680
y.create.l HWIO_PMIC_ARB_OBS4_CHNL398_CMD_ADDR A:0xe64c700
y.create.l HWIO_PMIC_ARB_OBS4_CHNL399_CMD_ADDR A:0xe64c780
y.create.l HWIO_PMIC_ARB_OBS4_CHNL400_CMD_ADDR A:0xe64c800
y.create.l HWIO_PMIC_ARB_OBS4_CHNL401_CMD_ADDR A:0xe64c880
y.create.l HWIO_PMIC_ARB_OBS4_CHNL402_CMD_ADDR A:0xe64c900
y.create.l HWIO_PMIC_ARB_OBS4_CHNL403_CMD_ADDR A:0xe64c980
y.create.l HWIO_PMIC_ARB_OBS4_CHNL404_CMD_ADDR A:0xe64ca00
y.create.l HWIO_PMIC_ARB_OBS4_CHNL405_CMD_ADDR A:0xe64ca80
y.create.l HWIO_PMIC_ARB_OBS4_CHNL406_CMD_ADDR A:0xe64cb00
y.create.l HWIO_PMIC_ARB_OBS4_CHNL407_CMD_ADDR A:0xe64cb80
y.create.l HWIO_PMIC_ARB_OBS4_CHNL408_CMD_ADDR A:0xe64cc00
y.create.l HWIO_PMIC_ARB_OBS4_CHNL409_CMD_ADDR A:0xe64cc80
y.create.l HWIO_PMIC_ARB_OBS4_CHNL410_CMD_ADDR A:0xe64cd00
y.create.l HWIO_PMIC_ARB_OBS4_CHNL411_CMD_ADDR A:0xe64cd80
y.create.l HWIO_PMIC_ARB_OBS4_CHNL412_CMD_ADDR A:0xe64ce00
y.create.l HWIO_PMIC_ARB_OBS4_CHNL413_CMD_ADDR A:0xe64ce80
y.create.l HWIO_PMIC_ARB_OBS4_CHNL414_CMD_ADDR A:0xe64cf00
y.create.l HWIO_PMIC_ARB_OBS4_CHNL415_CMD_ADDR A:0xe64cf80
y.create.l HWIO_PMIC_ARB_OBS4_CHNL416_CMD_ADDR A:0xe64d000
y.create.l HWIO_PMIC_ARB_OBS4_CHNL417_CMD_ADDR A:0xe64d080
y.create.l HWIO_PMIC_ARB_OBS4_CHNL418_CMD_ADDR A:0xe64d100
y.create.l HWIO_PMIC_ARB_OBS4_CHNL419_CMD_ADDR A:0xe64d180
y.create.l HWIO_PMIC_ARB_OBS4_CHNL420_CMD_ADDR A:0xe64d200
y.create.l HWIO_PMIC_ARB_OBS4_CHNL421_CMD_ADDR A:0xe64d280
y.create.l HWIO_PMIC_ARB_OBS4_CHNL422_CMD_ADDR A:0xe64d300
y.create.l HWIO_PMIC_ARB_OBS4_CHNL423_CMD_ADDR A:0xe64d380
y.create.l HWIO_PMIC_ARB_OBS4_CHNL424_CMD_ADDR A:0xe64d400
y.create.l HWIO_PMIC_ARB_OBS4_CHNL425_CMD_ADDR A:0xe64d480
y.create.l HWIO_PMIC_ARB_OBS4_CHNL426_CMD_ADDR A:0xe64d500
y.create.l HWIO_PMIC_ARB_OBS4_CHNL427_CMD_ADDR A:0xe64d580
y.create.l HWIO_PMIC_ARB_OBS4_CHNL428_CMD_ADDR A:0xe64d600
y.create.l HWIO_PMIC_ARB_OBS4_CHNL429_CMD_ADDR A:0xe64d680
y.create.l HWIO_PMIC_ARB_OBS4_CHNL430_CMD_ADDR A:0xe64d700
y.create.l HWIO_PMIC_ARB_OBS4_CHNL431_CMD_ADDR A:0xe64d780
y.create.l HWIO_PMIC_ARB_OBS4_CHNL432_CMD_ADDR A:0xe64d800
y.create.l HWIO_PMIC_ARB_OBS4_CHNL433_CMD_ADDR A:0xe64d880
y.create.l HWIO_PMIC_ARB_OBS4_CHNL434_CMD_ADDR A:0xe64d900
y.create.l HWIO_PMIC_ARB_OBS4_CHNL435_CMD_ADDR A:0xe64d980
y.create.l HWIO_PMIC_ARB_OBS4_CHNL436_CMD_ADDR A:0xe64da00
y.create.l HWIO_PMIC_ARB_OBS4_CHNL437_CMD_ADDR A:0xe64da80
y.create.l HWIO_PMIC_ARB_OBS4_CHNL438_CMD_ADDR A:0xe64db00
y.create.l HWIO_PMIC_ARB_OBS4_CHNL439_CMD_ADDR A:0xe64db80
y.create.l HWIO_PMIC_ARB_OBS4_CHNL440_CMD_ADDR A:0xe64dc00
y.create.l HWIO_PMIC_ARB_OBS4_CHNL441_CMD_ADDR A:0xe64dc80
y.create.l HWIO_PMIC_ARB_OBS4_CHNL442_CMD_ADDR A:0xe64dd00
y.create.l HWIO_PMIC_ARB_OBS4_CHNL443_CMD_ADDR A:0xe64dd80
y.create.l HWIO_PMIC_ARB_OBS4_CHNL444_CMD_ADDR A:0xe64de00
y.create.l HWIO_PMIC_ARB_OBS4_CHNL445_CMD_ADDR A:0xe64de80
y.create.l HWIO_PMIC_ARB_OBS4_CHNL446_CMD_ADDR A:0xe64df00
y.create.l HWIO_PMIC_ARB_OBS4_CHNL447_CMD_ADDR A:0xe64df80
y.create.l HWIO_PMIC_ARB_OBS4_CHNL448_CMD_ADDR A:0xe64e000
y.create.l HWIO_PMIC_ARB_OBS4_CHNL449_CMD_ADDR A:0xe64e080
y.create.l HWIO_PMIC_ARB_OBS4_CHNL450_CMD_ADDR A:0xe64e100
y.create.l HWIO_PMIC_ARB_OBS4_CHNL451_CMD_ADDR A:0xe64e180
y.create.l HWIO_PMIC_ARB_OBS4_CHNL452_CMD_ADDR A:0xe64e200
y.create.l HWIO_PMIC_ARB_OBS4_CHNL453_CMD_ADDR A:0xe64e280
y.create.l HWIO_PMIC_ARB_OBS4_CHNL454_CMD_ADDR A:0xe64e300
y.create.l HWIO_PMIC_ARB_OBS4_CHNL455_CMD_ADDR A:0xe64e380
y.create.l HWIO_PMIC_ARB_OBS4_CHNL456_CMD_ADDR A:0xe64e400
y.create.l HWIO_PMIC_ARB_OBS4_CHNL457_CMD_ADDR A:0xe64e480
y.create.l HWIO_PMIC_ARB_OBS4_CHNL458_CMD_ADDR A:0xe64e500
y.create.l HWIO_PMIC_ARB_OBS4_CHNL459_CMD_ADDR A:0xe64e580
y.create.l HWIO_PMIC_ARB_OBS4_CHNL460_CMD_ADDR A:0xe64e600
y.create.l HWIO_PMIC_ARB_OBS4_CHNL461_CMD_ADDR A:0xe64e680
y.create.l HWIO_PMIC_ARB_OBS4_CHNL462_CMD_ADDR A:0xe64e700
y.create.l HWIO_PMIC_ARB_OBS4_CHNL463_CMD_ADDR A:0xe64e780
y.create.l HWIO_PMIC_ARB_OBS4_CHNL464_CMD_ADDR A:0xe64e800
y.create.l HWIO_PMIC_ARB_OBS4_CHNL465_CMD_ADDR A:0xe64e880
y.create.l HWIO_PMIC_ARB_OBS4_CHNL466_CMD_ADDR A:0xe64e900
y.create.l HWIO_PMIC_ARB_OBS4_CHNL467_CMD_ADDR A:0xe64e980
y.create.l HWIO_PMIC_ARB_OBS4_CHNL468_CMD_ADDR A:0xe64ea00
y.create.l HWIO_PMIC_ARB_OBS4_CHNL469_CMD_ADDR A:0xe64ea80
y.create.l HWIO_PMIC_ARB_OBS4_CHNL470_CMD_ADDR A:0xe64eb00
y.create.l HWIO_PMIC_ARB_OBS4_CHNL471_CMD_ADDR A:0xe64eb80
y.create.l HWIO_PMIC_ARB_OBS4_CHNL472_CMD_ADDR A:0xe64ec00
y.create.l HWIO_PMIC_ARB_OBS4_CHNL473_CMD_ADDR A:0xe64ec80
y.create.l HWIO_PMIC_ARB_OBS4_CHNL474_CMD_ADDR A:0xe64ed00
y.create.l HWIO_PMIC_ARB_OBS4_CHNL475_CMD_ADDR A:0xe64ed80
y.create.l HWIO_PMIC_ARB_OBS4_CHNL476_CMD_ADDR A:0xe64ee00
y.create.l HWIO_PMIC_ARB_OBS4_CHNL477_CMD_ADDR A:0xe64ee80
y.create.l HWIO_PMIC_ARB_OBS4_CHNL478_CMD_ADDR A:0xe64ef00
y.create.l HWIO_PMIC_ARB_OBS4_CHNL479_CMD_ADDR A:0xe64ef80
y.create.l HWIO_PMIC_ARB_OBS4_CHNL480_CMD_ADDR A:0xe64f000
y.create.l HWIO_PMIC_ARB_OBS4_CHNL481_CMD_ADDR A:0xe64f080
y.create.l HWIO_PMIC_ARB_OBS4_CHNL482_CMD_ADDR A:0xe64f100
y.create.l HWIO_PMIC_ARB_OBS4_CHNL483_CMD_ADDR A:0xe64f180
y.create.l HWIO_PMIC_ARB_OBS4_CHNL484_CMD_ADDR A:0xe64f200
y.create.l HWIO_PMIC_ARB_OBS4_CHNL485_CMD_ADDR A:0xe64f280
y.create.l HWIO_PMIC_ARB_OBS4_CHNL486_CMD_ADDR A:0xe64f300
y.create.l HWIO_PMIC_ARB_OBS4_CHNL487_CMD_ADDR A:0xe64f380
y.create.l HWIO_PMIC_ARB_OBS4_CHNL488_CMD_ADDR A:0xe64f400
y.create.l HWIO_PMIC_ARB_OBS4_CHNL489_CMD_ADDR A:0xe64f480
y.create.l HWIO_PMIC_ARB_OBS4_CHNL490_CMD_ADDR A:0xe64f500
y.create.l HWIO_PMIC_ARB_OBS4_CHNL491_CMD_ADDR A:0xe64f580
y.create.l HWIO_PMIC_ARB_OBS4_CHNL492_CMD_ADDR A:0xe64f600
y.create.l HWIO_PMIC_ARB_OBS4_CHNL493_CMD_ADDR A:0xe64f680
y.create.l HWIO_PMIC_ARB_OBS4_CHNL494_CMD_ADDR A:0xe64f700
y.create.l HWIO_PMIC_ARB_OBS4_CHNL495_CMD_ADDR A:0xe64f780
y.create.l HWIO_PMIC_ARB_OBS4_CHNL496_CMD_ADDR A:0xe64f800
y.create.l HWIO_PMIC_ARB_OBS4_CHNL497_CMD_ADDR A:0xe64f880
y.create.l HWIO_PMIC_ARB_OBS4_CHNL498_CMD_ADDR A:0xe64f900
y.create.l HWIO_PMIC_ARB_OBS4_CHNL499_CMD_ADDR A:0xe64f980
y.create.l HWIO_PMIC_ARB_OBS4_CHNL500_CMD_ADDR A:0xe64fa00
y.create.l HWIO_PMIC_ARB_OBS4_CHNL501_CMD_ADDR A:0xe64fa80
y.create.l HWIO_PMIC_ARB_OBS4_CHNL502_CMD_ADDR A:0xe64fb00
y.create.l HWIO_PMIC_ARB_OBS4_CHNL503_CMD_ADDR A:0xe64fb80
y.create.l HWIO_PMIC_ARB_OBS4_CHNL504_CMD_ADDR A:0xe64fc00
y.create.l HWIO_PMIC_ARB_OBS4_CHNL505_CMD_ADDR A:0xe64fc80
y.create.l HWIO_PMIC_ARB_OBS4_CHNL506_CMD_ADDR A:0xe64fd00
y.create.l HWIO_PMIC_ARB_OBS4_CHNL507_CMD_ADDR A:0xe64fd80
y.create.l HWIO_PMIC_ARB_OBS4_CHNL508_CMD_ADDR A:0xe64fe00
y.create.l HWIO_PMIC_ARB_OBS4_CHNL509_CMD_ADDR A:0xe64fe80
y.create.l HWIO_PMIC_ARB_OBS4_CHNL510_CMD_ADDR A:0xe64ff00
y.create.l HWIO_PMIC_ARB_OBS4_CHNL511_CMD_ADDR A:0xe64ff80
y.create.l HWIO_PMIC_ARB_OBS5_CHNL0_CMD_ADDR A:0xe650000
y.create.l HWIO_PMIC_ARB_OBS5_CHNL1_CMD_ADDR A:0xe650080
y.create.l HWIO_PMIC_ARB_OBS5_CHNL2_CMD_ADDR A:0xe650100
y.create.l HWIO_PMIC_ARB_OBS5_CHNL3_CMD_ADDR A:0xe650180
y.create.l HWIO_PMIC_ARB_OBS5_CHNL4_CMD_ADDR A:0xe650200
y.create.l HWIO_PMIC_ARB_OBS5_CHNL5_CMD_ADDR A:0xe650280
y.create.l HWIO_PMIC_ARB_OBS5_CHNL6_CMD_ADDR A:0xe650300
y.create.l HWIO_PMIC_ARB_OBS5_CHNL7_CMD_ADDR A:0xe650380
y.create.l HWIO_PMIC_ARB_OBS5_CHNL8_CMD_ADDR A:0xe650400
y.create.l HWIO_PMIC_ARB_OBS5_CHNL9_CMD_ADDR A:0xe650480
y.create.l HWIO_PMIC_ARB_OBS5_CHNL10_CMD_ADDR A:0xe650500
y.create.l HWIO_PMIC_ARB_OBS5_CHNL11_CMD_ADDR A:0xe650580
y.create.l HWIO_PMIC_ARB_OBS5_CHNL12_CMD_ADDR A:0xe650600
y.create.l HWIO_PMIC_ARB_OBS5_CHNL13_CMD_ADDR A:0xe650680
y.create.l HWIO_PMIC_ARB_OBS5_CHNL14_CMD_ADDR A:0xe650700
y.create.l HWIO_PMIC_ARB_OBS5_CHNL15_CMD_ADDR A:0xe650780
y.create.l HWIO_PMIC_ARB_OBS5_CHNL16_CMD_ADDR A:0xe650800
y.create.l HWIO_PMIC_ARB_OBS5_CHNL17_CMD_ADDR A:0xe650880
y.create.l HWIO_PMIC_ARB_OBS5_CHNL18_CMD_ADDR A:0xe650900
y.create.l HWIO_PMIC_ARB_OBS5_CHNL19_CMD_ADDR A:0xe650980
y.create.l HWIO_PMIC_ARB_OBS5_CHNL20_CMD_ADDR A:0xe650a00
y.create.l HWIO_PMIC_ARB_OBS5_CHNL21_CMD_ADDR A:0xe650a80
y.create.l HWIO_PMIC_ARB_OBS5_CHNL22_CMD_ADDR A:0xe650b00
y.create.l HWIO_PMIC_ARB_OBS5_CHNL23_CMD_ADDR A:0xe650b80
y.create.l HWIO_PMIC_ARB_OBS5_CHNL24_CMD_ADDR A:0xe650c00
y.create.l HWIO_PMIC_ARB_OBS5_CHNL25_CMD_ADDR A:0xe650c80
y.create.l HWIO_PMIC_ARB_OBS5_CHNL26_CMD_ADDR A:0xe650d00
y.create.l HWIO_PMIC_ARB_OBS5_CHNL27_CMD_ADDR A:0xe650d80
y.create.l HWIO_PMIC_ARB_OBS5_CHNL28_CMD_ADDR A:0xe650e00
y.create.l HWIO_PMIC_ARB_OBS5_CHNL29_CMD_ADDR A:0xe650e80
y.create.l HWIO_PMIC_ARB_OBS5_CHNL30_CMD_ADDR A:0xe650f00
y.create.l HWIO_PMIC_ARB_OBS5_CHNL31_CMD_ADDR A:0xe650f80
y.create.l HWIO_PMIC_ARB_OBS5_CHNL32_CMD_ADDR A:0xe651000
y.create.l HWIO_PMIC_ARB_OBS5_CHNL33_CMD_ADDR A:0xe651080
y.create.l HWIO_PMIC_ARB_OBS5_CHNL34_CMD_ADDR A:0xe651100
y.create.l HWIO_PMIC_ARB_OBS5_CHNL35_CMD_ADDR A:0xe651180
y.create.l HWIO_PMIC_ARB_OBS5_CHNL36_CMD_ADDR A:0xe651200
y.create.l HWIO_PMIC_ARB_OBS5_CHNL37_CMD_ADDR A:0xe651280
y.create.l HWIO_PMIC_ARB_OBS5_CHNL38_CMD_ADDR A:0xe651300
y.create.l HWIO_PMIC_ARB_OBS5_CHNL39_CMD_ADDR A:0xe651380
y.create.l HWIO_PMIC_ARB_OBS5_CHNL40_CMD_ADDR A:0xe651400
y.create.l HWIO_PMIC_ARB_OBS5_CHNL41_CMD_ADDR A:0xe651480
y.create.l HWIO_PMIC_ARB_OBS5_CHNL42_CMD_ADDR A:0xe651500
y.create.l HWIO_PMIC_ARB_OBS5_CHNL43_CMD_ADDR A:0xe651580
y.create.l HWIO_PMIC_ARB_OBS5_CHNL44_CMD_ADDR A:0xe651600
y.create.l HWIO_PMIC_ARB_OBS5_CHNL45_CMD_ADDR A:0xe651680
y.create.l HWIO_PMIC_ARB_OBS5_CHNL46_CMD_ADDR A:0xe651700
y.create.l HWIO_PMIC_ARB_OBS5_CHNL47_CMD_ADDR A:0xe651780
y.create.l HWIO_PMIC_ARB_OBS5_CHNL48_CMD_ADDR A:0xe651800
y.create.l HWIO_PMIC_ARB_OBS5_CHNL49_CMD_ADDR A:0xe651880
y.create.l HWIO_PMIC_ARB_OBS5_CHNL50_CMD_ADDR A:0xe651900
y.create.l HWIO_PMIC_ARB_OBS5_CHNL51_CMD_ADDR A:0xe651980
y.create.l HWIO_PMIC_ARB_OBS5_CHNL52_CMD_ADDR A:0xe651a00
y.create.l HWIO_PMIC_ARB_OBS5_CHNL53_CMD_ADDR A:0xe651a80
y.create.l HWIO_PMIC_ARB_OBS5_CHNL54_CMD_ADDR A:0xe651b00
y.create.l HWIO_PMIC_ARB_OBS5_CHNL55_CMD_ADDR A:0xe651b80
y.create.l HWIO_PMIC_ARB_OBS5_CHNL56_CMD_ADDR A:0xe651c00
y.create.l HWIO_PMIC_ARB_OBS5_CHNL57_CMD_ADDR A:0xe651c80
y.create.l HWIO_PMIC_ARB_OBS5_CHNL58_CMD_ADDR A:0xe651d00
y.create.l HWIO_PMIC_ARB_OBS5_CHNL59_CMD_ADDR A:0xe651d80
y.create.l HWIO_PMIC_ARB_OBS5_CHNL60_CMD_ADDR A:0xe651e00
y.create.l HWIO_PMIC_ARB_OBS5_CHNL61_CMD_ADDR A:0xe651e80
y.create.l HWIO_PMIC_ARB_OBS5_CHNL62_CMD_ADDR A:0xe651f00
y.create.l HWIO_PMIC_ARB_OBS5_CHNL63_CMD_ADDR A:0xe651f80
y.create.l HWIO_PMIC_ARB_OBS5_CHNL64_CMD_ADDR A:0xe652000
y.create.l HWIO_PMIC_ARB_OBS5_CHNL65_CMD_ADDR A:0xe652080
y.create.l HWIO_PMIC_ARB_OBS5_CHNL66_CMD_ADDR A:0xe652100
y.create.l HWIO_PMIC_ARB_OBS5_CHNL67_CMD_ADDR A:0xe652180
y.create.l HWIO_PMIC_ARB_OBS5_CHNL68_CMD_ADDR A:0xe652200
y.create.l HWIO_PMIC_ARB_OBS5_CHNL69_CMD_ADDR A:0xe652280
y.create.l HWIO_PMIC_ARB_OBS5_CHNL70_CMD_ADDR A:0xe652300
y.create.l HWIO_PMIC_ARB_OBS5_CHNL71_CMD_ADDR A:0xe652380
y.create.l HWIO_PMIC_ARB_OBS5_CHNL72_CMD_ADDR A:0xe652400
y.create.l HWIO_PMIC_ARB_OBS5_CHNL73_CMD_ADDR A:0xe652480
y.create.l HWIO_PMIC_ARB_OBS5_CHNL74_CMD_ADDR A:0xe652500
y.create.l HWIO_PMIC_ARB_OBS5_CHNL75_CMD_ADDR A:0xe652580
y.create.l HWIO_PMIC_ARB_OBS5_CHNL76_CMD_ADDR A:0xe652600
y.create.l HWIO_PMIC_ARB_OBS5_CHNL77_CMD_ADDR A:0xe652680
y.create.l HWIO_PMIC_ARB_OBS5_CHNL78_CMD_ADDR A:0xe652700
y.create.l HWIO_PMIC_ARB_OBS5_CHNL79_CMD_ADDR A:0xe652780
y.create.l HWIO_PMIC_ARB_OBS5_CHNL80_CMD_ADDR A:0xe652800
y.create.l HWIO_PMIC_ARB_OBS5_CHNL81_CMD_ADDR A:0xe652880
y.create.l HWIO_PMIC_ARB_OBS5_CHNL82_CMD_ADDR A:0xe652900
y.create.l HWIO_PMIC_ARB_OBS5_CHNL83_CMD_ADDR A:0xe652980
y.create.l HWIO_PMIC_ARB_OBS5_CHNL84_CMD_ADDR A:0xe652a00
y.create.l HWIO_PMIC_ARB_OBS5_CHNL85_CMD_ADDR A:0xe652a80
y.create.l HWIO_PMIC_ARB_OBS5_CHNL86_CMD_ADDR A:0xe652b00
y.create.l HWIO_PMIC_ARB_OBS5_CHNL87_CMD_ADDR A:0xe652b80
y.create.l HWIO_PMIC_ARB_OBS5_CHNL88_CMD_ADDR A:0xe652c00
y.create.l HWIO_PMIC_ARB_OBS5_CHNL89_CMD_ADDR A:0xe652c80
y.create.l HWIO_PMIC_ARB_OBS5_CHNL90_CMD_ADDR A:0xe652d00
y.create.l HWIO_PMIC_ARB_OBS5_CHNL91_CMD_ADDR A:0xe652d80
y.create.l HWIO_PMIC_ARB_OBS5_CHNL92_CMD_ADDR A:0xe652e00
y.create.l HWIO_PMIC_ARB_OBS5_CHNL93_CMD_ADDR A:0xe652e80
y.create.l HWIO_PMIC_ARB_OBS5_CHNL94_CMD_ADDR A:0xe652f00
y.create.l HWIO_PMIC_ARB_OBS5_CHNL95_CMD_ADDR A:0xe652f80
y.create.l HWIO_PMIC_ARB_OBS5_CHNL96_CMD_ADDR A:0xe653000
y.create.l HWIO_PMIC_ARB_OBS5_CHNL97_CMD_ADDR A:0xe653080
y.create.l HWIO_PMIC_ARB_OBS5_CHNL98_CMD_ADDR A:0xe653100
y.create.l HWIO_PMIC_ARB_OBS5_CHNL99_CMD_ADDR A:0xe653180
y.create.l HWIO_PMIC_ARB_OBS5_CHNL100_CMD_ADDR A:0xe653200
y.create.l HWIO_PMIC_ARB_OBS5_CHNL101_CMD_ADDR A:0xe653280
y.create.l HWIO_PMIC_ARB_OBS5_CHNL102_CMD_ADDR A:0xe653300
y.create.l HWIO_PMIC_ARB_OBS5_CHNL103_CMD_ADDR A:0xe653380
y.create.l HWIO_PMIC_ARB_OBS5_CHNL104_CMD_ADDR A:0xe653400
y.create.l HWIO_PMIC_ARB_OBS5_CHNL105_CMD_ADDR A:0xe653480
y.create.l HWIO_PMIC_ARB_OBS5_CHNL106_CMD_ADDR A:0xe653500
y.create.l HWIO_PMIC_ARB_OBS5_CHNL107_CMD_ADDR A:0xe653580
y.create.l HWIO_PMIC_ARB_OBS5_CHNL108_CMD_ADDR A:0xe653600
y.create.l HWIO_PMIC_ARB_OBS5_CHNL109_CMD_ADDR A:0xe653680
y.create.l HWIO_PMIC_ARB_OBS5_CHNL110_CMD_ADDR A:0xe653700
y.create.l HWIO_PMIC_ARB_OBS5_CHNL111_CMD_ADDR A:0xe653780
y.create.l HWIO_PMIC_ARB_OBS5_CHNL112_CMD_ADDR A:0xe653800
y.create.l HWIO_PMIC_ARB_OBS5_CHNL113_CMD_ADDR A:0xe653880
y.create.l HWIO_PMIC_ARB_OBS5_CHNL114_CMD_ADDR A:0xe653900
y.create.l HWIO_PMIC_ARB_OBS5_CHNL115_CMD_ADDR A:0xe653980
y.create.l HWIO_PMIC_ARB_OBS5_CHNL116_CMD_ADDR A:0xe653a00
y.create.l HWIO_PMIC_ARB_OBS5_CHNL117_CMD_ADDR A:0xe653a80
y.create.l HWIO_PMIC_ARB_OBS5_CHNL118_CMD_ADDR A:0xe653b00
y.create.l HWIO_PMIC_ARB_OBS5_CHNL119_CMD_ADDR A:0xe653b80
y.create.l HWIO_PMIC_ARB_OBS5_CHNL120_CMD_ADDR A:0xe653c00
y.create.l HWIO_PMIC_ARB_OBS5_CHNL121_CMD_ADDR A:0xe653c80
y.create.l HWIO_PMIC_ARB_OBS5_CHNL122_CMD_ADDR A:0xe653d00
y.create.l HWIO_PMIC_ARB_OBS5_CHNL123_CMD_ADDR A:0xe653d80
y.create.l HWIO_PMIC_ARB_OBS5_CHNL124_CMD_ADDR A:0xe653e00
y.create.l HWIO_PMIC_ARB_OBS5_CHNL125_CMD_ADDR A:0xe653e80
y.create.l HWIO_PMIC_ARB_OBS5_CHNL126_CMD_ADDR A:0xe653f00
y.create.l HWIO_PMIC_ARB_OBS5_CHNL127_CMD_ADDR A:0xe653f80
y.create.l HWIO_PMIC_ARB_OBS5_CHNL128_CMD_ADDR A:0xe654000
y.create.l HWIO_PMIC_ARB_OBS5_CHNL129_CMD_ADDR A:0xe654080
y.create.l HWIO_PMIC_ARB_OBS5_CHNL130_CMD_ADDR A:0xe654100
y.create.l HWIO_PMIC_ARB_OBS5_CHNL131_CMD_ADDR A:0xe654180
y.create.l HWIO_PMIC_ARB_OBS5_CHNL132_CMD_ADDR A:0xe654200
y.create.l HWIO_PMIC_ARB_OBS5_CHNL133_CMD_ADDR A:0xe654280
y.create.l HWIO_PMIC_ARB_OBS5_CHNL134_CMD_ADDR A:0xe654300
y.create.l HWIO_PMIC_ARB_OBS5_CHNL135_CMD_ADDR A:0xe654380
y.create.l HWIO_PMIC_ARB_OBS5_CHNL136_CMD_ADDR A:0xe654400
y.create.l HWIO_PMIC_ARB_OBS5_CHNL137_CMD_ADDR A:0xe654480
y.create.l HWIO_PMIC_ARB_OBS5_CHNL138_CMD_ADDR A:0xe654500
y.create.l HWIO_PMIC_ARB_OBS5_CHNL139_CMD_ADDR A:0xe654580
y.create.l HWIO_PMIC_ARB_OBS5_CHNL140_CMD_ADDR A:0xe654600
y.create.l HWIO_PMIC_ARB_OBS5_CHNL141_CMD_ADDR A:0xe654680
y.create.l HWIO_PMIC_ARB_OBS5_CHNL142_CMD_ADDR A:0xe654700
y.create.l HWIO_PMIC_ARB_OBS5_CHNL143_CMD_ADDR A:0xe654780
y.create.l HWIO_PMIC_ARB_OBS5_CHNL144_CMD_ADDR A:0xe654800
y.create.l HWIO_PMIC_ARB_OBS5_CHNL145_CMD_ADDR A:0xe654880
y.create.l HWIO_PMIC_ARB_OBS5_CHNL146_CMD_ADDR A:0xe654900
y.create.l HWIO_PMIC_ARB_OBS5_CHNL147_CMD_ADDR A:0xe654980
y.create.l HWIO_PMIC_ARB_OBS5_CHNL148_CMD_ADDR A:0xe654a00
y.create.l HWIO_PMIC_ARB_OBS5_CHNL149_CMD_ADDR A:0xe654a80
y.create.l HWIO_PMIC_ARB_OBS5_CHNL150_CMD_ADDR A:0xe654b00
y.create.l HWIO_PMIC_ARB_OBS5_CHNL151_CMD_ADDR A:0xe654b80
y.create.l HWIO_PMIC_ARB_OBS5_CHNL152_CMD_ADDR A:0xe654c00
y.create.l HWIO_PMIC_ARB_OBS5_CHNL153_CMD_ADDR A:0xe654c80
y.create.l HWIO_PMIC_ARB_OBS5_CHNL154_CMD_ADDR A:0xe654d00
y.create.l HWIO_PMIC_ARB_OBS5_CHNL155_CMD_ADDR A:0xe654d80
y.create.l HWIO_PMIC_ARB_OBS5_CHNL156_CMD_ADDR A:0xe654e00
y.create.l HWIO_PMIC_ARB_OBS5_CHNL157_CMD_ADDR A:0xe654e80
y.create.l HWIO_PMIC_ARB_OBS5_CHNL158_CMD_ADDR A:0xe654f00
y.create.l HWIO_PMIC_ARB_OBS5_CHNL159_CMD_ADDR A:0xe654f80
y.create.l HWIO_PMIC_ARB_OBS5_CHNL160_CMD_ADDR A:0xe655000
y.create.l HWIO_PMIC_ARB_OBS5_CHNL161_CMD_ADDR A:0xe655080
y.create.l HWIO_PMIC_ARB_OBS5_CHNL162_CMD_ADDR A:0xe655100
y.create.l HWIO_PMIC_ARB_OBS5_CHNL163_CMD_ADDR A:0xe655180
y.create.l HWIO_PMIC_ARB_OBS5_CHNL164_CMD_ADDR A:0xe655200
y.create.l HWIO_PMIC_ARB_OBS5_CHNL165_CMD_ADDR A:0xe655280
y.create.l HWIO_PMIC_ARB_OBS5_CHNL166_CMD_ADDR A:0xe655300
y.create.l HWIO_PMIC_ARB_OBS5_CHNL167_CMD_ADDR A:0xe655380
y.create.l HWIO_PMIC_ARB_OBS5_CHNL168_CMD_ADDR A:0xe655400
y.create.l HWIO_PMIC_ARB_OBS5_CHNL169_CMD_ADDR A:0xe655480
y.create.l HWIO_PMIC_ARB_OBS5_CHNL170_CMD_ADDR A:0xe655500
y.create.l HWIO_PMIC_ARB_OBS5_CHNL171_CMD_ADDR A:0xe655580
y.create.l HWIO_PMIC_ARB_OBS5_CHNL172_CMD_ADDR A:0xe655600
y.create.l HWIO_PMIC_ARB_OBS5_CHNL173_CMD_ADDR A:0xe655680
y.create.l HWIO_PMIC_ARB_OBS5_CHNL174_CMD_ADDR A:0xe655700
y.create.l HWIO_PMIC_ARB_OBS5_CHNL175_CMD_ADDR A:0xe655780
y.create.l HWIO_PMIC_ARB_OBS5_CHNL176_CMD_ADDR A:0xe655800
y.create.l HWIO_PMIC_ARB_OBS5_CHNL177_CMD_ADDR A:0xe655880
y.create.l HWIO_PMIC_ARB_OBS5_CHNL178_CMD_ADDR A:0xe655900
y.create.l HWIO_PMIC_ARB_OBS5_CHNL179_CMD_ADDR A:0xe655980
y.create.l HWIO_PMIC_ARB_OBS5_CHNL180_CMD_ADDR A:0xe655a00
y.create.l HWIO_PMIC_ARB_OBS5_CHNL181_CMD_ADDR A:0xe655a80
y.create.l HWIO_PMIC_ARB_OBS5_CHNL182_CMD_ADDR A:0xe655b00
y.create.l HWIO_PMIC_ARB_OBS5_CHNL183_CMD_ADDR A:0xe655b80
y.create.l HWIO_PMIC_ARB_OBS5_CHNL184_CMD_ADDR A:0xe655c00
y.create.l HWIO_PMIC_ARB_OBS5_CHNL185_CMD_ADDR A:0xe655c80
y.create.l HWIO_PMIC_ARB_OBS5_CHNL186_CMD_ADDR A:0xe655d00
y.create.l HWIO_PMIC_ARB_OBS5_CHNL187_CMD_ADDR A:0xe655d80
y.create.l HWIO_PMIC_ARB_OBS5_CHNL188_CMD_ADDR A:0xe655e00
y.create.l HWIO_PMIC_ARB_OBS5_CHNL189_CMD_ADDR A:0xe655e80
y.create.l HWIO_PMIC_ARB_OBS5_CHNL190_CMD_ADDR A:0xe655f00
y.create.l HWIO_PMIC_ARB_OBS5_CHNL191_CMD_ADDR A:0xe655f80
y.create.l HWIO_PMIC_ARB_OBS5_CHNL192_CMD_ADDR A:0xe656000
y.create.l HWIO_PMIC_ARB_OBS5_CHNL193_CMD_ADDR A:0xe656080
y.create.l HWIO_PMIC_ARB_OBS5_CHNL194_CMD_ADDR A:0xe656100
y.create.l HWIO_PMIC_ARB_OBS5_CHNL195_CMD_ADDR A:0xe656180
y.create.l HWIO_PMIC_ARB_OBS5_CHNL196_CMD_ADDR A:0xe656200
y.create.l HWIO_PMIC_ARB_OBS5_CHNL197_CMD_ADDR A:0xe656280
y.create.l HWIO_PMIC_ARB_OBS5_CHNL198_CMD_ADDR A:0xe656300
y.create.l HWIO_PMIC_ARB_OBS5_CHNL199_CMD_ADDR A:0xe656380
y.create.l HWIO_PMIC_ARB_OBS5_CHNL200_CMD_ADDR A:0xe656400
y.create.l HWIO_PMIC_ARB_OBS5_CHNL201_CMD_ADDR A:0xe656480
y.create.l HWIO_PMIC_ARB_OBS5_CHNL202_CMD_ADDR A:0xe656500
y.create.l HWIO_PMIC_ARB_OBS5_CHNL203_CMD_ADDR A:0xe656580
y.create.l HWIO_PMIC_ARB_OBS5_CHNL204_CMD_ADDR A:0xe656600
y.create.l HWIO_PMIC_ARB_OBS5_CHNL205_CMD_ADDR A:0xe656680
y.create.l HWIO_PMIC_ARB_OBS5_CHNL206_CMD_ADDR A:0xe656700
y.create.l HWIO_PMIC_ARB_OBS5_CHNL207_CMD_ADDR A:0xe656780
y.create.l HWIO_PMIC_ARB_OBS5_CHNL208_CMD_ADDR A:0xe656800
y.create.l HWIO_PMIC_ARB_OBS5_CHNL209_CMD_ADDR A:0xe656880
y.create.l HWIO_PMIC_ARB_OBS5_CHNL210_CMD_ADDR A:0xe656900
y.create.l HWIO_PMIC_ARB_OBS5_CHNL211_CMD_ADDR A:0xe656980
y.create.l HWIO_PMIC_ARB_OBS5_CHNL212_CMD_ADDR A:0xe656a00
y.create.l HWIO_PMIC_ARB_OBS5_CHNL213_CMD_ADDR A:0xe656a80
y.create.l HWIO_PMIC_ARB_OBS5_CHNL214_CMD_ADDR A:0xe656b00
y.create.l HWIO_PMIC_ARB_OBS5_CHNL215_CMD_ADDR A:0xe656b80
y.create.l HWIO_PMIC_ARB_OBS5_CHNL216_CMD_ADDR A:0xe656c00
y.create.l HWIO_PMIC_ARB_OBS5_CHNL217_CMD_ADDR A:0xe656c80
y.create.l HWIO_PMIC_ARB_OBS5_CHNL218_CMD_ADDR A:0xe656d00
y.create.l HWIO_PMIC_ARB_OBS5_CHNL219_CMD_ADDR A:0xe656d80
y.create.l HWIO_PMIC_ARB_OBS5_CHNL220_CMD_ADDR A:0xe656e00
y.create.l HWIO_PMIC_ARB_OBS5_CHNL221_CMD_ADDR A:0xe656e80
y.create.l HWIO_PMIC_ARB_OBS5_CHNL222_CMD_ADDR A:0xe656f00
y.create.l HWIO_PMIC_ARB_OBS5_CHNL223_CMD_ADDR A:0xe656f80
y.create.l HWIO_PMIC_ARB_OBS5_CHNL224_CMD_ADDR A:0xe657000
y.create.l HWIO_PMIC_ARB_OBS5_CHNL225_CMD_ADDR A:0xe657080
y.create.l HWIO_PMIC_ARB_OBS5_CHNL226_CMD_ADDR A:0xe657100
y.create.l HWIO_PMIC_ARB_OBS5_CHNL227_CMD_ADDR A:0xe657180
y.create.l HWIO_PMIC_ARB_OBS5_CHNL228_CMD_ADDR A:0xe657200
y.create.l HWIO_PMIC_ARB_OBS5_CHNL229_CMD_ADDR A:0xe657280
y.create.l HWIO_PMIC_ARB_OBS5_CHNL230_CMD_ADDR A:0xe657300
y.create.l HWIO_PMIC_ARB_OBS5_CHNL231_CMD_ADDR A:0xe657380
y.create.l HWIO_PMIC_ARB_OBS5_CHNL232_CMD_ADDR A:0xe657400
y.create.l HWIO_PMIC_ARB_OBS5_CHNL233_CMD_ADDR A:0xe657480
y.create.l HWIO_PMIC_ARB_OBS5_CHNL234_CMD_ADDR A:0xe657500
y.create.l HWIO_PMIC_ARB_OBS5_CHNL235_CMD_ADDR A:0xe657580
y.create.l HWIO_PMIC_ARB_OBS5_CHNL236_CMD_ADDR A:0xe657600
y.create.l HWIO_PMIC_ARB_OBS5_CHNL237_CMD_ADDR A:0xe657680
y.create.l HWIO_PMIC_ARB_OBS5_CHNL238_CMD_ADDR A:0xe657700
y.create.l HWIO_PMIC_ARB_OBS5_CHNL239_CMD_ADDR A:0xe657780
y.create.l HWIO_PMIC_ARB_OBS5_CHNL240_CMD_ADDR A:0xe657800
y.create.l HWIO_PMIC_ARB_OBS5_CHNL241_CMD_ADDR A:0xe657880
y.create.l HWIO_PMIC_ARB_OBS5_CHNL242_CMD_ADDR A:0xe657900
y.create.l HWIO_PMIC_ARB_OBS5_CHNL243_CMD_ADDR A:0xe657980
y.create.l HWIO_PMIC_ARB_OBS5_CHNL244_CMD_ADDR A:0xe657a00
y.create.l HWIO_PMIC_ARB_OBS5_CHNL245_CMD_ADDR A:0xe657a80
y.create.l HWIO_PMIC_ARB_OBS5_CHNL246_CMD_ADDR A:0xe657b00
y.create.l HWIO_PMIC_ARB_OBS5_CHNL247_CMD_ADDR A:0xe657b80
y.create.l HWIO_PMIC_ARB_OBS5_CHNL248_CMD_ADDR A:0xe657c00
y.create.l HWIO_PMIC_ARB_OBS5_CHNL249_CMD_ADDR A:0xe657c80
y.create.l HWIO_PMIC_ARB_OBS5_CHNL250_CMD_ADDR A:0xe657d00
y.create.l HWIO_PMIC_ARB_OBS5_CHNL251_CMD_ADDR A:0xe657d80
y.create.l HWIO_PMIC_ARB_OBS5_CHNL252_CMD_ADDR A:0xe657e00
y.create.l HWIO_PMIC_ARB_OBS5_CHNL253_CMD_ADDR A:0xe657e80
y.create.l HWIO_PMIC_ARB_OBS5_CHNL254_CMD_ADDR A:0xe657f00
y.create.l HWIO_PMIC_ARB_OBS5_CHNL255_CMD_ADDR A:0xe657f80
y.create.l HWIO_PMIC_ARB_OBS5_CHNL256_CMD_ADDR A:0xe658000
y.create.l HWIO_PMIC_ARB_OBS5_CHNL257_CMD_ADDR A:0xe658080
y.create.l HWIO_PMIC_ARB_OBS5_CHNL258_CMD_ADDR A:0xe658100
y.create.l HWIO_PMIC_ARB_OBS5_CHNL259_CMD_ADDR A:0xe658180
y.create.l HWIO_PMIC_ARB_OBS5_CHNL260_CMD_ADDR A:0xe658200
y.create.l HWIO_PMIC_ARB_OBS5_CHNL261_CMD_ADDR A:0xe658280
y.create.l HWIO_PMIC_ARB_OBS5_CHNL262_CMD_ADDR A:0xe658300
y.create.l HWIO_PMIC_ARB_OBS5_CHNL263_CMD_ADDR A:0xe658380
y.create.l HWIO_PMIC_ARB_OBS5_CHNL264_CMD_ADDR A:0xe658400
y.create.l HWIO_PMIC_ARB_OBS5_CHNL265_CMD_ADDR A:0xe658480
y.create.l HWIO_PMIC_ARB_OBS5_CHNL266_CMD_ADDR A:0xe658500
y.create.l HWIO_PMIC_ARB_OBS5_CHNL267_CMD_ADDR A:0xe658580
y.create.l HWIO_PMIC_ARB_OBS5_CHNL268_CMD_ADDR A:0xe658600
y.create.l HWIO_PMIC_ARB_OBS5_CHNL269_CMD_ADDR A:0xe658680
y.create.l HWIO_PMIC_ARB_OBS5_CHNL270_CMD_ADDR A:0xe658700
y.create.l HWIO_PMIC_ARB_OBS5_CHNL271_CMD_ADDR A:0xe658780
y.create.l HWIO_PMIC_ARB_OBS5_CHNL272_CMD_ADDR A:0xe658800
y.create.l HWIO_PMIC_ARB_OBS5_CHNL273_CMD_ADDR A:0xe658880
y.create.l HWIO_PMIC_ARB_OBS5_CHNL274_CMD_ADDR A:0xe658900
y.create.l HWIO_PMIC_ARB_OBS5_CHNL275_CMD_ADDR A:0xe658980
y.create.l HWIO_PMIC_ARB_OBS5_CHNL276_CMD_ADDR A:0xe658a00
y.create.l HWIO_PMIC_ARB_OBS5_CHNL277_CMD_ADDR A:0xe658a80
y.create.l HWIO_PMIC_ARB_OBS5_CHNL278_CMD_ADDR A:0xe658b00
y.create.l HWIO_PMIC_ARB_OBS5_CHNL279_CMD_ADDR A:0xe658b80
y.create.l HWIO_PMIC_ARB_OBS5_CHNL280_CMD_ADDR A:0xe658c00
y.create.l HWIO_PMIC_ARB_OBS5_CHNL281_CMD_ADDR A:0xe658c80
y.create.l HWIO_PMIC_ARB_OBS5_CHNL282_CMD_ADDR A:0xe658d00
y.create.l HWIO_PMIC_ARB_OBS5_CHNL283_CMD_ADDR A:0xe658d80
y.create.l HWIO_PMIC_ARB_OBS5_CHNL284_CMD_ADDR A:0xe658e00
y.create.l HWIO_PMIC_ARB_OBS5_CHNL285_CMD_ADDR A:0xe658e80
y.create.l HWIO_PMIC_ARB_OBS5_CHNL286_CMD_ADDR A:0xe658f00
y.create.l HWIO_PMIC_ARB_OBS5_CHNL287_CMD_ADDR A:0xe658f80
y.create.l HWIO_PMIC_ARB_OBS5_CHNL288_CMD_ADDR A:0xe659000
y.create.l HWIO_PMIC_ARB_OBS5_CHNL289_CMD_ADDR A:0xe659080
y.create.l HWIO_PMIC_ARB_OBS5_CHNL290_CMD_ADDR A:0xe659100
y.create.l HWIO_PMIC_ARB_OBS5_CHNL291_CMD_ADDR A:0xe659180
y.create.l HWIO_PMIC_ARB_OBS5_CHNL292_CMD_ADDR A:0xe659200
y.create.l HWIO_PMIC_ARB_OBS5_CHNL293_CMD_ADDR A:0xe659280
y.create.l HWIO_PMIC_ARB_OBS5_CHNL294_CMD_ADDR A:0xe659300
y.create.l HWIO_PMIC_ARB_OBS5_CHNL295_CMD_ADDR A:0xe659380
y.create.l HWIO_PMIC_ARB_OBS5_CHNL296_CMD_ADDR A:0xe659400
y.create.l HWIO_PMIC_ARB_OBS5_CHNL297_CMD_ADDR A:0xe659480
y.create.l HWIO_PMIC_ARB_OBS5_CHNL298_CMD_ADDR A:0xe659500
y.create.l HWIO_PMIC_ARB_OBS5_CHNL299_CMD_ADDR A:0xe659580
y.create.l HWIO_PMIC_ARB_OBS5_CHNL300_CMD_ADDR A:0xe659600
y.create.l HWIO_PMIC_ARB_OBS5_CHNL301_CMD_ADDR A:0xe659680
y.create.l HWIO_PMIC_ARB_OBS5_CHNL302_CMD_ADDR A:0xe659700
y.create.l HWIO_PMIC_ARB_OBS5_CHNL303_CMD_ADDR A:0xe659780
y.create.l HWIO_PMIC_ARB_OBS5_CHNL304_CMD_ADDR A:0xe659800
y.create.l HWIO_PMIC_ARB_OBS5_CHNL305_CMD_ADDR A:0xe659880
y.create.l HWIO_PMIC_ARB_OBS5_CHNL306_CMD_ADDR A:0xe659900
y.create.l HWIO_PMIC_ARB_OBS5_CHNL307_CMD_ADDR A:0xe659980
y.create.l HWIO_PMIC_ARB_OBS5_CHNL308_CMD_ADDR A:0xe659a00
y.create.l HWIO_PMIC_ARB_OBS5_CHNL309_CMD_ADDR A:0xe659a80
y.create.l HWIO_PMIC_ARB_OBS5_CHNL310_CMD_ADDR A:0xe659b00
y.create.l HWIO_PMIC_ARB_OBS5_CHNL311_CMD_ADDR A:0xe659b80
y.create.l HWIO_PMIC_ARB_OBS5_CHNL312_CMD_ADDR A:0xe659c00
y.create.l HWIO_PMIC_ARB_OBS5_CHNL313_CMD_ADDR A:0xe659c80
y.create.l HWIO_PMIC_ARB_OBS5_CHNL314_CMD_ADDR A:0xe659d00
y.create.l HWIO_PMIC_ARB_OBS5_CHNL315_CMD_ADDR A:0xe659d80
y.create.l HWIO_PMIC_ARB_OBS5_CHNL316_CMD_ADDR A:0xe659e00
y.create.l HWIO_PMIC_ARB_OBS5_CHNL317_CMD_ADDR A:0xe659e80
y.create.l HWIO_PMIC_ARB_OBS5_CHNL318_CMD_ADDR A:0xe659f00
y.create.l HWIO_PMIC_ARB_OBS5_CHNL319_CMD_ADDR A:0xe659f80
y.create.l HWIO_PMIC_ARB_OBS5_CHNL320_CMD_ADDR A:0xe65a000
y.create.l HWIO_PMIC_ARB_OBS5_CHNL321_CMD_ADDR A:0xe65a080
y.create.l HWIO_PMIC_ARB_OBS5_CHNL322_CMD_ADDR A:0xe65a100
y.create.l HWIO_PMIC_ARB_OBS5_CHNL323_CMD_ADDR A:0xe65a180
y.create.l HWIO_PMIC_ARB_OBS5_CHNL324_CMD_ADDR A:0xe65a200
y.create.l HWIO_PMIC_ARB_OBS5_CHNL325_CMD_ADDR A:0xe65a280
y.create.l HWIO_PMIC_ARB_OBS5_CHNL326_CMD_ADDR A:0xe65a300
y.create.l HWIO_PMIC_ARB_OBS5_CHNL327_CMD_ADDR A:0xe65a380
y.create.l HWIO_PMIC_ARB_OBS5_CHNL328_CMD_ADDR A:0xe65a400
y.create.l HWIO_PMIC_ARB_OBS5_CHNL329_CMD_ADDR A:0xe65a480
y.create.l HWIO_PMIC_ARB_OBS5_CHNL330_CMD_ADDR A:0xe65a500
y.create.l HWIO_PMIC_ARB_OBS5_CHNL331_CMD_ADDR A:0xe65a580
y.create.l HWIO_PMIC_ARB_OBS5_CHNL332_CMD_ADDR A:0xe65a600
y.create.l HWIO_PMIC_ARB_OBS5_CHNL333_CMD_ADDR A:0xe65a680
y.create.l HWIO_PMIC_ARB_OBS5_CHNL334_CMD_ADDR A:0xe65a700
y.create.l HWIO_PMIC_ARB_OBS5_CHNL335_CMD_ADDR A:0xe65a780
y.create.l HWIO_PMIC_ARB_OBS5_CHNL336_CMD_ADDR A:0xe65a800
y.create.l HWIO_PMIC_ARB_OBS5_CHNL337_CMD_ADDR A:0xe65a880
y.create.l HWIO_PMIC_ARB_OBS5_CHNL338_CMD_ADDR A:0xe65a900
y.create.l HWIO_PMIC_ARB_OBS5_CHNL339_CMD_ADDR A:0xe65a980
y.create.l HWIO_PMIC_ARB_OBS5_CHNL340_CMD_ADDR A:0xe65aa00
y.create.l HWIO_PMIC_ARB_OBS5_CHNL341_CMD_ADDR A:0xe65aa80
y.create.l HWIO_PMIC_ARB_OBS5_CHNL342_CMD_ADDR A:0xe65ab00
y.create.l HWIO_PMIC_ARB_OBS5_CHNL343_CMD_ADDR A:0xe65ab80
y.create.l HWIO_PMIC_ARB_OBS5_CHNL344_CMD_ADDR A:0xe65ac00
y.create.l HWIO_PMIC_ARB_OBS5_CHNL345_CMD_ADDR A:0xe65ac80
y.create.l HWIO_PMIC_ARB_OBS5_CHNL346_CMD_ADDR A:0xe65ad00
y.create.l HWIO_PMIC_ARB_OBS5_CHNL347_CMD_ADDR A:0xe65ad80
y.create.l HWIO_PMIC_ARB_OBS5_CHNL348_CMD_ADDR A:0xe65ae00
y.create.l HWIO_PMIC_ARB_OBS5_CHNL349_CMD_ADDR A:0xe65ae80
y.create.l HWIO_PMIC_ARB_OBS5_CHNL350_CMD_ADDR A:0xe65af00
y.create.l HWIO_PMIC_ARB_OBS5_CHNL351_CMD_ADDR A:0xe65af80
y.create.l HWIO_PMIC_ARB_OBS5_CHNL352_CMD_ADDR A:0xe65b000
y.create.l HWIO_PMIC_ARB_OBS5_CHNL353_CMD_ADDR A:0xe65b080
y.create.l HWIO_PMIC_ARB_OBS5_CHNL354_CMD_ADDR A:0xe65b100
y.create.l HWIO_PMIC_ARB_OBS5_CHNL355_CMD_ADDR A:0xe65b180
y.create.l HWIO_PMIC_ARB_OBS5_CHNL356_CMD_ADDR A:0xe65b200
y.create.l HWIO_PMIC_ARB_OBS5_CHNL357_CMD_ADDR A:0xe65b280
y.create.l HWIO_PMIC_ARB_OBS5_CHNL358_CMD_ADDR A:0xe65b300
y.create.l HWIO_PMIC_ARB_OBS5_CHNL359_CMD_ADDR A:0xe65b380
y.create.l HWIO_PMIC_ARB_OBS5_CHNL360_CMD_ADDR A:0xe65b400
y.create.l HWIO_PMIC_ARB_OBS5_CHNL361_CMD_ADDR A:0xe65b480
y.create.l HWIO_PMIC_ARB_OBS5_CHNL362_CMD_ADDR A:0xe65b500
y.create.l HWIO_PMIC_ARB_OBS5_CHNL363_CMD_ADDR A:0xe65b580
y.create.l HWIO_PMIC_ARB_OBS5_CHNL364_CMD_ADDR A:0xe65b600
y.create.l HWIO_PMIC_ARB_OBS5_CHNL365_CMD_ADDR A:0xe65b680
y.create.l HWIO_PMIC_ARB_OBS5_CHNL366_CMD_ADDR A:0xe65b700
y.create.l HWIO_PMIC_ARB_OBS5_CHNL367_CMD_ADDR A:0xe65b780
y.create.l HWIO_PMIC_ARB_OBS5_CHNL368_CMD_ADDR A:0xe65b800
y.create.l HWIO_PMIC_ARB_OBS5_CHNL369_CMD_ADDR A:0xe65b880
y.create.l HWIO_PMIC_ARB_OBS5_CHNL370_CMD_ADDR A:0xe65b900
y.create.l HWIO_PMIC_ARB_OBS5_CHNL371_CMD_ADDR A:0xe65b980
y.create.l HWIO_PMIC_ARB_OBS5_CHNL372_CMD_ADDR A:0xe65ba00
y.create.l HWIO_PMIC_ARB_OBS5_CHNL373_CMD_ADDR A:0xe65ba80
y.create.l HWIO_PMIC_ARB_OBS5_CHNL374_CMD_ADDR A:0xe65bb00
y.create.l HWIO_PMIC_ARB_OBS5_CHNL375_CMD_ADDR A:0xe65bb80
y.create.l HWIO_PMIC_ARB_OBS5_CHNL376_CMD_ADDR A:0xe65bc00
y.create.l HWIO_PMIC_ARB_OBS5_CHNL377_CMD_ADDR A:0xe65bc80
y.create.l HWIO_PMIC_ARB_OBS5_CHNL378_CMD_ADDR A:0xe65bd00
y.create.l HWIO_PMIC_ARB_OBS5_CHNL379_CMD_ADDR A:0xe65bd80
y.create.l HWIO_PMIC_ARB_OBS5_CHNL380_CMD_ADDR A:0xe65be00
y.create.l HWIO_PMIC_ARB_OBS5_CHNL381_CMD_ADDR A:0xe65be80
y.create.l HWIO_PMIC_ARB_OBS5_CHNL382_CMD_ADDR A:0xe65bf00
y.create.l HWIO_PMIC_ARB_OBS5_CHNL383_CMD_ADDR A:0xe65bf80
y.create.l HWIO_PMIC_ARB_OBS5_CHNL384_CMD_ADDR A:0xe65c000
y.create.l HWIO_PMIC_ARB_OBS5_CHNL385_CMD_ADDR A:0xe65c080
y.create.l HWIO_PMIC_ARB_OBS5_CHNL386_CMD_ADDR A:0xe65c100
y.create.l HWIO_PMIC_ARB_OBS5_CHNL387_CMD_ADDR A:0xe65c180
y.create.l HWIO_PMIC_ARB_OBS5_CHNL388_CMD_ADDR A:0xe65c200
y.create.l HWIO_PMIC_ARB_OBS5_CHNL389_CMD_ADDR A:0xe65c280
y.create.l HWIO_PMIC_ARB_OBS5_CHNL390_CMD_ADDR A:0xe65c300
y.create.l HWIO_PMIC_ARB_OBS5_CHNL391_CMD_ADDR A:0xe65c380
y.create.l HWIO_PMIC_ARB_OBS5_CHNL392_CMD_ADDR A:0xe65c400
y.create.l HWIO_PMIC_ARB_OBS5_CHNL393_CMD_ADDR A:0xe65c480
y.create.l HWIO_PMIC_ARB_OBS5_CHNL394_CMD_ADDR A:0xe65c500
y.create.l HWIO_PMIC_ARB_OBS5_CHNL395_CMD_ADDR A:0xe65c580
y.create.l HWIO_PMIC_ARB_OBS5_CHNL396_CMD_ADDR A:0xe65c600
y.create.l HWIO_PMIC_ARB_OBS5_CHNL397_CMD_ADDR A:0xe65c680
y.create.l HWIO_PMIC_ARB_OBS5_CHNL398_CMD_ADDR A:0xe65c700
y.create.l HWIO_PMIC_ARB_OBS5_CHNL399_CMD_ADDR A:0xe65c780
y.create.l HWIO_PMIC_ARB_OBS5_CHNL400_CMD_ADDR A:0xe65c800
y.create.l HWIO_PMIC_ARB_OBS5_CHNL401_CMD_ADDR A:0xe65c880
y.create.l HWIO_PMIC_ARB_OBS5_CHNL402_CMD_ADDR A:0xe65c900
y.create.l HWIO_PMIC_ARB_OBS5_CHNL403_CMD_ADDR A:0xe65c980
y.create.l HWIO_PMIC_ARB_OBS5_CHNL404_CMD_ADDR A:0xe65ca00
y.create.l HWIO_PMIC_ARB_OBS5_CHNL405_CMD_ADDR A:0xe65ca80
y.create.l HWIO_PMIC_ARB_OBS5_CHNL406_CMD_ADDR A:0xe65cb00
y.create.l HWIO_PMIC_ARB_OBS5_CHNL407_CMD_ADDR A:0xe65cb80
y.create.l HWIO_PMIC_ARB_OBS5_CHNL408_CMD_ADDR A:0xe65cc00
y.create.l HWIO_PMIC_ARB_OBS5_CHNL409_CMD_ADDR A:0xe65cc80
y.create.l HWIO_PMIC_ARB_OBS5_CHNL410_CMD_ADDR A:0xe65cd00
y.create.l HWIO_PMIC_ARB_OBS5_CHNL411_CMD_ADDR A:0xe65cd80
y.create.l HWIO_PMIC_ARB_OBS5_CHNL412_CMD_ADDR A:0xe65ce00
y.create.l HWIO_PMIC_ARB_OBS5_CHNL413_CMD_ADDR A:0xe65ce80
y.create.l HWIO_PMIC_ARB_OBS5_CHNL414_CMD_ADDR A:0xe65cf00
y.create.l HWIO_PMIC_ARB_OBS5_CHNL415_CMD_ADDR A:0xe65cf80
y.create.l HWIO_PMIC_ARB_OBS5_CHNL416_CMD_ADDR A:0xe65d000
y.create.l HWIO_PMIC_ARB_OBS5_CHNL417_CMD_ADDR A:0xe65d080
y.create.l HWIO_PMIC_ARB_OBS5_CHNL418_CMD_ADDR A:0xe65d100
y.create.l HWIO_PMIC_ARB_OBS5_CHNL419_CMD_ADDR A:0xe65d180
y.create.l HWIO_PMIC_ARB_OBS5_CHNL420_CMD_ADDR A:0xe65d200
y.create.l HWIO_PMIC_ARB_OBS5_CHNL421_CMD_ADDR A:0xe65d280
y.create.l HWIO_PMIC_ARB_OBS5_CHNL422_CMD_ADDR A:0xe65d300
y.create.l HWIO_PMIC_ARB_OBS5_CHNL423_CMD_ADDR A:0xe65d380
y.create.l HWIO_PMIC_ARB_OBS5_CHNL424_CMD_ADDR A:0xe65d400
y.create.l HWIO_PMIC_ARB_OBS5_CHNL425_CMD_ADDR A:0xe65d480
y.create.l HWIO_PMIC_ARB_OBS5_CHNL426_CMD_ADDR A:0xe65d500
y.create.l HWIO_PMIC_ARB_OBS5_CHNL427_CMD_ADDR A:0xe65d580
y.create.l HWIO_PMIC_ARB_OBS5_CHNL428_CMD_ADDR A:0xe65d600
y.create.l HWIO_PMIC_ARB_OBS5_CHNL429_CMD_ADDR A:0xe65d680
y.create.l HWIO_PMIC_ARB_OBS5_CHNL430_CMD_ADDR A:0xe65d700
y.create.l HWIO_PMIC_ARB_OBS5_CHNL431_CMD_ADDR A:0xe65d780
y.create.l HWIO_PMIC_ARB_OBS5_CHNL432_CMD_ADDR A:0xe65d800
y.create.l HWIO_PMIC_ARB_OBS5_CHNL433_CMD_ADDR A:0xe65d880
y.create.l HWIO_PMIC_ARB_OBS5_CHNL434_CMD_ADDR A:0xe65d900
y.create.l HWIO_PMIC_ARB_OBS5_CHNL435_CMD_ADDR A:0xe65d980
y.create.l HWIO_PMIC_ARB_OBS5_CHNL436_CMD_ADDR A:0xe65da00
y.create.l HWIO_PMIC_ARB_OBS5_CHNL437_CMD_ADDR A:0xe65da80
y.create.l HWIO_PMIC_ARB_OBS5_CHNL438_CMD_ADDR A:0xe65db00
y.create.l HWIO_PMIC_ARB_OBS5_CHNL439_CMD_ADDR A:0xe65db80
y.create.l HWIO_PMIC_ARB_OBS5_CHNL440_CMD_ADDR A:0xe65dc00
y.create.l HWIO_PMIC_ARB_OBS5_CHNL441_CMD_ADDR A:0xe65dc80
y.create.l HWIO_PMIC_ARB_OBS5_CHNL442_CMD_ADDR A:0xe65dd00
y.create.l HWIO_PMIC_ARB_OBS5_CHNL443_CMD_ADDR A:0xe65dd80
y.create.l HWIO_PMIC_ARB_OBS5_CHNL444_CMD_ADDR A:0xe65de00
y.create.l HWIO_PMIC_ARB_OBS5_CHNL445_CMD_ADDR A:0xe65de80
y.create.l HWIO_PMIC_ARB_OBS5_CHNL446_CMD_ADDR A:0xe65df00
y.create.l HWIO_PMIC_ARB_OBS5_CHNL447_CMD_ADDR A:0xe65df80
y.create.l HWIO_PMIC_ARB_OBS5_CHNL448_CMD_ADDR A:0xe65e000
y.create.l HWIO_PMIC_ARB_OBS5_CHNL449_CMD_ADDR A:0xe65e080
y.create.l HWIO_PMIC_ARB_OBS5_CHNL450_CMD_ADDR A:0xe65e100
y.create.l HWIO_PMIC_ARB_OBS5_CHNL451_CMD_ADDR A:0xe65e180
y.create.l HWIO_PMIC_ARB_OBS5_CHNL452_CMD_ADDR A:0xe65e200
y.create.l HWIO_PMIC_ARB_OBS5_CHNL453_CMD_ADDR A:0xe65e280
y.create.l HWIO_PMIC_ARB_OBS5_CHNL454_CMD_ADDR A:0xe65e300
y.create.l HWIO_PMIC_ARB_OBS5_CHNL455_CMD_ADDR A:0xe65e380
y.create.l HWIO_PMIC_ARB_OBS5_CHNL456_CMD_ADDR A:0xe65e400
y.create.l HWIO_PMIC_ARB_OBS5_CHNL457_CMD_ADDR A:0xe65e480
y.create.l HWIO_PMIC_ARB_OBS5_CHNL458_CMD_ADDR A:0xe65e500
y.create.l HWIO_PMIC_ARB_OBS5_CHNL459_CMD_ADDR A:0xe65e580
y.create.l HWIO_PMIC_ARB_OBS5_CHNL460_CMD_ADDR A:0xe65e600
y.create.l HWIO_PMIC_ARB_OBS5_CHNL461_CMD_ADDR A:0xe65e680
y.create.l HWIO_PMIC_ARB_OBS5_CHNL462_CMD_ADDR A:0xe65e700
y.create.l HWIO_PMIC_ARB_OBS5_CHNL463_CMD_ADDR A:0xe65e780
y.create.l HWIO_PMIC_ARB_OBS5_CHNL464_CMD_ADDR A:0xe65e800
y.create.l HWIO_PMIC_ARB_OBS5_CHNL465_CMD_ADDR A:0xe65e880
y.create.l HWIO_PMIC_ARB_OBS5_CHNL466_CMD_ADDR A:0xe65e900
y.create.l HWIO_PMIC_ARB_OBS5_CHNL467_CMD_ADDR A:0xe65e980
y.create.l HWIO_PMIC_ARB_OBS5_CHNL468_CMD_ADDR A:0xe65ea00
y.create.l HWIO_PMIC_ARB_OBS5_CHNL469_CMD_ADDR A:0xe65ea80
y.create.l HWIO_PMIC_ARB_OBS5_CHNL470_CMD_ADDR A:0xe65eb00
y.create.l HWIO_PMIC_ARB_OBS5_CHNL471_CMD_ADDR A:0xe65eb80
y.create.l HWIO_PMIC_ARB_OBS5_CHNL472_CMD_ADDR A:0xe65ec00
y.create.l HWIO_PMIC_ARB_OBS5_CHNL473_CMD_ADDR A:0xe65ec80
y.create.l HWIO_PMIC_ARB_OBS5_CHNL474_CMD_ADDR A:0xe65ed00
y.create.l HWIO_PMIC_ARB_OBS5_CHNL475_CMD_ADDR A:0xe65ed80
y.create.l HWIO_PMIC_ARB_OBS5_CHNL476_CMD_ADDR A:0xe65ee00
y.create.l HWIO_PMIC_ARB_OBS5_CHNL477_CMD_ADDR A:0xe65ee80
y.create.l HWIO_PMIC_ARB_OBS5_CHNL478_CMD_ADDR A:0xe65ef00
y.create.l HWIO_PMIC_ARB_OBS5_CHNL479_CMD_ADDR A:0xe65ef80
y.create.l HWIO_PMIC_ARB_OBS5_CHNL480_CMD_ADDR A:0xe65f000
y.create.l HWIO_PMIC_ARB_OBS5_CHNL481_CMD_ADDR A:0xe65f080
y.create.l HWIO_PMIC_ARB_OBS5_CHNL482_CMD_ADDR A:0xe65f100
y.create.l HWIO_PMIC_ARB_OBS5_CHNL483_CMD_ADDR A:0xe65f180
y.create.l HWIO_PMIC_ARB_OBS5_CHNL484_CMD_ADDR A:0xe65f200
y.create.l HWIO_PMIC_ARB_OBS5_CHNL485_CMD_ADDR A:0xe65f280
y.create.l HWIO_PMIC_ARB_OBS5_CHNL486_CMD_ADDR A:0xe65f300
y.create.l HWIO_PMIC_ARB_OBS5_CHNL487_CMD_ADDR A:0xe65f380
y.create.l HWIO_PMIC_ARB_OBS5_CHNL488_CMD_ADDR A:0xe65f400
y.create.l HWIO_PMIC_ARB_OBS5_CHNL489_CMD_ADDR A:0xe65f480
y.create.l HWIO_PMIC_ARB_OBS5_CHNL490_CMD_ADDR A:0xe65f500
y.create.l HWIO_PMIC_ARB_OBS5_CHNL491_CMD_ADDR A:0xe65f580
y.create.l HWIO_PMIC_ARB_OBS5_CHNL492_CMD_ADDR A:0xe65f600
y.create.l HWIO_PMIC_ARB_OBS5_CHNL493_CMD_ADDR A:0xe65f680
y.create.l HWIO_PMIC_ARB_OBS5_CHNL494_CMD_ADDR A:0xe65f700
y.create.l HWIO_PMIC_ARB_OBS5_CHNL495_CMD_ADDR A:0xe65f780
y.create.l HWIO_PMIC_ARB_OBS5_CHNL496_CMD_ADDR A:0xe65f800
y.create.l HWIO_PMIC_ARB_OBS5_CHNL497_CMD_ADDR A:0xe65f880
y.create.l HWIO_PMIC_ARB_OBS5_CHNL498_CMD_ADDR A:0xe65f900
y.create.l HWIO_PMIC_ARB_OBS5_CHNL499_CMD_ADDR A:0xe65f980
y.create.l HWIO_PMIC_ARB_OBS5_CHNL500_CMD_ADDR A:0xe65fa00
y.create.l HWIO_PMIC_ARB_OBS5_CHNL501_CMD_ADDR A:0xe65fa80
y.create.l HWIO_PMIC_ARB_OBS5_CHNL502_CMD_ADDR A:0xe65fb00
y.create.l HWIO_PMIC_ARB_OBS5_CHNL503_CMD_ADDR A:0xe65fb80
y.create.l HWIO_PMIC_ARB_OBS5_CHNL504_CMD_ADDR A:0xe65fc00
y.create.l HWIO_PMIC_ARB_OBS5_CHNL505_CMD_ADDR A:0xe65fc80
y.create.l HWIO_PMIC_ARB_OBS5_CHNL506_CMD_ADDR A:0xe65fd00
y.create.l HWIO_PMIC_ARB_OBS5_CHNL507_CMD_ADDR A:0xe65fd80
y.create.l HWIO_PMIC_ARB_OBS5_CHNL508_CMD_ADDR A:0xe65fe00
y.create.l HWIO_PMIC_ARB_OBS5_CHNL509_CMD_ADDR A:0xe65fe80
y.create.l HWIO_PMIC_ARB_OBS5_CHNL510_CMD_ADDR A:0xe65ff00
y.create.l HWIO_PMIC_ARB_OBS5_CHNL511_CMD_ADDR A:0xe65ff80
y.create.l HWIO_PMIC_ARB_OBS6_CHNL0_CMD_ADDR A:0xe660000
y.create.l HWIO_PMIC_ARB_OBS6_CHNL1_CMD_ADDR A:0xe660080
y.create.l HWIO_PMIC_ARB_OBS6_CHNL2_CMD_ADDR A:0xe660100
y.create.l HWIO_PMIC_ARB_OBS6_CHNL3_CMD_ADDR A:0xe660180
y.create.l HWIO_PMIC_ARB_OBS6_CHNL4_CMD_ADDR A:0xe660200
y.create.l HWIO_PMIC_ARB_OBS6_CHNL5_CMD_ADDR A:0xe660280
y.create.l HWIO_PMIC_ARB_OBS6_CHNL6_CMD_ADDR A:0xe660300
y.create.l HWIO_PMIC_ARB_OBS6_CHNL7_CMD_ADDR A:0xe660380
y.create.l HWIO_PMIC_ARB_OBS6_CHNL8_CMD_ADDR A:0xe660400
y.create.l HWIO_PMIC_ARB_OBS6_CHNL9_CMD_ADDR A:0xe660480
y.create.l HWIO_PMIC_ARB_OBS6_CHNL10_CMD_ADDR A:0xe660500
y.create.l HWIO_PMIC_ARB_OBS6_CHNL11_CMD_ADDR A:0xe660580
y.create.l HWIO_PMIC_ARB_OBS6_CHNL12_CMD_ADDR A:0xe660600
y.create.l HWIO_PMIC_ARB_OBS6_CHNL13_CMD_ADDR A:0xe660680
y.create.l HWIO_PMIC_ARB_OBS6_CHNL14_CMD_ADDR A:0xe660700
y.create.l HWIO_PMIC_ARB_OBS6_CHNL15_CMD_ADDR A:0xe660780
y.create.l HWIO_PMIC_ARB_OBS6_CHNL16_CMD_ADDR A:0xe660800
y.create.l HWIO_PMIC_ARB_OBS6_CHNL17_CMD_ADDR A:0xe660880
y.create.l HWIO_PMIC_ARB_OBS6_CHNL18_CMD_ADDR A:0xe660900
y.create.l HWIO_PMIC_ARB_OBS6_CHNL19_CMD_ADDR A:0xe660980
y.create.l HWIO_PMIC_ARB_OBS6_CHNL20_CMD_ADDR A:0xe660a00
y.create.l HWIO_PMIC_ARB_OBS6_CHNL21_CMD_ADDR A:0xe660a80
y.create.l HWIO_PMIC_ARB_OBS6_CHNL22_CMD_ADDR A:0xe660b00
y.create.l HWIO_PMIC_ARB_OBS6_CHNL23_CMD_ADDR A:0xe660b80
y.create.l HWIO_PMIC_ARB_OBS6_CHNL24_CMD_ADDR A:0xe660c00
y.create.l HWIO_PMIC_ARB_OBS6_CHNL25_CMD_ADDR A:0xe660c80
y.create.l HWIO_PMIC_ARB_OBS6_CHNL26_CMD_ADDR A:0xe660d00
y.create.l HWIO_PMIC_ARB_OBS6_CHNL27_CMD_ADDR A:0xe660d80
y.create.l HWIO_PMIC_ARB_OBS6_CHNL28_CMD_ADDR A:0xe660e00
y.create.l HWIO_PMIC_ARB_OBS6_CHNL29_CMD_ADDR A:0xe660e80
y.create.l HWIO_PMIC_ARB_OBS6_CHNL30_CMD_ADDR A:0xe660f00
y.create.l HWIO_PMIC_ARB_OBS6_CHNL31_CMD_ADDR A:0xe660f80
y.create.l HWIO_PMIC_ARB_OBS6_CHNL32_CMD_ADDR A:0xe661000
y.create.l HWIO_PMIC_ARB_OBS6_CHNL33_CMD_ADDR A:0xe661080
y.create.l HWIO_PMIC_ARB_OBS6_CHNL34_CMD_ADDR A:0xe661100
y.create.l HWIO_PMIC_ARB_OBS6_CHNL35_CMD_ADDR A:0xe661180
y.create.l HWIO_PMIC_ARB_OBS6_CHNL36_CMD_ADDR A:0xe661200
y.create.l HWIO_PMIC_ARB_OBS6_CHNL37_CMD_ADDR A:0xe661280
y.create.l HWIO_PMIC_ARB_OBS6_CHNL38_CMD_ADDR A:0xe661300
y.create.l HWIO_PMIC_ARB_OBS6_CHNL39_CMD_ADDR A:0xe661380
y.create.l HWIO_PMIC_ARB_OBS6_CHNL40_CMD_ADDR A:0xe661400
y.create.l HWIO_PMIC_ARB_OBS6_CHNL41_CMD_ADDR A:0xe661480
y.create.l HWIO_PMIC_ARB_OBS6_CHNL42_CMD_ADDR A:0xe661500
y.create.l HWIO_PMIC_ARB_OBS6_CHNL43_CMD_ADDR A:0xe661580
y.create.l HWIO_PMIC_ARB_OBS6_CHNL44_CMD_ADDR A:0xe661600
y.create.l HWIO_PMIC_ARB_OBS6_CHNL45_CMD_ADDR A:0xe661680
y.create.l HWIO_PMIC_ARB_OBS6_CHNL46_CMD_ADDR A:0xe661700
y.create.l HWIO_PMIC_ARB_OBS6_CHNL47_CMD_ADDR A:0xe661780
y.create.l HWIO_PMIC_ARB_OBS6_CHNL48_CMD_ADDR A:0xe661800
y.create.l HWIO_PMIC_ARB_OBS6_CHNL49_CMD_ADDR A:0xe661880
y.create.l HWIO_PMIC_ARB_OBS6_CHNL50_CMD_ADDR A:0xe661900
y.create.l HWIO_PMIC_ARB_OBS6_CHNL51_CMD_ADDR A:0xe661980
y.create.l HWIO_PMIC_ARB_OBS6_CHNL52_CMD_ADDR A:0xe661a00
y.create.l HWIO_PMIC_ARB_OBS6_CHNL53_CMD_ADDR A:0xe661a80
y.create.l HWIO_PMIC_ARB_OBS6_CHNL54_CMD_ADDR A:0xe661b00
y.create.l HWIO_PMIC_ARB_OBS6_CHNL55_CMD_ADDR A:0xe661b80
y.create.l HWIO_PMIC_ARB_OBS6_CHNL56_CMD_ADDR A:0xe661c00
y.create.l HWIO_PMIC_ARB_OBS6_CHNL57_CMD_ADDR A:0xe661c80
y.create.l HWIO_PMIC_ARB_OBS6_CHNL58_CMD_ADDR A:0xe661d00
y.create.l HWIO_PMIC_ARB_OBS6_CHNL59_CMD_ADDR A:0xe661d80
y.create.l HWIO_PMIC_ARB_OBS6_CHNL60_CMD_ADDR A:0xe661e00
y.create.l HWIO_PMIC_ARB_OBS6_CHNL61_CMD_ADDR A:0xe661e80
y.create.l HWIO_PMIC_ARB_OBS6_CHNL62_CMD_ADDR A:0xe661f00
y.create.l HWIO_PMIC_ARB_OBS6_CHNL63_CMD_ADDR A:0xe661f80
y.create.l HWIO_PMIC_ARB_OBS6_CHNL64_CMD_ADDR A:0xe662000
y.create.l HWIO_PMIC_ARB_OBS6_CHNL65_CMD_ADDR A:0xe662080
y.create.l HWIO_PMIC_ARB_OBS6_CHNL66_CMD_ADDR A:0xe662100
y.create.l HWIO_PMIC_ARB_OBS6_CHNL67_CMD_ADDR A:0xe662180
y.create.l HWIO_PMIC_ARB_OBS6_CHNL68_CMD_ADDR A:0xe662200
y.create.l HWIO_PMIC_ARB_OBS6_CHNL69_CMD_ADDR A:0xe662280
y.create.l HWIO_PMIC_ARB_OBS6_CHNL70_CMD_ADDR A:0xe662300
y.create.l HWIO_PMIC_ARB_OBS6_CHNL71_CMD_ADDR A:0xe662380
y.create.l HWIO_PMIC_ARB_OBS6_CHNL72_CMD_ADDR A:0xe662400
y.create.l HWIO_PMIC_ARB_OBS6_CHNL73_CMD_ADDR A:0xe662480
y.create.l HWIO_PMIC_ARB_OBS6_CHNL74_CMD_ADDR A:0xe662500
y.create.l HWIO_PMIC_ARB_OBS6_CHNL75_CMD_ADDR A:0xe662580
y.create.l HWIO_PMIC_ARB_OBS6_CHNL76_CMD_ADDR A:0xe662600
y.create.l HWIO_PMIC_ARB_OBS6_CHNL77_CMD_ADDR A:0xe662680
y.create.l HWIO_PMIC_ARB_OBS6_CHNL78_CMD_ADDR A:0xe662700
y.create.l HWIO_PMIC_ARB_OBS6_CHNL79_CMD_ADDR A:0xe662780
y.create.l HWIO_PMIC_ARB_OBS6_CHNL80_CMD_ADDR A:0xe662800
y.create.l HWIO_PMIC_ARB_OBS6_CHNL81_CMD_ADDR A:0xe662880
y.create.l HWIO_PMIC_ARB_OBS6_CHNL82_CMD_ADDR A:0xe662900
y.create.l HWIO_PMIC_ARB_OBS6_CHNL83_CMD_ADDR A:0xe662980
y.create.l HWIO_PMIC_ARB_OBS6_CHNL84_CMD_ADDR A:0xe662a00
y.create.l HWIO_PMIC_ARB_OBS6_CHNL85_CMD_ADDR A:0xe662a80
y.create.l HWIO_PMIC_ARB_OBS6_CHNL86_CMD_ADDR A:0xe662b00
y.create.l HWIO_PMIC_ARB_OBS6_CHNL87_CMD_ADDR A:0xe662b80
y.create.l HWIO_PMIC_ARB_OBS6_CHNL88_CMD_ADDR A:0xe662c00
y.create.l HWIO_PMIC_ARB_OBS6_CHNL89_CMD_ADDR A:0xe662c80
y.create.l HWIO_PMIC_ARB_OBS6_CHNL90_CMD_ADDR A:0xe662d00
y.create.l HWIO_PMIC_ARB_OBS6_CHNL91_CMD_ADDR A:0xe662d80
y.create.l HWIO_PMIC_ARB_OBS6_CHNL92_CMD_ADDR A:0xe662e00
y.create.l HWIO_PMIC_ARB_OBS6_CHNL93_CMD_ADDR A:0xe662e80
y.create.l HWIO_PMIC_ARB_OBS6_CHNL94_CMD_ADDR A:0xe662f00
y.create.l HWIO_PMIC_ARB_OBS6_CHNL95_CMD_ADDR A:0xe662f80
y.create.l HWIO_PMIC_ARB_OBS6_CHNL96_CMD_ADDR A:0xe663000
y.create.l HWIO_PMIC_ARB_OBS6_CHNL97_CMD_ADDR A:0xe663080
y.create.l HWIO_PMIC_ARB_OBS6_CHNL98_CMD_ADDR A:0xe663100
y.create.l HWIO_PMIC_ARB_OBS6_CHNL99_CMD_ADDR A:0xe663180
y.create.l HWIO_PMIC_ARB_OBS6_CHNL100_CMD_ADDR A:0xe663200
y.create.l HWIO_PMIC_ARB_OBS6_CHNL101_CMD_ADDR A:0xe663280
y.create.l HWIO_PMIC_ARB_OBS6_CHNL102_CMD_ADDR A:0xe663300
y.create.l HWIO_PMIC_ARB_OBS6_CHNL103_CMD_ADDR A:0xe663380
y.create.l HWIO_PMIC_ARB_OBS6_CHNL104_CMD_ADDR A:0xe663400
y.create.l HWIO_PMIC_ARB_OBS6_CHNL105_CMD_ADDR A:0xe663480
y.create.l HWIO_PMIC_ARB_OBS6_CHNL106_CMD_ADDR A:0xe663500
y.create.l HWIO_PMIC_ARB_OBS6_CHNL107_CMD_ADDR A:0xe663580
y.create.l HWIO_PMIC_ARB_OBS6_CHNL108_CMD_ADDR A:0xe663600
y.create.l HWIO_PMIC_ARB_OBS6_CHNL109_CMD_ADDR A:0xe663680
y.create.l HWIO_PMIC_ARB_OBS6_CHNL110_CMD_ADDR A:0xe663700
y.create.l HWIO_PMIC_ARB_OBS6_CHNL111_CMD_ADDR A:0xe663780
y.create.l HWIO_PMIC_ARB_OBS6_CHNL112_CMD_ADDR A:0xe663800
y.create.l HWIO_PMIC_ARB_OBS6_CHNL113_CMD_ADDR A:0xe663880
y.create.l HWIO_PMIC_ARB_OBS6_CHNL114_CMD_ADDR A:0xe663900
y.create.l HWIO_PMIC_ARB_OBS6_CHNL115_CMD_ADDR A:0xe663980
y.create.l HWIO_PMIC_ARB_OBS6_CHNL116_CMD_ADDR A:0xe663a00
y.create.l HWIO_PMIC_ARB_OBS6_CHNL117_CMD_ADDR A:0xe663a80
y.create.l HWIO_PMIC_ARB_OBS6_CHNL118_CMD_ADDR A:0xe663b00
y.create.l HWIO_PMIC_ARB_OBS6_CHNL119_CMD_ADDR A:0xe663b80
y.create.l HWIO_PMIC_ARB_OBS6_CHNL120_CMD_ADDR A:0xe663c00
y.create.l HWIO_PMIC_ARB_OBS6_CHNL121_CMD_ADDR A:0xe663c80
y.create.l HWIO_PMIC_ARB_OBS6_CHNL122_CMD_ADDR A:0xe663d00
y.create.l HWIO_PMIC_ARB_OBS6_CHNL123_CMD_ADDR A:0xe663d80
y.create.l HWIO_PMIC_ARB_OBS6_CHNL124_CMD_ADDR A:0xe663e00
y.create.l HWIO_PMIC_ARB_OBS6_CHNL125_CMD_ADDR A:0xe663e80
y.create.l HWIO_PMIC_ARB_OBS6_CHNL126_CMD_ADDR A:0xe663f00
y.create.l HWIO_PMIC_ARB_OBS6_CHNL127_CMD_ADDR A:0xe663f80
y.create.l HWIO_PMIC_ARB_OBS6_CHNL128_CMD_ADDR A:0xe664000
y.create.l HWIO_PMIC_ARB_OBS6_CHNL129_CMD_ADDR A:0xe664080
y.create.l HWIO_PMIC_ARB_OBS6_CHNL130_CMD_ADDR A:0xe664100
y.create.l HWIO_PMIC_ARB_OBS6_CHNL131_CMD_ADDR A:0xe664180
y.create.l HWIO_PMIC_ARB_OBS6_CHNL132_CMD_ADDR A:0xe664200
y.create.l HWIO_PMIC_ARB_OBS6_CHNL133_CMD_ADDR A:0xe664280
y.create.l HWIO_PMIC_ARB_OBS6_CHNL134_CMD_ADDR A:0xe664300
y.create.l HWIO_PMIC_ARB_OBS6_CHNL135_CMD_ADDR A:0xe664380
y.create.l HWIO_PMIC_ARB_OBS6_CHNL136_CMD_ADDR A:0xe664400
y.create.l HWIO_PMIC_ARB_OBS6_CHNL137_CMD_ADDR A:0xe664480
y.create.l HWIO_PMIC_ARB_OBS6_CHNL138_CMD_ADDR A:0xe664500
y.create.l HWIO_PMIC_ARB_OBS6_CHNL139_CMD_ADDR A:0xe664580
y.create.l HWIO_PMIC_ARB_OBS6_CHNL140_CMD_ADDR A:0xe664600
y.create.l HWIO_PMIC_ARB_OBS6_CHNL141_CMD_ADDR A:0xe664680
y.create.l HWIO_PMIC_ARB_OBS6_CHNL142_CMD_ADDR A:0xe664700
y.create.l HWIO_PMIC_ARB_OBS6_CHNL143_CMD_ADDR A:0xe664780
y.create.l HWIO_PMIC_ARB_OBS6_CHNL144_CMD_ADDR A:0xe664800
y.create.l HWIO_PMIC_ARB_OBS6_CHNL145_CMD_ADDR A:0xe664880
y.create.l HWIO_PMIC_ARB_OBS6_CHNL146_CMD_ADDR A:0xe664900
y.create.l HWIO_PMIC_ARB_OBS6_CHNL147_CMD_ADDR A:0xe664980
y.create.l HWIO_PMIC_ARB_OBS6_CHNL148_CMD_ADDR A:0xe664a00
y.create.l HWIO_PMIC_ARB_OBS6_CHNL149_CMD_ADDR A:0xe664a80
y.create.l HWIO_PMIC_ARB_OBS6_CHNL150_CMD_ADDR A:0xe664b00
y.create.l HWIO_PMIC_ARB_OBS6_CHNL151_CMD_ADDR A:0xe664b80
y.create.l HWIO_PMIC_ARB_OBS6_CHNL152_CMD_ADDR A:0xe664c00
y.create.l HWIO_PMIC_ARB_OBS6_CHNL153_CMD_ADDR A:0xe664c80
y.create.l HWIO_PMIC_ARB_OBS6_CHNL154_CMD_ADDR A:0xe664d00
y.create.l HWIO_PMIC_ARB_OBS6_CHNL155_CMD_ADDR A:0xe664d80
y.create.l HWIO_PMIC_ARB_OBS6_CHNL156_CMD_ADDR A:0xe664e00
y.create.l HWIO_PMIC_ARB_OBS6_CHNL157_CMD_ADDR A:0xe664e80
y.create.l HWIO_PMIC_ARB_OBS6_CHNL158_CMD_ADDR A:0xe664f00
y.create.l HWIO_PMIC_ARB_OBS6_CHNL159_CMD_ADDR A:0xe664f80
y.create.l HWIO_PMIC_ARB_OBS6_CHNL160_CMD_ADDR A:0xe665000
y.create.l HWIO_PMIC_ARB_OBS6_CHNL161_CMD_ADDR A:0xe665080
y.create.l HWIO_PMIC_ARB_OBS6_CHNL162_CMD_ADDR A:0xe665100
y.create.l HWIO_PMIC_ARB_OBS6_CHNL163_CMD_ADDR A:0xe665180
y.create.l HWIO_PMIC_ARB_OBS6_CHNL164_CMD_ADDR A:0xe665200
y.create.l HWIO_PMIC_ARB_OBS6_CHNL165_CMD_ADDR A:0xe665280
y.create.l HWIO_PMIC_ARB_OBS6_CHNL166_CMD_ADDR A:0xe665300
y.create.l HWIO_PMIC_ARB_OBS6_CHNL167_CMD_ADDR A:0xe665380
y.create.l HWIO_PMIC_ARB_OBS6_CHNL168_CMD_ADDR A:0xe665400
y.create.l HWIO_PMIC_ARB_OBS6_CHNL169_CMD_ADDR A:0xe665480
y.create.l HWIO_PMIC_ARB_OBS6_CHNL170_CMD_ADDR A:0xe665500
y.create.l HWIO_PMIC_ARB_OBS6_CHNL171_CMD_ADDR A:0xe665580
y.create.l HWIO_PMIC_ARB_OBS6_CHNL172_CMD_ADDR A:0xe665600
y.create.l HWIO_PMIC_ARB_OBS6_CHNL173_CMD_ADDR A:0xe665680
y.create.l HWIO_PMIC_ARB_OBS6_CHNL174_CMD_ADDR A:0xe665700
y.create.l HWIO_PMIC_ARB_OBS6_CHNL175_CMD_ADDR A:0xe665780
y.create.l HWIO_PMIC_ARB_OBS6_CHNL176_CMD_ADDR A:0xe665800
y.create.l HWIO_PMIC_ARB_OBS6_CHNL177_CMD_ADDR A:0xe665880
y.create.l HWIO_PMIC_ARB_OBS6_CHNL178_CMD_ADDR A:0xe665900
y.create.l HWIO_PMIC_ARB_OBS6_CHNL179_CMD_ADDR A:0xe665980
y.create.l HWIO_PMIC_ARB_OBS6_CHNL180_CMD_ADDR A:0xe665a00
y.create.l HWIO_PMIC_ARB_OBS6_CHNL181_CMD_ADDR A:0xe665a80
y.create.l HWIO_PMIC_ARB_OBS6_CHNL182_CMD_ADDR A:0xe665b00
y.create.l HWIO_PMIC_ARB_OBS6_CHNL183_CMD_ADDR A:0xe665b80
y.create.l HWIO_PMIC_ARB_OBS6_CHNL184_CMD_ADDR A:0xe665c00
y.create.l HWIO_PMIC_ARB_OBS6_CHNL185_CMD_ADDR A:0xe665c80
y.create.l HWIO_PMIC_ARB_OBS6_CHNL186_CMD_ADDR A:0xe665d00
y.create.l HWIO_PMIC_ARB_OBS6_CHNL187_CMD_ADDR A:0xe665d80
y.create.l HWIO_PMIC_ARB_OBS6_CHNL188_CMD_ADDR A:0xe665e00
y.create.l HWIO_PMIC_ARB_OBS6_CHNL189_CMD_ADDR A:0xe665e80
y.create.l HWIO_PMIC_ARB_OBS6_CHNL190_CMD_ADDR A:0xe665f00
y.create.l HWIO_PMIC_ARB_OBS6_CHNL191_CMD_ADDR A:0xe665f80
y.create.l HWIO_PMIC_ARB_OBS6_CHNL192_CMD_ADDR A:0xe666000
y.create.l HWIO_PMIC_ARB_OBS6_CHNL193_CMD_ADDR A:0xe666080
y.create.l HWIO_PMIC_ARB_OBS6_CHNL194_CMD_ADDR A:0xe666100
y.create.l HWIO_PMIC_ARB_OBS6_CHNL195_CMD_ADDR A:0xe666180
y.create.l HWIO_PMIC_ARB_OBS6_CHNL196_CMD_ADDR A:0xe666200
y.create.l HWIO_PMIC_ARB_OBS6_CHNL197_CMD_ADDR A:0xe666280
y.create.l HWIO_PMIC_ARB_OBS6_CHNL198_CMD_ADDR A:0xe666300
y.create.l HWIO_PMIC_ARB_OBS6_CHNL199_CMD_ADDR A:0xe666380
y.create.l HWIO_PMIC_ARB_OBS6_CHNL200_CMD_ADDR A:0xe666400
y.create.l HWIO_PMIC_ARB_OBS6_CHNL201_CMD_ADDR A:0xe666480
y.create.l HWIO_PMIC_ARB_OBS6_CHNL202_CMD_ADDR A:0xe666500
y.create.l HWIO_PMIC_ARB_OBS6_CHNL203_CMD_ADDR A:0xe666580
y.create.l HWIO_PMIC_ARB_OBS6_CHNL204_CMD_ADDR A:0xe666600
y.create.l HWIO_PMIC_ARB_OBS6_CHNL205_CMD_ADDR A:0xe666680
y.create.l HWIO_PMIC_ARB_OBS6_CHNL206_CMD_ADDR A:0xe666700
y.create.l HWIO_PMIC_ARB_OBS6_CHNL207_CMD_ADDR A:0xe666780
y.create.l HWIO_PMIC_ARB_OBS6_CHNL208_CMD_ADDR A:0xe666800
y.create.l HWIO_PMIC_ARB_OBS6_CHNL209_CMD_ADDR A:0xe666880
y.create.l HWIO_PMIC_ARB_OBS6_CHNL210_CMD_ADDR A:0xe666900
y.create.l HWIO_PMIC_ARB_OBS6_CHNL211_CMD_ADDR A:0xe666980
y.create.l HWIO_PMIC_ARB_OBS6_CHNL212_CMD_ADDR A:0xe666a00
y.create.l HWIO_PMIC_ARB_OBS6_CHNL213_CMD_ADDR A:0xe666a80
y.create.l HWIO_PMIC_ARB_OBS6_CHNL214_CMD_ADDR A:0xe666b00
y.create.l HWIO_PMIC_ARB_OBS6_CHNL215_CMD_ADDR A:0xe666b80
y.create.l HWIO_PMIC_ARB_OBS6_CHNL216_CMD_ADDR A:0xe666c00
y.create.l HWIO_PMIC_ARB_OBS6_CHNL217_CMD_ADDR A:0xe666c80
y.create.l HWIO_PMIC_ARB_OBS6_CHNL218_CMD_ADDR A:0xe666d00
y.create.l HWIO_PMIC_ARB_OBS6_CHNL219_CMD_ADDR A:0xe666d80
y.create.l HWIO_PMIC_ARB_OBS6_CHNL220_CMD_ADDR A:0xe666e00
y.create.l HWIO_PMIC_ARB_OBS6_CHNL221_CMD_ADDR A:0xe666e80
y.create.l HWIO_PMIC_ARB_OBS6_CHNL222_CMD_ADDR A:0xe666f00
y.create.l HWIO_PMIC_ARB_OBS6_CHNL223_CMD_ADDR A:0xe666f80
y.create.l HWIO_PMIC_ARB_OBS6_CHNL224_CMD_ADDR A:0xe667000
y.create.l HWIO_PMIC_ARB_OBS6_CHNL225_CMD_ADDR A:0xe667080
y.create.l HWIO_PMIC_ARB_OBS6_CHNL226_CMD_ADDR A:0xe667100
y.create.l HWIO_PMIC_ARB_OBS6_CHNL227_CMD_ADDR A:0xe667180
y.create.l HWIO_PMIC_ARB_OBS6_CHNL228_CMD_ADDR A:0xe667200
y.create.l HWIO_PMIC_ARB_OBS6_CHNL229_CMD_ADDR A:0xe667280
y.create.l HWIO_PMIC_ARB_OBS6_CHNL230_CMD_ADDR A:0xe667300
y.create.l HWIO_PMIC_ARB_OBS6_CHNL231_CMD_ADDR A:0xe667380
y.create.l HWIO_PMIC_ARB_OBS6_CHNL232_CMD_ADDR A:0xe667400
y.create.l HWIO_PMIC_ARB_OBS6_CHNL233_CMD_ADDR A:0xe667480
y.create.l HWIO_PMIC_ARB_OBS6_CHNL234_CMD_ADDR A:0xe667500
y.create.l HWIO_PMIC_ARB_OBS6_CHNL235_CMD_ADDR A:0xe667580
y.create.l HWIO_PMIC_ARB_OBS6_CHNL236_CMD_ADDR A:0xe667600
y.create.l HWIO_PMIC_ARB_OBS6_CHNL237_CMD_ADDR A:0xe667680
y.create.l HWIO_PMIC_ARB_OBS6_CHNL238_CMD_ADDR A:0xe667700
y.create.l HWIO_PMIC_ARB_OBS6_CHNL239_CMD_ADDR A:0xe667780
y.create.l HWIO_PMIC_ARB_OBS6_CHNL240_CMD_ADDR A:0xe667800
y.create.l HWIO_PMIC_ARB_OBS6_CHNL241_CMD_ADDR A:0xe667880
y.create.l HWIO_PMIC_ARB_OBS6_CHNL242_CMD_ADDR A:0xe667900
y.create.l HWIO_PMIC_ARB_OBS6_CHNL243_CMD_ADDR A:0xe667980
y.create.l HWIO_PMIC_ARB_OBS6_CHNL244_CMD_ADDR A:0xe667a00
y.create.l HWIO_PMIC_ARB_OBS6_CHNL245_CMD_ADDR A:0xe667a80
y.create.l HWIO_PMIC_ARB_OBS6_CHNL246_CMD_ADDR A:0xe667b00
y.create.l HWIO_PMIC_ARB_OBS6_CHNL247_CMD_ADDR A:0xe667b80
y.create.l HWIO_PMIC_ARB_OBS6_CHNL248_CMD_ADDR A:0xe667c00
y.create.l HWIO_PMIC_ARB_OBS6_CHNL249_CMD_ADDR A:0xe667c80
y.create.l HWIO_PMIC_ARB_OBS6_CHNL250_CMD_ADDR A:0xe667d00
y.create.l HWIO_PMIC_ARB_OBS6_CHNL251_CMD_ADDR A:0xe667d80
y.create.l HWIO_PMIC_ARB_OBS6_CHNL252_CMD_ADDR A:0xe667e00
y.create.l HWIO_PMIC_ARB_OBS6_CHNL253_CMD_ADDR A:0xe667e80
y.create.l HWIO_PMIC_ARB_OBS6_CHNL254_CMD_ADDR A:0xe667f00
y.create.l HWIO_PMIC_ARB_OBS6_CHNL255_CMD_ADDR A:0xe667f80
y.create.l HWIO_PMIC_ARB_OBS6_CHNL256_CMD_ADDR A:0xe668000
y.create.l HWIO_PMIC_ARB_OBS6_CHNL257_CMD_ADDR A:0xe668080
y.create.l HWIO_PMIC_ARB_OBS6_CHNL258_CMD_ADDR A:0xe668100
y.create.l HWIO_PMIC_ARB_OBS6_CHNL259_CMD_ADDR A:0xe668180
y.create.l HWIO_PMIC_ARB_OBS6_CHNL260_CMD_ADDR A:0xe668200
y.create.l HWIO_PMIC_ARB_OBS6_CHNL261_CMD_ADDR A:0xe668280
y.create.l HWIO_PMIC_ARB_OBS6_CHNL262_CMD_ADDR A:0xe668300
y.create.l HWIO_PMIC_ARB_OBS6_CHNL263_CMD_ADDR A:0xe668380
y.create.l HWIO_PMIC_ARB_OBS6_CHNL264_CMD_ADDR A:0xe668400
y.create.l HWIO_PMIC_ARB_OBS6_CHNL265_CMD_ADDR A:0xe668480
y.create.l HWIO_PMIC_ARB_OBS6_CHNL266_CMD_ADDR A:0xe668500
y.create.l HWIO_PMIC_ARB_OBS6_CHNL267_CMD_ADDR A:0xe668580
y.create.l HWIO_PMIC_ARB_OBS6_CHNL268_CMD_ADDR A:0xe668600
y.create.l HWIO_PMIC_ARB_OBS6_CHNL269_CMD_ADDR A:0xe668680
y.create.l HWIO_PMIC_ARB_OBS6_CHNL270_CMD_ADDR A:0xe668700
y.create.l HWIO_PMIC_ARB_OBS6_CHNL271_CMD_ADDR A:0xe668780
y.create.l HWIO_PMIC_ARB_OBS6_CHNL272_CMD_ADDR A:0xe668800
y.create.l HWIO_PMIC_ARB_OBS6_CHNL273_CMD_ADDR A:0xe668880
y.create.l HWIO_PMIC_ARB_OBS6_CHNL274_CMD_ADDR A:0xe668900
y.create.l HWIO_PMIC_ARB_OBS6_CHNL275_CMD_ADDR A:0xe668980
y.create.l HWIO_PMIC_ARB_OBS6_CHNL276_CMD_ADDR A:0xe668a00
y.create.l HWIO_PMIC_ARB_OBS6_CHNL277_CMD_ADDR A:0xe668a80
y.create.l HWIO_PMIC_ARB_OBS6_CHNL278_CMD_ADDR A:0xe668b00
y.create.l HWIO_PMIC_ARB_OBS6_CHNL279_CMD_ADDR A:0xe668b80
y.create.l HWIO_PMIC_ARB_OBS6_CHNL280_CMD_ADDR A:0xe668c00
y.create.l HWIO_PMIC_ARB_OBS6_CHNL281_CMD_ADDR A:0xe668c80
y.create.l HWIO_PMIC_ARB_OBS6_CHNL282_CMD_ADDR A:0xe668d00
y.create.l HWIO_PMIC_ARB_OBS6_CHNL283_CMD_ADDR A:0xe668d80
y.create.l HWIO_PMIC_ARB_OBS6_CHNL284_CMD_ADDR A:0xe668e00
y.create.l HWIO_PMIC_ARB_OBS6_CHNL285_CMD_ADDR A:0xe668e80
y.create.l HWIO_PMIC_ARB_OBS6_CHNL286_CMD_ADDR A:0xe668f00
y.create.l HWIO_PMIC_ARB_OBS6_CHNL287_CMD_ADDR A:0xe668f80
y.create.l HWIO_PMIC_ARB_OBS6_CHNL288_CMD_ADDR A:0xe669000
y.create.l HWIO_PMIC_ARB_OBS6_CHNL289_CMD_ADDR A:0xe669080
y.create.l HWIO_PMIC_ARB_OBS6_CHNL290_CMD_ADDR A:0xe669100
y.create.l HWIO_PMIC_ARB_OBS6_CHNL291_CMD_ADDR A:0xe669180
y.create.l HWIO_PMIC_ARB_OBS6_CHNL292_CMD_ADDR A:0xe669200
y.create.l HWIO_PMIC_ARB_OBS6_CHNL293_CMD_ADDR A:0xe669280
y.create.l HWIO_PMIC_ARB_OBS6_CHNL294_CMD_ADDR A:0xe669300
y.create.l HWIO_PMIC_ARB_OBS6_CHNL295_CMD_ADDR A:0xe669380
y.create.l HWIO_PMIC_ARB_OBS6_CHNL296_CMD_ADDR A:0xe669400
y.create.l HWIO_PMIC_ARB_OBS6_CHNL297_CMD_ADDR A:0xe669480
y.create.l HWIO_PMIC_ARB_OBS6_CHNL298_CMD_ADDR A:0xe669500
y.create.l HWIO_PMIC_ARB_OBS6_CHNL299_CMD_ADDR A:0xe669580
y.create.l HWIO_PMIC_ARB_OBS6_CHNL300_CMD_ADDR A:0xe669600
y.create.l HWIO_PMIC_ARB_OBS6_CHNL301_CMD_ADDR A:0xe669680
y.create.l HWIO_PMIC_ARB_OBS6_CHNL302_CMD_ADDR A:0xe669700
y.create.l HWIO_PMIC_ARB_OBS6_CHNL303_CMD_ADDR A:0xe669780
y.create.l HWIO_PMIC_ARB_OBS6_CHNL304_CMD_ADDR A:0xe669800
y.create.l HWIO_PMIC_ARB_OBS6_CHNL305_CMD_ADDR A:0xe669880
y.create.l HWIO_PMIC_ARB_OBS6_CHNL306_CMD_ADDR A:0xe669900
y.create.l HWIO_PMIC_ARB_OBS6_CHNL307_CMD_ADDR A:0xe669980
y.create.l HWIO_PMIC_ARB_OBS6_CHNL308_CMD_ADDR A:0xe669a00
y.create.l HWIO_PMIC_ARB_OBS6_CHNL309_CMD_ADDR A:0xe669a80
y.create.l HWIO_PMIC_ARB_OBS6_CHNL310_CMD_ADDR A:0xe669b00
y.create.l HWIO_PMIC_ARB_OBS6_CHNL311_CMD_ADDR A:0xe669b80
y.create.l HWIO_PMIC_ARB_OBS6_CHNL312_CMD_ADDR A:0xe669c00
y.create.l HWIO_PMIC_ARB_OBS6_CHNL313_CMD_ADDR A:0xe669c80
y.create.l HWIO_PMIC_ARB_OBS6_CHNL314_CMD_ADDR A:0xe669d00
y.create.l HWIO_PMIC_ARB_OBS6_CHNL315_CMD_ADDR A:0xe669d80
y.create.l HWIO_PMIC_ARB_OBS6_CHNL316_CMD_ADDR A:0xe669e00
y.create.l HWIO_PMIC_ARB_OBS6_CHNL317_CMD_ADDR A:0xe669e80
y.create.l HWIO_PMIC_ARB_OBS6_CHNL318_CMD_ADDR A:0xe669f00
y.create.l HWIO_PMIC_ARB_OBS6_CHNL319_CMD_ADDR A:0xe669f80
y.create.l HWIO_PMIC_ARB_OBS6_CHNL320_CMD_ADDR A:0xe66a000
y.create.l HWIO_PMIC_ARB_OBS6_CHNL321_CMD_ADDR A:0xe66a080
y.create.l HWIO_PMIC_ARB_OBS6_CHNL322_CMD_ADDR A:0xe66a100
y.create.l HWIO_PMIC_ARB_OBS6_CHNL323_CMD_ADDR A:0xe66a180
y.create.l HWIO_PMIC_ARB_OBS6_CHNL324_CMD_ADDR A:0xe66a200
y.create.l HWIO_PMIC_ARB_OBS6_CHNL325_CMD_ADDR A:0xe66a280
y.create.l HWIO_PMIC_ARB_OBS6_CHNL326_CMD_ADDR A:0xe66a300
y.create.l HWIO_PMIC_ARB_OBS6_CHNL327_CMD_ADDR A:0xe66a380
y.create.l HWIO_PMIC_ARB_OBS6_CHNL328_CMD_ADDR A:0xe66a400
y.create.l HWIO_PMIC_ARB_OBS6_CHNL329_CMD_ADDR A:0xe66a480
y.create.l HWIO_PMIC_ARB_OBS6_CHNL330_CMD_ADDR A:0xe66a500
y.create.l HWIO_PMIC_ARB_OBS6_CHNL331_CMD_ADDR A:0xe66a580
y.create.l HWIO_PMIC_ARB_OBS6_CHNL332_CMD_ADDR A:0xe66a600
y.create.l HWIO_PMIC_ARB_OBS6_CHNL333_CMD_ADDR A:0xe66a680
y.create.l HWIO_PMIC_ARB_OBS6_CHNL334_CMD_ADDR A:0xe66a700
y.create.l HWIO_PMIC_ARB_OBS6_CHNL335_CMD_ADDR A:0xe66a780
y.create.l HWIO_PMIC_ARB_OBS6_CHNL336_CMD_ADDR A:0xe66a800
y.create.l HWIO_PMIC_ARB_OBS6_CHNL337_CMD_ADDR A:0xe66a880
y.create.l HWIO_PMIC_ARB_OBS6_CHNL338_CMD_ADDR A:0xe66a900
y.create.l HWIO_PMIC_ARB_OBS6_CHNL339_CMD_ADDR A:0xe66a980
y.create.l HWIO_PMIC_ARB_OBS6_CHNL340_CMD_ADDR A:0xe66aa00
y.create.l HWIO_PMIC_ARB_OBS6_CHNL341_CMD_ADDR A:0xe66aa80
y.create.l HWIO_PMIC_ARB_OBS6_CHNL342_CMD_ADDR A:0xe66ab00
y.create.l HWIO_PMIC_ARB_OBS6_CHNL343_CMD_ADDR A:0xe66ab80
y.create.l HWIO_PMIC_ARB_OBS6_CHNL344_CMD_ADDR A:0xe66ac00
y.create.l HWIO_PMIC_ARB_OBS6_CHNL345_CMD_ADDR A:0xe66ac80
y.create.l HWIO_PMIC_ARB_OBS6_CHNL346_CMD_ADDR A:0xe66ad00
y.create.l HWIO_PMIC_ARB_OBS6_CHNL347_CMD_ADDR A:0xe66ad80
y.create.l HWIO_PMIC_ARB_OBS6_CHNL348_CMD_ADDR A:0xe66ae00
y.create.l HWIO_PMIC_ARB_OBS6_CHNL349_CMD_ADDR A:0xe66ae80
y.create.l HWIO_PMIC_ARB_OBS6_CHNL350_CMD_ADDR A:0xe66af00
y.create.l HWIO_PMIC_ARB_OBS6_CHNL351_CMD_ADDR A:0xe66af80
y.create.l HWIO_PMIC_ARB_OBS6_CHNL352_CMD_ADDR A:0xe66b000
y.create.l HWIO_PMIC_ARB_OBS6_CHNL353_CMD_ADDR A:0xe66b080
y.create.l HWIO_PMIC_ARB_OBS6_CHNL354_CMD_ADDR A:0xe66b100
y.create.l HWIO_PMIC_ARB_OBS6_CHNL355_CMD_ADDR A:0xe66b180
y.create.l HWIO_PMIC_ARB_OBS6_CHNL356_CMD_ADDR A:0xe66b200
y.create.l HWIO_PMIC_ARB_OBS6_CHNL357_CMD_ADDR A:0xe66b280
y.create.l HWIO_PMIC_ARB_OBS6_CHNL358_CMD_ADDR A:0xe66b300
y.create.l HWIO_PMIC_ARB_OBS6_CHNL359_CMD_ADDR A:0xe66b380
y.create.l HWIO_PMIC_ARB_OBS6_CHNL360_CMD_ADDR A:0xe66b400
y.create.l HWIO_PMIC_ARB_OBS6_CHNL361_CMD_ADDR A:0xe66b480
y.create.l HWIO_PMIC_ARB_OBS6_CHNL362_CMD_ADDR A:0xe66b500
y.create.l HWIO_PMIC_ARB_OBS6_CHNL363_CMD_ADDR A:0xe66b580
y.create.l HWIO_PMIC_ARB_OBS6_CHNL364_CMD_ADDR A:0xe66b600
y.create.l HWIO_PMIC_ARB_OBS6_CHNL365_CMD_ADDR A:0xe66b680
y.create.l HWIO_PMIC_ARB_OBS6_CHNL366_CMD_ADDR A:0xe66b700
y.create.l HWIO_PMIC_ARB_OBS6_CHNL367_CMD_ADDR A:0xe66b780
y.create.l HWIO_PMIC_ARB_OBS6_CHNL368_CMD_ADDR A:0xe66b800
y.create.l HWIO_PMIC_ARB_OBS6_CHNL369_CMD_ADDR A:0xe66b880
y.create.l HWIO_PMIC_ARB_OBS6_CHNL370_CMD_ADDR A:0xe66b900
y.create.l HWIO_PMIC_ARB_OBS6_CHNL371_CMD_ADDR A:0xe66b980
y.create.l HWIO_PMIC_ARB_OBS6_CHNL372_CMD_ADDR A:0xe66ba00
y.create.l HWIO_PMIC_ARB_OBS6_CHNL373_CMD_ADDR A:0xe66ba80
y.create.l HWIO_PMIC_ARB_OBS6_CHNL374_CMD_ADDR A:0xe66bb00
y.create.l HWIO_PMIC_ARB_OBS6_CHNL375_CMD_ADDR A:0xe66bb80
y.create.l HWIO_PMIC_ARB_OBS6_CHNL376_CMD_ADDR A:0xe66bc00
y.create.l HWIO_PMIC_ARB_OBS6_CHNL377_CMD_ADDR A:0xe66bc80
y.create.l HWIO_PMIC_ARB_OBS6_CHNL378_CMD_ADDR A:0xe66bd00
y.create.l HWIO_PMIC_ARB_OBS6_CHNL379_CMD_ADDR A:0xe66bd80
y.create.l HWIO_PMIC_ARB_OBS6_CHNL380_CMD_ADDR A:0xe66be00
y.create.l HWIO_PMIC_ARB_OBS6_CHNL381_CMD_ADDR A:0xe66be80
y.create.l HWIO_PMIC_ARB_OBS6_CHNL382_CMD_ADDR A:0xe66bf00
y.create.l HWIO_PMIC_ARB_OBS6_CHNL383_CMD_ADDR A:0xe66bf80
y.create.l HWIO_PMIC_ARB_OBS6_CHNL384_CMD_ADDR A:0xe66c000
y.create.l HWIO_PMIC_ARB_OBS6_CHNL385_CMD_ADDR A:0xe66c080
y.create.l HWIO_PMIC_ARB_OBS6_CHNL386_CMD_ADDR A:0xe66c100
y.create.l HWIO_PMIC_ARB_OBS6_CHNL387_CMD_ADDR A:0xe66c180
y.create.l HWIO_PMIC_ARB_OBS6_CHNL388_CMD_ADDR A:0xe66c200
y.create.l HWIO_PMIC_ARB_OBS6_CHNL389_CMD_ADDR A:0xe66c280
y.create.l HWIO_PMIC_ARB_OBS6_CHNL390_CMD_ADDR A:0xe66c300
y.create.l HWIO_PMIC_ARB_OBS6_CHNL391_CMD_ADDR A:0xe66c380
y.create.l HWIO_PMIC_ARB_OBS6_CHNL392_CMD_ADDR A:0xe66c400
y.create.l HWIO_PMIC_ARB_OBS6_CHNL393_CMD_ADDR A:0xe66c480
y.create.l HWIO_PMIC_ARB_OBS6_CHNL394_CMD_ADDR A:0xe66c500
y.create.l HWIO_PMIC_ARB_OBS6_CHNL395_CMD_ADDR A:0xe66c580
y.create.l HWIO_PMIC_ARB_OBS6_CHNL396_CMD_ADDR A:0xe66c600
y.create.l HWIO_PMIC_ARB_OBS6_CHNL397_CMD_ADDR A:0xe66c680
y.create.l HWIO_PMIC_ARB_OBS6_CHNL398_CMD_ADDR A:0xe66c700
y.create.l HWIO_PMIC_ARB_OBS6_CHNL399_CMD_ADDR A:0xe66c780
y.create.l HWIO_PMIC_ARB_OBS6_CHNL400_CMD_ADDR A:0xe66c800
y.create.l HWIO_PMIC_ARB_OBS6_CHNL401_CMD_ADDR A:0xe66c880
y.create.l HWIO_PMIC_ARB_OBS6_CHNL402_CMD_ADDR A:0xe66c900
y.create.l HWIO_PMIC_ARB_OBS6_CHNL403_CMD_ADDR A:0xe66c980
y.create.l HWIO_PMIC_ARB_OBS6_CHNL404_CMD_ADDR A:0xe66ca00
y.create.l HWIO_PMIC_ARB_OBS6_CHNL405_CMD_ADDR A:0xe66ca80
y.create.l HWIO_PMIC_ARB_OBS6_CHNL406_CMD_ADDR A:0xe66cb00
y.create.l HWIO_PMIC_ARB_OBS6_CHNL407_CMD_ADDR A:0xe66cb80
y.create.l HWIO_PMIC_ARB_OBS6_CHNL408_CMD_ADDR A:0xe66cc00
y.create.l HWIO_PMIC_ARB_OBS6_CHNL409_CMD_ADDR A:0xe66cc80
y.create.l HWIO_PMIC_ARB_OBS6_CHNL410_CMD_ADDR A:0xe66cd00
y.create.l HWIO_PMIC_ARB_OBS6_CHNL411_CMD_ADDR A:0xe66cd80
y.create.l HWIO_PMIC_ARB_OBS6_CHNL412_CMD_ADDR A:0xe66ce00
y.create.l HWIO_PMIC_ARB_OBS6_CHNL413_CMD_ADDR A:0xe66ce80
y.create.l HWIO_PMIC_ARB_OBS6_CHNL414_CMD_ADDR A:0xe66cf00
y.create.l HWIO_PMIC_ARB_OBS6_CHNL415_CMD_ADDR A:0xe66cf80
y.create.l HWIO_PMIC_ARB_OBS6_CHNL416_CMD_ADDR A:0xe66d000
y.create.l HWIO_PMIC_ARB_OBS6_CHNL417_CMD_ADDR A:0xe66d080
y.create.l HWIO_PMIC_ARB_OBS6_CHNL418_CMD_ADDR A:0xe66d100
y.create.l HWIO_PMIC_ARB_OBS6_CHNL419_CMD_ADDR A:0xe66d180
y.create.l HWIO_PMIC_ARB_OBS6_CHNL420_CMD_ADDR A:0xe66d200
y.create.l HWIO_PMIC_ARB_OBS6_CHNL421_CMD_ADDR A:0xe66d280
y.create.l HWIO_PMIC_ARB_OBS6_CHNL422_CMD_ADDR A:0xe66d300
y.create.l HWIO_PMIC_ARB_OBS6_CHNL423_CMD_ADDR A:0xe66d380
y.create.l HWIO_PMIC_ARB_OBS6_CHNL424_CMD_ADDR A:0xe66d400
y.create.l HWIO_PMIC_ARB_OBS6_CHNL425_CMD_ADDR A:0xe66d480
y.create.l HWIO_PMIC_ARB_OBS6_CHNL426_CMD_ADDR A:0xe66d500
y.create.l HWIO_PMIC_ARB_OBS6_CHNL427_CMD_ADDR A:0xe66d580
y.create.l HWIO_PMIC_ARB_OBS6_CHNL428_CMD_ADDR A:0xe66d600
y.create.l HWIO_PMIC_ARB_OBS6_CHNL429_CMD_ADDR A:0xe66d680
y.create.l HWIO_PMIC_ARB_OBS6_CHNL430_CMD_ADDR A:0xe66d700
y.create.l HWIO_PMIC_ARB_OBS6_CHNL431_CMD_ADDR A:0xe66d780
y.create.l HWIO_PMIC_ARB_OBS6_CHNL432_CMD_ADDR A:0xe66d800
y.create.l HWIO_PMIC_ARB_OBS6_CHNL433_CMD_ADDR A:0xe66d880
y.create.l HWIO_PMIC_ARB_OBS6_CHNL434_CMD_ADDR A:0xe66d900
y.create.l HWIO_PMIC_ARB_OBS6_CHNL435_CMD_ADDR A:0xe66d980
y.create.l HWIO_PMIC_ARB_OBS6_CHNL436_CMD_ADDR A:0xe66da00
y.create.l HWIO_PMIC_ARB_OBS6_CHNL437_CMD_ADDR A:0xe66da80
y.create.l HWIO_PMIC_ARB_OBS6_CHNL438_CMD_ADDR A:0xe66db00
y.create.l HWIO_PMIC_ARB_OBS6_CHNL439_CMD_ADDR A:0xe66db80
y.create.l HWIO_PMIC_ARB_OBS6_CHNL440_CMD_ADDR A:0xe66dc00
y.create.l HWIO_PMIC_ARB_OBS6_CHNL441_CMD_ADDR A:0xe66dc80
y.create.l HWIO_PMIC_ARB_OBS6_CHNL442_CMD_ADDR A:0xe66dd00
y.create.l HWIO_PMIC_ARB_OBS6_CHNL443_CMD_ADDR A:0xe66dd80
y.create.l HWIO_PMIC_ARB_OBS6_CHNL444_CMD_ADDR A:0xe66de00
y.create.l HWIO_PMIC_ARB_OBS6_CHNL445_CMD_ADDR A:0xe66de80
y.create.l HWIO_PMIC_ARB_OBS6_CHNL446_CMD_ADDR A:0xe66df00
y.create.l HWIO_PMIC_ARB_OBS6_CHNL447_CMD_ADDR A:0xe66df80
y.create.l HWIO_PMIC_ARB_OBS6_CHNL448_CMD_ADDR A:0xe66e000
y.create.l HWIO_PMIC_ARB_OBS6_CHNL449_CMD_ADDR A:0xe66e080
y.create.l HWIO_PMIC_ARB_OBS6_CHNL450_CMD_ADDR A:0xe66e100
y.create.l HWIO_PMIC_ARB_OBS6_CHNL451_CMD_ADDR A:0xe66e180
y.create.l HWIO_PMIC_ARB_OBS6_CHNL452_CMD_ADDR A:0xe66e200
y.create.l HWIO_PMIC_ARB_OBS6_CHNL453_CMD_ADDR A:0xe66e280
y.create.l HWIO_PMIC_ARB_OBS6_CHNL454_CMD_ADDR A:0xe66e300
y.create.l HWIO_PMIC_ARB_OBS6_CHNL455_CMD_ADDR A:0xe66e380
y.create.l HWIO_PMIC_ARB_OBS6_CHNL456_CMD_ADDR A:0xe66e400
y.create.l HWIO_PMIC_ARB_OBS6_CHNL457_CMD_ADDR A:0xe66e480
y.create.l HWIO_PMIC_ARB_OBS6_CHNL458_CMD_ADDR A:0xe66e500
y.create.l HWIO_PMIC_ARB_OBS6_CHNL459_CMD_ADDR A:0xe66e580
y.create.l HWIO_PMIC_ARB_OBS6_CHNL460_CMD_ADDR A:0xe66e600
y.create.l HWIO_PMIC_ARB_OBS6_CHNL461_CMD_ADDR A:0xe66e680
y.create.l HWIO_PMIC_ARB_OBS6_CHNL462_CMD_ADDR A:0xe66e700
y.create.l HWIO_PMIC_ARB_OBS6_CHNL463_CMD_ADDR A:0xe66e780
y.create.l HWIO_PMIC_ARB_OBS6_CHNL464_CMD_ADDR A:0xe66e800
y.create.l HWIO_PMIC_ARB_OBS6_CHNL465_CMD_ADDR A:0xe66e880
y.create.l HWIO_PMIC_ARB_OBS6_CHNL466_CMD_ADDR A:0xe66e900
y.create.l HWIO_PMIC_ARB_OBS6_CHNL467_CMD_ADDR A:0xe66e980
y.create.l HWIO_PMIC_ARB_OBS6_CHNL468_CMD_ADDR A:0xe66ea00
y.create.l HWIO_PMIC_ARB_OBS6_CHNL469_CMD_ADDR A:0xe66ea80
y.create.l HWIO_PMIC_ARB_OBS6_CHNL470_CMD_ADDR A:0xe66eb00
y.create.l HWIO_PMIC_ARB_OBS6_CHNL471_CMD_ADDR A:0xe66eb80
y.create.l HWIO_PMIC_ARB_OBS6_CHNL472_CMD_ADDR A:0xe66ec00
y.create.l HWIO_PMIC_ARB_OBS6_CHNL473_CMD_ADDR A:0xe66ec80
y.create.l HWIO_PMIC_ARB_OBS6_CHNL474_CMD_ADDR A:0xe66ed00
y.create.l HWIO_PMIC_ARB_OBS6_CHNL475_CMD_ADDR A:0xe66ed80
y.create.l HWIO_PMIC_ARB_OBS6_CHNL476_CMD_ADDR A:0xe66ee00
y.create.l HWIO_PMIC_ARB_OBS6_CHNL477_CMD_ADDR A:0xe66ee80
y.create.l HWIO_PMIC_ARB_OBS6_CHNL478_CMD_ADDR A:0xe66ef00
y.create.l HWIO_PMIC_ARB_OBS6_CHNL479_CMD_ADDR A:0xe66ef80
y.create.l HWIO_PMIC_ARB_OBS6_CHNL480_CMD_ADDR A:0xe66f000
y.create.l HWIO_PMIC_ARB_OBS6_CHNL481_CMD_ADDR A:0xe66f080
y.create.l HWIO_PMIC_ARB_OBS6_CHNL482_CMD_ADDR A:0xe66f100
y.create.l HWIO_PMIC_ARB_OBS6_CHNL483_CMD_ADDR A:0xe66f180
y.create.l HWIO_PMIC_ARB_OBS6_CHNL484_CMD_ADDR A:0xe66f200
y.create.l HWIO_PMIC_ARB_OBS6_CHNL485_CMD_ADDR A:0xe66f280
y.create.l HWIO_PMIC_ARB_OBS6_CHNL486_CMD_ADDR A:0xe66f300
y.create.l HWIO_PMIC_ARB_OBS6_CHNL487_CMD_ADDR A:0xe66f380
y.create.l HWIO_PMIC_ARB_OBS6_CHNL488_CMD_ADDR A:0xe66f400
y.create.l HWIO_PMIC_ARB_OBS6_CHNL489_CMD_ADDR A:0xe66f480
y.create.l HWIO_PMIC_ARB_OBS6_CHNL490_CMD_ADDR A:0xe66f500
y.create.l HWIO_PMIC_ARB_OBS6_CHNL491_CMD_ADDR A:0xe66f580
y.create.l HWIO_PMIC_ARB_OBS6_CHNL492_CMD_ADDR A:0xe66f600
y.create.l HWIO_PMIC_ARB_OBS6_CHNL493_CMD_ADDR A:0xe66f680
y.create.l HWIO_PMIC_ARB_OBS6_CHNL494_CMD_ADDR A:0xe66f700
y.create.l HWIO_PMIC_ARB_OBS6_CHNL495_CMD_ADDR A:0xe66f780
y.create.l HWIO_PMIC_ARB_OBS6_CHNL496_CMD_ADDR A:0xe66f800
y.create.l HWIO_PMIC_ARB_OBS6_CHNL497_CMD_ADDR A:0xe66f880
y.create.l HWIO_PMIC_ARB_OBS6_CHNL498_CMD_ADDR A:0xe66f900
y.create.l HWIO_PMIC_ARB_OBS6_CHNL499_CMD_ADDR A:0xe66f980
y.create.l HWIO_PMIC_ARB_OBS6_CHNL500_CMD_ADDR A:0xe66fa00
y.create.l HWIO_PMIC_ARB_OBS6_CHNL501_CMD_ADDR A:0xe66fa80
y.create.l HWIO_PMIC_ARB_OBS6_CHNL502_CMD_ADDR A:0xe66fb00
y.create.l HWIO_PMIC_ARB_OBS6_CHNL503_CMD_ADDR A:0xe66fb80
y.create.l HWIO_PMIC_ARB_OBS6_CHNL504_CMD_ADDR A:0xe66fc00
y.create.l HWIO_PMIC_ARB_OBS6_CHNL505_CMD_ADDR A:0xe66fc80
y.create.l HWIO_PMIC_ARB_OBS6_CHNL506_CMD_ADDR A:0xe66fd00
y.create.l HWIO_PMIC_ARB_OBS6_CHNL507_CMD_ADDR A:0xe66fd80
y.create.l HWIO_PMIC_ARB_OBS6_CHNL508_CMD_ADDR A:0xe66fe00
y.create.l HWIO_PMIC_ARB_OBS6_CHNL509_CMD_ADDR A:0xe66fe80
y.create.l HWIO_PMIC_ARB_OBS6_CHNL510_CMD_ADDR A:0xe66ff00
y.create.l HWIO_PMIC_ARB_OBS6_CHNL511_CMD_ADDR A:0xe66ff80
y.create.l HWIO_PMIC_ARB_OBS0_CHNL0_CONFIG_ADDR A:0xe600004
y.create.l HWIO_PMIC_ARB_OBS0_CHNL1_CONFIG_ADDR A:0xe600084
y.create.l HWIO_PMIC_ARB_OBS0_CHNL2_CONFIG_ADDR A:0xe600104
y.create.l HWIO_PMIC_ARB_OBS0_CHNL3_CONFIG_ADDR A:0xe600184
y.create.l HWIO_PMIC_ARB_OBS0_CHNL4_CONFIG_ADDR A:0xe600204
y.create.l HWIO_PMIC_ARB_OBS0_CHNL5_CONFIG_ADDR A:0xe600284
y.create.l HWIO_PMIC_ARB_OBS0_CHNL6_CONFIG_ADDR A:0xe600304
y.create.l HWIO_PMIC_ARB_OBS0_CHNL7_CONFIG_ADDR A:0xe600384
y.create.l HWIO_PMIC_ARB_OBS0_CHNL8_CONFIG_ADDR A:0xe600404
y.create.l HWIO_PMIC_ARB_OBS0_CHNL9_CONFIG_ADDR A:0xe600484
y.create.l HWIO_PMIC_ARB_OBS0_CHNL10_CONFIG_ADDR A:0xe600504
y.create.l HWIO_PMIC_ARB_OBS0_CHNL11_CONFIG_ADDR A:0xe600584
y.create.l HWIO_PMIC_ARB_OBS0_CHNL12_CONFIG_ADDR A:0xe600604
y.create.l HWIO_PMIC_ARB_OBS0_CHNL13_CONFIG_ADDR A:0xe600684
y.create.l HWIO_PMIC_ARB_OBS0_CHNL14_CONFIG_ADDR A:0xe600704
y.create.l HWIO_PMIC_ARB_OBS0_CHNL15_CONFIG_ADDR A:0xe600784
y.create.l HWIO_PMIC_ARB_OBS0_CHNL16_CONFIG_ADDR A:0xe600804
y.create.l HWIO_PMIC_ARB_OBS0_CHNL17_CONFIG_ADDR A:0xe600884
y.create.l HWIO_PMIC_ARB_OBS0_CHNL18_CONFIG_ADDR A:0xe600904
y.create.l HWIO_PMIC_ARB_OBS0_CHNL19_CONFIG_ADDR A:0xe600984
y.create.l HWIO_PMIC_ARB_OBS0_CHNL20_CONFIG_ADDR A:0xe600a04
y.create.l HWIO_PMIC_ARB_OBS0_CHNL21_CONFIG_ADDR A:0xe600a84
y.create.l HWIO_PMIC_ARB_OBS0_CHNL22_CONFIG_ADDR A:0xe600b04
y.create.l HWIO_PMIC_ARB_OBS0_CHNL23_CONFIG_ADDR A:0xe600b84
y.create.l HWIO_PMIC_ARB_OBS0_CHNL24_CONFIG_ADDR A:0xe600c04
y.create.l HWIO_PMIC_ARB_OBS0_CHNL25_CONFIG_ADDR A:0xe600c84
y.create.l HWIO_PMIC_ARB_OBS0_CHNL26_CONFIG_ADDR A:0xe600d04
y.create.l HWIO_PMIC_ARB_OBS0_CHNL27_CONFIG_ADDR A:0xe600d84
y.create.l HWIO_PMIC_ARB_OBS0_CHNL28_CONFIG_ADDR A:0xe600e04
y.create.l HWIO_PMIC_ARB_OBS0_CHNL29_CONFIG_ADDR A:0xe600e84
y.create.l HWIO_PMIC_ARB_OBS0_CHNL30_CONFIG_ADDR A:0xe600f04
y.create.l HWIO_PMIC_ARB_OBS0_CHNL31_CONFIG_ADDR A:0xe600f84
y.create.l HWIO_PMIC_ARB_OBS0_CHNL32_CONFIG_ADDR A:0xe601004
y.create.l HWIO_PMIC_ARB_OBS0_CHNL33_CONFIG_ADDR A:0xe601084
y.create.l HWIO_PMIC_ARB_OBS0_CHNL34_CONFIG_ADDR A:0xe601104
y.create.l HWIO_PMIC_ARB_OBS0_CHNL35_CONFIG_ADDR A:0xe601184
y.create.l HWIO_PMIC_ARB_OBS0_CHNL36_CONFIG_ADDR A:0xe601204
y.create.l HWIO_PMIC_ARB_OBS0_CHNL37_CONFIG_ADDR A:0xe601284
y.create.l HWIO_PMIC_ARB_OBS0_CHNL38_CONFIG_ADDR A:0xe601304
y.create.l HWIO_PMIC_ARB_OBS0_CHNL39_CONFIG_ADDR A:0xe601384
y.create.l HWIO_PMIC_ARB_OBS0_CHNL40_CONFIG_ADDR A:0xe601404
y.create.l HWIO_PMIC_ARB_OBS0_CHNL41_CONFIG_ADDR A:0xe601484
y.create.l HWIO_PMIC_ARB_OBS0_CHNL42_CONFIG_ADDR A:0xe601504
y.create.l HWIO_PMIC_ARB_OBS0_CHNL43_CONFIG_ADDR A:0xe601584
y.create.l HWIO_PMIC_ARB_OBS0_CHNL44_CONFIG_ADDR A:0xe601604
y.create.l HWIO_PMIC_ARB_OBS0_CHNL45_CONFIG_ADDR A:0xe601684
y.create.l HWIO_PMIC_ARB_OBS0_CHNL46_CONFIG_ADDR A:0xe601704
y.create.l HWIO_PMIC_ARB_OBS0_CHNL47_CONFIG_ADDR A:0xe601784
y.create.l HWIO_PMIC_ARB_OBS0_CHNL48_CONFIG_ADDR A:0xe601804
y.create.l HWIO_PMIC_ARB_OBS0_CHNL49_CONFIG_ADDR A:0xe601884
y.create.l HWIO_PMIC_ARB_OBS0_CHNL50_CONFIG_ADDR A:0xe601904
y.create.l HWIO_PMIC_ARB_OBS0_CHNL51_CONFIG_ADDR A:0xe601984
y.create.l HWIO_PMIC_ARB_OBS0_CHNL52_CONFIG_ADDR A:0xe601a04
y.create.l HWIO_PMIC_ARB_OBS0_CHNL53_CONFIG_ADDR A:0xe601a84
y.create.l HWIO_PMIC_ARB_OBS0_CHNL54_CONFIG_ADDR A:0xe601b04
y.create.l HWIO_PMIC_ARB_OBS0_CHNL55_CONFIG_ADDR A:0xe601b84
y.create.l HWIO_PMIC_ARB_OBS0_CHNL56_CONFIG_ADDR A:0xe601c04
y.create.l HWIO_PMIC_ARB_OBS0_CHNL57_CONFIG_ADDR A:0xe601c84
y.create.l HWIO_PMIC_ARB_OBS0_CHNL58_CONFIG_ADDR A:0xe601d04
y.create.l HWIO_PMIC_ARB_OBS0_CHNL59_CONFIG_ADDR A:0xe601d84
y.create.l HWIO_PMIC_ARB_OBS0_CHNL60_CONFIG_ADDR A:0xe601e04
y.create.l HWIO_PMIC_ARB_OBS0_CHNL61_CONFIG_ADDR A:0xe601e84
y.create.l HWIO_PMIC_ARB_OBS0_CHNL62_CONFIG_ADDR A:0xe601f04
y.create.l HWIO_PMIC_ARB_OBS0_CHNL63_CONFIG_ADDR A:0xe601f84
y.create.l HWIO_PMIC_ARB_OBS0_CHNL64_CONFIG_ADDR A:0xe602004
y.create.l HWIO_PMIC_ARB_OBS0_CHNL65_CONFIG_ADDR A:0xe602084
y.create.l HWIO_PMIC_ARB_OBS0_CHNL66_CONFIG_ADDR A:0xe602104
y.create.l HWIO_PMIC_ARB_OBS0_CHNL67_CONFIG_ADDR A:0xe602184
y.create.l HWIO_PMIC_ARB_OBS0_CHNL68_CONFIG_ADDR A:0xe602204
y.create.l HWIO_PMIC_ARB_OBS0_CHNL69_CONFIG_ADDR A:0xe602284
y.create.l HWIO_PMIC_ARB_OBS0_CHNL70_CONFIG_ADDR A:0xe602304
y.create.l HWIO_PMIC_ARB_OBS0_CHNL71_CONFIG_ADDR A:0xe602384
y.create.l HWIO_PMIC_ARB_OBS0_CHNL72_CONFIG_ADDR A:0xe602404
y.create.l HWIO_PMIC_ARB_OBS0_CHNL73_CONFIG_ADDR A:0xe602484
y.create.l HWIO_PMIC_ARB_OBS0_CHNL74_CONFIG_ADDR A:0xe602504
y.create.l HWIO_PMIC_ARB_OBS0_CHNL75_CONFIG_ADDR A:0xe602584
y.create.l HWIO_PMIC_ARB_OBS0_CHNL76_CONFIG_ADDR A:0xe602604
y.create.l HWIO_PMIC_ARB_OBS0_CHNL77_CONFIG_ADDR A:0xe602684
y.create.l HWIO_PMIC_ARB_OBS0_CHNL78_CONFIG_ADDR A:0xe602704
y.create.l HWIO_PMIC_ARB_OBS0_CHNL79_CONFIG_ADDR A:0xe602784
y.create.l HWIO_PMIC_ARB_OBS0_CHNL80_CONFIG_ADDR A:0xe602804
y.create.l HWIO_PMIC_ARB_OBS0_CHNL81_CONFIG_ADDR A:0xe602884
y.create.l HWIO_PMIC_ARB_OBS0_CHNL82_CONFIG_ADDR A:0xe602904
y.create.l HWIO_PMIC_ARB_OBS0_CHNL83_CONFIG_ADDR A:0xe602984
y.create.l HWIO_PMIC_ARB_OBS0_CHNL84_CONFIG_ADDR A:0xe602a04
y.create.l HWIO_PMIC_ARB_OBS0_CHNL85_CONFIG_ADDR A:0xe602a84
y.create.l HWIO_PMIC_ARB_OBS0_CHNL86_CONFIG_ADDR A:0xe602b04
y.create.l HWIO_PMIC_ARB_OBS0_CHNL87_CONFIG_ADDR A:0xe602b84
y.create.l HWIO_PMIC_ARB_OBS0_CHNL88_CONFIG_ADDR A:0xe602c04
y.create.l HWIO_PMIC_ARB_OBS0_CHNL89_CONFIG_ADDR A:0xe602c84
y.create.l HWIO_PMIC_ARB_OBS0_CHNL90_CONFIG_ADDR A:0xe602d04
y.create.l HWIO_PMIC_ARB_OBS0_CHNL91_CONFIG_ADDR A:0xe602d84
y.create.l HWIO_PMIC_ARB_OBS0_CHNL92_CONFIG_ADDR A:0xe602e04
y.create.l HWIO_PMIC_ARB_OBS0_CHNL93_CONFIG_ADDR A:0xe602e84
y.create.l HWIO_PMIC_ARB_OBS0_CHNL94_CONFIG_ADDR A:0xe602f04
y.create.l HWIO_PMIC_ARB_OBS0_CHNL95_CONFIG_ADDR A:0xe602f84
y.create.l HWIO_PMIC_ARB_OBS0_CHNL96_CONFIG_ADDR A:0xe603004
y.create.l HWIO_PMIC_ARB_OBS0_CHNL97_CONFIG_ADDR A:0xe603084
y.create.l HWIO_PMIC_ARB_OBS0_CHNL98_CONFIG_ADDR A:0xe603104
y.create.l HWIO_PMIC_ARB_OBS0_CHNL99_CONFIG_ADDR A:0xe603184
y.create.l HWIO_PMIC_ARB_OBS0_CHNL100_CONFIG_ADDR A:0xe603204
y.create.l HWIO_PMIC_ARB_OBS0_CHNL101_CONFIG_ADDR A:0xe603284
y.create.l HWIO_PMIC_ARB_OBS0_CHNL102_CONFIG_ADDR A:0xe603304
y.create.l HWIO_PMIC_ARB_OBS0_CHNL103_CONFIG_ADDR A:0xe603384
y.create.l HWIO_PMIC_ARB_OBS0_CHNL104_CONFIG_ADDR A:0xe603404
y.create.l HWIO_PMIC_ARB_OBS0_CHNL105_CONFIG_ADDR A:0xe603484
y.create.l HWIO_PMIC_ARB_OBS0_CHNL106_CONFIG_ADDR A:0xe603504
y.create.l HWIO_PMIC_ARB_OBS0_CHNL107_CONFIG_ADDR A:0xe603584
y.create.l HWIO_PMIC_ARB_OBS0_CHNL108_CONFIG_ADDR A:0xe603604
y.create.l HWIO_PMIC_ARB_OBS0_CHNL109_CONFIG_ADDR A:0xe603684
y.create.l HWIO_PMIC_ARB_OBS0_CHNL110_CONFIG_ADDR A:0xe603704
y.create.l HWIO_PMIC_ARB_OBS0_CHNL111_CONFIG_ADDR A:0xe603784
y.create.l HWIO_PMIC_ARB_OBS0_CHNL112_CONFIG_ADDR A:0xe603804
y.create.l HWIO_PMIC_ARB_OBS0_CHNL113_CONFIG_ADDR A:0xe603884
y.create.l HWIO_PMIC_ARB_OBS0_CHNL114_CONFIG_ADDR A:0xe603904
y.create.l HWIO_PMIC_ARB_OBS0_CHNL115_CONFIG_ADDR A:0xe603984
y.create.l HWIO_PMIC_ARB_OBS0_CHNL116_CONFIG_ADDR A:0xe603a04
y.create.l HWIO_PMIC_ARB_OBS0_CHNL117_CONFIG_ADDR A:0xe603a84
y.create.l HWIO_PMIC_ARB_OBS0_CHNL118_CONFIG_ADDR A:0xe603b04
y.create.l HWIO_PMIC_ARB_OBS0_CHNL119_CONFIG_ADDR A:0xe603b84
y.create.l HWIO_PMIC_ARB_OBS0_CHNL120_CONFIG_ADDR A:0xe603c04
y.create.l HWIO_PMIC_ARB_OBS0_CHNL121_CONFIG_ADDR A:0xe603c84
y.create.l HWIO_PMIC_ARB_OBS0_CHNL122_CONFIG_ADDR A:0xe603d04
y.create.l HWIO_PMIC_ARB_OBS0_CHNL123_CONFIG_ADDR A:0xe603d84
y.create.l HWIO_PMIC_ARB_OBS0_CHNL124_CONFIG_ADDR A:0xe603e04
y.create.l HWIO_PMIC_ARB_OBS0_CHNL125_CONFIG_ADDR A:0xe603e84
y.create.l HWIO_PMIC_ARB_OBS0_CHNL126_CONFIG_ADDR A:0xe603f04
y.create.l HWIO_PMIC_ARB_OBS0_CHNL127_CONFIG_ADDR A:0xe603f84
y.create.l HWIO_PMIC_ARB_OBS0_CHNL128_CONFIG_ADDR A:0xe604004
y.create.l HWIO_PMIC_ARB_OBS0_CHNL129_CONFIG_ADDR A:0xe604084
y.create.l HWIO_PMIC_ARB_OBS0_CHNL130_CONFIG_ADDR A:0xe604104
y.create.l HWIO_PMIC_ARB_OBS0_CHNL131_CONFIG_ADDR A:0xe604184
y.create.l HWIO_PMIC_ARB_OBS0_CHNL132_CONFIG_ADDR A:0xe604204
y.create.l HWIO_PMIC_ARB_OBS0_CHNL133_CONFIG_ADDR A:0xe604284
y.create.l HWIO_PMIC_ARB_OBS0_CHNL134_CONFIG_ADDR A:0xe604304
y.create.l HWIO_PMIC_ARB_OBS0_CHNL135_CONFIG_ADDR A:0xe604384
y.create.l HWIO_PMIC_ARB_OBS0_CHNL136_CONFIG_ADDR A:0xe604404
y.create.l HWIO_PMIC_ARB_OBS0_CHNL137_CONFIG_ADDR A:0xe604484
y.create.l HWIO_PMIC_ARB_OBS0_CHNL138_CONFIG_ADDR A:0xe604504
y.create.l HWIO_PMIC_ARB_OBS0_CHNL139_CONFIG_ADDR A:0xe604584
y.create.l HWIO_PMIC_ARB_OBS0_CHNL140_CONFIG_ADDR A:0xe604604
y.create.l HWIO_PMIC_ARB_OBS0_CHNL141_CONFIG_ADDR A:0xe604684
y.create.l HWIO_PMIC_ARB_OBS0_CHNL142_CONFIG_ADDR A:0xe604704
y.create.l HWIO_PMIC_ARB_OBS0_CHNL143_CONFIG_ADDR A:0xe604784
y.create.l HWIO_PMIC_ARB_OBS0_CHNL144_CONFIG_ADDR A:0xe604804
y.create.l HWIO_PMIC_ARB_OBS0_CHNL145_CONFIG_ADDR A:0xe604884
y.create.l HWIO_PMIC_ARB_OBS0_CHNL146_CONFIG_ADDR A:0xe604904
y.create.l HWIO_PMIC_ARB_OBS0_CHNL147_CONFIG_ADDR A:0xe604984
y.create.l HWIO_PMIC_ARB_OBS0_CHNL148_CONFIG_ADDR A:0xe604a04
y.create.l HWIO_PMIC_ARB_OBS0_CHNL149_CONFIG_ADDR A:0xe604a84
y.create.l HWIO_PMIC_ARB_OBS0_CHNL150_CONFIG_ADDR A:0xe604b04
y.create.l HWIO_PMIC_ARB_OBS0_CHNL151_CONFIG_ADDR A:0xe604b84
y.create.l HWIO_PMIC_ARB_OBS0_CHNL152_CONFIG_ADDR A:0xe604c04
y.create.l HWIO_PMIC_ARB_OBS0_CHNL153_CONFIG_ADDR A:0xe604c84
y.create.l HWIO_PMIC_ARB_OBS0_CHNL154_CONFIG_ADDR A:0xe604d04
y.create.l HWIO_PMIC_ARB_OBS0_CHNL155_CONFIG_ADDR A:0xe604d84
y.create.l HWIO_PMIC_ARB_OBS0_CHNL156_CONFIG_ADDR A:0xe604e04
y.create.l HWIO_PMIC_ARB_OBS0_CHNL157_CONFIG_ADDR A:0xe604e84
y.create.l HWIO_PMIC_ARB_OBS0_CHNL158_CONFIG_ADDR A:0xe604f04
y.create.l HWIO_PMIC_ARB_OBS0_CHNL159_CONFIG_ADDR A:0xe604f84
y.create.l HWIO_PMIC_ARB_OBS0_CHNL160_CONFIG_ADDR A:0xe605004
y.create.l HWIO_PMIC_ARB_OBS0_CHNL161_CONFIG_ADDR A:0xe605084
y.create.l HWIO_PMIC_ARB_OBS0_CHNL162_CONFIG_ADDR A:0xe605104
y.create.l HWIO_PMIC_ARB_OBS0_CHNL163_CONFIG_ADDR A:0xe605184
y.create.l HWIO_PMIC_ARB_OBS0_CHNL164_CONFIG_ADDR A:0xe605204
y.create.l HWIO_PMIC_ARB_OBS0_CHNL165_CONFIG_ADDR A:0xe605284
y.create.l HWIO_PMIC_ARB_OBS0_CHNL166_CONFIG_ADDR A:0xe605304
y.create.l HWIO_PMIC_ARB_OBS0_CHNL167_CONFIG_ADDR A:0xe605384
y.create.l HWIO_PMIC_ARB_OBS0_CHNL168_CONFIG_ADDR A:0xe605404
y.create.l HWIO_PMIC_ARB_OBS0_CHNL169_CONFIG_ADDR A:0xe605484
y.create.l HWIO_PMIC_ARB_OBS0_CHNL170_CONFIG_ADDR A:0xe605504
y.create.l HWIO_PMIC_ARB_OBS0_CHNL171_CONFIG_ADDR A:0xe605584
y.create.l HWIO_PMIC_ARB_OBS0_CHNL172_CONFIG_ADDR A:0xe605604
y.create.l HWIO_PMIC_ARB_OBS0_CHNL173_CONFIG_ADDR A:0xe605684
y.create.l HWIO_PMIC_ARB_OBS0_CHNL174_CONFIG_ADDR A:0xe605704
y.create.l HWIO_PMIC_ARB_OBS0_CHNL175_CONFIG_ADDR A:0xe605784
y.create.l HWIO_PMIC_ARB_OBS0_CHNL176_CONFIG_ADDR A:0xe605804
y.create.l HWIO_PMIC_ARB_OBS0_CHNL177_CONFIG_ADDR A:0xe605884
y.create.l HWIO_PMIC_ARB_OBS0_CHNL178_CONFIG_ADDR A:0xe605904
y.create.l HWIO_PMIC_ARB_OBS0_CHNL179_CONFIG_ADDR A:0xe605984
y.create.l HWIO_PMIC_ARB_OBS0_CHNL180_CONFIG_ADDR A:0xe605a04
y.create.l HWIO_PMIC_ARB_OBS0_CHNL181_CONFIG_ADDR A:0xe605a84
y.create.l HWIO_PMIC_ARB_OBS0_CHNL182_CONFIG_ADDR A:0xe605b04
y.create.l HWIO_PMIC_ARB_OBS0_CHNL183_CONFIG_ADDR A:0xe605b84
y.create.l HWIO_PMIC_ARB_OBS0_CHNL184_CONFIG_ADDR A:0xe605c04
y.create.l HWIO_PMIC_ARB_OBS0_CHNL185_CONFIG_ADDR A:0xe605c84
y.create.l HWIO_PMIC_ARB_OBS0_CHNL186_CONFIG_ADDR A:0xe605d04
y.create.l HWIO_PMIC_ARB_OBS0_CHNL187_CONFIG_ADDR A:0xe605d84
y.create.l HWIO_PMIC_ARB_OBS0_CHNL188_CONFIG_ADDR A:0xe605e04
y.create.l HWIO_PMIC_ARB_OBS0_CHNL189_CONFIG_ADDR A:0xe605e84
y.create.l HWIO_PMIC_ARB_OBS0_CHNL190_CONFIG_ADDR A:0xe605f04
y.create.l HWIO_PMIC_ARB_OBS0_CHNL191_CONFIG_ADDR A:0xe605f84
y.create.l HWIO_PMIC_ARB_OBS0_CHNL192_CONFIG_ADDR A:0xe606004
y.create.l HWIO_PMIC_ARB_OBS0_CHNL193_CONFIG_ADDR A:0xe606084
y.create.l HWIO_PMIC_ARB_OBS0_CHNL194_CONFIG_ADDR A:0xe606104
y.create.l HWIO_PMIC_ARB_OBS0_CHNL195_CONFIG_ADDR A:0xe606184
y.create.l HWIO_PMIC_ARB_OBS0_CHNL196_CONFIG_ADDR A:0xe606204
y.create.l HWIO_PMIC_ARB_OBS0_CHNL197_CONFIG_ADDR A:0xe606284
y.create.l HWIO_PMIC_ARB_OBS0_CHNL198_CONFIG_ADDR A:0xe606304
y.create.l HWIO_PMIC_ARB_OBS0_CHNL199_CONFIG_ADDR A:0xe606384
y.create.l HWIO_PMIC_ARB_OBS0_CHNL200_CONFIG_ADDR A:0xe606404
y.create.l HWIO_PMIC_ARB_OBS0_CHNL201_CONFIG_ADDR A:0xe606484
y.create.l HWIO_PMIC_ARB_OBS0_CHNL202_CONFIG_ADDR A:0xe606504
y.create.l HWIO_PMIC_ARB_OBS0_CHNL203_CONFIG_ADDR A:0xe606584
y.create.l HWIO_PMIC_ARB_OBS0_CHNL204_CONFIG_ADDR A:0xe606604
y.create.l HWIO_PMIC_ARB_OBS0_CHNL205_CONFIG_ADDR A:0xe606684
y.create.l HWIO_PMIC_ARB_OBS0_CHNL206_CONFIG_ADDR A:0xe606704
y.create.l HWIO_PMIC_ARB_OBS0_CHNL207_CONFIG_ADDR A:0xe606784
y.create.l HWIO_PMIC_ARB_OBS0_CHNL208_CONFIG_ADDR A:0xe606804
y.create.l HWIO_PMIC_ARB_OBS0_CHNL209_CONFIG_ADDR A:0xe606884
y.create.l HWIO_PMIC_ARB_OBS0_CHNL210_CONFIG_ADDR A:0xe606904
y.create.l HWIO_PMIC_ARB_OBS0_CHNL211_CONFIG_ADDR A:0xe606984
y.create.l HWIO_PMIC_ARB_OBS0_CHNL212_CONFIG_ADDR A:0xe606a04
y.create.l HWIO_PMIC_ARB_OBS0_CHNL213_CONFIG_ADDR A:0xe606a84
y.create.l HWIO_PMIC_ARB_OBS0_CHNL214_CONFIG_ADDR A:0xe606b04
y.create.l HWIO_PMIC_ARB_OBS0_CHNL215_CONFIG_ADDR A:0xe606b84
y.create.l HWIO_PMIC_ARB_OBS0_CHNL216_CONFIG_ADDR A:0xe606c04
y.create.l HWIO_PMIC_ARB_OBS0_CHNL217_CONFIG_ADDR A:0xe606c84
y.create.l HWIO_PMIC_ARB_OBS0_CHNL218_CONFIG_ADDR A:0xe606d04
y.create.l HWIO_PMIC_ARB_OBS0_CHNL219_CONFIG_ADDR A:0xe606d84
y.create.l HWIO_PMIC_ARB_OBS0_CHNL220_CONFIG_ADDR A:0xe606e04
y.create.l HWIO_PMIC_ARB_OBS0_CHNL221_CONFIG_ADDR A:0xe606e84
y.create.l HWIO_PMIC_ARB_OBS0_CHNL222_CONFIG_ADDR A:0xe606f04
y.create.l HWIO_PMIC_ARB_OBS0_CHNL223_CONFIG_ADDR A:0xe606f84
y.create.l HWIO_PMIC_ARB_OBS0_CHNL224_CONFIG_ADDR A:0xe607004
y.create.l HWIO_PMIC_ARB_OBS0_CHNL225_CONFIG_ADDR A:0xe607084
y.create.l HWIO_PMIC_ARB_OBS0_CHNL226_CONFIG_ADDR A:0xe607104
y.create.l HWIO_PMIC_ARB_OBS0_CHNL227_CONFIG_ADDR A:0xe607184
y.create.l HWIO_PMIC_ARB_OBS0_CHNL228_CONFIG_ADDR A:0xe607204
y.create.l HWIO_PMIC_ARB_OBS0_CHNL229_CONFIG_ADDR A:0xe607284
y.create.l HWIO_PMIC_ARB_OBS0_CHNL230_CONFIG_ADDR A:0xe607304
y.create.l HWIO_PMIC_ARB_OBS0_CHNL231_CONFIG_ADDR A:0xe607384
y.create.l HWIO_PMIC_ARB_OBS0_CHNL232_CONFIG_ADDR A:0xe607404
y.create.l HWIO_PMIC_ARB_OBS0_CHNL233_CONFIG_ADDR A:0xe607484
y.create.l HWIO_PMIC_ARB_OBS0_CHNL234_CONFIG_ADDR A:0xe607504
y.create.l HWIO_PMIC_ARB_OBS0_CHNL235_CONFIG_ADDR A:0xe607584
y.create.l HWIO_PMIC_ARB_OBS0_CHNL236_CONFIG_ADDR A:0xe607604
y.create.l HWIO_PMIC_ARB_OBS0_CHNL237_CONFIG_ADDR A:0xe607684
y.create.l HWIO_PMIC_ARB_OBS0_CHNL238_CONFIG_ADDR A:0xe607704
y.create.l HWIO_PMIC_ARB_OBS0_CHNL239_CONFIG_ADDR A:0xe607784
y.create.l HWIO_PMIC_ARB_OBS0_CHNL240_CONFIG_ADDR A:0xe607804
y.create.l HWIO_PMIC_ARB_OBS0_CHNL241_CONFIG_ADDR A:0xe607884
y.create.l HWIO_PMIC_ARB_OBS0_CHNL242_CONFIG_ADDR A:0xe607904
y.create.l HWIO_PMIC_ARB_OBS0_CHNL243_CONFIG_ADDR A:0xe607984
y.create.l HWIO_PMIC_ARB_OBS0_CHNL244_CONFIG_ADDR A:0xe607a04
y.create.l HWIO_PMIC_ARB_OBS0_CHNL245_CONFIG_ADDR A:0xe607a84
y.create.l HWIO_PMIC_ARB_OBS0_CHNL246_CONFIG_ADDR A:0xe607b04
y.create.l HWIO_PMIC_ARB_OBS0_CHNL247_CONFIG_ADDR A:0xe607b84
y.create.l HWIO_PMIC_ARB_OBS0_CHNL248_CONFIG_ADDR A:0xe607c04
y.create.l HWIO_PMIC_ARB_OBS0_CHNL249_CONFIG_ADDR A:0xe607c84
y.create.l HWIO_PMIC_ARB_OBS0_CHNL250_CONFIG_ADDR A:0xe607d04
y.create.l HWIO_PMIC_ARB_OBS0_CHNL251_CONFIG_ADDR A:0xe607d84
y.create.l HWIO_PMIC_ARB_OBS0_CHNL252_CONFIG_ADDR A:0xe607e04
y.create.l HWIO_PMIC_ARB_OBS0_CHNL253_CONFIG_ADDR A:0xe607e84
y.create.l HWIO_PMIC_ARB_OBS0_CHNL254_CONFIG_ADDR A:0xe607f04
y.create.l HWIO_PMIC_ARB_OBS0_CHNL255_CONFIG_ADDR A:0xe607f84
y.create.l HWIO_PMIC_ARB_OBS0_CHNL256_CONFIG_ADDR A:0xe608004
y.create.l HWIO_PMIC_ARB_OBS0_CHNL257_CONFIG_ADDR A:0xe608084
y.create.l HWIO_PMIC_ARB_OBS0_CHNL258_CONFIG_ADDR A:0xe608104
y.create.l HWIO_PMIC_ARB_OBS0_CHNL259_CONFIG_ADDR A:0xe608184
y.create.l HWIO_PMIC_ARB_OBS0_CHNL260_CONFIG_ADDR A:0xe608204
y.create.l HWIO_PMIC_ARB_OBS0_CHNL261_CONFIG_ADDR A:0xe608284
y.create.l HWIO_PMIC_ARB_OBS0_CHNL262_CONFIG_ADDR A:0xe608304
y.create.l HWIO_PMIC_ARB_OBS0_CHNL263_CONFIG_ADDR A:0xe608384
y.create.l HWIO_PMIC_ARB_OBS0_CHNL264_CONFIG_ADDR A:0xe608404
y.create.l HWIO_PMIC_ARB_OBS0_CHNL265_CONFIG_ADDR A:0xe608484
y.create.l HWIO_PMIC_ARB_OBS0_CHNL266_CONFIG_ADDR A:0xe608504
y.create.l HWIO_PMIC_ARB_OBS0_CHNL267_CONFIG_ADDR A:0xe608584
y.create.l HWIO_PMIC_ARB_OBS0_CHNL268_CONFIG_ADDR A:0xe608604
y.create.l HWIO_PMIC_ARB_OBS0_CHNL269_CONFIG_ADDR A:0xe608684
y.create.l HWIO_PMIC_ARB_OBS0_CHNL270_CONFIG_ADDR A:0xe608704
y.create.l HWIO_PMIC_ARB_OBS0_CHNL271_CONFIG_ADDR A:0xe608784
y.create.l HWIO_PMIC_ARB_OBS0_CHNL272_CONFIG_ADDR A:0xe608804
y.create.l HWIO_PMIC_ARB_OBS0_CHNL273_CONFIG_ADDR A:0xe608884
y.create.l HWIO_PMIC_ARB_OBS0_CHNL274_CONFIG_ADDR A:0xe608904
y.create.l HWIO_PMIC_ARB_OBS0_CHNL275_CONFIG_ADDR A:0xe608984
y.create.l HWIO_PMIC_ARB_OBS0_CHNL276_CONFIG_ADDR A:0xe608a04
y.create.l HWIO_PMIC_ARB_OBS0_CHNL277_CONFIG_ADDR A:0xe608a84
y.create.l HWIO_PMIC_ARB_OBS0_CHNL278_CONFIG_ADDR A:0xe608b04
y.create.l HWIO_PMIC_ARB_OBS0_CHNL279_CONFIG_ADDR A:0xe608b84
y.create.l HWIO_PMIC_ARB_OBS0_CHNL280_CONFIG_ADDR A:0xe608c04
y.create.l HWIO_PMIC_ARB_OBS0_CHNL281_CONFIG_ADDR A:0xe608c84
y.create.l HWIO_PMIC_ARB_OBS0_CHNL282_CONFIG_ADDR A:0xe608d04
y.create.l HWIO_PMIC_ARB_OBS0_CHNL283_CONFIG_ADDR A:0xe608d84
y.create.l HWIO_PMIC_ARB_OBS0_CHNL284_CONFIG_ADDR A:0xe608e04
y.create.l HWIO_PMIC_ARB_OBS0_CHNL285_CONFIG_ADDR A:0xe608e84
y.create.l HWIO_PMIC_ARB_OBS0_CHNL286_CONFIG_ADDR A:0xe608f04
y.create.l HWIO_PMIC_ARB_OBS0_CHNL287_CONFIG_ADDR A:0xe608f84
y.create.l HWIO_PMIC_ARB_OBS0_CHNL288_CONFIG_ADDR A:0xe609004
y.create.l HWIO_PMIC_ARB_OBS0_CHNL289_CONFIG_ADDR A:0xe609084
y.create.l HWIO_PMIC_ARB_OBS0_CHNL290_CONFIG_ADDR A:0xe609104
y.create.l HWIO_PMIC_ARB_OBS0_CHNL291_CONFIG_ADDR A:0xe609184
y.create.l HWIO_PMIC_ARB_OBS0_CHNL292_CONFIG_ADDR A:0xe609204
y.create.l HWIO_PMIC_ARB_OBS0_CHNL293_CONFIG_ADDR A:0xe609284
y.create.l HWIO_PMIC_ARB_OBS0_CHNL294_CONFIG_ADDR A:0xe609304
y.create.l HWIO_PMIC_ARB_OBS0_CHNL295_CONFIG_ADDR A:0xe609384
y.create.l HWIO_PMIC_ARB_OBS0_CHNL296_CONFIG_ADDR A:0xe609404
y.create.l HWIO_PMIC_ARB_OBS0_CHNL297_CONFIG_ADDR A:0xe609484
y.create.l HWIO_PMIC_ARB_OBS0_CHNL298_CONFIG_ADDR A:0xe609504
y.create.l HWIO_PMIC_ARB_OBS0_CHNL299_CONFIG_ADDR A:0xe609584
y.create.l HWIO_PMIC_ARB_OBS0_CHNL300_CONFIG_ADDR A:0xe609604
y.create.l HWIO_PMIC_ARB_OBS0_CHNL301_CONFIG_ADDR A:0xe609684
y.create.l HWIO_PMIC_ARB_OBS0_CHNL302_CONFIG_ADDR A:0xe609704
y.create.l HWIO_PMIC_ARB_OBS0_CHNL303_CONFIG_ADDR A:0xe609784
y.create.l HWIO_PMIC_ARB_OBS0_CHNL304_CONFIG_ADDR A:0xe609804
y.create.l HWIO_PMIC_ARB_OBS0_CHNL305_CONFIG_ADDR A:0xe609884
y.create.l HWIO_PMIC_ARB_OBS0_CHNL306_CONFIG_ADDR A:0xe609904
y.create.l HWIO_PMIC_ARB_OBS0_CHNL307_CONFIG_ADDR A:0xe609984
y.create.l HWIO_PMIC_ARB_OBS0_CHNL308_CONFIG_ADDR A:0xe609a04
y.create.l HWIO_PMIC_ARB_OBS0_CHNL309_CONFIG_ADDR A:0xe609a84
y.create.l HWIO_PMIC_ARB_OBS0_CHNL310_CONFIG_ADDR A:0xe609b04
y.create.l HWIO_PMIC_ARB_OBS0_CHNL311_CONFIG_ADDR A:0xe609b84
y.create.l HWIO_PMIC_ARB_OBS0_CHNL312_CONFIG_ADDR A:0xe609c04
y.create.l HWIO_PMIC_ARB_OBS0_CHNL313_CONFIG_ADDR A:0xe609c84
y.create.l HWIO_PMIC_ARB_OBS0_CHNL314_CONFIG_ADDR A:0xe609d04
y.create.l HWIO_PMIC_ARB_OBS0_CHNL315_CONFIG_ADDR A:0xe609d84
y.create.l HWIO_PMIC_ARB_OBS0_CHNL316_CONFIG_ADDR A:0xe609e04
y.create.l HWIO_PMIC_ARB_OBS0_CHNL317_CONFIG_ADDR A:0xe609e84
y.create.l HWIO_PMIC_ARB_OBS0_CHNL318_CONFIG_ADDR A:0xe609f04
y.create.l HWIO_PMIC_ARB_OBS0_CHNL319_CONFIG_ADDR A:0xe609f84
y.create.l HWIO_PMIC_ARB_OBS0_CHNL320_CONFIG_ADDR A:0xe60a004
y.create.l HWIO_PMIC_ARB_OBS0_CHNL321_CONFIG_ADDR A:0xe60a084
y.create.l HWIO_PMIC_ARB_OBS0_CHNL322_CONFIG_ADDR A:0xe60a104
y.create.l HWIO_PMIC_ARB_OBS0_CHNL323_CONFIG_ADDR A:0xe60a184
y.create.l HWIO_PMIC_ARB_OBS0_CHNL324_CONFIG_ADDR A:0xe60a204
y.create.l HWIO_PMIC_ARB_OBS0_CHNL325_CONFIG_ADDR A:0xe60a284
y.create.l HWIO_PMIC_ARB_OBS0_CHNL326_CONFIG_ADDR A:0xe60a304
y.create.l HWIO_PMIC_ARB_OBS0_CHNL327_CONFIG_ADDR A:0xe60a384
y.create.l HWIO_PMIC_ARB_OBS0_CHNL328_CONFIG_ADDR A:0xe60a404
y.create.l HWIO_PMIC_ARB_OBS0_CHNL329_CONFIG_ADDR A:0xe60a484
y.create.l HWIO_PMIC_ARB_OBS0_CHNL330_CONFIG_ADDR A:0xe60a504
y.create.l HWIO_PMIC_ARB_OBS0_CHNL331_CONFIG_ADDR A:0xe60a584
y.create.l HWIO_PMIC_ARB_OBS0_CHNL332_CONFIG_ADDR A:0xe60a604
y.create.l HWIO_PMIC_ARB_OBS0_CHNL333_CONFIG_ADDR A:0xe60a684
y.create.l HWIO_PMIC_ARB_OBS0_CHNL334_CONFIG_ADDR A:0xe60a704
y.create.l HWIO_PMIC_ARB_OBS0_CHNL335_CONFIG_ADDR A:0xe60a784
y.create.l HWIO_PMIC_ARB_OBS0_CHNL336_CONFIG_ADDR A:0xe60a804
y.create.l HWIO_PMIC_ARB_OBS0_CHNL337_CONFIG_ADDR A:0xe60a884
y.create.l HWIO_PMIC_ARB_OBS0_CHNL338_CONFIG_ADDR A:0xe60a904
y.create.l HWIO_PMIC_ARB_OBS0_CHNL339_CONFIG_ADDR A:0xe60a984
y.create.l HWIO_PMIC_ARB_OBS0_CHNL340_CONFIG_ADDR A:0xe60aa04
y.create.l HWIO_PMIC_ARB_OBS0_CHNL341_CONFIG_ADDR A:0xe60aa84
y.create.l HWIO_PMIC_ARB_OBS0_CHNL342_CONFIG_ADDR A:0xe60ab04
y.create.l HWIO_PMIC_ARB_OBS0_CHNL343_CONFIG_ADDR A:0xe60ab84
y.create.l HWIO_PMIC_ARB_OBS0_CHNL344_CONFIG_ADDR A:0xe60ac04
y.create.l HWIO_PMIC_ARB_OBS0_CHNL345_CONFIG_ADDR A:0xe60ac84
y.create.l HWIO_PMIC_ARB_OBS0_CHNL346_CONFIG_ADDR A:0xe60ad04
y.create.l HWIO_PMIC_ARB_OBS0_CHNL347_CONFIG_ADDR A:0xe60ad84
y.create.l HWIO_PMIC_ARB_OBS0_CHNL348_CONFIG_ADDR A:0xe60ae04
y.create.l HWIO_PMIC_ARB_OBS0_CHNL349_CONFIG_ADDR A:0xe60ae84
y.create.l HWIO_PMIC_ARB_OBS0_CHNL350_CONFIG_ADDR A:0xe60af04
y.create.l HWIO_PMIC_ARB_OBS0_CHNL351_CONFIG_ADDR A:0xe60af84
y.create.l HWIO_PMIC_ARB_OBS0_CHNL352_CONFIG_ADDR A:0xe60b004
y.create.l HWIO_PMIC_ARB_OBS0_CHNL353_CONFIG_ADDR A:0xe60b084
y.create.l HWIO_PMIC_ARB_OBS0_CHNL354_CONFIG_ADDR A:0xe60b104
y.create.l HWIO_PMIC_ARB_OBS0_CHNL355_CONFIG_ADDR A:0xe60b184
y.create.l HWIO_PMIC_ARB_OBS0_CHNL356_CONFIG_ADDR A:0xe60b204
y.create.l HWIO_PMIC_ARB_OBS0_CHNL357_CONFIG_ADDR A:0xe60b284
y.create.l HWIO_PMIC_ARB_OBS0_CHNL358_CONFIG_ADDR A:0xe60b304
y.create.l HWIO_PMIC_ARB_OBS0_CHNL359_CONFIG_ADDR A:0xe60b384
y.create.l HWIO_PMIC_ARB_OBS0_CHNL360_CONFIG_ADDR A:0xe60b404
y.create.l HWIO_PMIC_ARB_OBS0_CHNL361_CONFIG_ADDR A:0xe60b484
y.create.l HWIO_PMIC_ARB_OBS0_CHNL362_CONFIG_ADDR A:0xe60b504
y.create.l HWIO_PMIC_ARB_OBS0_CHNL363_CONFIG_ADDR A:0xe60b584
y.create.l HWIO_PMIC_ARB_OBS0_CHNL364_CONFIG_ADDR A:0xe60b604
y.create.l HWIO_PMIC_ARB_OBS0_CHNL365_CONFIG_ADDR A:0xe60b684
y.create.l HWIO_PMIC_ARB_OBS0_CHNL366_CONFIG_ADDR A:0xe60b704
y.create.l HWIO_PMIC_ARB_OBS0_CHNL367_CONFIG_ADDR A:0xe60b784
y.create.l HWIO_PMIC_ARB_OBS0_CHNL368_CONFIG_ADDR A:0xe60b804
y.create.l HWIO_PMIC_ARB_OBS0_CHNL369_CONFIG_ADDR A:0xe60b884
y.create.l HWIO_PMIC_ARB_OBS0_CHNL370_CONFIG_ADDR A:0xe60b904
y.create.l HWIO_PMIC_ARB_OBS0_CHNL371_CONFIG_ADDR A:0xe60b984
y.create.l HWIO_PMIC_ARB_OBS0_CHNL372_CONFIG_ADDR A:0xe60ba04
y.create.l HWIO_PMIC_ARB_OBS0_CHNL373_CONFIG_ADDR A:0xe60ba84
y.create.l HWIO_PMIC_ARB_OBS0_CHNL374_CONFIG_ADDR A:0xe60bb04
y.create.l HWIO_PMIC_ARB_OBS0_CHNL375_CONFIG_ADDR A:0xe60bb84
y.create.l HWIO_PMIC_ARB_OBS0_CHNL376_CONFIG_ADDR A:0xe60bc04
y.create.l HWIO_PMIC_ARB_OBS0_CHNL377_CONFIG_ADDR A:0xe60bc84
y.create.l HWIO_PMIC_ARB_OBS0_CHNL378_CONFIG_ADDR A:0xe60bd04
y.create.l HWIO_PMIC_ARB_OBS0_CHNL379_CONFIG_ADDR A:0xe60bd84
y.create.l HWIO_PMIC_ARB_OBS0_CHNL380_CONFIG_ADDR A:0xe60be04
y.create.l HWIO_PMIC_ARB_OBS0_CHNL381_CONFIG_ADDR A:0xe60be84
y.create.l HWIO_PMIC_ARB_OBS0_CHNL382_CONFIG_ADDR A:0xe60bf04
y.create.l HWIO_PMIC_ARB_OBS0_CHNL383_CONFIG_ADDR A:0xe60bf84
y.create.l HWIO_PMIC_ARB_OBS0_CHNL384_CONFIG_ADDR A:0xe60c004
y.create.l HWIO_PMIC_ARB_OBS0_CHNL385_CONFIG_ADDR A:0xe60c084
y.create.l HWIO_PMIC_ARB_OBS0_CHNL386_CONFIG_ADDR A:0xe60c104
y.create.l HWIO_PMIC_ARB_OBS0_CHNL387_CONFIG_ADDR A:0xe60c184
y.create.l HWIO_PMIC_ARB_OBS0_CHNL388_CONFIG_ADDR A:0xe60c204
y.create.l HWIO_PMIC_ARB_OBS0_CHNL389_CONFIG_ADDR A:0xe60c284
y.create.l HWIO_PMIC_ARB_OBS0_CHNL390_CONFIG_ADDR A:0xe60c304
y.create.l HWIO_PMIC_ARB_OBS0_CHNL391_CONFIG_ADDR A:0xe60c384
y.create.l HWIO_PMIC_ARB_OBS0_CHNL392_CONFIG_ADDR A:0xe60c404
y.create.l HWIO_PMIC_ARB_OBS0_CHNL393_CONFIG_ADDR A:0xe60c484
y.create.l HWIO_PMIC_ARB_OBS0_CHNL394_CONFIG_ADDR A:0xe60c504
y.create.l HWIO_PMIC_ARB_OBS0_CHNL395_CONFIG_ADDR A:0xe60c584
y.create.l HWIO_PMIC_ARB_OBS0_CHNL396_CONFIG_ADDR A:0xe60c604
y.create.l HWIO_PMIC_ARB_OBS0_CHNL397_CONFIG_ADDR A:0xe60c684
y.create.l HWIO_PMIC_ARB_OBS0_CHNL398_CONFIG_ADDR A:0xe60c704
y.create.l HWIO_PMIC_ARB_OBS0_CHNL399_CONFIG_ADDR A:0xe60c784
y.create.l HWIO_PMIC_ARB_OBS0_CHNL400_CONFIG_ADDR A:0xe60c804
y.create.l HWIO_PMIC_ARB_OBS0_CHNL401_CONFIG_ADDR A:0xe60c884
y.create.l HWIO_PMIC_ARB_OBS0_CHNL402_CONFIG_ADDR A:0xe60c904
y.create.l HWIO_PMIC_ARB_OBS0_CHNL403_CONFIG_ADDR A:0xe60c984
y.create.l HWIO_PMIC_ARB_OBS0_CHNL404_CONFIG_ADDR A:0xe60ca04
y.create.l HWIO_PMIC_ARB_OBS0_CHNL405_CONFIG_ADDR A:0xe60ca84
y.create.l HWIO_PMIC_ARB_OBS0_CHNL406_CONFIG_ADDR A:0xe60cb04
y.create.l HWIO_PMIC_ARB_OBS0_CHNL407_CONFIG_ADDR A:0xe60cb84
y.create.l HWIO_PMIC_ARB_OBS0_CHNL408_CONFIG_ADDR A:0xe60cc04
y.create.l HWIO_PMIC_ARB_OBS0_CHNL409_CONFIG_ADDR A:0xe60cc84
y.create.l HWIO_PMIC_ARB_OBS0_CHNL410_CONFIG_ADDR A:0xe60cd04
y.create.l HWIO_PMIC_ARB_OBS0_CHNL411_CONFIG_ADDR A:0xe60cd84
y.create.l HWIO_PMIC_ARB_OBS0_CHNL412_CONFIG_ADDR A:0xe60ce04
y.create.l HWIO_PMIC_ARB_OBS0_CHNL413_CONFIG_ADDR A:0xe60ce84
y.create.l HWIO_PMIC_ARB_OBS0_CHNL414_CONFIG_ADDR A:0xe60cf04
y.create.l HWIO_PMIC_ARB_OBS0_CHNL415_CONFIG_ADDR A:0xe60cf84
y.create.l HWIO_PMIC_ARB_OBS0_CHNL416_CONFIG_ADDR A:0xe60d004
y.create.l HWIO_PMIC_ARB_OBS0_CHNL417_CONFIG_ADDR A:0xe60d084
y.create.l HWIO_PMIC_ARB_OBS0_CHNL418_CONFIG_ADDR A:0xe60d104
y.create.l HWIO_PMIC_ARB_OBS0_CHNL419_CONFIG_ADDR A:0xe60d184
y.create.l HWIO_PMIC_ARB_OBS0_CHNL420_CONFIG_ADDR A:0xe60d204
y.create.l HWIO_PMIC_ARB_OBS0_CHNL421_CONFIG_ADDR A:0xe60d284
y.create.l HWIO_PMIC_ARB_OBS0_CHNL422_CONFIG_ADDR A:0xe60d304
y.create.l HWIO_PMIC_ARB_OBS0_CHNL423_CONFIG_ADDR A:0xe60d384
y.create.l HWIO_PMIC_ARB_OBS0_CHNL424_CONFIG_ADDR A:0xe60d404
y.create.l HWIO_PMIC_ARB_OBS0_CHNL425_CONFIG_ADDR A:0xe60d484
y.create.l HWIO_PMIC_ARB_OBS0_CHNL426_CONFIG_ADDR A:0xe60d504
y.create.l HWIO_PMIC_ARB_OBS0_CHNL427_CONFIG_ADDR A:0xe60d584
y.create.l HWIO_PMIC_ARB_OBS0_CHNL428_CONFIG_ADDR A:0xe60d604
y.create.l HWIO_PMIC_ARB_OBS0_CHNL429_CONFIG_ADDR A:0xe60d684
y.create.l HWIO_PMIC_ARB_OBS0_CHNL430_CONFIG_ADDR A:0xe60d704
y.create.l HWIO_PMIC_ARB_OBS0_CHNL431_CONFIG_ADDR A:0xe60d784
y.create.l HWIO_PMIC_ARB_OBS0_CHNL432_CONFIG_ADDR A:0xe60d804
y.create.l HWIO_PMIC_ARB_OBS0_CHNL433_CONFIG_ADDR A:0xe60d884
y.create.l HWIO_PMIC_ARB_OBS0_CHNL434_CONFIG_ADDR A:0xe60d904
y.create.l HWIO_PMIC_ARB_OBS0_CHNL435_CONFIG_ADDR A:0xe60d984
y.create.l HWIO_PMIC_ARB_OBS0_CHNL436_CONFIG_ADDR A:0xe60da04
y.create.l HWIO_PMIC_ARB_OBS0_CHNL437_CONFIG_ADDR A:0xe60da84
y.create.l HWIO_PMIC_ARB_OBS0_CHNL438_CONFIG_ADDR A:0xe60db04
y.create.l HWIO_PMIC_ARB_OBS0_CHNL439_CONFIG_ADDR A:0xe60db84
y.create.l HWIO_PMIC_ARB_OBS0_CHNL440_CONFIG_ADDR A:0xe60dc04
y.create.l HWIO_PMIC_ARB_OBS0_CHNL441_CONFIG_ADDR A:0xe60dc84
y.create.l HWIO_PMIC_ARB_OBS0_CHNL442_CONFIG_ADDR A:0xe60dd04
y.create.l HWIO_PMIC_ARB_OBS0_CHNL443_CONFIG_ADDR A:0xe60dd84
y.create.l HWIO_PMIC_ARB_OBS0_CHNL444_CONFIG_ADDR A:0xe60de04
y.create.l HWIO_PMIC_ARB_OBS0_CHNL445_CONFIG_ADDR A:0xe60de84
y.create.l HWIO_PMIC_ARB_OBS0_CHNL446_CONFIG_ADDR A:0xe60df04
y.create.l HWIO_PMIC_ARB_OBS0_CHNL447_CONFIG_ADDR A:0xe60df84
y.create.l HWIO_PMIC_ARB_OBS0_CHNL448_CONFIG_ADDR A:0xe60e004
y.create.l HWIO_PMIC_ARB_OBS0_CHNL449_CONFIG_ADDR A:0xe60e084
y.create.l HWIO_PMIC_ARB_OBS0_CHNL450_CONFIG_ADDR A:0xe60e104
y.create.l HWIO_PMIC_ARB_OBS0_CHNL451_CONFIG_ADDR A:0xe60e184
y.create.l HWIO_PMIC_ARB_OBS0_CHNL452_CONFIG_ADDR A:0xe60e204
y.create.l HWIO_PMIC_ARB_OBS0_CHNL453_CONFIG_ADDR A:0xe60e284
y.create.l HWIO_PMIC_ARB_OBS0_CHNL454_CONFIG_ADDR A:0xe60e304
y.create.l HWIO_PMIC_ARB_OBS0_CHNL455_CONFIG_ADDR A:0xe60e384
y.create.l HWIO_PMIC_ARB_OBS0_CHNL456_CONFIG_ADDR A:0xe60e404
y.create.l HWIO_PMIC_ARB_OBS0_CHNL457_CONFIG_ADDR A:0xe60e484
y.create.l HWIO_PMIC_ARB_OBS0_CHNL458_CONFIG_ADDR A:0xe60e504
y.create.l HWIO_PMIC_ARB_OBS0_CHNL459_CONFIG_ADDR A:0xe60e584
y.create.l HWIO_PMIC_ARB_OBS0_CHNL460_CONFIG_ADDR A:0xe60e604
y.create.l HWIO_PMIC_ARB_OBS0_CHNL461_CONFIG_ADDR A:0xe60e684
y.create.l HWIO_PMIC_ARB_OBS0_CHNL462_CONFIG_ADDR A:0xe60e704
y.create.l HWIO_PMIC_ARB_OBS0_CHNL463_CONFIG_ADDR A:0xe60e784
y.create.l HWIO_PMIC_ARB_OBS0_CHNL464_CONFIG_ADDR A:0xe60e804
y.create.l HWIO_PMIC_ARB_OBS0_CHNL465_CONFIG_ADDR A:0xe60e884
y.create.l HWIO_PMIC_ARB_OBS0_CHNL466_CONFIG_ADDR A:0xe60e904
y.create.l HWIO_PMIC_ARB_OBS0_CHNL467_CONFIG_ADDR A:0xe60e984
y.create.l HWIO_PMIC_ARB_OBS0_CHNL468_CONFIG_ADDR A:0xe60ea04
y.create.l HWIO_PMIC_ARB_OBS0_CHNL469_CONFIG_ADDR A:0xe60ea84
y.create.l HWIO_PMIC_ARB_OBS0_CHNL470_CONFIG_ADDR A:0xe60eb04
y.create.l HWIO_PMIC_ARB_OBS0_CHNL471_CONFIG_ADDR A:0xe60eb84
y.create.l HWIO_PMIC_ARB_OBS0_CHNL472_CONFIG_ADDR A:0xe60ec04
y.create.l HWIO_PMIC_ARB_OBS0_CHNL473_CONFIG_ADDR A:0xe60ec84
y.create.l HWIO_PMIC_ARB_OBS0_CHNL474_CONFIG_ADDR A:0xe60ed04
y.create.l HWIO_PMIC_ARB_OBS0_CHNL475_CONFIG_ADDR A:0xe60ed84
y.create.l HWIO_PMIC_ARB_OBS0_CHNL476_CONFIG_ADDR A:0xe60ee04
y.create.l HWIO_PMIC_ARB_OBS0_CHNL477_CONFIG_ADDR A:0xe60ee84
y.create.l HWIO_PMIC_ARB_OBS0_CHNL478_CONFIG_ADDR A:0xe60ef04
y.create.l HWIO_PMIC_ARB_OBS0_CHNL479_CONFIG_ADDR A:0xe60ef84
y.create.l HWIO_PMIC_ARB_OBS0_CHNL480_CONFIG_ADDR A:0xe60f004
y.create.l HWIO_PMIC_ARB_OBS0_CHNL481_CONFIG_ADDR A:0xe60f084
y.create.l HWIO_PMIC_ARB_OBS0_CHNL482_CONFIG_ADDR A:0xe60f104
y.create.l HWIO_PMIC_ARB_OBS0_CHNL483_CONFIG_ADDR A:0xe60f184
y.create.l HWIO_PMIC_ARB_OBS0_CHNL484_CONFIG_ADDR A:0xe60f204
y.create.l HWIO_PMIC_ARB_OBS0_CHNL485_CONFIG_ADDR A:0xe60f284
y.create.l HWIO_PMIC_ARB_OBS0_CHNL486_CONFIG_ADDR A:0xe60f304
y.create.l HWIO_PMIC_ARB_OBS0_CHNL487_CONFIG_ADDR A:0xe60f384
y.create.l HWIO_PMIC_ARB_OBS0_CHNL488_CONFIG_ADDR A:0xe60f404
y.create.l HWIO_PMIC_ARB_OBS0_CHNL489_CONFIG_ADDR A:0xe60f484
y.create.l HWIO_PMIC_ARB_OBS0_CHNL490_CONFIG_ADDR A:0xe60f504
y.create.l HWIO_PMIC_ARB_OBS0_CHNL491_CONFIG_ADDR A:0xe60f584
y.create.l HWIO_PMIC_ARB_OBS0_CHNL492_CONFIG_ADDR A:0xe60f604
y.create.l HWIO_PMIC_ARB_OBS0_CHNL493_CONFIG_ADDR A:0xe60f684
y.create.l HWIO_PMIC_ARB_OBS0_CHNL494_CONFIG_ADDR A:0xe60f704
y.create.l HWIO_PMIC_ARB_OBS0_CHNL495_CONFIG_ADDR A:0xe60f784
y.create.l HWIO_PMIC_ARB_OBS0_CHNL496_CONFIG_ADDR A:0xe60f804
y.create.l HWIO_PMIC_ARB_OBS0_CHNL497_CONFIG_ADDR A:0xe60f884
y.create.l HWIO_PMIC_ARB_OBS0_CHNL498_CONFIG_ADDR A:0xe60f904
y.create.l HWIO_PMIC_ARB_OBS0_CHNL499_CONFIG_ADDR A:0xe60f984
y.create.l HWIO_PMIC_ARB_OBS0_CHNL500_CONFIG_ADDR A:0xe60fa04
y.create.l HWIO_PMIC_ARB_OBS0_CHNL501_CONFIG_ADDR A:0xe60fa84
y.create.l HWIO_PMIC_ARB_OBS0_CHNL502_CONFIG_ADDR A:0xe60fb04
y.create.l HWIO_PMIC_ARB_OBS0_CHNL503_CONFIG_ADDR A:0xe60fb84
y.create.l HWIO_PMIC_ARB_OBS0_CHNL504_CONFIG_ADDR A:0xe60fc04
y.create.l HWIO_PMIC_ARB_OBS0_CHNL505_CONFIG_ADDR A:0xe60fc84
y.create.l HWIO_PMIC_ARB_OBS0_CHNL506_CONFIG_ADDR A:0xe60fd04
y.create.l HWIO_PMIC_ARB_OBS0_CHNL507_CONFIG_ADDR A:0xe60fd84
y.create.l HWIO_PMIC_ARB_OBS0_CHNL508_CONFIG_ADDR A:0xe60fe04
y.create.l HWIO_PMIC_ARB_OBS0_CHNL509_CONFIG_ADDR A:0xe60fe84
y.create.l HWIO_PMIC_ARB_OBS0_CHNL510_CONFIG_ADDR A:0xe60ff04
y.create.l HWIO_PMIC_ARB_OBS0_CHNL511_CONFIG_ADDR A:0xe60ff84
y.create.l HWIO_PMIC_ARB_OBS1_CHNL0_CONFIG_ADDR A:0xe610004
y.create.l HWIO_PMIC_ARB_OBS1_CHNL1_CONFIG_ADDR A:0xe610084
y.create.l HWIO_PMIC_ARB_OBS1_CHNL2_CONFIG_ADDR A:0xe610104
y.create.l HWIO_PMIC_ARB_OBS1_CHNL3_CONFIG_ADDR A:0xe610184
y.create.l HWIO_PMIC_ARB_OBS1_CHNL4_CONFIG_ADDR A:0xe610204
y.create.l HWIO_PMIC_ARB_OBS1_CHNL5_CONFIG_ADDR A:0xe610284
y.create.l HWIO_PMIC_ARB_OBS1_CHNL6_CONFIG_ADDR A:0xe610304
y.create.l HWIO_PMIC_ARB_OBS1_CHNL7_CONFIG_ADDR A:0xe610384
y.create.l HWIO_PMIC_ARB_OBS1_CHNL8_CONFIG_ADDR A:0xe610404
y.create.l HWIO_PMIC_ARB_OBS1_CHNL9_CONFIG_ADDR A:0xe610484
y.create.l HWIO_PMIC_ARB_OBS1_CHNL10_CONFIG_ADDR A:0xe610504
y.create.l HWIO_PMIC_ARB_OBS1_CHNL11_CONFIG_ADDR A:0xe610584
y.create.l HWIO_PMIC_ARB_OBS1_CHNL12_CONFIG_ADDR A:0xe610604
y.create.l HWIO_PMIC_ARB_OBS1_CHNL13_CONFIG_ADDR A:0xe610684
y.create.l HWIO_PMIC_ARB_OBS1_CHNL14_CONFIG_ADDR A:0xe610704
y.create.l HWIO_PMIC_ARB_OBS1_CHNL15_CONFIG_ADDR A:0xe610784
y.create.l HWIO_PMIC_ARB_OBS1_CHNL16_CONFIG_ADDR A:0xe610804
y.create.l HWIO_PMIC_ARB_OBS1_CHNL17_CONFIG_ADDR A:0xe610884
y.create.l HWIO_PMIC_ARB_OBS1_CHNL18_CONFIG_ADDR A:0xe610904
y.create.l HWIO_PMIC_ARB_OBS1_CHNL19_CONFIG_ADDR A:0xe610984
y.create.l HWIO_PMIC_ARB_OBS1_CHNL20_CONFIG_ADDR A:0xe610a04
y.create.l HWIO_PMIC_ARB_OBS1_CHNL21_CONFIG_ADDR A:0xe610a84
y.create.l HWIO_PMIC_ARB_OBS1_CHNL22_CONFIG_ADDR A:0xe610b04
y.create.l HWIO_PMIC_ARB_OBS1_CHNL23_CONFIG_ADDR A:0xe610b84
y.create.l HWIO_PMIC_ARB_OBS1_CHNL24_CONFIG_ADDR A:0xe610c04
y.create.l HWIO_PMIC_ARB_OBS1_CHNL25_CONFIG_ADDR A:0xe610c84
y.create.l HWIO_PMIC_ARB_OBS1_CHNL26_CONFIG_ADDR A:0xe610d04
y.create.l HWIO_PMIC_ARB_OBS1_CHNL27_CONFIG_ADDR A:0xe610d84
y.create.l HWIO_PMIC_ARB_OBS1_CHNL28_CONFIG_ADDR A:0xe610e04
y.create.l HWIO_PMIC_ARB_OBS1_CHNL29_CONFIG_ADDR A:0xe610e84
y.create.l HWIO_PMIC_ARB_OBS1_CHNL30_CONFIG_ADDR A:0xe610f04
y.create.l HWIO_PMIC_ARB_OBS1_CHNL31_CONFIG_ADDR A:0xe610f84
y.create.l HWIO_PMIC_ARB_OBS1_CHNL32_CONFIG_ADDR A:0xe611004
y.create.l HWIO_PMIC_ARB_OBS1_CHNL33_CONFIG_ADDR A:0xe611084
y.create.l HWIO_PMIC_ARB_OBS1_CHNL34_CONFIG_ADDR A:0xe611104
y.create.l HWIO_PMIC_ARB_OBS1_CHNL35_CONFIG_ADDR A:0xe611184
y.create.l HWIO_PMIC_ARB_OBS1_CHNL36_CONFIG_ADDR A:0xe611204
y.create.l HWIO_PMIC_ARB_OBS1_CHNL37_CONFIG_ADDR A:0xe611284
y.create.l HWIO_PMIC_ARB_OBS1_CHNL38_CONFIG_ADDR A:0xe611304
y.create.l HWIO_PMIC_ARB_OBS1_CHNL39_CONFIG_ADDR A:0xe611384
y.create.l HWIO_PMIC_ARB_OBS1_CHNL40_CONFIG_ADDR A:0xe611404
y.create.l HWIO_PMIC_ARB_OBS1_CHNL41_CONFIG_ADDR A:0xe611484
y.create.l HWIO_PMIC_ARB_OBS1_CHNL42_CONFIG_ADDR A:0xe611504
y.create.l HWIO_PMIC_ARB_OBS1_CHNL43_CONFIG_ADDR A:0xe611584
y.create.l HWIO_PMIC_ARB_OBS1_CHNL44_CONFIG_ADDR A:0xe611604
y.create.l HWIO_PMIC_ARB_OBS1_CHNL45_CONFIG_ADDR A:0xe611684
y.create.l HWIO_PMIC_ARB_OBS1_CHNL46_CONFIG_ADDR A:0xe611704
y.create.l HWIO_PMIC_ARB_OBS1_CHNL47_CONFIG_ADDR A:0xe611784
y.create.l HWIO_PMIC_ARB_OBS1_CHNL48_CONFIG_ADDR A:0xe611804
y.create.l HWIO_PMIC_ARB_OBS1_CHNL49_CONFIG_ADDR A:0xe611884
y.create.l HWIO_PMIC_ARB_OBS1_CHNL50_CONFIG_ADDR A:0xe611904
y.create.l HWIO_PMIC_ARB_OBS1_CHNL51_CONFIG_ADDR A:0xe611984
y.create.l HWIO_PMIC_ARB_OBS1_CHNL52_CONFIG_ADDR A:0xe611a04
y.create.l HWIO_PMIC_ARB_OBS1_CHNL53_CONFIG_ADDR A:0xe611a84
y.create.l HWIO_PMIC_ARB_OBS1_CHNL54_CONFIG_ADDR A:0xe611b04
y.create.l HWIO_PMIC_ARB_OBS1_CHNL55_CONFIG_ADDR A:0xe611b84
y.create.l HWIO_PMIC_ARB_OBS1_CHNL56_CONFIG_ADDR A:0xe611c04
y.create.l HWIO_PMIC_ARB_OBS1_CHNL57_CONFIG_ADDR A:0xe611c84
y.create.l HWIO_PMIC_ARB_OBS1_CHNL58_CONFIG_ADDR A:0xe611d04
y.create.l HWIO_PMIC_ARB_OBS1_CHNL59_CONFIG_ADDR A:0xe611d84
y.create.l HWIO_PMIC_ARB_OBS1_CHNL60_CONFIG_ADDR A:0xe611e04
y.create.l HWIO_PMIC_ARB_OBS1_CHNL61_CONFIG_ADDR A:0xe611e84
y.create.l HWIO_PMIC_ARB_OBS1_CHNL62_CONFIG_ADDR A:0xe611f04
y.create.l HWIO_PMIC_ARB_OBS1_CHNL63_CONFIG_ADDR A:0xe611f84
y.create.l HWIO_PMIC_ARB_OBS1_CHNL64_CONFIG_ADDR A:0xe612004
y.create.l HWIO_PMIC_ARB_OBS1_CHNL65_CONFIG_ADDR A:0xe612084
y.create.l HWIO_PMIC_ARB_OBS1_CHNL66_CONFIG_ADDR A:0xe612104
y.create.l HWIO_PMIC_ARB_OBS1_CHNL67_CONFIG_ADDR A:0xe612184
y.create.l HWIO_PMIC_ARB_OBS1_CHNL68_CONFIG_ADDR A:0xe612204
y.create.l HWIO_PMIC_ARB_OBS1_CHNL69_CONFIG_ADDR A:0xe612284
y.create.l HWIO_PMIC_ARB_OBS1_CHNL70_CONFIG_ADDR A:0xe612304
y.create.l HWIO_PMIC_ARB_OBS1_CHNL71_CONFIG_ADDR A:0xe612384
y.create.l HWIO_PMIC_ARB_OBS1_CHNL72_CONFIG_ADDR A:0xe612404
y.create.l HWIO_PMIC_ARB_OBS1_CHNL73_CONFIG_ADDR A:0xe612484
y.create.l HWIO_PMIC_ARB_OBS1_CHNL74_CONFIG_ADDR A:0xe612504
y.create.l HWIO_PMIC_ARB_OBS1_CHNL75_CONFIG_ADDR A:0xe612584
y.create.l HWIO_PMIC_ARB_OBS1_CHNL76_CONFIG_ADDR A:0xe612604
y.create.l HWIO_PMIC_ARB_OBS1_CHNL77_CONFIG_ADDR A:0xe612684
y.create.l HWIO_PMIC_ARB_OBS1_CHNL78_CONFIG_ADDR A:0xe612704
y.create.l HWIO_PMIC_ARB_OBS1_CHNL79_CONFIG_ADDR A:0xe612784
y.create.l HWIO_PMIC_ARB_OBS1_CHNL80_CONFIG_ADDR A:0xe612804
y.create.l HWIO_PMIC_ARB_OBS1_CHNL81_CONFIG_ADDR A:0xe612884
y.create.l HWIO_PMIC_ARB_OBS1_CHNL82_CONFIG_ADDR A:0xe612904
y.create.l HWIO_PMIC_ARB_OBS1_CHNL83_CONFIG_ADDR A:0xe612984
y.create.l HWIO_PMIC_ARB_OBS1_CHNL84_CONFIG_ADDR A:0xe612a04
y.create.l HWIO_PMIC_ARB_OBS1_CHNL85_CONFIG_ADDR A:0xe612a84
y.create.l HWIO_PMIC_ARB_OBS1_CHNL86_CONFIG_ADDR A:0xe612b04
y.create.l HWIO_PMIC_ARB_OBS1_CHNL87_CONFIG_ADDR A:0xe612b84
y.create.l HWIO_PMIC_ARB_OBS1_CHNL88_CONFIG_ADDR A:0xe612c04
y.create.l HWIO_PMIC_ARB_OBS1_CHNL89_CONFIG_ADDR A:0xe612c84
y.create.l HWIO_PMIC_ARB_OBS1_CHNL90_CONFIG_ADDR A:0xe612d04
y.create.l HWIO_PMIC_ARB_OBS1_CHNL91_CONFIG_ADDR A:0xe612d84
y.create.l HWIO_PMIC_ARB_OBS1_CHNL92_CONFIG_ADDR A:0xe612e04
y.create.l HWIO_PMIC_ARB_OBS1_CHNL93_CONFIG_ADDR A:0xe612e84
y.create.l HWIO_PMIC_ARB_OBS1_CHNL94_CONFIG_ADDR A:0xe612f04
y.create.l HWIO_PMIC_ARB_OBS1_CHNL95_CONFIG_ADDR A:0xe612f84
y.create.l HWIO_PMIC_ARB_OBS1_CHNL96_CONFIG_ADDR A:0xe613004
y.create.l HWIO_PMIC_ARB_OBS1_CHNL97_CONFIG_ADDR A:0xe613084
y.create.l HWIO_PMIC_ARB_OBS1_CHNL98_CONFIG_ADDR A:0xe613104
y.create.l HWIO_PMIC_ARB_OBS1_CHNL99_CONFIG_ADDR A:0xe613184
y.create.l HWIO_PMIC_ARB_OBS1_CHNL100_CONFIG_ADDR A:0xe613204
y.create.l HWIO_PMIC_ARB_OBS1_CHNL101_CONFIG_ADDR A:0xe613284
y.create.l HWIO_PMIC_ARB_OBS1_CHNL102_CONFIG_ADDR A:0xe613304
y.create.l HWIO_PMIC_ARB_OBS1_CHNL103_CONFIG_ADDR A:0xe613384
y.create.l HWIO_PMIC_ARB_OBS1_CHNL104_CONFIG_ADDR A:0xe613404
y.create.l HWIO_PMIC_ARB_OBS1_CHNL105_CONFIG_ADDR A:0xe613484
y.create.l HWIO_PMIC_ARB_OBS1_CHNL106_CONFIG_ADDR A:0xe613504
y.create.l HWIO_PMIC_ARB_OBS1_CHNL107_CONFIG_ADDR A:0xe613584
y.create.l HWIO_PMIC_ARB_OBS1_CHNL108_CONFIG_ADDR A:0xe613604
y.create.l HWIO_PMIC_ARB_OBS1_CHNL109_CONFIG_ADDR A:0xe613684
y.create.l HWIO_PMIC_ARB_OBS1_CHNL110_CONFIG_ADDR A:0xe613704
y.create.l HWIO_PMIC_ARB_OBS1_CHNL111_CONFIG_ADDR A:0xe613784
y.create.l HWIO_PMIC_ARB_OBS1_CHNL112_CONFIG_ADDR A:0xe613804
y.create.l HWIO_PMIC_ARB_OBS1_CHNL113_CONFIG_ADDR A:0xe613884
y.create.l HWIO_PMIC_ARB_OBS1_CHNL114_CONFIG_ADDR A:0xe613904
y.create.l HWIO_PMIC_ARB_OBS1_CHNL115_CONFIG_ADDR A:0xe613984
y.create.l HWIO_PMIC_ARB_OBS1_CHNL116_CONFIG_ADDR A:0xe613a04
y.create.l HWIO_PMIC_ARB_OBS1_CHNL117_CONFIG_ADDR A:0xe613a84
y.create.l HWIO_PMIC_ARB_OBS1_CHNL118_CONFIG_ADDR A:0xe613b04
y.create.l HWIO_PMIC_ARB_OBS1_CHNL119_CONFIG_ADDR A:0xe613b84
y.create.l HWIO_PMIC_ARB_OBS1_CHNL120_CONFIG_ADDR A:0xe613c04
y.create.l HWIO_PMIC_ARB_OBS1_CHNL121_CONFIG_ADDR A:0xe613c84
y.create.l HWIO_PMIC_ARB_OBS1_CHNL122_CONFIG_ADDR A:0xe613d04
y.create.l HWIO_PMIC_ARB_OBS1_CHNL123_CONFIG_ADDR A:0xe613d84
y.create.l HWIO_PMIC_ARB_OBS1_CHNL124_CONFIG_ADDR A:0xe613e04
y.create.l HWIO_PMIC_ARB_OBS1_CHNL125_CONFIG_ADDR A:0xe613e84
y.create.l HWIO_PMIC_ARB_OBS1_CHNL126_CONFIG_ADDR A:0xe613f04
y.create.l HWIO_PMIC_ARB_OBS1_CHNL127_CONFIG_ADDR A:0xe613f84
y.create.l HWIO_PMIC_ARB_OBS1_CHNL128_CONFIG_ADDR A:0xe614004
y.create.l HWIO_PMIC_ARB_OBS1_CHNL129_CONFIG_ADDR A:0xe614084
y.create.l HWIO_PMIC_ARB_OBS1_CHNL130_CONFIG_ADDR A:0xe614104
y.create.l HWIO_PMIC_ARB_OBS1_CHNL131_CONFIG_ADDR A:0xe614184
y.create.l HWIO_PMIC_ARB_OBS1_CHNL132_CONFIG_ADDR A:0xe614204
y.create.l HWIO_PMIC_ARB_OBS1_CHNL133_CONFIG_ADDR A:0xe614284
y.create.l HWIO_PMIC_ARB_OBS1_CHNL134_CONFIG_ADDR A:0xe614304
y.create.l HWIO_PMIC_ARB_OBS1_CHNL135_CONFIG_ADDR A:0xe614384
y.create.l HWIO_PMIC_ARB_OBS1_CHNL136_CONFIG_ADDR A:0xe614404
y.create.l HWIO_PMIC_ARB_OBS1_CHNL137_CONFIG_ADDR A:0xe614484
y.create.l HWIO_PMIC_ARB_OBS1_CHNL138_CONFIG_ADDR A:0xe614504
y.create.l HWIO_PMIC_ARB_OBS1_CHNL139_CONFIG_ADDR A:0xe614584
y.create.l HWIO_PMIC_ARB_OBS1_CHNL140_CONFIG_ADDR A:0xe614604
y.create.l HWIO_PMIC_ARB_OBS1_CHNL141_CONFIG_ADDR A:0xe614684
y.create.l HWIO_PMIC_ARB_OBS1_CHNL142_CONFIG_ADDR A:0xe614704
y.create.l HWIO_PMIC_ARB_OBS1_CHNL143_CONFIG_ADDR A:0xe614784
y.create.l HWIO_PMIC_ARB_OBS1_CHNL144_CONFIG_ADDR A:0xe614804
y.create.l HWIO_PMIC_ARB_OBS1_CHNL145_CONFIG_ADDR A:0xe614884
y.create.l HWIO_PMIC_ARB_OBS1_CHNL146_CONFIG_ADDR A:0xe614904
y.create.l HWIO_PMIC_ARB_OBS1_CHNL147_CONFIG_ADDR A:0xe614984
y.create.l HWIO_PMIC_ARB_OBS1_CHNL148_CONFIG_ADDR A:0xe614a04
y.create.l HWIO_PMIC_ARB_OBS1_CHNL149_CONFIG_ADDR A:0xe614a84
y.create.l HWIO_PMIC_ARB_OBS1_CHNL150_CONFIG_ADDR A:0xe614b04
y.create.l HWIO_PMIC_ARB_OBS1_CHNL151_CONFIG_ADDR A:0xe614b84
y.create.l HWIO_PMIC_ARB_OBS1_CHNL152_CONFIG_ADDR A:0xe614c04
y.create.l HWIO_PMIC_ARB_OBS1_CHNL153_CONFIG_ADDR A:0xe614c84
y.create.l HWIO_PMIC_ARB_OBS1_CHNL154_CONFIG_ADDR A:0xe614d04
y.create.l HWIO_PMIC_ARB_OBS1_CHNL155_CONFIG_ADDR A:0xe614d84
y.create.l HWIO_PMIC_ARB_OBS1_CHNL156_CONFIG_ADDR A:0xe614e04
y.create.l HWIO_PMIC_ARB_OBS1_CHNL157_CONFIG_ADDR A:0xe614e84
y.create.l HWIO_PMIC_ARB_OBS1_CHNL158_CONFIG_ADDR A:0xe614f04
y.create.l HWIO_PMIC_ARB_OBS1_CHNL159_CONFIG_ADDR A:0xe614f84
y.create.l HWIO_PMIC_ARB_OBS1_CHNL160_CONFIG_ADDR A:0xe615004
y.create.l HWIO_PMIC_ARB_OBS1_CHNL161_CONFIG_ADDR A:0xe615084
y.create.l HWIO_PMIC_ARB_OBS1_CHNL162_CONFIG_ADDR A:0xe615104
y.create.l HWIO_PMIC_ARB_OBS1_CHNL163_CONFIG_ADDR A:0xe615184
y.create.l HWIO_PMIC_ARB_OBS1_CHNL164_CONFIG_ADDR A:0xe615204
y.create.l HWIO_PMIC_ARB_OBS1_CHNL165_CONFIG_ADDR A:0xe615284
y.create.l HWIO_PMIC_ARB_OBS1_CHNL166_CONFIG_ADDR A:0xe615304
y.create.l HWIO_PMIC_ARB_OBS1_CHNL167_CONFIG_ADDR A:0xe615384
y.create.l HWIO_PMIC_ARB_OBS1_CHNL168_CONFIG_ADDR A:0xe615404
y.create.l HWIO_PMIC_ARB_OBS1_CHNL169_CONFIG_ADDR A:0xe615484
y.create.l HWIO_PMIC_ARB_OBS1_CHNL170_CONFIG_ADDR A:0xe615504
y.create.l HWIO_PMIC_ARB_OBS1_CHNL171_CONFIG_ADDR A:0xe615584
y.create.l HWIO_PMIC_ARB_OBS1_CHNL172_CONFIG_ADDR A:0xe615604
y.create.l HWIO_PMIC_ARB_OBS1_CHNL173_CONFIG_ADDR A:0xe615684
y.create.l HWIO_PMIC_ARB_OBS1_CHNL174_CONFIG_ADDR A:0xe615704
y.create.l HWIO_PMIC_ARB_OBS1_CHNL175_CONFIG_ADDR A:0xe615784
y.create.l HWIO_PMIC_ARB_OBS1_CHNL176_CONFIG_ADDR A:0xe615804
y.create.l HWIO_PMIC_ARB_OBS1_CHNL177_CONFIG_ADDR A:0xe615884
y.create.l HWIO_PMIC_ARB_OBS1_CHNL178_CONFIG_ADDR A:0xe615904
y.create.l HWIO_PMIC_ARB_OBS1_CHNL179_CONFIG_ADDR A:0xe615984
y.create.l HWIO_PMIC_ARB_OBS1_CHNL180_CONFIG_ADDR A:0xe615a04
y.create.l HWIO_PMIC_ARB_OBS1_CHNL181_CONFIG_ADDR A:0xe615a84
y.create.l HWIO_PMIC_ARB_OBS1_CHNL182_CONFIG_ADDR A:0xe615b04
y.create.l HWIO_PMIC_ARB_OBS1_CHNL183_CONFIG_ADDR A:0xe615b84
y.create.l HWIO_PMIC_ARB_OBS1_CHNL184_CONFIG_ADDR A:0xe615c04
y.create.l HWIO_PMIC_ARB_OBS1_CHNL185_CONFIG_ADDR A:0xe615c84
y.create.l HWIO_PMIC_ARB_OBS1_CHNL186_CONFIG_ADDR A:0xe615d04
y.create.l HWIO_PMIC_ARB_OBS1_CHNL187_CONFIG_ADDR A:0xe615d84
y.create.l HWIO_PMIC_ARB_OBS1_CHNL188_CONFIG_ADDR A:0xe615e04
y.create.l HWIO_PMIC_ARB_OBS1_CHNL189_CONFIG_ADDR A:0xe615e84
y.create.l HWIO_PMIC_ARB_OBS1_CHNL190_CONFIG_ADDR A:0xe615f04
y.create.l HWIO_PMIC_ARB_OBS1_CHNL191_CONFIG_ADDR A:0xe615f84
y.create.l HWIO_PMIC_ARB_OBS1_CHNL192_CONFIG_ADDR A:0xe616004
y.create.l HWIO_PMIC_ARB_OBS1_CHNL193_CONFIG_ADDR A:0xe616084
y.create.l HWIO_PMIC_ARB_OBS1_CHNL194_CONFIG_ADDR A:0xe616104
y.create.l HWIO_PMIC_ARB_OBS1_CHNL195_CONFIG_ADDR A:0xe616184
y.create.l HWIO_PMIC_ARB_OBS1_CHNL196_CONFIG_ADDR A:0xe616204
y.create.l HWIO_PMIC_ARB_OBS1_CHNL197_CONFIG_ADDR A:0xe616284
y.create.l HWIO_PMIC_ARB_OBS1_CHNL198_CONFIG_ADDR A:0xe616304
y.create.l HWIO_PMIC_ARB_OBS1_CHNL199_CONFIG_ADDR A:0xe616384
y.create.l HWIO_PMIC_ARB_OBS1_CHNL200_CONFIG_ADDR A:0xe616404
y.create.l HWIO_PMIC_ARB_OBS1_CHNL201_CONFIG_ADDR A:0xe616484
y.create.l HWIO_PMIC_ARB_OBS1_CHNL202_CONFIG_ADDR A:0xe616504
y.create.l HWIO_PMIC_ARB_OBS1_CHNL203_CONFIG_ADDR A:0xe616584
y.create.l HWIO_PMIC_ARB_OBS1_CHNL204_CONFIG_ADDR A:0xe616604
y.create.l HWIO_PMIC_ARB_OBS1_CHNL205_CONFIG_ADDR A:0xe616684
y.create.l HWIO_PMIC_ARB_OBS1_CHNL206_CONFIG_ADDR A:0xe616704
y.create.l HWIO_PMIC_ARB_OBS1_CHNL207_CONFIG_ADDR A:0xe616784
y.create.l HWIO_PMIC_ARB_OBS1_CHNL208_CONFIG_ADDR A:0xe616804
y.create.l HWIO_PMIC_ARB_OBS1_CHNL209_CONFIG_ADDR A:0xe616884
y.create.l HWIO_PMIC_ARB_OBS1_CHNL210_CONFIG_ADDR A:0xe616904
y.create.l HWIO_PMIC_ARB_OBS1_CHNL211_CONFIG_ADDR A:0xe616984
y.create.l HWIO_PMIC_ARB_OBS1_CHNL212_CONFIG_ADDR A:0xe616a04
y.create.l HWIO_PMIC_ARB_OBS1_CHNL213_CONFIG_ADDR A:0xe616a84
y.create.l HWIO_PMIC_ARB_OBS1_CHNL214_CONFIG_ADDR A:0xe616b04
y.create.l HWIO_PMIC_ARB_OBS1_CHNL215_CONFIG_ADDR A:0xe616b84
y.create.l HWIO_PMIC_ARB_OBS1_CHNL216_CONFIG_ADDR A:0xe616c04
y.create.l HWIO_PMIC_ARB_OBS1_CHNL217_CONFIG_ADDR A:0xe616c84
y.create.l HWIO_PMIC_ARB_OBS1_CHNL218_CONFIG_ADDR A:0xe616d04
y.create.l HWIO_PMIC_ARB_OBS1_CHNL219_CONFIG_ADDR A:0xe616d84
y.create.l HWIO_PMIC_ARB_OBS1_CHNL220_CONFIG_ADDR A:0xe616e04
y.create.l HWIO_PMIC_ARB_OBS1_CHNL221_CONFIG_ADDR A:0xe616e84
y.create.l HWIO_PMIC_ARB_OBS1_CHNL222_CONFIG_ADDR A:0xe616f04
y.create.l HWIO_PMIC_ARB_OBS1_CHNL223_CONFIG_ADDR A:0xe616f84
y.create.l HWIO_PMIC_ARB_OBS1_CHNL224_CONFIG_ADDR A:0xe617004
y.create.l HWIO_PMIC_ARB_OBS1_CHNL225_CONFIG_ADDR A:0xe617084
y.create.l HWIO_PMIC_ARB_OBS1_CHNL226_CONFIG_ADDR A:0xe617104
y.create.l HWIO_PMIC_ARB_OBS1_CHNL227_CONFIG_ADDR A:0xe617184
y.create.l HWIO_PMIC_ARB_OBS1_CHNL228_CONFIG_ADDR A:0xe617204
y.create.l HWIO_PMIC_ARB_OBS1_CHNL229_CONFIG_ADDR A:0xe617284
y.create.l HWIO_PMIC_ARB_OBS1_CHNL230_CONFIG_ADDR A:0xe617304
y.create.l HWIO_PMIC_ARB_OBS1_CHNL231_CONFIG_ADDR A:0xe617384
y.create.l HWIO_PMIC_ARB_OBS1_CHNL232_CONFIG_ADDR A:0xe617404
y.create.l HWIO_PMIC_ARB_OBS1_CHNL233_CONFIG_ADDR A:0xe617484
y.create.l HWIO_PMIC_ARB_OBS1_CHNL234_CONFIG_ADDR A:0xe617504
y.create.l HWIO_PMIC_ARB_OBS1_CHNL235_CONFIG_ADDR A:0xe617584
y.create.l HWIO_PMIC_ARB_OBS1_CHNL236_CONFIG_ADDR A:0xe617604
y.create.l HWIO_PMIC_ARB_OBS1_CHNL237_CONFIG_ADDR A:0xe617684
y.create.l HWIO_PMIC_ARB_OBS1_CHNL238_CONFIG_ADDR A:0xe617704
y.create.l HWIO_PMIC_ARB_OBS1_CHNL239_CONFIG_ADDR A:0xe617784
y.create.l HWIO_PMIC_ARB_OBS1_CHNL240_CONFIG_ADDR A:0xe617804
y.create.l HWIO_PMIC_ARB_OBS1_CHNL241_CONFIG_ADDR A:0xe617884
y.create.l HWIO_PMIC_ARB_OBS1_CHNL242_CONFIG_ADDR A:0xe617904
y.create.l HWIO_PMIC_ARB_OBS1_CHNL243_CONFIG_ADDR A:0xe617984
y.create.l HWIO_PMIC_ARB_OBS1_CHNL244_CONFIG_ADDR A:0xe617a04
y.create.l HWIO_PMIC_ARB_OBS1_CHNL245_CONFIG_ADDR A:0xe617a84
y.create.l HWIO_PMIC_ARB_OBS1_CHNL246_CONFIG_ADDR A:0xe617b04
y.create.l HWIO_PMIC_ARB_OBS1_CHNL247_CONFIG_ADDR A:0xe617b84
y.create.l HWIO_PMIC_ARB_OBS1_CHNL248_CONFIG_ADDR A:0xe617c04
y.create.l HWIO_PMIC_ARB_OBS1_CHNL249_CONFIG_ADDR A:0xe617c84
y.create.l HWIO_PMIC_ARB_OBS1_CHNL250_CONFIG_ADDR A:0xe617d04
y.create.l HWIO_PMIC_ARB_OBS1_CHNL251_CONFIG_ADDR A:0xe617d84
y.create.l HWIO_PMIC_ARB_OBS1_CHNL252_CONFIG_ADDR A:0xe617e04
y.create.l HWIO_PMIC_ARB_OBS1_CHNL253_CONFIG_ADDR A:0xe617e84
y.create.l HWIO_PMIC_ARB_OBS1_CHNL254_CONFIG_ADDR A:0xe617f04
y.create.l HWIO_PMIC_ARB_OBS1_CHNL255_CONFIG_ADDR A:0xe617f84
y.create.l HWIO_PMIC_ARB_OBS1_CHNL256_CONFIG_ADDR A:0xe618004
y.create.l HWIO_PMIC_ARB_OBS1_CHNL257_CONFIG_ADDR A:0xe618084
y.create.l HWIO_PMIC_ARB_OBS1_CHNL258_CONFIG_ADDR A:0xe618104
y.create.l HWIO_PMIC_ARB_OBS1_CHNL259_CONFIG_ADDR A:0xe618184
y.create.l HWIO_PMIC_ARB_OBS1_CHNL260_CONFIG_ADDR A:0xe618204
y.create.l HWIO_PMIC_ARB_OBS1_CHNL261_CONFIG_ADDR A:0xe618284
y.create.l HWIO_PMIC_ARB_OBS1_CHNL262_CONFIG_ADDR A:0xe618304
y.create.l HWIO_PMIC_ARB_OBS1_CHNL263_CONFIG_ADDR A:0xe618384
y.create.l HWIO_PMIC_ARB_OBS1_CHNL264_CONFIG_ADDR A:0xe618404
y.create.l HWIO_PMIC_ARB_OBS1_CHNL265_CONFIG_ADDR A:0xe618484
y.create.l HWIO_PMIC_ARB_OBS1_CHNL266_CONFIG_ADDR A:0xe618504
y.create.l HWIO_PMIC_ARB_OBS1_CHNL267_CONFIG_ADDR A:0xe618584
y.create.l HWIO_PMIC_ARB_OBS1_CHNL268_CONFIG_ADDR A:0xe618604
y.create.l HWIO_PMIC_ARB_OBS1_CHNL269_CONFIG_ADDR A:0xe618684
y.create.l HWIO_PMIC_ARB_OBS1_CHNL270_CONFIG_ADDR A:0xe618704
y.create.l HWIO_PMIC_ARB_OBS1_CHNL271_CONFIG_ADDR A:0xe618784
y.create.l HWIO_PMIC_ARB_OBS1_CHNL272_CONFIG_ADDR A:0xe618804
y.create.l HWIO_PMIC_ARB_OBS1_CHNL273_CONFIG_ADDR A:0xe618884
y.create.l HWIO_PMIC_ARB_OBS1_CHNL274_CONFIG_ADDR A:0xe618904
y.create.l HWIO_PMIC_ARB_OBS1_CHNL275_CONFIG_ADDR A:0xe618984
y.create.l HWIO_PMIC_ARB_OBS1_CHNL276_CONFIG_ADDR A:0xe618a04
y.create.l HWIO_PMIC_ARB_OBS1_CHNL277_CONFIG_ADDR A:0xe618a84
y.create.l HWIO_PMIC_ARB_OBS1_CHNL278_CONFIG_ADDR A:0xe618b04
y.create.l HWIO_PMIC_ARB_OBS1_CHNL279_CONFIG_ADDR A:0xe618b84
y.create.l HWIO_PMIC_ARB_OBS1_CHNL280_CONFIG_ADDR A:0xe618c04
y.create.l HWIO_PMIC_ARB_OBS1_CHNL281_CONFIG_ADDR A:0xe618c84
y.create.l HWIO_PMIC_ARB_OBS1_CHNL282_CONFIG_ADDR A:0xe618d04
y.create.l HWIO_PMIC_ARB_OBS1_CHNL283_CONFIG_ADDR A:0xe618d84
y.create.l HWIO_PMIC_ARB_OBS1_CHNL284_CONFIG_ADDR A:0xe618e04
y.create.l HWIO_PMIC_ARB_OBS1_CHNL285_CONFIG_ADDR A:0xe618e84
y.create.l HWIO_PMIC_ARB_OBS1_CHNL286_CONFIG_ADDR A:0xe618f04
y.create.l HWIO_PMIC_ARB_OBS1_CHNL287_CONFIG_ADDR A:0xe618f84
y.create.l HWIO_PMIC_ARB_OBS1_CHNL288_CONFIG_ADDR A:0xe619004
y.create.l HWIO_PMIC_ARB_OBS1_CHNL289_CONFIG_ADDR A:0xe619084
y.create.l HWIO_PMIC_ARB_OBS1_CHNL290_CONFIG_ADDR A:0xe619104
y.create.l HWIO_PMIC_ARB_OBS1_CHNL291_CONFIG_ADDR A:0xe619184
y.create.l HWIO_PMIC_ARB_OBS1_CHNL292_CONFIG_ADDR A:0xe619204
y.create.l HWIO_PMIC_ARB_OBS1_CHNL293_CONFIG_ADDR A:0xe619284
y.create.l HWIO_PMIC_ARB_OBS1_CHNL294_CONFIG_ADDR A:0xe619304
y.create.l HWIO_PMIC_ARB_OBS1_CHNL295_CONFIG_ADDR A:0xe619384
y.create.l HWIO_PMIC_ARB_OBS1_CHNL296_CONFIG_ADDR A:0xe619404
y.create.l HWIO_PMIC_ARB_OBS1_CHNL297_CONFIG_ADDR A:0xe619484
y.create.l HWIO_PMIC_ARB_OBS1_CHNL298_CONFIG_ADDR A:0xe619504
y.create.l HWIO_PMIC_ARB_OBS1_CHNL299_CONFIG_ADDR A:0xe619584
y.create.l HWIO_PMIC_ARB_OBS1_CHNL300_CONFIG_ADDR A:0xe619604
y.create.l HWIO_PMIC_ARB_OBS1_CHNL301_CONFIG_ADDR A:0xe619684
y.create.l HWIO_PMIC_ARB_OBS1_CHNL302_CONFIG_ADDR A:0xe619704
y.create.l HWIO_PMIC_ARB_OBS1_CHNL303_CONFIG_ADDR A:0xe619784
y.create.l HWIO_PMIC_ARB_OBS1_CHNL304_CONFIG_ADDR A:0xe619804
y.create.l HWIO_PMIC_ARB_OBS1_CHNL305_CONFIG_ADDR A:0xe619884
y.create.l HWIO_PMIC_ARB_OBS1_CHNL306_CONFIG_ADDR A:0xe619904
y.create.l HWIO_PMIC_ARB_OBS1_CHNL307_CONFIG_ADDR A:0xe619984
y.create.l HWIO_PMIC_ARB_OBS1_CHNL308_CONFIG_ADDR A:0xe619a04
y.create.l HWIO_PMIC_ARB_OBS1_CHNL309_CONFIG_ADDR A:0xe619a84
y.create.l HWIO_PMIC_ARB_OBS1_CHNL310_CONFIG_ADDR A:0xe619b04
y.create.l HWIO_PMIC_ARB_OBS1_CHNL311_CONFIG_ADDR A:0xe619b84
y.create.l HWIO_PMIC_ARB_OBS1_CHNL312_CONFIG_ADDR A:0xe619c04
y.create.l HWIO_PMIC_ARB_OBS1_CHNL313_CONFIG_ADDR A:0xe619c84
y.create.l HWIO_PMIC_ARB_OBS1_CHNL314_CONFIG_ADDR A:0xe619d04
y.create.l HWIO_PMIC_ARB_OBS1_CHNL315_CONFIG_ADDR A:0xe619d84
y.create.l HWIO_PMIC_ARB_OBS1_CHNL316_CONFIG_ADDR A:0xe619e04
y.create.l HWIO_PMIC_ARB_OBS1_CHNL317_CONFIG_ADDR A:0xe619e84
y.create.l HWIO_PMIC_ARB_OBS1_CHNL318_CONFIG_ADDR A:0xe619f04
y.create.l HWIO_PMIC_ARB_OBS1_CHNL319_CONFIG_ADDR A:0xe619f84
y.create.l HWIO_PMIC_ARB_OBS1_CHNL320_CONFIG_ADDR A:0xe61a004
y.create.l HWIO_PMIC_ARB_OBS1_CHNL321_CONFIG_ADDR A:0xe61a084
y.create.l HWIO_PMIC_ARB_OBS1_CHNL322_CONFIG_ADDR A:0xe61a104
y.create.l HWIO_PMIC_ARB_OBS1_CHNL323_CONFIG_ADDR A:0xe61a184
y.create.l HWIO_PMIC_ARB_OBS1_CHNL324_CONFIG_ADDR A:0xe61a204
y.create.l HWIO_PMIC_ARB_OBS1_CHNL325_CONFIG_ADDR A:0xe61a284
y.create.l HWIO_PMIC_ARB_OBS1_CHNL326_CONFIG_ADDR A:0xe61a304
y.create.l HWIO_PMIC_ARB_OBS1_CHNL327_CONFIG_ADDR A:0xe61a384
y.create.l HWIO_PMIC_ARB_OBS1_CHNL328_CONFIG_ADDR A:0xe61a404
y.create.l HWIO_PMIC_ARB_OBS1_CHNL329_CONFIG_ADDR A:0xe61a484
y.create.l HWIO_PMIC_ARB_OBS1_CHNL330_CONFIG_ADDR A:0xe61a504
y.create.l HWIO_PMIC_ARB_OBS1_CHNL331_CONFIG_ADDR A:0xe61a584
y.create.l HWIO_PMIC_ARB_OBS1_CHNL332_CONFIG_ADDR A:0xe61a604
y.create.l HWIO_PMIC_ARB_OBS1_CHNL333_CONFIG_ADDR A:0xe61a684
y.create.l HWIO_PMIC_ARB_OBS1_CHNL334_CONFIG_ADDR A:0xe61a704
y.create.l HWIO_PMIC_ARB_OBS1_CHNL335_CONFIG_ADDR A:0xe61a784
y.create.l HWIO_PMIC_ARB_OBS1_CHNL336_CONFIG_ADDR A:0xe61a804
y.create.l HWIO_PMIC_ARB_OBS1_CHNL337_CONFIG_ADDR A:0xe61a884
y.create.l HWIO_PMIC_ARB_OBS1_CHNL338_CONFIG_ADDR A:0xe61a904
y.create.l HWIO_PMIC_ARB_OBS1_CHNL339_CONFIG_ADDR A:0xe61a984
y.create.l HWIO_PMIC_ARB_OBS1_CHNL340_CONFIG_ADDR A:0xe61aa04
y.create.l HWIO_PMIC_ARB_OBS1_CHNL341_CONFIG_ADDR A:0xe61aa84
y.create.l HWIO_PMIC_ARB_OBS1_CHNL342_CONFIG_ADDR A:0xe61ab04
y.create.l HWIO_PMIC_ARB_OBS1_CHNL343_CONFIG_ADDR A:0xe61ab84
y.create.l HWIO_PMIC_ARB_OBS1_CHNL344_CONFIG_ADDR A:0xe61ac04
y.create.l HWIO_PMIC_ARB_OBS1_CHNL345_CONFIG_ADDR A:0xe61ac84
y.create.l HWIO_PMIC_ARB_OBS1_CHNL346_CONFIG_ADDR A:0xe61ad04
y.create.l HWIO_PMIC_ARB_OBS1_CHNL347_CONFIG_ADDR A:0xe61ad84
y.create.l HWIO_PMIC_ARB_OBS1_CHNL348_CONFIG_ADDR A:0xe61ae04
y.create.l HWIO_PMIC_ARB_OBS1_CHNL349_CONFIG_ADDR A:0xe61ae84
y.create.l HWIO_PMIC_ARB_OBS1_CHNL350_CONFIG_ADDR A:0xe61af04
y.create.l HWIO_PMIC_ARB_OBS1_CHNL351_CONFIG_ADDR A:0xe61af84
y.create.l HWIO_PMIC_ARB_OBS1_CHNL352_CONFIG_ADDR A:0xe61b004
y.create.l HWIO_PMIC_ARB_OBS1_CHNL353_CONFIG_ADDR A:0xe61b084
y.create.l HWIO_PMIC_ARB_OBS1_CHNL354_CONFIG_ADDR A:0xe61b104
y.create.l HWIO_PMIC_ARB_OBS1_CHNL355_CONFIG_ADDR A:0xe61b184
y.create.l HWIO_PMIC_ARB_OBS1_CHNL356_CONFIG_ADDR A:0xe61b204
y.create.l HWIO_PMIC_ARB_OBS1_CHNL357_CONFIG_ADDR A:0xe61b284
y.create.l HWIO_PMIC_ARB_OBS1_CHNL358_CONFIG_ADDR A:0xe61b304
y.create.l HWIO_PMIC_ARB_OBS1_CHNL359_CONFIG_ADDR A:0xe61b384
y.create.l HWIO_PMIC_ARB_OBS1_CHNL360_CONFIG_ADDR A:0xe61b404
y.create.l HWIO_PMIC_ARB_OBS1_CHNL361_CONFIG_ADDR A:0xe61b484
y.create.l HWIO_PMIC_ARB_OBS1_CHNL362_CONFIG_ADDR A:0xe61b504
y.create.l HWIO_PMIC_ARB_OBS1_CHNL363_CONFIG_ADDR A:0xe61b584
y.create.l HWIO_PMIC_ARB_OBS1_CHNL364_CONFIG_ADDR A:0xe61b604
y.create.l HWIO_PMIC_ARB_OBS1_CHNL365_CONFIG_ADDR A:0xe61b684
y.create.l HWIO_PMIC_ARB_OBS1_CHNL366_CONFIG_ADDR A:0xe61b704
y.create.l HWIO_PMIC_ARB_OBS1_CHNL367_CONFIG_ADDR A:0xe61b784
y.create.l HWIO_PMIC_ARB_OBS1_CHNL368_CONFIG_ADDR A:0xe61b804
y.create.l HWIO_PMIC_ARB_OBS1_CHNL369_CONFIG_ADDR A:0xe61b884
y.create.l HWIO_PMIC_ARB_OBS1_CHNL370_CONFIG_ADDR A:0xe61b904
y.create.l HWIO_PMIC_ARB_OBS1_CHNL371_CONFIG_ADDR A:0xe61b984
y.create.l HWIO_PMIC_ARB_OBS1_CHNL372_CONFIG_ADDR A:0xe61ba04
y.create.l HWIO_PMIC_ARB_OBS1_CHNL373_CONFIG_ADDR A:0xe61ba84
y.create.l HWIO_PMIC_ARB_OBS1_CHNL374_CONFIG_ADDR A:0xe61bb04
y.create.l HWIO_PMIC_ARB_OBS1_CHNL375_CONFIG_ADDR A:0xe61bb84
y.create.l HWIO_PMIC_ARB_OBS1_CHNL376_CONFIG_ADDR A:0xe61bc04
y.create.l HWIO_PMIC_ARB_OBS1_CHNL377_CONFIG_ADDR A:0xe61bc84
y.create.l HWIO_PMIC_ARB_OBS1_CHNL378_CONFIG_ADDR A:0xe61bd04
y.create.l HWIO_PMIC_ARB_OBS1_CHNL379_CONFIG_ADDR A:0xe61bd84
y.create.l HWIO_PMIC_ARB_OBS1_CHNL380_CONFIG_ADDR A:0xe61be04
y.create.l HWIO_PMIC_ARB_OBS1_CHNL381_CONFIG_ADDR A:0xe61be84
y.create.l HWIO_PMIC_ARB_OBS1_CHNL382_CONFIG_ADDR A:0xe61bf04
y.create.l HWIO_PMIC_ARB_OBS1_CHNL383_CONFIG_ADDR A:0xe61bf84
y.create.l HWIO_PMIC_ARB_OBS1_CHNL384_CONFIG_ADDR A:0xe61c004
y.create.l HWIO_PMIC_ARB_OBS1_CHNL385_CONFIG_ADDR A:0xe61c084
y.create.l HWIO_PMIC_ARB_OBS1_CHNL386_CONFIG_ADDR A:0xe61c104
y.create.l HWIO_PMIC_ARB_OBS1_CHNL387_CONFIG_ADDR A:0xe61c184
y.create.l HWIO_PMIC_ARB_OBS1_CHNL388_CONFIG_ADDR A:0xe61c204
y.create.l HWIO_PMIC_ARB_OBS1_CHNL389_CONFIG_ADDR A:0xe61c284
y.create.l HWIO_PMIC_ARB_OBS1_CHNL390_CONFIG_ADDR A:0xe61c304
y.create.l HWIO_PMIC_ARB_OBS1_CHNL391_CONFIG_ADDR A:0xe61c384
y.create.l HWIO_PMIC_ARB_OBS1_CHNL392_CONFIG_ADDR A:0xe61c404
y.create.l HWIO_PMIC_ARB_OBS1_CHNL393_CONFIG_ADDR A:0xe61c484
y.create.l HWIO_PMIC_ARB_OBS1_CHNL394_CONFIG_ADDR A:0xe61c504
y.create.l HWIO_PMIC_ARB_OBS1_CHNL395_CONFIG_ADDR A:0xe61c584
y.create.l HWIO_PMIC_ARB_OBS1_CHNL396_CONFIG_ADDR A:0xe61c604
y.create.l HWIO_PMIC_ARB_OBS1_CHNL397_CONFIG_ADDR A:0xe61c684
y.create.l HWIO_PMIC_ARB_OBS1_CHNL398_CONFIG_ADDR A:0xe61c704
y.create.l HWIO_PMIC_ARB_OBS1_CHNL399_CONFIG_ADDR A:0xe61c784
y.create.l HWIO_PMIC_ARB_OBS1_CHNL400_CONFIG_ADDR A:0xe61c804
y.create.l HWIO_PMIC_ARB_OBS1_CHNL401_CONFIG_ADDR A:0xe61c884
y.create.l HWIO_PMIC_ARB_OBS1_CHNL402_CONFIG_ADDR A:0xe61c904
y.create.l HWIO_PMIC_ARB_OBS1_CHNL403_CONFIG_ADDR A:0xe61c984
y.create.l HWIO_PMIC_ARB_OBS1_CHNL404_CONFIG_ADDR A:0xe61ca04
y.create.l HWIO_PMIC_ARB_OBS1_CHNL405_CONFIG_ADDR A:0xe61ca84
y.create.l HWIO_PMIC_ARB_OBS1_CHNL406_CONFIG_ADDR A:0xe61cb04
y.create.l HWIO_PMIC_ARB_OBS1_CHNL407_CONFIG_ADDR A:0xe61cb84
y.create.l HWIO_PMIC_ARB_OBS1_CHNL408_CONFIG_ADDR A:0xe61cc04
y.create.l HWIO_PMIC_ARB_OBS1_CHNL409_CONFIG_ADDR A:0xe61cc84
y.create.l HWIO_PMIC_ARB_OBS1_CHNL410_CONFIG_ADDR A:0xe61cd04
y.create.l HWIO_PMIC_ARB_OBS1_CHNL411_CONFIG_ADDR A:0xe61cd84
y.create.l HWIO_PMIC_ARB_OBS1_CHNL412_CONFIG_ADDR A:0xe61ce04
y.create.l HWIO_PMIC_ARB_OBS1_CHNL413_CONFIG_ADDR A:0xe61ce84
y.create.l HWIO_PMIC_ARB_OBS1_CHNL414_CONFIG_ADDR A:0xe61cf04
y.create.l HWIO_PMIC_ARB_OBS1_CHNL415_CONFIG_ADDR A:0xe61cf84
y.create.l HWIO_PMIC_ARB_OBS1_CHNL416_CONFIG_ADDR A:0xe61d004
y.create.l HWIO_PMIC_ARB_OBS1_CHNL417_CONFIG_ADDR A:0xe61d084
y.create.l HWIO_PMIC_ARB_OBS1_CHNL418_CONFIG_ADDR A:0xe61d104
y.create.l HWIO_PMIC_ARB_OBS1_CHNL419_CONFIG_ADDR A:0xe61d184
y.create.l HWIO_PMIC_ARB_OBS1_CHNL420_CONFIG_ADDR A:0xe61d204
y.create.l HWIO_PMIC_ARB_OBS1_CHNL421_CONFIG_ADDR A:0xe61d284
y.create.l HWIO_PMIC_ARB_OBS1_CHNL422_CONFIG_ADDR A:0xe61d304
y.create.l HWIO_PMIC_ARB_OBS1_CHNL423_CONFIG_ADDR A:0xe61d384
y.create.l HWIO_PMIC_ARB_OBS1_CHNL424_CONFIG_ADDR A:0xe61d404
y.create.l HWIO_PMIC_ARB_OBS1_CHNL425_CONFIG_ADDR A:0xe61d484
y.create.l HWIO_PMIC_ARB_OBS1_CHNL426_CONFIG_ADDR A:0xe61d504
y.create.l HWIO_PMIC_ARB_OBS1_CHNL427_CONFIG_ADDR A:0xe61d584
y.create.l HWIO_PMIC_ARB_OBS1_CHNL428_CONFIG_ADDR A:0xe61d604
y.create.l HWIO_PMIC_ARB_OBS1_CHNL429_CONFIG_ADDR A:0xe61d684
y.create.l HWIO_PMIC_ARB_OBS1_CHNL430_CONFIG_ADDR A:0xe61d704
y.create.l HWIO_PMIC_ARB_OBS1_CHNL431_CONFIG_ADDR A:0xe61d784
y.create.l HWIO_PMIC_ARB_OBS1_CHNL432_CONFIG_ADDR A:0xe61d804
y.create.l HWIO_PMIC_ARB_OBS1_CHNL433_CONFIG_ADDR A:0xe61d884
y.create.l HWIO_PMIC_ARB_OBS1_CHNL434_CONFIG_ADDR A:0xe61d904
y.create.l HWIO_PMIC_ARB_OBS1_CHNL435_CONFIG_ADDR A:0xe61d984
y.create.l HWIO_PMIC_ARB_OBS1_CHNL436_CONFIG_ADDR A:0xe61da04
y.create.l HWIO_PMIC_ARB_OBS1_CHNL437_CONFIG_ADDR A:0xe61da84
y.create.l HWIO_PMIC_ARB_OBS1_CHNL438_CONFIG_ADDR A:0xe61db04
y.create.l HWIO_PMIC_ARB_OBS1_CHNL439_CONFIG_ADDR A:0xe61db84
y.create.l HWIO_PMIC_ARB_OBS1_CHNL440_CONFIG_ADDR A:0xe61dc04
y.create.l HWIO_PMIC_ARB_OBS1_CHNL441_CONFIG_ADDR A:0xe61dc84
y.create.l HWIO_PMIC_ARB_OBS1_CHNL442_CONFIG_ADDR A:0xe61dd04
y.create.l HWIO_PMIC_ARB_OBS1_CHNL443_CONFIG_ADDR A:0xe61dd84
y.create.l HWIO_PMIC_ARB_OBS1_CHNL444_CONFIG_ADDR A:0xe61de04
y.create.l HWIO_PMIC_ARB_OBS1_CHNL445_CONFIG_ADDR A:0xe61de84
y.create.l HWIO_PMIC_ARB_OBS1_CHNL446_CONFIG_ADDR A:0xe61df04
y.create.l HWIO_PMIC_ARB_OBS1_CHNL447_CONFIG_ADDR A:0xe61df84
y.create.l HWIO_PMIC_ARB_OBS1_CHNL448_CONFIG_ADDR A:0xe61e004
y.create.l HWIO_PMIC_ARB_OBS1_CHNL449_CONFIG_ADDR A:0xe61e084
y.create.l HWIO_PMIC_ARB_OBS1_CHNL450_CONFIG_ADDR A:0xe61e104
y.create.l HWIO_PMIC_ARB_OBS1_CHNL451_CONFIG_ADDR A:0xe61e184
y.create.l HWIO_PMIC_ARB_OBS1_CHNL452_CONFIG_ADDR A:0xe61e204
y.create.l HWIO_PMIC_ARB_OBS1_CHNL453_CONFIG_ADDR A:0xe61e284
y.create.l HWIO_PMIC_ARB_OBS1_CHNL454_CONFIG_ADDR A:0xe61e304
y.create.l HWIO_PMIC_ARB_OBS1_CHNL455_CONFIG_ADDR A:0xe61e384
y.create.l HWIO_PMIC_ARB_OBS1_CHNL456_CONFIG_ADDR A:0xe61e404
y.create.l HWIO_PMIC_ARB_OBS1_CHNL457_CONFIG_ADDR A:0xe61e484
y.create.l HWIO_PMIC_ARB_OBS1_CHNL458_CONFIG_ADDR A:0xe61e504
y.create.l HWIO_PMIC_ARB_OBS1_CHNL459_CONFIG_ADDR A:0xe61e584
y.create.l HWIO_PMIC_ARB_OBS1_CHNL460_CONFIG_ADDR A:0xe61e604
y.create.l HWIO_PMIC_ARB_OBS1_CHNL461_CONFIG_ADDR A:0xe61e684
y.create.l HWIO_PMIC_ARB_OBS1_CHNL462_CONFIG_ADDR A:0xe61e704
y.create.l HWIO_PMIC_ARB_OBS1_CHNL463_CONFIG_ADDR A:0xe61e784
y.create.l HWIO_PMIC_ARB_OBS1_CHNL464_CONFIG_ADDR A:0xe61e804
y.create.l HWIO_PMIC_ARB_OBS1_CHNL465_CONFIG_ADDR A:0xe61e884
y.create.l HWIO_PMIC_ARB_OBS1_CHNL466_CONFIG_ADDR A:0xe61e904
y.create.l HWIO_PMIC_ARB_OBS1_CHNL467_CONFIG_ADDR A:0xe61e984
y.create.l HWIO_PMIC_ARB_OBS1_CHNL468_CONFIG_ADDR A:0xe61ea04
y.create.l HWIO_PMIC_ARB_OBS1_CHNL469_CONFIG_ADDR A:0xe61ea84
y.create.l HWIO_PMIC_ARB_OBS1_CHNL470_CONFIG_ADDR A:0xe61eb04
y.create.l HWIO_PMIC_ARB_OBS1_CHNL471_CONFIG_ADDR A:0xe61eb84
y.create.l HWIO_PMIC_ARB_OBS1_CHNL472_CONFIG_ADDR A:0xe61ec04
y.create.l HWIO_PMIC_ARB_OBS1_CHNL473_CONFIG_ADDR A:0xe61ec84
y.create.l HWIO_PMIC_ARB_OBS1_CHNL474_CONFIG_ADDR A:0xe61ed04
y.create.l HWIO_PMIC_ARB_OBS1_CHNL475_CONFIG_ADDR A:0xe61ed84
y.create.l HWIO_PMIC_ARB_OBS1_CHNL476_CONFIG_ADDR A:0xe61ee04
y.create.l HWIO_PMIC_ARB_OBS1_CHNL477_CONFIG_ADDR A:0xe61ee84
y.create.l HWIO_PMIC_ARB_OBS1_CHNL478_CONFIG_ADDR A:0xe61ef04
y.create.l HWIO_PMIC_ARB_OBS1_CHNL479_CONFIG_ADDR A:0xe61ef84
y.create.l HWIO_PMIC_ARB_OBS1_CHNL480_CONFIG_ADDR A:0xe61f004
y.create.l HWIO_PMIC_ARB_OBS1_CHNL481_CONFIG_ADDR A:0xe61f084
y.create.l HWIO_PMIC_ARB_OBS1_CHNL482_CONFIG_ADDR A:0xe61f104
y.create.l HWIO_PMIC_ARB_OBS1_CHNL483_CONFIG_ADDR A:0xe61f184
y.create.l HWIO_PMIC_ARB_OBS1_CHNL484_CONFIG_ADDR A:0xe61f204
y.create.l HWIO_PMIC_ARB_OBS1_CHNL485_CONFIG_ADDR A:0xe61f284
y.create.l HWIO_PMIC_ARB_OBS1_CHNL486_CONFIG_ADDR A:0xe61f304
y.create.l HWIO_PMIC_ARB_OBS1_CHNL487_CONFIG_ADDR A:0xe61f384
y.create.l HWIO_PMIC_ARB_OBS1_CHNL488_CONFIG_ADDR A:0xe61f404
y.create.l HWIO_PMIC_ARB_OBS1_CHNL489_CONFIG_ADDR A:0xe61f484
y.create.l HWIO_PMIC_ARB_OBS1_CHNL490_CONFIG_ADDR A:0xe61f504
y.create.l HWIO_PMIC_ARB_OBS1_CHNL491_CONFIG_ADDR A:0xe61f584
y.create.l HWIO_PMIC_ARB_OBS1_CHNL492_CONFIG_ADDR A:0xe61f604
y.create.l HWIO_PMIC_ARB_OBS1_CHNL493_CONFIG_ADDR A:0xe61f684
y.create.l HWIO_PMIC_ARB_OBS1_CHNL494_CONFIG_ADDR A:0xe61f704
y.create.l HWIO_PMIC_ARB_OBS1_CHNL495_CONFIG_ADDR A:0xe61f784
y.create.l HWIO_PMIC_ARB_OBS1_CHNL496_CONFIG_ADDR A:0xe61f804
y.create.l HWIO_PMIC_ARB_OBS1_CHNL497_CONFIG_ADDR A:0xe61f884
y.create.l HWIO_PMIC_ARB_OBS1_CHNL498_CONFIG_ADDR A:0xe61f904
y.create.l HWIO_PMIC_ARB_OBS1_CHNL499_CONFIG_ADDR A:0xe61f984
y.create.l HWIO_PMIC_ARB_OBS1_CHNL500_CONFIG_ADDR A:0xe61fa04
y.create.l HWIO_PMIC_ARB_OBS1_CHNL501_CONFIG_ADDR A:0xe61fa84
y.create.l HWIO_PMIC_ARB_OBS1_CHNL502_CONFIG_ADDR A:0xe61fb04
y.create.l HWIO_PMIC_ARB_OBS1_CHNL503_CONFIG_ADDR A:0xe61fb84
y.create.l HWIO_PMIC_ARB_OBS1_CHNL504_CONFIG_ADDR A:0xe61fc04
y.create.l HWIO_PMIC_ARB_OBS1_CHNL505_CONFIG_ADDR A:0xe61fc84
y.create.l HWIO_PMIC_ARB_OBS1_CHNL506_CONFIG_ADDR A:0xe61fd04
y.create.l HWIO_PMIC_ARB_OBS1_CHNL507_CONFIG_ADDR A:0xe61fd84
y.create.l HWIO_PMIC_ARB_OBS1_CHNL508_CONFIG_ADDR A:0xe61fe04
y.create.l HWIO_PMIC_ARB_OBS1_CHNL509_CONFIG_ADDR A:0xe61fe84
y.create.l HWIO_PMIC_ARB_OBS1_CHNL510_CONFIG_ADDR A:0xe61ff04
y.create.l HWIO_PMIC_ARB_OBS1_CHNL511_CONFIG_ADDR A:0xe61ff84
y.create.l HWIO_PMIC_ARB_OBS2_CHNL0_CONFIG_ADDR A:0xe620004
y.create.l HWIO_PMIC_ARB_OBS2_CHNL1_CONFIG_ADDR A:0xe620084
y.create.l HWIO_PMIC_ARB_OBS2_CHNL2_CONFIG_ADDR A:0xe620104
y.create.l HWIO_PMIC_ARB_OBS2_CHNL3_CONFIG_ADDR A:0xe620184
y.create.l HWIO_PMIC_ARB_OBS2_CHNL4_CONFIG_ADDR A:0xe620204
y.create.l HWIO_PMIC_ARB_OBS2_CHNL5_CONFIG_ADDR A:0xe620284
y.create.l HWIO_PMIC_ARB_OBS2_CHNL6_CONFIG_ADDR A:0xe620304
y.create.l HWIO_PMIC_ARB_OBS2_CHNL7_CONFIG_ADDR A:0xe620384
y.create.l HWIO_PMIC_ARB_OBS2_CHNL8_CONFIG_ADDR A:0xe620404
y.create.l HWIO_PMIC_ARB_OBS2_CHNL9_CONFIG_ADDR A:0xe620484
y.create.l HWIO_PMIC_ARB_OBS2_CHNL10_CONFIG_ADDR A:0xe620504
y.create.l HWIO_PMIC_ARB_OBS2_CHNL11_CONFIG_ADDR A:0xe620584
y.create.l HWIO_PMIC_ARB_OBS2_CHNL12_CONFIG_ADDR A:0xe620604
y.create.l HWIO_PMIC_ARB_OBS2_CHNL13_CONFIG_ADDR A:0xe620684
y.create.l HWIO_PMIC_ARB_OBS2_CHNL14_CONFIG_ADDR A:0xe620704
y.create.l HWIO_PMIC_ARB_OBS2_CHNL15_CONFIG_ADDR A:0xe620784
y.create.l HWIO_PMIC_ARB_OBS2_CHNL16_CONFIG_ADDR A:0xe620804
y.create.l HWIO_PMIC_ARB_OBS2_CHNL17_CONFIG_ADDR A:0xe620884
y.create.l HWIO_PMIC_ARB_OBS2_CHNL18_CONFIG_ADDR A:0xe620904
y.create.l HWIO_PMIC_ARB_OBS2_CHNL19_CONFIG_ADDR A:0xe620984
y.create.l HWIO_PMIC_ARB_OBS2_CHNL20_CONFIG_ADDR A:0xe620a04
y.create.l HWIO_PMIC_ARB_OBS2_CHNL21_CONFIG_ADDR A:0xe620a84
y.create.l HWIO_PMIC_ARB_OBS2_CHNL22_CONFIG_ADDR A:0xe620b04
y.create.l HWIO_PMIC_ARB_OBS2_CHNL23_CONFIG_ADDR A:0xe620b84
y.create.l HWIO_PMIC_ARB_OBS2_CHNL24_CONFIG_ADDR A:0xe620c04
y.create.l HWIO_PMIC_ARB_OBS2_CHNL25_CONFIG_ADDR A:0xe620c84
y.create.l HWIO_PMIC_ARB_OBS2_CHNL26_CONFIG_ADDR A:0xe620d04
y.create.l HWIO_PMIC_ARB_OBS2_CHNL27_CONFIG_ADDR A:0xe620d84
y.create.l HWIO_PMIC_ARB_OBS2_CHNL28_CONFIG_ADDR A:0xe620e04
y.create.l HWIO_PMIC_ARB_OBS2_CHNL29_CONFIG_ADDR A:0xe620e84
y.create.l HWIO_PMIC_ARB_OBS2_CHNL30_CONFIG_ADDR A:0xe620f04
y.create.l HWIO_PMIC_ARB_OBS2_CHNL31_CONFIG_ADDR A:0xe620f84
y.create.l HWIO_PMIC_ARB_OBS2_CHNL32_CONFIG_ADDR A:0xe621004
y.create.l HWIO_PMIC_ARB_OBS2_CHNL33_CONFIG_ADDR A:0xe621084
y.create.l HWIO_PMIC_ARB_OBS2_CHNL34_CONFIG_ADDR A:0xe621104
y.create.l HWIO_PMIC_ARB_OBS2_CHNL35_CONFIG_ADDR A:0xe621184
y.create.l HWIO_PMIC_ARB_OBS2_CHNL36_CONFIG_ADDR A:0xe621204
y.create.l HWIO_PMIC_ARB_OBS2_CHNL37_CONFIG_ADDR A:0xe621284
y.create.l HWIO_PMIC_ARB_OBS2_CHNL38_CONFIG_ADDR A:0xe621304
y.create.l HWIO_PMIC_ARB_OBS2_CHNL39_CONFIG_ADDR A:0xe621384
y.create.l HWIO_PMIC_ARB_OBS2_CHNL40_CONFIG_ADDR A:0xe621404
y.create.l HWIO_PMIC_ARB_OBS2_CHNL41_CONFIG_ADDR A:0xe621484
y.create.l HWIO_PMIC_ARB_OBS2_CHNL42_CONFIG_ADDR A:0xe621504
y.create.l HWIO_PMIC_ARB_OBS2_CHNL43_CONFIG_ADDR A:0xe621584
y.create.l HWIO_PMIC_ARB_OBS2_CHNL44_CONFIG_ADDR A:0xe621604
y.create.l HWIO_PMIC_ARB_OBS2_CHNL45_CONFIG_ADDR A:0xe621684
y.create.l HWIO_PMIC_ARB_OBS2_CHNL46_CONFIG_ADDR A:0xe621704
y.create.l HWIO_PMIC_ARB_OBS2_CHNL47_CONFIG_ADDR A:0xe621784
y.create.l HWIO_PMIC_ARB_OBS2_CHNL48_CONFIG_ADDR A:0xe621804
y.create.l HWIO_PMIC_ARB_OBS2_CHNL49_CONFIG_ADDR A:0xe621884
y.create.l HWIO_PMIC_ARB_OBS2_CHNL50_CONFIG_ADDR A:0xe621904
y.create.l HWIO_PMIC_ARB_OBS2_CHNL51_CONFIG_ADDR A:0xe621984
y.create.l HWIO_PMIC_ARB_OBS2_CHNL52_CONFIG_ADDR A:0xe621a04
y.create.l HWIO_PMIC_ARB_OBS2_CHNL53_CONFIG_ADDR A:0xe621a84
y.create.l HWIO_PMIC_ARB_OBS2_CHNL54_CONFIG_ADDR A:0xe621b04
y.create.l HWIO_PMIC_ARB_OBS2_CHNL55_CONFIG_ADDR A:0xe621b84
y.create.l HWIO_PMIC_ARB_OBS2_CHNL56_CONFIG_ADDR A:0xe621c04
y.create.l HWIO_PMIC_ARB_OBS2_CHNL57_CONFIG_ADDR A:0xe621c84
y.create.l HWIO_PMIC_ARB_OBS2_CHNL58_CONFIG_ADDR A:0xe621d04
y.create.l HWIO_PMIC_ARB_OBS2_CHNL59_CONFIG_ADDR A:0xe621d84
y.create.l HWIO_PMIC_ARB_OBS2_CHNL60_CONFIG_ADDR A:0xe621e04
y.create.l HWIO_PMIC_ARB_OBS2_CHNL61_CONFIG_ADDR A:0xe621e84
y.create.l HWIO_PMIC_ARB_OBS2_CHNL62_CONFIG_ADDR A:0xe621f04
y.create.l HWIO_PMIC_ARB_OBS2_CHNL63_CONFIG_ADDR A:0xe621f84
y.create.l HWIO_PMIC_ARB_OBS2_CHNL64_CONFIG_ADDR A:0xe622004
y.create.l HWIO_PMIC_ARB_OBS2_CHNL65_CONFIG_ADDR A:0xe622084
y.create.l HWIO_PMIC_ARB_OBS2_CHNL66_CONFIG_ADDR A:0xe622104
y.create.l HWIO_PMIC_ARB_OBS2_CHNL67_CONFIG_ADDR A:0xe622184
y.create.l HWIO_PMIC_ARB_OBS2_CHNL68_CONFIG_ADDR A:0xe622204
y.create.l HWIO_PMIC_ARB_OBS2_CHNL69_CONFIG_ADDR A:0xe622284
y.create.l HWIO_PMIC_ARB_OBS2_CHNL70_CONFIG_ADDR A:0xe622304
y.create.l HWIO_PMIC_ARB_OBS2_CHNL71_CONFIG_ADDR A:0xe622384
y.create.l HWIO_PMIC_ARB_OBS2_CHNL72_CONFIG_ADDR A:0xe622404
y.create.l HWIO_PMIC_ARB_OBS2_CHNL73_CONFIG_ADDR A:0xe622484
y.create.l HWIO_PMIC_ARB_OBS2_CHNL74_CONFIG_ADDR A:0xe622504
y.create.l HWIO_PMIC_ARB_OBS2_CHNL75_CONFIG_ADDR A:0xe622584
y.create.l HWIO_PMIC_ARB_OBS2_CHNL76_CONFIG_ADDR A:0xe622604
y.create.l HWIO_PMIC_ARB_OBS2_CHNL77_CONFIG_ADDR A:0xe622684
y.create.l HWIO_PMIC_ARB_OBS2_CHNL78_CONFIG_ADDR A:0xe622704
y.create.l HWIO_PMIC_ARB_OBS2_CHNL79_CONFIG_ADDR A:0xe622784
y.create.l HWIO_PMIC_ARB_OBS2_CHNL80_CONFIG_ADDR A:0xe622804
y.create.l HWIO_PMIC_ARB_OBS2_CHNL81_CONFIG_ADDR A:0xe622884
y.create.l HWIO_PMIC_ARB_OBS2_CHNL82_CONFIG_ADDR A:0xe622904
y.create.l HWIO_PMIC_ARB_OBS2_CHNL83_CONFIG_ADDR A:0xe622984
y.create.l HWIO_PMIC_ARB_OBS2_CHNL84_CONFIG_ADDR A:0xe622a04
y.create.l HWIO_PMIC_ARB_OBS2_CHNL85_CONFIG_ADDR A:0xe622a84
y.create.l HWIO_PMIC_ARB_OBS2_CHNL86_CONFIG_ADDR A:0xe622b04
y.create.l HWIO_PMIC_ARB_OBS2_CHNL87_CONFIG_ADDR A:0xe622b84
y.create.l HWIO_PMIC_ARB_OBS2_CHNL88_CONFIG_ADDR A:0xe622c04
y.create.l HWIO_PMIC_ARB_OBS2_CHNL89_CONFIG_ADDR A:0xe622c84
y.create.l HWIO_PMIC_ARB_OBS2_CHNL90_CONFIG_ADDR A:0xe622d04
y.create.l HWIO_PMIC_ARB_OBS2_CHNL91_CONFIG_ADDR A:0xe622d84
y.create.l HWIO_PMIC_ARB_OBS2_CHNL92_CONFIG_ADDR A:0xe622e04
y.create.l HWIO_PMIC_ARB_OBS2_CHNL93_CONFIG_ADDR A:0xe622e84
y.create.l HWIO_PMIC_ARB_OBS2_CHNL94_CONFIG_ADDR A:0xe622f04
y.create.l HWIO_PMIC_ARB_OBS2_CHNL95_CONFIG_ADDR A:0xe622f84
y.create.l HWIO_PMIC_ARB_OBS2_CHNL96_CONFIG_ADDR A:0xe623004
y.create.l HWIO_PMIC_ARB_OBS2_CHNL97_CONFIG_ADDR A:0xe623084
y.create.l HWIO_PMIC_ARB_OBS2_CHNL98_CONFIG_ADDR A:0xe623104
y.create.l HWIO_PMIC_ARB_OBS2_CHNL99_CONFIG_ADDR A:0xe623184
y.create.l HWIO_PMIC_ARB_OBS2_CHNL100_CONFIG_ADDR A:0xe623204
y.create.l HWIO_PMIC_ARB_OBS2_CHNL101_CONFIG_ADDR A:0xe623284
y.create.l HWIO_PMIC_ARB_OBS2_CHNL102_CONFIG_ADDR A:0xe623304
y.create.l HWIO_PMIC_ARB_OBS2_CHNL103_CONFIG_ADDR A:0xe623384
y.create.l HWIO_PMIC_ARB_OBS2_CHNL104_CONFIG_ADDR A:0xe623404
y.create.l HWIO_PMIC_ARB_OBS2_CHNL105_CONFIG_ADDR A:0xe623484
y.create.l HWIO_PMIC_ARB_OBS2_CHNL106_CONFIG_ADDR A:0xe623504
y.create.l HWIO_PMIC_ARB_OBS2_CHNL107_CONFIG_ADDR A:0xe623584
y.create.l HWIO_PMIC_ARB_OBS2_CHNL108_CONFIG_ADDR A:0xe623604
y.create.l HWIO_PMIC_ARB_OBS2_CHNL109_CONFIG_ADDR A:0xe623684
y.create.l HWIO_PMIC_ARB_OBS2_CHNL110_CONFIG_ADDR A:0xe623704
y.create.l HWIO_PMIC_ARB_OBS2_CHNL111_CONFIG_ADDR A:0xe623784
y.create.l HWIO_PMIC_ARB_OBS2_CHNL112_CONFIG_ADDR A:0xe623804
y.create.l HWIO_PMIC_ARB_OBS2_CHNL113_CONFIG_ADDR A:0xe623884
y.create.l HWIO_PMIC_ARB_OBS2_CHNL114_CONFIG_ADDR A:0xe623904
y.create.l HWIO_PMIC_ARB_OBS2_CHNL115_CONFIG_ADDR A:0xe623984
y.create.l HWIO_PMIC_ARB_OBS2_CHNL116_CONFIG_ADDR A:0xe623a04
y.create.l HWIO_PMIC_ARB_OBS2_CHNL117_CONFIG_ADDR A:0xe623a84
y.create.l HWIO_PMIC_ARB_OBS2_CHNL118_CONFIG_ADDR A:0xe623b04
y.create.l HWIO_PMIC_ARB_OBS2_CHNL119_CONFIG_ADDR A:0xe623b84
y.create.l HWIO_PMIC_ARB_OBS2_CHNL120_CONFIG_ADDR A:0xe623c04
y.create.l HWIO_PMIC_ARB_OBS2_CHNL121_CONFIG_ADDR A:0xe623c84
y.create.l HWIO_PMIC_ARB_OBS2_CHNL122_CONFIG_ADDR A:0xe623d04
y.create.l HWIO_PMIC_ARB_OBS2_CHNL123_CONFIG_ADDR A:0xe623d84
y.create.l HWIO_PMIC_ARB_OBS2_CHNL124_CONFIG_ADDR A:0xe623e04
y.create.l HWIO_PMIC_ARB_OBS2_CHNL125_CONFIG_ADDR A:0xe623e84
y.create.l HWIO_PMIC_ARB_OBS2_CHNL126_CONFIG_ADDR A:0xe623f04
y.create.l HWIO_PMIC_ARB_OBS2_CHNL127_CONFIG_ADDR A:0xe623f84
y.create.l HWIO_PMIC_ARB_OBS2_CHNL128_CONFIG_ADDR A:0xe624004
y.create.l HWIO_PMIC_ARB_OBS2_CHNL129_CONFIG_ADDR A:0xe624084
y.create.l HWIO_PMIC_ARB_OBS2_CHNL130_CONFIG_ADDR A:0xe624104
y.create.l HWIO_PMIC_ARB_OBS2_CHNL131_CONFIG_ADDR A:0xe624184
y.create.l HWIO_PMIC_ARB_OBS2_CHNL132_CONFIG_ADDR A:0xe624204
y.create.l HWIO_PMIC_ARB_OBS2_CHNL133_CONFIG_ADDR A:0xe624284
y.create.l HWIO_PMIC_ARB_OBS2_CHNL134_CONFIG_ADDR A:0xe624304
y.create.l HWIO_PMIC_ARB_OBS2_CHNL135_CONFIG_ADDR A:0xe624384
y.create.l HWIO_PMIC_ARB_OBS2_CHNL136_CONFIG_ADDR A:0xe624404
y.create.l HWIO_PMIC_ARB_OBS2_CHNL137_CONFIG_ADDR A:0xe624484
y.create.l HWIO_PMIC_ARB_OBS2_CHNL138_CONFIG_ADDR A:0xe624504
y.create.l HWIO_PMIC_ARB_OBS2_CHNL139_CONFIG_ADDR A:0xe624584
y.create.l HWIO_PMIC_ARB_OBS2_CHNL140_CONFIG_ADDR A:0xe624604
y.create.l HWIO_PMIC_ARB_OBS2_CHNL141_CONFIG_ADDR A:0xe624684
y.create.l HWIO_PMIC_ARB_OBS2_CHNL142_CONFIG_ADDR A:0xe624704
y.create.l HWIO_PMIC_ARB_OBS2_CHNL143_CONFIG_ADDR A:0xe624784
y.create.l HWIO_PMIC_ARB_OBS2_CHNL144_CONFIG_ADDR A:0xe624804
y.create.l HWIO_PMIC_ARB_OBS2_CHNL145_CONFIG_ADDR A:0xe624884
y.create.l HWIO_PMIC_ARB_OBS2_CHNL146_CONFIG_ADDR A:0xe624904
y.create.l HWIO_PMIC_ARB_OBS2_CHNL147_CONFIG_ADDR A:0xe624984
y.create.l HWIO_PMIC_ARB_OBS2_CHNL148_CONFIG_ADDR A:0xe624a04
y.create.l HWIO_PMIC_ARB_OBS2_CHNL149_CONFIG_ADDR A:0xe624a84
y.create.l HWIO_PMIC_ARB_OBS2_CHNL150_CONFIG_ADDR A:0xe624b04
y.create.l HWIO_PMIC_ARB_OBS2_CHNL151_CONFIG_ADDR A:0xe624b84
y.create.l HWIO_PMIC_ARB_OBS2_CHNL152_CONFIG_ADDR A:0xe624c04
y.create.l HWIO_PMIC_ARB_OBS2_CHNL153_CONFIG_ADDR A:0xe624c84
y.create.l HWIO_PMIC_ARB_OBS2_CHNL154_CONFIG_ADDR A:0xe624d04
y.create.l HWIO_PMIC_ARB_OBS2_CHNL155_CONFIG_ADDR A:0xe624d84
y.create.l HWIO_PMIC_ARB_OBS2_CHNL156_CONFIG_ADDR A:0xe624e04
y.create.l HWIO_PMIC_ARB_OBS2_CHNL157_CONFIG_ADDR A:0xe624e84
y.create.l HWIO_PMIC_ARB_OBS2_CHNL158_CONFIG_ADDR A:0xe624f04
y.create.l HWIO_PMIC_ARB_OBS2_CHNL159_CONFIG_ADDR A:0xe624f84
y.create.l HWIO_PMIC_ARB_OBS2_CHNL160_CONFIG_ADDR A:0xe625004
y.create.l HWIO_PMIC_ARB_OBS2_CHNL161_CONFIG_ADDR A:0xe625084
y.create.l HWIO_PMIC_ARB_OBS2_CHNL162_CONFIG_ADDR A:0xe625104
y.create.l HWIO_PMIC_ARB_OBS2_CHNL163_CONFIG_ADDR A:0xe625184
y.create.l HWIO_PMIC_ARB_OBS2_CHNL164_CONFIG_ADDR A:0xe625204
y.create.l HWIO_PMIC_ARB_OBS2_CHNL165_CONFIG_ADDR A:0xe625284
y.create.l HWIO_PMIC_ARB_OBS2_CHNL166_CONFIG_ADDR A:0xe625304
y.create.l HWIO_PMIC_ARB_OBS2_CHNL167_CONFIG_ADDR A:0xe625384
y.create.l HWIO_PMIC_ARB_OBS2_CHNL168_CONFIG_ADDR A:0xe625404
y.create.l HWIO_PMIC_ARB_OBS2_CHNL169_CONFIG_ADDR A:0xe625484
y.create.l HWIO_PMIC_ARB_OBS2_CHNL170_CONFIG_ADDR A:0xe625504
y.create.l HWIO_PMIC_ARB_OBS2_CHNL171_CONFIG_ADDR A:0xe625584
y.create.l HWIO_PMIC_ARB_OBS2_CHNL172_CONFIG_ADDR A:0xe625604
y.create.l HWIO_PMIC_ARB_OBS2_CHNL173_CONFIG_ADDR A:0xe625684
y.create.l HWIO_PMIC_ARB_OBS2_CHNL174_CONFIG_ADDR A:0xe625704
y.create.l HWIO_PMIC_ARB_OBS2_CHNL175_CONFIG_ADDR A:0xe625784
y.create.l HWIO_PMIC_ARB_OBS2_CHNL176_CONFIG_ADDR A:0xe625804
y.create.l HWIO_PMIC_ARB_OBS2_CHNL177_CONFIG_ADDR A:0xe625884
y.create.l HWIO_PMIC_ARB_OBS2_CHNL178_CONFIG_ADDR A:0xe625904
y.create.l HWIO_PMIC_ARB_OBS2_CHNL179_CONFIG_ADDR A:0xe625984
y.create.l HWIO_PMIC_ARB_OBS2_CHNL180_CONFIG_ADDR A:0xe625a04
y.create.l HWIO_PMIC_ARB_OBS2_CHNL181_CONFIG_ADDR A:0xe625a84
y.create.l HWIO_PMIC_ARB_OBS2_CHNL182_CONFIG_ADDR A:0xe625b04
y.create.l HWIO_PMIC_ARB_OBS2_CHNL183_CONFIG_ADDR A:0xe625b84
y.create.l HWIO_PMIC_ARB_OBS2_CHNL184_CONFIG_ADDR A:0xe625c04
y.create.l HWIO_PMIC_ARB_OBS2_CHNL185_CONFIG_ADDR A:0xe625c84
y.create.l HWIO_PMIC_ARB_OBS2_CHNL186_CONFIG_ADDR A:0xe625d04
y.create.l HWIO_PMIC_ARB_OBS2_CHNL187_CONFIG_ADDR A:0xe625d84
y.create.l HWIO_PMIC_ARB_OBS2_CHNL188_CONFIG_ADDR A:0xe625e04
y.create.l HWIO_PMIC_ARB_OBS2_CHNL189_CONFIG_ADDR A:0xe625e84
y.create.l HWIO_PMIC_ARB_OBS2_CHNL190_CONFIG_ADDR A:0xe625f04
y.create.l HWIO_PMIC_ARB_OBS2_CHNL191_CONFIG_ADDR A:0xe625f84
y.create.l HWIO_PMIC_ARB_OBS2_CHNL192_CONFIG_ADDR A:0xe626004
y.create.l HWIO_PMIC_ARB_OBS2_CHNL193_CONFIG_ADDR A:0xe626084
y.create.l HWIO_PMIC_ARB_OBS2_CHNL194_CONFIG_ADDR A:0xe626104
y.create.l HWIO_PMIC_ARB_OBS2_CHNL195_CONFIG_ADDR A:0xe626184
y.create.l HWIO_PMIC_ARB_OBS2_CHNL196_CONFIG_ADDR A:0xe626204
y.create.l HWIO_PMIC_ARB_OBS2_CHNL197_CONFIG_ADDR A:0xe626284
y.create.l HWIO_PMIC_ARB_OBS2_CHNL198_CONFIG_ADDR A:0xe626304
y.create.l HWIO_PMIC_ARB_OBS2_CHNL199_CONFIG_ADDR A:0xe626384
y.create.l HWIO_PMIC_ARB_OBS2_CHNL200_CONFIG_ADDR A:0xe626404
y.create.l HWIO_PMIC_ARB_OBS2_CHNL201_CONFIG_ADDR A:0xe626484
y.create.l HWIO_PMIC_ARB_OBS2_CHNL202_CONFIG_ADDR A:0xe626504
y.create.l HWIO_PMIC_ARB_OBS2_CHNL203_CONFIG_ADDR A:0xe626584
y.create.l HWIO_PMIC_ARB_OBS2_CHNL204_CONFIG_ADDR A:0xe626604
y.create.l HWIO_PMIC_ARB_OBS2_CHNL205_CONFIG_ADDR A:0xe626684
y.create.l HWIO_PMIC_ARB_OBS2_CHNL206_CONFIG_ADDR A:0xe626704
y.create.l HWIO_PMIC_ARB_OBS2_CHNL207_CONFIG_ADDR A:0xe626784
y.create.l HWIO_PMIC_ARB_OBS2_CHNL208_CONFIG_ADDR A:0xe626804
y.create.l HWIO_PMIC_ARB_OBS2_CHNL209_CONFIG_ADDR A:0xe626884
y.create.l HWIO_PMIC_ARB_OBS2_CHNL210_CONFIG_ADDR A:0xe626904
y.create.l HWIO_PMIC_ARB_OBS2_CHNL211_CONFIG_ADDR A:0xe626984
y.create.l HWIO_PMIC_ARB_OBS2_CHNL212_CONFIG_ADDR A:0xe626a04
y.create.l HWIO_PMIC_ARB_OBS2_CHNL213_CONFIG_ADDR A:0xe626a84
y.create.l HWIO_PMIC_ARB_OBS2_CHNL214_CONFIG_ADDR A:0xe626b04
y.create.l HWIO_PMIC_ARB_OBS2_CHNL215_CONFIG_ADDR A:0xe626b84
y.create.l HWIO_PMIC_ARB_OBS2_CHNL216_CONFIG_ADDR A:0xe626c04
y.create.l HWIO_PMIC_ARB_OBS2_CHNL217_CONFIG_ADDR A:0xe626c84
y.create.l HWIO_PMIC_ARB_OBS2_CHNL218_CONFIG_ADDR A:0xe626d04
y.create.l HWIO_PMIC_ARB_OBS2_CHNL219_CONFIG_ADDR A:0xe626d84
y.create.l HWIO_PMIC_ARB_OBS2_CHNL220_CONFIG_ADDR A:0xe626e04
y.create.l HWIO_PMIC_ARB_OBS2_CHNL221_CONFIG_ADDR A:0xe626e84
y.create.l HWIO_PMIC_ARB_OBS2_CHNL222_CONFIG_ADDR A:0xe626f04
y.create.l HWIO_PMIC_ARB_OBS2_CHNL223_CONFIG_ADDR A:0xe626f84
y.create.l HWIO_PMIC_ARB_OBS2_CHNL224_CONFIG_ADDR A:0xe627004
y.create.l HWIO_PMIC_ARB_OBS2_CHNL225_CONFIG_ADDR A:0xe627084
y.create.l HWIO_PMIC_ARB_OBS2_CHNL226_CONFIG_ADDR A:0xe627104
y.create.l HWIO_PMIC_ARB_OBS2_CHNL227_CONFIG_ADDR A:0xe627184
y.create.l HWIO_PMIC_ARB_OBS2_CHNL228_CONFIG_ADDR A:0xe627204
y.create.l HWIO_PMIC_ARB_OBS2_CHNL229_CONFIG_ADDR A:0xe627284
y.create.l HWIO_PMIC_ARB_OBS2_CHNL230_CONFIG_ADDR A:0xe627304
y.create.l HWIO_PMIC_ARB_OBS2_CHNL231_CONFIG_ADDR A:0xe627384
y.create.l HWIO_PMIC_ARB_OBS2_CHNL232_CONFIG_ADDR A:0xe627404
y.create.l HWIO_PMIC_ARB_OBS2_CHNL233_CONFIG_ADDR A:0xe627484
y.create.l HWIO_PMIC_ARB_OBS2_CHNL234_CONFIG_ADDR A:0xe627504
y.create.l HWIO_PMIC_ARB_OBS2_CHNL235_CONFIG_ADDR A:0xe627584
y.create.l HWIO_PMIC_ARB_OBS2_CHNL236_CONFIG_ADDR A:0xe627604
y.create.l HWIO_PMIC_ARB_OBS2_CHNL237_CONFIG_ADDR A:0xe627684
y.create.l HWIO_PMIC_ARB_OBS2_CHNL238_CONFIG_ADDR A:0xe627704
y.create.l HWIO_PMIC_ARB_OBS2_CHNL239_CONFIG_ADDR A:0xe627784
y.create.l HWIO_PMIC_ARB_OBS2_CHNL240_CONFIG_ADDR A:0xe627804
y.create.l HWIO_PMIC_ARB_OBS2_CHNL241_CONFIG_ADDR A:0xe627884
y.create.l HWIO_PMIC_ARB_OBS2_CHNL242_CONFIG_ADDR A:0xe627904
y.create.l HWIO_PMIC_ARB_OBS2_CHNL243_CONFIG_ADDR A:0xe627984
y.create.l HWIO_PMIC_ARB_OBS2_CHNL244_CONFIG_ADDR A:0xe627a04
y.create.l HWIO_PMIC_ARB_OBS2_CHNL245_CONFIG_ADDR A:0xe627a84
y.create.l HWIO_PMIC_ARB_OBS2_CHNL246_CONFIG_ADDR A:0xe627b04
y.create.l HWIO_PMIC_ARB_OBS2_CHNL247_CONFIG_ADDR A:0xe627b84
y.create.l HWIO_PMIC_ARB_OBS2_CHNL248_CONFIG_ADDR A:0xe627c04
y.create.l HWIO_PMIC_ARB_OBS2_CHNL249_CONFIG_ADDR A:0xe627c84
y.create.l HWIO_PMIC_ARB_OBS2_CHNL250_CONFIG_ADDR A:0xe627d04
y.create.l HWIO_PMIC_ARB_OBS2_CHNL251_CONFIG_ADDR A:0xe627d84
y.create.l HWIO_PMIC_ARB_OBS2_CHNL252_CONFIG_ADDR A:0xe627e04
y.create.l HWIO_PMIC_ARB_OBS2_CHNL253_CONFIG_ADDR A:0xe627e84
y.create.l HWIO_PMIC_ARB_OBS2_CHNL254_CONFIG_ADDR A:0xe627f04
y.create.l HWIO_PMIC_ARB_OBS2_CHNL255_CONFIG_ADDR A:0xe627f84
y.create.l HWIO_PMIC_ARB_OBS2_CHNL256_CONFIG_ADDR A:0xe628004
y.create.l HWIO_PMIC_ARB_OBS2_CHNL257_CONFIG_ADDR A:0xe628084
y.create.l HWIO_PMIC_ARB_OBS2_CHNL258_CONFIG_ADDR A:0xe628104
y.create.l HWIO_PMIC_ARB_OBS2_CHNL259_CONFIG_ADDR A:0xe628184
y.create.l HWIO_PMIC_ARB_OBS2_CHNL260_CONFIG_ADDR A:0xe628204
y.create.l HWIO_PMIC_ARB_OBS2_CHNL261_CONFIG_ADDR A:0xe628284
y.create.l HWIO_PMIC_ARB_OBS2_CHNL262_CONFIG_ADDR A:0xe628304
y.create.l HWIO_PMIC_ARB_OBS2_CHNL263_CONFIG_ADDR A:0xe628384
y.create.l HWIO_PMIC_ARB_OBS2_CHNL264_CONFIG_ADDR A:0xe628404
y.create.l HWIO_PMIC_ARB_OBS2_CHNL265_CONFIG_ADDR A:0xe628484
y.create.l HWIO_PMIC_ARB_OBS2_CHNL266_CONFIG_ADDR A:0xe628504
y.create.l HWIO_PMIC_ARB_OBS2_CHNL267_CONFIG_ADDR A:0xe628584
y.create.l HWIO_PMIC_ARB_OBS2_CHNL268_CONFIG_ADDR A:0xe628604
y.create.l HWIO_PMIC_ARB_OBS2_CHNL269_CONFIG_ADDR A:0xe628684
y.create.l HWIO_PMIC_ARB_OBS2_CHNL270_CONFIG_ADDR A:0xe628704
y.create.l HWIO_PMIC_ARB_OBS2_CHNL271_CONFIG_ADDR A:0xe628784
y.create.l HWIO_PMIC_ARB_OBS2_CHNL272_CONFIG_ADDR A:0xe628804
y.create.l HWIO_PMIC_ARB_OBS2_CHNL273_CONFIG_ADDR A:0xe628884
y.create.l HWIO_PMIC_ARB_OBS2_CHNL274_CONFIG_ADDR A:0xe628904
y.create.l HWIO_PMIC_ARB_OBS2_CHNL275_CONFIG_ADDR A:0xe628984
y.create.l HWIO_PMIC_ARB_OBS2_CHNL276_CONFIG_ADDR A:0xe628a04
y.create.l HWIO_PMIC_ARB_OBS2_CHNL277_CONFIG_ADDR A:0xe628a84
y.create.l HWIO_PMIC_ARB_OBS2_CHNL278_CONFIG_ADDR A:0xe628b04
y.create.l HWIO_PMIC_ARB_OBS2_CHNL279_CONFIG_ADDR A:0xe628b84
y.create.l HWIO_PMIC_ARB_OBS2_CHNL280_CONFIG_ADDR A:0xe628c04
y.create.l HWIO_PMIC_ARB_OBS2_CHNL281_CONFIG_ADDR A:0xe628c84
y.create.l HWIO_PMIC_ARB_OBS2_CHNL282_CONFIG_ADDR A:0xe628d04
y.create.l HWIO_PMIC_ARB_OBS2_CHNL283_CONFIG_ADDR A:0xe628d84
y.create.l HWIO_PMIC_ARB_OBS2_CHNL284_CONFIG_ADDR A:0xe628e04
y.create.l HWIO_PMIC_ARB_OBS2_CHNL285_CONFIG_ADDR A:0xe628e84
y.create.l HWIO_PMIC_ARB_OBS2_CHNL286_CONFIG_ADDR A:0xe628f04
y.create.l HWIO_PMIC_ARB_OBS2_CHNL287_CONFIG_ADDR A:0xe628f84
y.create.l HWIO_PMIC_ARB_OBS2_CHNL288_CONFIG_ADDR A:0xe629004
y.create.l HWIO_PMIC_ARB_OBS2_CHNL289_CONFIG_ADDR A:0xe629084
y.create.l HWIO_PMIC_ARB_OBS2_CHNL290_CONFIG_ADDR A:0xe629104
y.create.l HWIO_PMIC_ARB_OBS2_CHNL291_CONFIG_ADDR A:0xe629184
y.create.l HWIO_PMIC_ARB_OBS2_CHNL292_CONFIG_ADDR A:0xe629204
y.create.l HWIO_PMIC_ARB_OBS2_CHNL293_CONFIG_ADDR A:0xe629284
y.create.l HWIO_PMIC_ARB_OBS2_CHNL294_CONFIG_ADDR A:0xe629304
y.create.l HWIO_PMIC_ARB_OBS2_CHNL295_CONFIG_ADDR A:0xe629384
y.create.l HWIO_PMIC_ARB_OBS2_CHNL296_CONFIG_ADDR A:0xe629404
y.create.l HWIO_PMIC_ARB_OBS2_CHNL297_CONFIG_ADDR A:0xe629484
y.create.l HWIO_PMIC_ARB_OBS2_CHNL298_CONFIG_ADDR A:0xe629504
y.create.l HWIO_PMIC_ARB_OBS2_CHNL299_CONFIG_ADDR A:0xe629584
y.create.l HWIO_PMIC_ARB_OBS2_CHNL300_CONFIG_ADDR A:0xe629604
y.create.l HWIO_PMIC_ARB_OBS2_CHNL301_CONFIG_ADDR A:0xe629684
y.create.l HWIO_PMIC_ARB_OBS2_CHNL302_CONFIG_ADDR A:0xe629704
y.create.l HWIO_PMIC_ARB_OBS2_CHNL303_CONFIG_ADDR A:0xe629784
y.create.l HWIO_PMIC_ARB_OBS2_CHNL304_CONFIG_ADDR A:0xe629804
y.create.l HWIO_PMIC_ARB_OBS2_CHNL305_CONFIG_ADDR A:0xe629884
y.create.l HWIO_PMIC_ARB_OBS2_CHNL306_CONFIG_ADDR A:0xe629904
y.create.l HWIO_PMIC_ARB_OBS2_CHNL307_CONFIG_ADDR A:0xe629984
y.create.l HWIO_PMIC_ARB_OBS2_CHNL308_CONFIG_ADDR A:0xe629a04
y.create.l HWIO_PMIC_ARB_OBS2_CHNL309_CONFIG_ADDR A:0xe629a84
y.create.l HWIO_PMIC_ARB_OBS2_CHNL310_CONFIG_ADDR A:0xe629b04
y.create.l HWIO_PMIC_ARB_OBS2_CHNL311_CONFIG_ADDR A:0xe629b84
y.create.l HWIO_PMIC_ARB_OBS2_CHNL312_CONFIG_ADDR A:0xe629c04
y.create.l HWIO_PMIC_ARB_OBS2_CHNL313_CONFIG_ADDR A:0xe629c84
y.create.l HWIO_PMIC_ARB_OBS2_CHNL314_CONFIG_ADDR A:0xe629d04
y.create.l HWIO_PMIC_ARB_OBS2_CHNL315_CONFIG_ADDR A:0xe629d84
y.create.l HWIO_PMIC_ARB_OBS2_CHNL316_CONFIG_ADDR A:0xe629e04
y.create.l HWIO_PMIC_ARB_OBS2_CHNL317_CONFIG_ADDR A:0xe629e84
y.create.l HWIO_PMIC_ARB_OBS2_CHNL318_CONFIG_ADDR A:0xe629f04
y.create.l HWIO_PMIC_ARB_OBS2_CHNL319_CONFIG_ADDR A:0xe629f84
y.create.l HWIO_PMIC_ARB_OBS2_CHNL320_CONFIG_ADDR A:0xe62a004
y.create.l HWIO_PMIC_ARB_OBS2_CHNL321_CONFIG_ADDR A:0xe62a084
y.create.l HWIO_PMIC_ARB_OBS2_CHNL322_CONFIG_ADDR A:0xe62a104
y.create.l HWIO_PMIC_ARB_OBS2_CHNL323_CONFIG_ADDR A:0xe62a184
y.create.l HWIO_PMIC_ARB_OBS2_CHNL324_CONFIG_ADDR A:0xe62a204
y.create.l HWIO_PMIC_ARB_OBS2_CHNL325_CONFIG_ADDR A:0xe62a284
y.create.l HWIO_PMIC_ARB_OBS2_CHNL326_CONFIG_ADDR A:0xe62a304
y.create.l HWIO_PMIC_ARB_OBS2_CHNL327_CONFIG_ADDR A:0xe62a384
y.create.l HWIO_PMIC_ARB_OBS2_CHNL328_CONFIG_ADDR A:0xe62a404
y.create.l HWIO_PMIC_ARB_OBS2_CHNL329_CONFIG_ADDR A:0xe62a484
y.create.l HWIO_PMIC_ARB_OBS2_CHNL330_CONFIG_ADDR A:0xe62a504
y.create.l HWIO_PMIC_ARB_OBS2_CHNL331_CONFIG_ADDR A:0xe62a584
y.create.l HWIO_PMIC_ARB_OBS2_CHNL332_CONFIG_ADDR A:0xe62a604
y.create.l HWIO_PMIC_ARB_OBS2_CHNL333_CONFIG_ADDR A:0xe62a684
y.create.l HWIO_PMIC_ARB_OBS2_CHNL334_CONFIG_ADDR A:0xe62a704
y.create.l HWIO_PMIC_ARB_OBS2_CHNL335_CONFIG_ADDR A:0xe62a784
y.create.l HWIO_PMIC_ARB_OBS2_CHNL336_CONFIG_ADDR A:0xe62a804
y.create.l HWIO_PMIC_ARB_OBS2_CHNL337_CONFIG_ADDR A:0xe62a884
y.create.l HWIO_PMIC_ARB_OBS2_CHNL338_CONFIG_ADDR A:0xe62a904
y.create.l HWIO_PMIC_ARB_OBS2_CHNL339_CONFIG_ADDR A:0xe62a984
y.create.l HWIO_PMIC_ARB_OBS2_CHNL340_CONFIG_ADDR A:0xe62aa04
y.create.l HWIO_PMIC_ARB_OBS2_CHNL341_CONFIG_ADDR A:0xe62aa84
y.create.l HWIO_PMIC_ARB_OBS2_CHNL342_CONFIG_ADDR A:0xe62ab04
y.create.l HWIO_PMIC_ARB_OBS2_CHNL343_CONFIG_ADDR A:0xe62ab84
y.create.l HWIO_PMIC_ARB_OBS2_CHNL344_CONFIG_ADDR A:0xe62ac04
y.create.l HWIO_PMIC_ARB_OBS2_CHNL345_CONFIG_ADDR A:0xe62ac84
y.create.l HWIO_PMIC_ARB_OBS2_CHNL346_CONFIG_ADDR A:0xe62ad04
y.create.l HWIO_PMIC_ARB_OBS2_CHNL347_CONFIG_ADDR A:0xe62ad84
y.create.l HWIO_PMIC_ARB_OBS2_CHNL348_CONFIG_ADDR A:0xe62ae04
y.create.l HWIO_PMIC_ARB_OBS2_CHNL349_CONFIG_ADDR A:0xe62ae84
y.create.l HWIO_PMIC_ARB_OBS2_CHNL350_CONFIG_ADDR A:0xe62af04
y.create.l HWIO_PMIC_ARB_OBS2_CHNL351_CONFIG_ADDR A:0xe62af84
y.create.l HWIO_PMIC_ARB_OBS2_CHNL352_CONFIG_ADDR A:0xe62b004
y.create.l HWIO_PMIC_ARB_OBS2_CHNL353_CONFIG_ADDR A:0xe62b084
y.create.l HWIO_PMIC_ARB_OBS2_CHNL354_CONFIG_ADDR A:0xe62b104
y.create.l HWIO_PMIC_ARB_OBS2_CHNL355_CONFIG_ADDR A:0xe62b184
y.create.l HWIO_PMIC_ARB_OBS2_CHNL356_CONFIG_ADDR A:0xe62b204
y.create.l HWIO_PMIC_ARB_OBS2_CHNL357_CONFIG_ADDR A:0xe62b284
y.create.l HWIO_PMIC_ARB_OBS2_CHNL358_CONFIG_ADDR A:0xe62b304
y.create.l HWIO_PMIC_ARB_OBS2_CHNL359_CONFIG_ADDR A:0xe62b384
y.create.l HWIO_PMIC_ARB_OBS2_CHNL360_CONFIG_ADDR A:0xe62b404
y.create.l HWIO_PMIC_ARB_OBS2_CHNL361_CONFIG_ADDR A:0xe62b484
y.create.l HWIO_PMIC_ARB_OBS2_CHNL362_CONFIG_ADDR A:0xe62b504
y.create.l HWIO_PMIC_ARB_OBS2_CHNL363_CONFIG_ADDR A:0xe62b584
y.create.l HWIO_PMIC_ARB_OBS2_CHNL364_CONFIG_ADDR A:0xe62b604
y.create.l HWIO_PMIC_ARB_OBS2_CHNL365_CONFIG_ADDR A:0xe62b684
y.create.l HWIO_PMIC_ARB_OBS2_CHNL366_CONFIG_ADDR A:0xe62b704
y.create.l HWIO_PMIC_ARB_OBS2_CHNL367_CONFIG_ADDR A:0xe62b784
y.create.l HWIO_PMIC_ARB_OBS2_CHNL368_CONFIG_ADDR A:0xe62b804
y.create.l HWIO_PMIC_ARB_OBS2_CHNL369_CONFIG_ADDR A:0xe62b884
y.create.l HWIO_PMIC_ARB_OBS2_CHNL370_CONFIG_ADDR A:0xe62b904
y.create.l HWIO_PMIC_ARB_OBS2_CHNL371_CONFIG_ADDR A:0xe62b984
y.create.l HWIO_PMIC_ARB_OBS2_CHNL372_CONFIG_ADDR A:0xe62ba04
y.create.l HWIO_PMIC_ARB_OBS2_CHNL373_CONFIG_ADDR A:0xe62ba84
y.create.l HWIO_PMIC_ARB_OBS2_CHNL374_CONFIG_ADDR A:0xe62bb04
y.create.l HWIO_PMIC_ARB_OBS2_CHNL375_CONFIG_ADDR A:0xe62bb84
y.create.l HWIO_PMIC_ARB_OBS2_CHNL376_CONFIG_ADDR A:0xe62bc04
y.create.l HWIO_PMIC_ARB_OBS2_CHNL377_CONFIG_ADDR A:0xe62bc84
y.create.l HWIO_PMIC_ARB_OBS2_CHNL378_CONFIG_ADDR A:0xe62bd04
y.create.l HWIO_PMIC_ARB_OBS2_CHNL379_CONFIG_ADDR A:0xe62bd84
y.create.l HWIO_PMIC_ARB_OBS2_CHNL380_CONFIG_ADDR A:0xe62be04
y.create.l HWIO_PMIC_ARB_OBS2_CHNL381_CONFIG_ADDR A:0xe62be84
y.create.l HWIO_PMIC_ARB_OBS2_CHNL382_CONFIG_ADDR A:0xe62bf04
y.create.l HWIO_PMIC_ARB_OBS2_CHNL383_CONFIG_ADDR A:0xe62bf84
y.create.l HWIO_PMIC_ARB_OBS2_CHNL384_CONFIG_ADDR A:0xe62c004
y.create.l HWIO_PMIC_ARB_OBS2_CHNL385_CONFIG_ADDR A:0xe62c084
y.create.l HWIO_PMIC_ARB_OBS2_CHNL386_CONFIG_ADDR A:0xe62c104
y.create.l HWIO_PMIC_ARB_OBS2_CHNL387_CONFIG_ADDR A:0xe62c184
y.create.l HWIO_PMIC_ARB_OBS2_CHNL388_CONFIG_ADDR A:0xe62c204
y.create.l HWIO_PMIC_ARB_OBS2_CHNL389_CONFIG_ADDR A:0xe62c284
y.create.l HWIO_PMIC_ARB_OBS2_CHNL390_CONFIG_ADDR A:0xe62c304
y.create.l HWIO_PMIC_ARB_OBS2_CHNL391_CONFIG_ADDR A:0xe62c384
y.create.l HWIO_PMIC_ARB_OBS2_CHNL392_CONFIG_ADDR A:0xe62c404
y.create.l HWIO_PMIC_ARB_OBS2_CHNL393_CONFIG_ADDR A:0xe62c484
y.create.l HWIO_PMIC_ARB_OBS2_CHNL394_CONFIG_ADDR A:0xe62c504
y.create.l HWIO_PMIC_ARB_OBS2_CHNL395_CONFIG_ADDR A:0xe62c584
y.create.l HWIO_PMIC_ARB_OBS2_CHNL396_CONFIG_ADDR A:0xe62c604
y.create.l HWIO_PMIC_ARB_OBS2_CHNL397_CONFIG_ADDR A:0xe62c684
y.create.l HWIO_PMIC_ARB_OBS2_CHNL398_CONFIG_ADDR A:0xe62c704
y.create.l HWIO_PMIC_ARB_OBS2_CHNL399_CONFIG_ADDR A:0xe62c784
y.create.l HWIO_PMIC_ARB_OBS2_CHNL400_CONFIG_ADDR A:0xe62c804
y.create.l HWIO_PMIC_ARB_OBS2_CHNL401_CONFIG_ADDR A:0xe62c884
y.create.l HWIO_PMIC_ARB_OBS2_CHNL402_CONFIG_ADDR A:0xe62c904
y.create.l HWIO_PMIC_ARB_OBS2_CHNL403_CONFIG_ADDR A:0xe62c984
y.create.l HWIO_PMIC_ARB_OBS2_CHNL404_CONFIG_ADDR A:0xe62ca04
y.create.l HWIO_PMIC_ARB_OBS2_CHNL405_CONFIG_ADDR A:0xe62ca84
y.create.l HWIO_PMIC_ARB_OBS2_CHNL406_CONFIG_ADDR A:0xe62cb04
y.create.l HWIO_PMIC_ARB_OBS2_CHNL407_CONFIG_ADDR A:0xe62cb84
y.create.l HWIO_PMIC_ARB_OBS2_CHNL408_CONFIG_ADDR A:0xe62cc04
y.create.l HWIO_PMIC_ARB_OBS2_CHNL409_CONFIG_ADDR A:0xe62cc84
y.create.l HWIO_PMIC_ARB_OBS2_CHNL410_CONFIG_ADDR A:0xe62cd04
y.create.l HWIO_PMIC_ARB_OBS2_CHNL411_CONFIG_ADDR A:0xe62cd84
y.create.l HWIO_PMIC_ARB_OBS2_CHNL412_CONFIG_ADDR A:0xe62ce04
y.create.l HWIO_PMIC_ARB_OBS2_CHNL413_CONFIG_ADDR A:0xe62ce84
y.create.l HWIO_PMIC_ARB_OBS2_CHNL414_CONFIG_ADDR A:0xe62cf04
y.create.l HWIO_PMIC_ARB_OBS2_CHNL415_CONFIG_ADDR A:0xe62cf84
y.create.l HWIO_PMIC_ARB_OBS2_CHNL416_CONFIG_ADDR A:0xe62d004
y.create.l HWIO_PMIC_ARB_OBS2_CHNL417_CONFIG_ADDR A:0xe62d084
y.create.l HWIO_PMIC_ARB_OBS2_CHNL418_CONFIG_ADDR A:0xe62d104
y.create.l HWIO_PMIC_ARB_OBS2_CHNL419_CONFIG_ADDR A:0xe62d184
y.create.l HWIO_PMIC_ARB_OBS2_CHNL420_CONFIG_ADDR A:0xe62d204
y.create.l HWIO_PMIC_ARB_OBS2_CHNL421_CONFIG_ADDR A:0xe62d284
y.create.l HWIO_PMIC_ARB_OBS2_CHNL422_CONFIG_ADDR A:0xe62d304
y.create.l HWIO_PMIC_ARB_OBS2_CHNL423_CONFIG_ADDR A:0xe62d384
y.create.l HWIO_PMIC_ARB_OBS2_CHNL424_CONFIG_ADDR A:0xe62d404
y.create.l HWIO_PMIC_ARB_OBS2_CHNL425_CONFIG_ADDR A:0xe62d484
y.create.l HWIO_PMIC_ARB_OBS2_CHNL426_CONFIG_ADDR A:0xe62d504
y.create.l HWIO_PMIC_ARB_OBS2_CHNL427_CONFIG_ADDR A:0xe62d584
y.create.l HWIO_PMIC_ARB_OBS2_CHNL428_CONFIG_ADDR A:0xe62d604
y.create.l HWIO_PMIC_ARB_OBS2_CHNL429_CONFIG_ADDR A:0xe62d684
y.create.l HWIO_PMIC_ARB_OBS2_CHNL430_CONFIG_ADDR A:0xe62d704
y.create.l HWIO_PMIC_ARB_OBS2_CHNL431_CONFIG_ADDR A:0xe62d784
y.create.l HWIO_PMIC_ARB_OBS2_CHNL432_CONFIG_ADDR A:0xe62d804
y.create.l HWIO_PMIC_ARB_OBS2_CHNL433_CONFIG_ADDR A:0xe62d884
y.create.l HWIO_PMIC_ARB_OBS2_CHNL434_CONFIG_ADDR A:0xe62d904
y.create.l HWIO_PMIC_ARB_OBS2_CHNL435_CONFIG_ADDR A:0xe62d984
y.create.l HWIO_PMIC_ARB_OBS2_CHNL436_CONFIG_ADDR A:0xe62da04
y.create.l HWIO_PMIC_ARB_OBS2_CHNL437_CONFIG_ADDR A:0xe62da84
y.create.l HWIO_PMIC_ARB_OBS2_CHNL438_CONFIG_ADDR A:0xe62db04
y.create.l HWIO_PMIC_ARB_OBS2_CHNL439_CONFIG_ADDR A:0xe62db84
y.create.l HWIO_PMIC_ARB_OBS2_CHNL440_CONFIG_ADDR A:0xe62dc04
y.create.l HWIO_PMIC_ARB_OBS2_CHNL441_CONFIG_ADDR A:0xe62dc84
y.create.l HWIO_PMIC_ARB_OBS2_CHNL442_CONFIG_ADDR A:0xe62dd04
y.create.l HWIO_PMIC_ARB_OBS2_CHNL443_CONFIG_ADDR A:0xe62dd84
y.create.l HWIO_PMIC_ARB_OBS2_CHNL444_CONFIG_ADDR A:0xe62de04
y.create.l HWIO_PMIC_ARB_OBS2_CHNL445_CONFIG_ADDR A:0xe62de84
y.create.l HWIO_PMIC_ARB_OBS2_CHNL446_CONFIG_ADDR A:0xe62df04
y.create.l HWIO_PMIC_ARB_OBS2_CHNL447_CONFIG_ADDR A:0xe62df84
y.create.l HWIO_PMIC_ARB_OBS2_CHNL448_CONFIG_ADDR A:0xe62e004
y.create.l HWIO_PMIC_ARB_OBS2_CHNL449_CONFIG_ADDR A:0xe62e084
y.create.l HWIO_PMIC_ARB_OBS2_CHNL450_CONFIG_ADDR A:0xe62e104
y.create.l HWIO_PMIC_ARB_OBS2_CHNL451_CONFIG_ADDR A:0xe62e184
y.create.l HWIO_PMIC_ARB_OBS2_CHNL452_CONFIG_ADDR A:0xe62e204
y.create.l HWIO_PMIC_ARB_OBS2_CHNL453_CONFIG_ADDR A:0xe62e284
y.create.l HWIO_PMIC_ARB_OBS2_CHNL454_CONFIG_ADDR A:0xe62e304
y.create.l HWIO_PMIC_ARB_OBS2_CHNL455_CONFIG_ADDR A:0xe62e384
y.create.l HWIO_PMIC_ARB_OBS2_CHNL456_CONFIG_ADDR A:0xe62e404
y.create.l HWIO_PMIC_ARB_OBS2_CHNL457_CONFIG_ADDR A:0xe62e484
y.create.l HWIO_PMIC_ARB_OBS2_CHNL458_CONFIG_ADDR A:0xe62e504
y.create.l HWIO_PMIC_ARB_OBS2_CHNL459_CONFIG_ADDR A:0xe62e584
y.create.l HWIO_PMIC_ARB_OBS2_CHNL460_CONFIG_ADDR A:0xe62e604
y.create.l HWIO_PMIC_ARB_OBS2_CHNL461_CONFIG_ADDR A:0xe62e684
y.create.l HWIO_PMIC_ARB_OBS2_CHNL462_CONFIG_ADDR A:0xe62e704
y.create.l HWIO_PMIC_ARB_OBS2_CHNL463_CONFIG_ADDR A:0xe62e784
y.create.l HWIO_PMIC_ARB_OBS2_CHNL464_CONFIG_ADDR A:0xe62e804
y.create.l HWIO_PMIC_ARB_OBS2_CHNL465_CONFIG_ADDR A:0xe62e884
y.create.l HWIO_PMIC_ARB_OBS2_CHNL466_CONFIG_ADDR A:0xe62e904
y.create.l HWIO_PMIC_ARB_OBS2_CHNL467_CONFIG_ADDR A:0xe62e984
y.create.l HWIO_PMIC_ARB_OBS2_CHNL468_CONFIG_ADDR A:0xe62ea04
y.create.l HWIO_PMIC_ARB_OBS2_CHNL469_CONFIG_ADDR A:0xe62ea84
y.create.l HWIO_PMIC_ARB_OBS2_CHNL470_CONFIG_ADDR A:0xe62eb04
y.create.l HWIO_PMIC_ARB_OBS2_CHNL471_CONFIG_ADDR A:0xe62eb84
y.create.l HWIO_PMIC_ARB_OBS2_CHNL472_CONFIG_ADDR A:0xe62ec04
y.create.l HWIO_PMIC_ARB_OBS2_CHNL473_CONFIG_ADDR A:0xe62ec84
y.create.l HWIO_PMIC_ARB_OBS2_CHNL474_CONFIG_ADDR A:0xe62ed04
y.create.l HWIO_PMIC_ARB_OBS2_CHNL475_CONFIG_ADDR A:0xe62ed84
y.create.l HWIO_PMIC_ARB_OBS2_CHNL476_CONFIG_ADDR A:0xe62ee04
y.create.l HWIO_PMIC_ARB_OBS2_CHNL477_CONFIG_ADDR A:0xe62ee84
y.create.l HWIO_PMIC_ARB_OBS2_CHNL478_CONFIG_ADDR A:0xe62ef04
y.create.l HWIO_PMIC_ARB_OBS2_CHNL479_CONFIG_ADDR A:0xe62ef84
y.create.l HWIO_PMIC_ARB_OBS2_CHNL480_CONFIG_ADDR A:0xe62f004
y.create.l HWIO_PMIC_ARB_OBS2_CHNL481_CONFIG_ADDR A:0xe62f084
y.create.l HWIO_PMIC_ARB_OBS2_CHNL482_CONFIG_ADDR A:0xe62f104
y.create.l HWIO_PMIC_ARB_OBS2_CHNL483_CONFIG_ADDR A:0xe62f184
y.create.l HWIO_PMIC_ARB_OBS2_CHNL484_CONFIG_ADDR A:0xe62f204
y.create.l HWIO_PMIC_ARB_OBS2_CHNL485_CONFIG_ADDR A:0xe62f284
y.create.l HWIO_PMIC_ARB_OBS2_CHNL486_CONFIG_ADDR A:0xe62f304
y.create.l HWIO_PMIC_ARB_OBS2_CHNL487_CONFIG_ADDR A:0xe62f384
y.create.l HWIO_PMIC_ARB_OBS2_CHNL488_CONFIG_ADDR A:0xe62f404
y.create.l HWIO_PMIC_ARB_OBS2_CHNL489_CONFIG_ADDR A:0xe62f484
y.create.l HWIO_PMIC_ARB_OBS2_CHNL490_CONFIG_ADDR A:0xe62f504
y.create.l HWIO_PMIC_ARB_OBS2_CHNL491_CONFIG_ADDR A:0xe62f584
y.create.l HWIO_PMIC_ARB_OBS2_CHNL492_CONFIG_ADDR A:0xe62f604
y.create.l HWIO_PMIC_ARB_OBS2_CHNL493_CONFIG_ADDR A:0xe62f684
y.create.l HWIO_PMIC_ARB_OBS2_CHNL494_CONFIG_ADDR A:0xe62f704
y.create.l HWIO_PMIC_ARB_OBS2_CHNL495_CONFIG_ADDR A:0xe62f784
y.create.l HWIO_PMIC_ARB_OBS2_CHNL496_CONFIG_ADDR A:0xe62f804
y.create.l HWIO_PMIC_ARB_OBS2_CHNL497_CONFIG_ADDR A:0xe62f884
y.create.l HWIO_PMIC_ARB_OBS2_CHNL498_CONFIG_ADDR A:0xe62f904
y.create.l HWIO_PMIC_ARB_OBS2_CHNL499_CONFIG_ADDR A:0xe62f984
y.create.l HWIO_PMIC_ARB_OBS2_CHNL500_CONFIG_ADDR A:0xe62fa04
y.create.l HWIO_PMIC_ARB_OBS2_CHNL501_CONFIG_ADDR A:0xe62fa84
y.create.l HWIO_PMIC_ARB_OBS2_CHNL502_CONFIG_ADDR A:0xe62fb04
y.create.l HWIO_PMIC_ARB_OBS2_CHNL503_CONFIG_ADDR A:0xe62fb84
y.create.l HWIO_PMIC_ARB_OBS2_CHNL504_CONFIG_ADDR A:0xe62fc04
y.create.l HWIO_PMIC_ARB_OBS2_CHNL505_CONFIG_ADDR A:0xe62fc84
y.create.l HWIO_PMIC_ARB_OBS2_CHNL506_CONFIG_ADDR A:0xe62fd04
y.create.l HWIO_PMIC_ARB_OBS2_CHNL507_CONFIG_ADDR A:0xe62fd84
y.create.l HWIO_PMIC_ARB_OBS2_CHNL508_CONFIG_ADDR A:0xe62fe04
y.create.l HWIO_PMIC_ARB_OBS2_CHNL509_CONFIG_ADDR A:0xe62fe84
y.create.l HWIO_PMIC_ARB_OBS2_CHNL510_CONFIG_ADDR A:0xe62ff04
y.create.l HWIO_PMIC_ARB_OBS2_CHNL511_CONFIG_ADDR A:0xe62ff84
y.create.l HWIO_PMIC_ARB_OBS3_CHNL0_CONFIG_ADDR A:0xe630004
y.create.l HWIO_PMIC_ARB_OBS3_CHNL1_CONFIG_ADDR A:0xe630084
y.create.l HWIO_PMIC_ARB_OBS3_CHNL2_CONFIG_ADDR A:0xe630104
y.create.l HWIO_PMIC_ARB_OBS3_CHNL3_CONFIG_ADDR A:0xe630184
y.create.l HWIO_PMIC_ARB_OBS3_CHNL4_CONFIG_ADDR A:0xe630204
y.create.l HWIO_PMIC_ARB_OBS3_CHNL5_CONFIG_ADDR A:0xe630284
y.create.l HWIO_PMIC_ARB_OBS3_CHNL6_CONFIG_ADDR A:0xe630304
y.create.l HWIO_PMIC_ARB_OBS3_CHNL7_CONFIG_ADDR A:0xe630384
y.create.l HWIO_PMIC_ARB_OBS3_CHNL8_CONFIG_ADDR A:0xe630404
y.create.l HWIO_PMIC_ARB_OBS3_CHNL9_CONFIG_ADDR A:0xe630484
y.create.l HWIO_PMIC_ARB_OBS3_CHNL10_CONFIG_ADDR A:0xe630504
y.create.l HWIO_PMIC_ARB_OBS3_CHNL11_CONFIG_ADDR A:0xe630584
y.create.l HWIO_PMIC_ARB_OBS3_CHNL12_CONFIG_ADDR A:0xe630604
y.create.l HWIO_PMIC_ARB_OBS3_CHNL13_CONFIG_ADDR A:0xe630684
y.create.l HWIO_PMIC_ARB_OBS3_CHNL14_CONFIG_ADDR A:0xe630704
y.create.l HWIO_PMIC_ARB_OBS3_CHNL15_CONFIG_ADDR A:0xe630784
y.create.l HWIO_PMIC_ARB_OBS3_CHNL16_CONFIG_ADDR A:0xe630804
y.create.l HWIO_PMIC_ARB_OBS3_CHNL17_CONFIG_ADDR A:0xe630884
y.create.l HWIO_PMIC_ARB_OBS3_CHNL18_CONFIG_ADDR A:0xe630904
y.create.l HWIO_PMIC_ARB_OBS3_CHNL19_CONFIG_ADDR A:0xe630984
y.create.l HWIO_PMIC_ARB_OBS3_CHNL20_CONFIG_ADDR A:0xe630a04
y.create.l HWIO_PMIC_ARB_OBS3_CHNL21_CONFIG_ADDR A:0xe630a84
y.create.l HWIO_PMIC_ARB_OBS3_CHNL22_CONFIG_ADDR A:0xe630b04
y.create.l HWIO_PMIC_ARB_OBS3_CHNL23_CONFIG_ADDR A:0xe630b84
y.create.l HWIO_PMIC_ARB_OBS3_CHNL24_CONFIG_ADDR A:0xe630c04
y.create.l HWIO_PMIC_ARB_OBS3_CHNL25_CONFIG_ADDR A:0xe630c84
y.create.l HWIO_PMIC_ARB_OBS3_CHNL26_CONFIG_ADDR A:0xe630d04
y.create.l HWIO_PMIC_ARB_OBS3_CHNL27_CONFIG_ADDR A:0xe630d84
y.create.l HWIO_PMIC_ARB_OBS3_CHNL28_CONFIG_ADDR A:0xe630e04
y.create.l HWIO_PMIC_ARB_OBS3_CHNL29_CONFIG_ADDR A:0xe630e84
y.create.l HWIO_PMIC_ARB_OBS3_CHNL30_CONFIG_ADDR A:0xe630f04
y.create.l HWIO_PMIC_ARB_OBS3_CHNL31_CONFIG_ADDR A:0xe630f84
y.create.l HWIO_PMIC_ARB_OBS3_CHNL32_CONFIG_ADDR A:0xe631004
y.create.l HWIO_PMIC_ARB_OBS3_CHNL33_CONFIG_ADDR A:0xe631084
y.create.l HWIO_PMIC_ARB_OBS3_CHNL34_CONFIG_ADDR A:0xe631104
y.create.l HWIO_PMIC_ARB_OBS3_CHNL35_CONFIG_ADDR A:0xe631184
y.create.l HWIO_PMIC_ARB_OBS3_CHNL36_CONFIG_ADDR A:0xe631204
y.create.l HWIO_PMIC_ARB_OBS3_CHNL37_CONFIG_ADDR A:0xe631284
y.create.l HWIO_PMIC_ARB_OBS3_CHNL38_CONFIG_ADDR A:0xe631304
y.create.l HWIO_PMIC_ARB_OBS3_CHNL39_CONFIG_ADDR A:0xe631384
y.create.l HWIO_PMIC_ARB_OBS3_CHNL40_CONFIG_ADDR A:0xe631404
y.create.l HWIO_PMIC_ARB_OBS3_CHNL41_CONFIG_ADDR A:0xe631484
y.create.l HWIO_PMIC_ARB_OBS3_CHNL42_CONFIG_ADDR A:0xe631504
y.create.l HWIO_PMIC_ARB_OBS3_CHNL43_CONFIG_ADDR A:0xe631584
y.create.l HWIO_PMIC_ARB_OBS3_CHNL44_CONFIG_ADDR A:0xe631604
y.create.l HWIO_PMIC_ARB_OBS3_CHNL45_CONFIG_ADDR A:0xe631684
y.create.l HWIO_PMIC_ARB_OBS3_CHNL46_CONFIG_ADDR A:0xe631704
y.create.l HWIO_PMIC_ARB_OBS3_CHNL47_CONFIG_ADDR A:0xe631784
y.create.l HWIO_PMIC_ARB_OBS3_CHNL48_CONFIG_ADDR A:0xe631804
y.create.l HWIO_PMIC_ARB_OBS3_CHNL49_CONFIG_ADDR A:0xe631884
y.create.l HWIO_PMIC_ARB_OBS3_CHNL50_CONFIG_ADDR A:0xe631904
y.create.l HWIO_PMIC_ARB_OBS3_CHNL51_CONFIG_ADDR A:0xe631984
y.create.l HWIO_PMIC_ARB_OBS3_CHNL52_CONFIG_ADDR A:0xe631a04
y.create.l HWIO_PMIC_ARB_OBS3_CHNL53_CONFIG_ADDR A:0xe631a84
y.create.l HWIO_PMIC_ARB_OBS3_CHNL54_CONFIG_ADDR A:0xe631b04
y.create.l HWIO_PMIC_ARB_OBS3_CHNL55_CONFIG_ADDR A:0xe631b84
y.create.l HWIO_PMIC_ARB_OBS3_CHNL56_CONFIG_ADDR A:0xe631c04
y.create.l HWIO_PMIC_ARB_OBS3_CHNL57_CONFIG_ADDR A:0xe631c84
y.create.l HWIO_PMIC_ARB_OBS3_CHNL58_CONFIG_ADDR A:0xe631d04
y.create.l HWIO_PMIC_ARB_OBS3_CHNL59_CONFIG_ADDR A:0xe631d84
y.create.l HWIO_PMIC_ARB_OBS3_CHNL60_CONFIG_ADDR A:0xe631e04
y.create.l HWIO_PMIC_ARB_OBS3_CHNL61_CONFIG_ADDR A:0xe631e84
y.create.l HWIO_PMIC_ARB_OBS3_CHNL62_CONFIG_ADDR A:0xe631f04
y.create.l HWIO_PMIC_ARB_OBS3_CHNL63_CONFIG_ADDR A:0xe631f84
y.create.l HWIO_PMIC_ARB_OBS3_CHNL64_CONFIG_ADDR A:0xe632004
y.create.l HWIO_PMIC_ARB_OBS3_CHNL65_CONFIG_ADDR A:0xe632084
y.create.l HWIO_PMIC_ARB_OBS3_CHNL66_CONFIG_ADDR A:0xe632104
y.create.l HWIO_PMIC_ARB_OBS3_CHNL67_CONFIG_ADDR A:0xe632184
y.create.l HWIO_PMIC_ARB_OBS3_CHNL68_CONFIG_ADDR A:0xe632204
y.create.l HWIO_PMIC_ARB_OBS3_CHNL69_CONFIG_ADDR A:0xe632284
y.create.l HWIO_PMIC_ARB_OBS3_CHNL70_CONFIG_ADDR A:0xe632304
y.create.l HWIO_PMIC_ARB_OBS3_CHNL71_CONFIG_ADDR A:0xe632384
y.create.l HWIO_PMIC_ARB_OBS3_CHNL72_CONFIG_ADDR A:0xe632404
y.create.l HWIO_PMIC_ARB_OBS3_CHNL73_CONFIG_ADDR A:0xe632484
y.create.l HWIO_PMIC_ARB_OBS3_CHNL74_CONFIG_ADDR A:0xe632504
y.create.l HWIO_PMIC_ARB_OBS3_CHNL75_CONFIG_ADDR A:0xe632584
y.create.l HWIO_PMIC_ARB_OBS3_CHNL76_CONFIG_ADDR A:0xe632604
y.create.l HWIO_PMIC_ARB_OBS3_CHNL77_CONFIG_ADDR A:0xe632684
y.create.l HWIO_PMIC_ARB_OBS3_CHNL78_CONFIG_ADDR A:0xe632704
y.create.l HWIO_PMIC_ARB_OBS3_CHNL79_CONFIG_ADDR A:0xe632784
y.create.l HWIO_PMIC_ARB_OBS3_CHNL80_CONFIG_ADDR A:0xe632804
y.create.l HWIO_PMIC_ARB_OBS3_CHNL81_CONFIG_ADDR A:0xe632884
y.create.l HWIO_PMIC_ARB_OBS3_CHNL82_CONFIG_ADDR A:0xe632904
y.create.l HWIO_PMIC_ARB_OBS3_CHNL83_CONFIG_ADDR A:0xe632984
y.create.l HWIO_PMIC_ARB_OBS3_CHNL84_CONFIG_ADDR A:0xe632a04
y.create.l HWIO_PMIC_ARB_OBS3_CHNL85_CONFIG_ADDR A:0xe632a84
y.create.l HWIO_PMIC_ARB_OBS3_CHNL86_CONFIG_ADDR A:0xe632b04
y.create.l HWIO_PMIC_ARB_OBS3_CHNL87_CONFIG_ADDR A:0xe632b84
y.create.l HWIO_PMIC_ARB_OBS3_CHNL88_CONFIG_ADDR A:0xe632c04
y.create.l HWIO_PMIC_ARB_OBS3_CHNL89_CONFIG_ADDR A:0xe632c84
y.create.l HWIO_PMIC_ARB_OBS3_CHNL90_CONFIG_ADDR A:0xe632d04
y.create.l HWIO_PMIC_ARB_OBS3_CHNL91_CONFIG_ADDR A:0xe632d84
y.create.l HWIO_PMIC_ARB_OBS3_CHNL92_CONFIG_ADDR A:0xe632e04
y.create.l HWIO_PMIC_ARB_OBS3_CHNL93_CONFIG_ADDR A:0xe632e84
y.create.l HWIO_PMIC_ARB_OBS3_CHNL94_CONFIG_ADDR A:0xe632f04
y.create.l HWIO_PMIC_ARB_OBS3_CHNL95_CONFIG_ADDR A:0xe632f84
y.create.l HWIO_PMIC_ARB_OBS3_CHNL96_CONFIG_ADDR A:0xe633004
y.create.l HWIO_PMIC_ARB_OBS3_CHNL97_CONFIG_ADDR A:0xe633084
y.create.l HWIO_PMIC_ARB_OBS3_CHNL98_CONFIG_ADDR A:0xe633104
y.create.l HWIO_PMIC_ARB_OBS3_CHNL99_CONFIG_ADDR A:0xe633184
y.create.l HWIO_PMIC_ARB_OBS3_CHNL100_CONFIG_ADDR A:0xe633204
y.create.l HWIO_PMIC_ARB_OBS3_CHNL101_CONFIG_ADDR A:0xe633284
y.create.l HWIO_PMIC_ARB_OBS3_CHNL102_CONFIG_ADDR A:0xe633304
y.create.l HWIO_PMIC_ARB_OBS3_CHNL103_CONFIG_ADDR A:0xe633384
y.create.l HWIO_PMIC_ARB_OBS3_CHNL104_CONFIG_ADDR A:0xe633404
y.create.l HWIO_PMIC_ARB_OBS3_CHNL105_CONFIG_ADDR A:0xe633484
y.create.l HWIO_PMIC_ARB_OBS3_CHNL106_CONFIG_ADDR A:0xe633504
y.create.l HWIO_PMIC_ARB_OBS3_CHNL107_CONFIG_ADDR A:0xe633584
y.create.l HWIO_PMIC_ARB_OBS3_CHNL108_CONFIG_ADDR A:0xe633604
y.create.l HWIO_PMIC_ARB_OBS3_CHNL109_CONFIG_ADDR A:0xe633684
y.create.l HWIO_PMIC_ARB_OBS3_CHNL110_CONFIG_ADDR A:0xe633704
y.create.l HWIO_PMIC_ARB_OBS3_CHNL111_CONFIG_ADDR A:0xe633784
y.create.l HWIO_PMIC_ARB_OBS3_CHNL112_CONFIG_ADDR A:0xe633804
y.create.l HWIO_PMIC_ARB_OBS3_CHNL113_CONFIG_ADDR A:0xe633884
y.create.l HWIO_PMIC_ARB_OBS3_CHNL114_CONFIG_ADDR A:0xe633904
y.create.l HWIO_PMIC_ARB_OBS3_CHNL115_CONFIG_ADDR A:0xe633984
y.create.l HWIO_PMIC_ARB_OBS3_CHNL116_CONFIG_ADDR A:0xe633a04
y.create.l HWIO_PMIC_ARB_OBS3_CHNL117_CONFIG_ADDR A:0xe633a84
y.create.l HWIO_PMIC_ARB_OBS3_CHNL118_CONFIG_ADDR A:0xe633b04
y.create.l HWIO_PMIC_ARB_OBS3_CHNL119_CONFIG_ADDR A:0xe633b84
y.create.l HWIO_PMIC_ARB_OBS3_CHNL120_CONFIG_ADDR A:0xe633c04
y.create.l HWIO_PMIC_ARB_OBS3_CHNL121_CONFIG_ADDR A:0xe633c84
y.create.l HWIO_PMIC_ARB_OBS3_CHNL122_CONFIG_ADDR A:0xe633d04
y.create.l HWIO_PMIC_ARB_OBS3_CHNL123_CONFIG_ADDR A:0xe633d84
y.create.l HWIO_PMIC_ARB_OBS3_CHNL124_CONFIG_ADDR A:0xe633e04
y.create.l HWIO_PMIC_ARB_OBS3_CHNL125_CONFIG_ADDR A:0xe633e84
y.create.l HWIO_PMIC_ARB_OBS3_CHNL126_CONFIG_ADDR A:0xe633f04
y.create.l HWIO_PMIC_ARB_OBS3_CHNL127_CONFIG_ADDR A:0xe633f84
y.create.l HWIO_PMIC_ARB_OBS3_CHNL128_CONFIG_ADDR A:0xe634004
y.create.l HWIO_PMIC_ARB_OBS3_CHNL129_CONFIG_ADDR A:0xe634084
y.create.l HWIO_PMIC_ARB_OBS3_CHNL130_CONFIG_ADDR A:0xe634104
y.create.l HWIO_PMIC_ARB_OBS3_CHNL131_CONFIG_ADDR A:0xe634184
y.create.l HWIO_PMIC_ARB_OBS3_CHNL132_CONFIG_ADDR A:0xe634204
y.create.l HWIO_PMIC_ARB_OBS3_CHNL133_CONFIG_ADDR A:0xe634284
y.create.l HWIO_PMIC_ARB_OBS3_CHNL134_CONFIG_ADDR A:0xe634304
y.create.l HWIO_PMIC_ARB_OBS3_CHNL135_CONFIG_ADDR A:0xe634384
y.create.l HWIO_PMIC_ARB_OBS3_CHNL136_CONFIG_ADDR A:0xe634404
y.create.l HWIO_PMIC_ARB_OBS3_CHNL137_CONFIG_ADDR A:0xe634484
y.create.l HWIO_PMIC_ARB_OBS3_CHNL138_CONFIG_ADDR A:0xe634504
y.create.l HWIO_PMIC_ARB_OBS3_CHNL139_CONFIG_ADDR A:0xe634584
y.create.l HWIO_PMIC_ARB_OBS3_CHNL140_CONFIG_ADDR A:0xe634604
y.create.l HWIO_PMIC_ARB_OBS3_CHNL141_CONFIG_ADDR A:0xe634684
y.create.l HWIO_PMIC_ARB_OBS3_CHNL142_CONFIG_ADDR A:0xe634704
y.create.l HWIO_PMIC_ARB_OBS3_CHNL143_CONFIG_ADDR A:0xe634784
y.create.l HWIO_PMIC_ARB_OBS3_CHNL144_CONFIG_ADDR A:0xe634804
y.create.l HWIO_PMIC_ARB_OBS3_CHNL145_CONFIG_ADDR A:0xe634884
y.create.l HWIO_PMIC_ARB_OBS3_CHNL146_CONFIG_ADDR A:0xe634904
y.create.l HWIO_PMIC_ARB_OBS3_CHNL147_CONFIG_ADDR A:0xe634984
y.create.l HWIO_PMIC_ARB_OBS3_CHNL148_CONFIG_ADDR A:0xe634a04
y.create.l HWIO_PMIC_ARB_OBS3_CHNL149_CONFIG_ADDR A:0xe634a84
y.create.l HWIO_PMIC_ARB_OBS3_CHNL150_CONFIG_ADDR A:0xe634b04
y.create.l HWIO_PMIC_ARB_OBS3_CHNL151_CONFIG_ADDR A:0xe634b84
y.create.l HWIO_PMIC_ARB_OBS3_CHNL152_CONFIG_ADDR A:0xe634c04
y.create.l HWIO_PMIC_ARB_OBS3_CHNL153_CONFIG_ADDR A:0xe634c84
y.create.l HWIO_PMIC_ARB_OBS3_CHNL154_CONFIG_ADDR A:0xe634d04
y.create.l HWIO_PMIC_ARB_OBS3_CHNL155_CONFIG_ADDR A:0xe634d84
y.create.l HWIO_PMIC_ARB_OBS3_CHNL156_CONFIG_ADDR A:0xe634e04
y.create.l HWIO_PMIC_ARB_OBS3_CHNL157_CONFIG_ADDR A:0xe634e84
y.create.l HWIO_PMIC_ARB_OBS3_CHNL158_CONFIG_ADDR A:0xe634f04
y.create.l HWIO_PMIC_ARB_OBS3_CHNL159_CONFIG_ADDR A:0xe634f84
y.create.l HWIO_PMIC_ARB_OBS3_CHNL160_CONFIG_ADDR A:0xe635004
y.create.l HWIO_PMIC_ARB_OBS3_CHNL161_CONFIG_ADDR A:0xe635084
y.create.l HWIO_PMIC_ARB_OBS3_CHNL162_CONFIG_ADDR A:0xe635104
y.create.l HWIO_PMIC_ARB_OBS3_CHNL163_CONFIG_ADDR A:0xe635184
y.create.l HWIO_PMIC_ARB_OBS3_CHNL164_CONFIG_ADDR A:0xe635204
y.create.l HWIO_PMIC_ARB_OBS3_CHNL165_CONFIG_ADDR A:0xe635284
y.create.l HWIO_PMIC_ARB_OBS3_CHNL166_CONFIG_ADDR A:0xe635304
y.create.l HWIO_PMIC_ARB_OBS3_CHNL167_CONFIG_ADDR A:0xe635384
y.create.l HWIO_PMIC_ARB_OBS3_CHNL168_CONFIG_ADDR A:0xe635404
y.create.l HWIO_PMIC_ARB_OBS3_CHNL169_CONFIG_ADDR A:0xe635484
y.create.l HWIO_PMIC_ARB_OBS3_CHNL170_CONFIG_ADDR A:0xe635504
y.create.l HWIO_PMIC_ARB_OBS3_CHNL171_CONFIG_ADDR A:0xe635584
y.create.l HWIO_PMIC_ARB_OBS3_CHNL172_CONFIG_ADDR A:0xe635604
y.create.l HWIO_PMIC_ARB_OBS3_CHNL173_CONFIG_ADDR A:0xe635684
y.create.l HWIO_PMIC_ARB_OBS3_CHNL174_CONFIG_ADDR A:0xe635704
y.create.l HWIO_PMIC_ARB_OBS3_CHNL175_CONFIG_ADDR A:0xe635784
y.create.l HWIO_PMIC_ARB_OBS3_CHNL176_CONFIG_ADDR A:0xe635804
y.create.l HWIO_PMIC_ARB_OBS3_CHNL177_CONFIG_ADDR A:0xe635884
y.create.l HWIO_PMIC_ARB_OBS3_CHNL178_CONFIG_ADDR A:0xe635904
y.create.l HWIO_PMIC_ARB_OBS3_CHNL179_CONFIG_ADDR A:0xe635984
y.create.l HWIO_PMIC_ARB_OBS3_CHNL180_CONFIG_ADDR A:0xe635a04
y.create.l HWIO_PMIC_ARB_OBS3_CHNL181_CONFIG_ADDR A:0xe635a84
y.create.l HWIO_PMIC_ARB_OBS3_CHNL182_CONFIG_ADDR A:0xe635b04
y.create.l HWIO_PMIC_ARB_OBS3_CHNL183_CONFIG_ADDR A:0xe635b84
y.create.l HWIO_PMIC_ARB_OBS3_CHNL184_CONFIG_ADDR A:0xe635c04
y.create.l HWIO_PMIC_ARB_OBS3_CHNL185_CONFIG_ADDR A:0xe635c84
y.create.l HWIO_PMIC_ARB_OBS3_CHNL186_CONFIG_ADDR A:0xe635d04
y.create.l HWIO_PMIC_ARB_OBS3_CHNL187_CONFIG_ADDR A:0xe635d84
y.create.l HWIO_PMIC_ARB_OBS3_CHNL188_CONFIG_ADDR A:0xe635e04
y.create.l HWIO_PMIC_ARB_OBS3_CHNL189_CONFIG_ADDR A:0xe635e84
y.create.l HWIO_PMIC_ARB_OBS3_CHNL190_CONFIG_ADDR A:0xe635f04
y.create.l HWIO_PMIC_ARB_OBS3_CHNL191_CONFIG_ADDR A:0xe635f84
y.create.l HWIO_PMIC_ARB_OBS3_CHNL192_CONFIG_ADDR A:0xe636004
y.create.l HWIO_PMIC_ARB_OBS3_CHNL193_CONFIG_ADDR A:0xe636084
y.create.l HWIO_PMIC_ARB_OBS3_CHNL194_CONFIG_ADDR A:0xe636104
y.create.l HWIO_PMIC_ARB_OBS3_CHNL195_CONFIG_ADDR A:0xe636184
y.create.l HWIO_PMIC_ARB_OBS3_CHNL196_CONFIG_ADDR A:0xe636204
y.create.l HWIO_PMIC_ARB_OBS3_CHNL197_CONFIG_ADDR A:0xe636284
y.create.l HWIO_PMIC_ARB_OBS3_CHNL198_CONFIG_ADDR A:0xe636304
y.create.l HWIO_PMIC_ARB_OBS3_CHNL199_CONFIG_ADDR A:0xe636384
y.create.l HWIO_PMIC_ARB_OBS3_CHNL200_CONFIG_ADDR A:0xe636404
y.create.l HWIO_PMIC_ARB_OBS3_CHNL201_CONFIG_ADDR A:0xe636484
y.create.l HWIO_PMIC_ARB_OBS3_CHNL202_CONFIG_ADDR A:0xe636504
y.create.l HWIO_PMIC_ARB_OBS3_CHNL203_CONFIG_ADDR A:0xe636584
y.create.l HWIO_PMIC_ARB_OBS3_CHNL204_CONFIG_ADDR A:0xe636604
y.create.l HWIO_PMIC_ARB_OBS3_CHNL205_CONFIG_ADDR A:0xe636684
y.create.l HWIO_PMIC_ARB_OBS3_CHNL206_CONFIG_ADDR A:0xe636704
y.create.l HWIO_PMIC_ARB_OBS3_CHNL207_CONFIG_ADDR A:0xe636784
y.create.l HWIO_PMIC_ARB_OBS3_CHNL208_CONFIG_ADDR A:0xe636804
y.create.l HWIO_PMIC_ARB_OBS3_CHNL209_CONFIG_ADDR A:0xe636884
y.create.l HWIO_PMIC_ARB_OBS3_CHNL210_CONFIG_ADDR A:0xe636904
y.create.l HWIO_PMIC_ARB_OBS3_CHNL211_CONFIG_ADDR A:0xe636984
y.create.l HWIO_PMIC_ARB_OBS3_CHNL212_CONFIG_ADDR A:0xe636a04
y.create.l HWIO_PMIC_ARB_OBS3_CHNL213_CONFIG_ADDR A:0xe636a84
y.create.l HWIO_PMIC_ARB_OBS3_CHNL214_CONFIG_ADDR A:0xe636b04
y.create.l HWIO_PMIC_ARB_OBS3_CHNL215_CONFIG_ADDR A:0xe636b84
y.create.l HWIO_PMIC_ARB_OBS3_CHNL216_CONFIG_ADDR A:0xe636c04
y.create.l HWIO_PMIC_ARB_OBS3_CHNL217_CONFIG_ADDR A:0xe636c84
y.create.l HWIO_PMIC_ARB_OBS3_CHNL218_CONFIG_ADDR A:0xe636d04
y.create.l HWIO_PMIC_ARB_OBS3_CHNL219_CONFIG_ADDR A:0xe636d84
y.create.l HWIO_PMIC_ARB_OBS3_CHNL220_CONFIG_ADDR A:0xe636e04
y.create.l HWIO_PMIC_ARB_OBS3_CHNL221_CONFIG_ADDR A:0xe636e84
y.create.l HWIO_PMIC_ARB_OBS3_CHNL222_CONFIG_ADDR A:0xe636f04
y.create.l HWIO_PMIC_ARB_OBS3_CHNL223_CONFIG_ADDR A:0xe636f84
y.create.l HWIO_PMIC_ARB_OBS3_CHNL224_CONFIG_ADDR A:0xe637004
y.create.l HWIO_PMIC_ARB_OBS3_CHNL225_CONFIG_ADDR A:0xe637084
y.create.l HWIO_PMIC_ARB_OBS3_CHNL226_CONFIG_ADDR A:0xe637104
y.create.l HWIO_PMIC_ARB_OBS3_CHNL227_CONFIG_ADDR A:0xe637184
y.create.l HWIO_PMIC_ARB_OBS3_CHNL228_CONFIG_ADDR A:0xe637204
y.create.l HWIO_PMIC_ARB_OBS3_CHNL229_CONFIG_ADDR A:0xe637284
y.create.l HWIO_PMIC_ARB_OBS3_CHNL230_CONFIG_ADDR A:0xe637304
y.create.l HWIO_PMIC_ARB_OBS3_CHNL231_CONFIG_ADDR A:0xe637384
y.create.l HWIO_PMIC_ARB_OBS3_CHNL232_CONFIG_ADDR A:0xe637404
y.create.l HWIO_PMIC_ARB_OBS3_CHNL233_CONFIG_ADDR A:0xe637484
y.create.l HWIO_PMIC_ARB_OBS3_CHNL234_CONFIG_ADDR A:0xe637504
y.create.l HWIO_PMIC_ARB_OBS3_CHNL235_CONFIG_ADDR A:0xe637584
y.create.l HWIO_PMIC_ARB_OBS3_CHNL236_CONFIG_ADDR A:0xe637604
y.create.l HWIO_PMIC_ARB_OBS3_CHNL237_CONFIG_ADDR A:0xe637684
y.create.l HWIO_PMIC_ARB_OBS3_CHNL238_CONFIG_ADDR A:0xe637704
y.create.l HWIO_PMIC_ARB_OBS3_CHNL239_CONFIG_ADDR A:0xe637784
y.create.l HWIO_PMIC_ARB_OBS3_CHNL240_CONFIG_ADDR A:0xe637804
y.create.l HWIO_PMIC_ARB_OBS3_CHNL241_CONFIG_ADDR A:0xe637884
y.create.l HWIO_PMIC_ARB_OBS3_CHNL242_CONFIG_ADDR A:0xe637904
y.create.l HWIO_PMIC_ARB_OBS3_CHNL243_CONFIG_ADDR A:0xe637984
y.create.l HWIO_PMIC_ARB_OBS3_CHNL244_CONFIG_ADDR A:0xe637a04
y.create.l HWIO_PMIC_ARB_OBS3_CHNL245_CONFIG_ADDR A:0xe637a84
y.create.l HWIO_PMIC_ARB_OBS3_CHNL246_CONFIG_ADDR A:0xe637b04
y.create.l HWIO_PMIC_ARB_OBS3_CHNL247_CONFIG_ADDR A:0xe637b84
y.create.l HWIO_PMIC_ARB_OBS3_CHNL248_CONFIG_ADDR A:0xe637c04
y.create.l HWIO_PMIC_ARB_OBS3_CHNL249_CONFIG_ADDR A:0xe637c84
y.create.l HWIO_PMIC_ARB_OBS3_CHNL250_CONFIG_ADDR A:0xe637d04
y.create.l HWIO_PMIC_ARB_OBS3_CHNL251_CONFIG_ADDR A:0xe637d84
y.create.l HWIO_PMIC_ARB_OBS3_CHNL252_CONFIG_ADDR A:0xe637e04
y.create.l HWIO_PMIC_ARB_OBS3_CHNL253_CONFIG_ADDR A:0xe637e84
y.create.l HWIO_PMIC_ARB_OBS3_CHNL254_CONFIG_ADDR A:0xe637f04
y.create.l HWIO_PMIC_ARB_OBS3_CHNL255_CONFIG_ADDR A:0xe637f84
y.create.l HWIO_PMIC_ARB_OBS3_CHNL256_CONFIG_ADDR A:0xe638004
y.create.l HWIO_PMIC_ARB_OBS3_CHNL257_CONFIG_ADDR A:0xe638084
y.create.l HWIO_PMIC_ARB_OBS3_CHNL258_CONFIG_ADDR A:0xe638104
y.create.l HWIO_PMIC_ARB_OBS3_CHNL259_CONFIG_ADDR A:0xe638184
y.create.l HWIO_PMIC_ARB_OBS3_CHNL260_CONFIG_ADDR A:0xe638204
y.create.l HWIO_PMIC_ARB_OBS3_CHNL261_CONFIG_ADDR A:0xe638284
y.create.l HWIO_PMIC_ARB_OBS3_CHNL262_CONFIG_ADDR A:0xe638304
y.create.l HWIO_PMIC_ARB_OBS3_CHNL263_CONFIG_ADDR A:0xe638384
y.create.l HWIO_PMIC_ARB_OBS3_CHNL264_CONFIG_ADDR A:0xe638404
y.create.l HWIO_PMIC_ARB_OBS3_CHNL265_CONFIG_ADDR A:0xe638484
y.create.l HWIO_PMIC_ARB_OBS3_CHNL266_CONFIG_ADDR A:0xe638504
y.create.l HWIO_PMIC_ARB_OBS3_CHNL267_CONFIG_ADDR A:0xe638584
y.create.l HWIO_PMIC_ARB_OBS3_CHNL268_CONFIG_ADDR A:0xe638604
y.create.l HWIO_PMIC_ARB_OBS3_CHNL269_CONFIG_ADDR A:0xe638684
y.create.l HWIO_PMIC_ARB_OBS3_CHNL270_CONFIG_ADDR A:0xe638704
y.create.l HWIO_PMIC_ARB_OBS3_CHNL271_CONFIG_ADDR A:0xe638784
y.create.l HWIO_PMIC_ARB_OBS3_CHNL272_CONFIG_ADDR A:0xe638804
y.create.l HWIO_PMIC_ARB_OBS3_CHNL273_CONFIG_ADDR A:0xe638884
y.create.l HWIO_PMIC_ARB_OBS3_CHNL274_CONFIG_ADDR A:0xe638904
y.create.l HWIO_PMIC_ARB_OBS3_CHNL275_CONFIG_ADDR A:0xe638984
y.create.l HWIO_PMIC_ARB_OBS3_CHNL276_CONFIG_ADDR A:0xe638a04
y.create.l HWIO_PMIC_ARB_OBS3_CHNL277_CONFIG_ADDR A:0xe638a84
y.create.l HWIO_PMIC_ARB_OBS3_CHNL278_CONFIG_ADDR A:0xe638b04
y.create.l HWIO_PMIC_ARB_OBS3_CHNL279_CONFIG_ADDR A:0xe638b84
y.create.l HWIO_PMIC_ARB_OBS3_CHNL280_CONFIG_ADDR A:0xe638c04
y.create.l HWIO_PMIC_ARB_OBS3_CHNL281_CONFIG_ADDR A:0xe638c84
y.create.l HWIO_PMIC_ARB_OBS3_CHNL282_CONFIG_ADDR A:0xe638d04
y.create.l HWIO_PMIC_ARB_OBS3_CHNL283_CONFIG_ADDR A:0xe638d84
y.create.l HWIO_PMIC_ARB_OBS3_CHNL284_CONFIG_ADDR A:0xe638e04
y.create.l HWIO_PMIC_ARB_OBS3_CHNL285_CONFIG_ADDR A:0xe638e84
y.create.l HWIO_PMIC_ARB_OBS3_CHNL286_CONFIG_ADDR A:0xe638f04
y.create.l HWIO_PMIC_ARB_OBS3_CHNL287_CONFIG_ADDR A:0xe638f84
y.create.l HWIO_PMIC_ARB_OBS3_CHNL288_CONFIG_ADDR A:0xe639004
y.create.l HWIO_PMIC_ARB_OBS3_CHNL289_CONFIG_ADDR A:0xe639084
y.create.l HWIO_PMIC_ARB_OBS3_CHNL290_CONFIG_ADDR A:0xe639104
y.create.l HWIO_PMIC_ARB_OBS3_CHNL291_CONFIG_ADDR A:0xe639184
y.create.l HWIO_PMIC_ARB_OBS3_CHNL292_CONFIG_ADDR A:0xe639204
y.create.l HWIO_PMIC_ARB_OBS3_CHNL293_CONFIG_ADDR A:0xe639284
y.create.l HWIO_PMIC_ARB_OBS3_CHNL294_CONFIG_ADDR A:0xe639304
y.create.l HWIO_PMIC_ARB_OBS3_CHNL295_CONFIG_ADDR A:0xe639384
y.create.l HWIO_PMIC_ARB_OBS3_CHNL296_CONFIG_ADDR A:0xe639404
y.create.l HWIO_PMIC_ARB_OBS3_CHNL297_CONFIG_ADDR A:0xe639484
y.create.l HWIO_PMIC_ARB_OBS3_CHNL298_CONFIG_ADDR A:0xe639504
y.create.l HWIO_PMIC_ARB_OBS3_CHNL299_CONFIG_ADDR A:0xe639584
y.create.l HWIO_PMIC_ARB_OBS3_CHNL300_CONFIG_ADDR A:0xe639604
y.create.l HWIO_PMIC_ARB_OBS3_CHNL301_CONFIG_ADDR A:0xe639684
y.create.l HWIO_PMIC_ARB_OBS3_CHNL302_CONFIG_ADDR A:0xe639704
y.create.l HWIO_PMIC_ARB_OBS3_CHNL303_CONFIG_ADDR A:0xe639784
y.create.l HWIO_PMIC_ARB_OBS3_CHNL304_CONFIG_ADDR A:0xe639804
y.create.l HWIO_PMIC_ARB_OBS3_CHNL305_CONFIG_ADDR A:0xe639884
y.create.l HWIO_PMIC_ARB_OBS3_CHNL306_CONFIG_ADDR A:0xe639904
y.create.l HWIO_PMIC_ARB_OBS3_CHNL307_CONFIG_ADDR A:0xe639984
y.create.l HWIO_PMIC_ARB_OBS3_CHNL308_CONFIG_ADDR A:0xe639a04
y.create.l HWIO_PMIC_ARB_OBS3_CHNL309_CONFIG_ADDR A:0xe639a84
y.create.l HWIO_PMIC_ARB_OBS3_CHNL310_CONFIG_ADDR A:0xe639b04
y.create.l HWIO_PMIC_ARB_OBS3_CHNL311_CONFIG_ADDR A:0xe639b84
y.create.l HWIO_PMIC_ARB_OBS3_CHNL312_CONFIG_ADDR A:0xe639c04
y.create.l HWIO_PMIC_ARB_OBS3_CHNL313_CONFIG_ADDR A:0xe639c84
y.create.l HWIO_PMIC_ARB_OBS3_CHNL314_CONFIG_ADDR A:0xe639d04
y.create.l HWIO_PMIC_ARB_OBS3_CHNL315_CONFIG_ADDR A:0xe639d84
y.create.l HWIO_PMIC_ARB_OBS3_CHNL316_CONFIG_ADDR A:0xe639e04
y.create.l HWIO_PMIC_ARB_OBS3_CHNL317_CONFIG_ADDR A:0xe639e84
y.create.l HWIO_PMIC_ARB_OBS3_CHNL318_CONFIG_ADDR A:0xe639f04
y.create.l HWIO_PMIC_ARB_OBS3_CHNL319_CONFIG_ADDR A:0xe639f84
y.create.l HWIO_PMIC_ARB_OBS3_CHNL320_CONFIG_ADDR A:0xe63a004
y.create.l HWIO_PMIC_ARB_OBS3_CHNL321_CONFIG_ADDR A:0xe63a084
y.create.l HWIO_PMIC_ARB_OBS3_CHNL322_CONFIG_ADDR A:0xe63a104
y.create.l HWIO_PMIC_ARB_OBS3_CHNL323_CONFIG_ADDR A:0xe63a184
y.create.l HWIO_PMIC_ARB_OBS3_CHNL324_CONFIG_ADDR A:0xe63a204
y.create.l HWIO_PMIC_ARB_OBS3_CHNL325_CONFIG_ADDR A:0xe63a284
y.create.l HWIO_PMIC_ARB_OBS3_CHNL326_CONFIG_ADDR A:0xe63a304
y.create.l HWIO_PMIC_ARB_OBS3_CHNL327_CONFIG_ADDR A:0xe63a384
y.create.l HWIO_PMIC_ARB_OBS3_CHNL328_CONFIG_ADDR A:0xe63a404
y.create.l HWIO_PMIC_ARB_OBS3_CHNL329_CONFIG_ADDR A:0xe63a484
y.create.l HWIO_PMIC_ARB_OBS3_CHNL330_CONFIG_ADDR A:0xe63a504
y.create.l HWIO_PMIC_ARB_OBS3_CHNL331_CONFIG_ADDR A:0xe63a584
y.create.l HWIO_PMIC_ARB_OBS3_CHNL332_CONFIG_ADDR A:0xe63a604
y.create.l HWIO_PMIC_ARB_OBS3_CHNL333_CONFIG_ADDR A:0xe63a684
y.create.l HWIO_PMIC_ARB_OBS3_CHNL334_CONFIG_ADDR A:0xe63a704
y.create.l HWIO_PMIC_ARB_OBS3_CHNL335_CONFIG_ADDR A:0xe63a784
y.create.l HWIO_PMIC_ARB_OBS3_CHNL336_CONFIG_ADDR A:0xe63a804
y.create.l HWIO_PMIC_ARB_OBS3_CHNL337_CONFIG_ADDR A:0xe63a884
y.create.l HWIO_PMIC_ARB_OBS3_CHNL338_CONFIG_ADDR A:0xe63a904
y.create.l HWIO_PMIC_ARB_OBS3_CHNL339_CONFIG_ADDR A:0xe63a984
y.create.l HWIO_PMIC_ARB_OBS3_CHNL340_CONFIG_ADDR A:0xe63aa04
y.create.l HWIO_PMIC_ARB_OBS3_CHNL341_CONFIG_ADDR A:0xe63aa84
y.create.l HWIO_PMIC_ARB_OBS3_CHNL342_CONFIG_ADDR A:0xe63ab04
y.create.l HWIO_PMIC_ARB_OBS3_CHNL343_CONFIG_ADDR A:0xe63ab84
y.create.l HWIO_PMIC_ARB_OBS3_CHNL344_CONFIG_ADDR A:0xe63ac04
y.create.l HWIO_PMIC_ARB_OBS3_CHNL345_CONFIG_ADDR A:0xe63ac84
y.create.l HWIO_PMIC_ARB_OBS3_CHNL346_CONFIG_ADDR A:0xe63ad04
y.create.l HWIO_PMIC_ARB_OBS3_CHNL347_CONFIG_ADDR A:0xe63ad84
y.create.l HWIO_PMIC_ARB_OBS3_CHNL348_CONFIG_ADDR A:0xe63ae04
y.create.l HWIO_PMIC_ARB_OBS3_CHNL349_CONFIG_ADDR A:0xe63ae84
y.create.l HWIO_PMIC_ARB_OBS3_CHNL350_CONFIG_ADDR A:0xe63af04
y.create.l HWIO_PMIC_ARB_OBS3_CHNL351_CONFIG_ADDR A:0xe63af84
y.create.l HWIO_PMIC_ARB_OBS3_CHNL352_CONFIG_ADDR A:0xe63b004
y.create.l HWIO_PMIC_ARB_OBS3_CHNL353_CONFIG_ADDR A:0xe63b084
y.create.l HWIO_PMIC_ARB_OBS3_CHNL354_CONFIG_ADDR A:0xe63b104
y.create.l HWIO_PMIC_ARB_OBS3_CHNL355_CONFIG_ADDR A:0xe63b184
y.create.l HWIO_PMIC_ARB_OBS3_CHNL356_CONFIG_ADDR A:0xe63b204
y.create.l HWIO_PMIC_ARB_OBS3_CHNL357_CONFIG_ADDR A:0xe63b284
y.create.l HWIO_PMIC_ARB_OBS3_CHNL358_CONFIG_ADDR A:0xe63b304
y.create.l HWIO_PMIC_ARB_OBS3_CHNL359_CONFIG_ADDR A:0xe63b384
y.create.l HWIO_PMIC_ARB_OBS3_CHNL360_CONFIG_ADDR A:0xe63b404
y.create.l HWIO_PMIC_ARB_OBS3_CHNL361_CONFIG_ADDR A:0xe63b484
y.create.l HWIO_PMIC_ARB_OBS3_CHNL362_CONFIG_ADDR A:0xe63b504
y.create.l HWIO_PMIC_ARB_OBS3_CHNL363_CONFIG_ADDR A:0xe63b584
y.create.l HWIO_PMIC_ARB_OBS3_CHNL364_CONFIG_ADDR A:0xe63b604
y.create.l HWIO_PMIC_ARB_OBS3_CHNL365_CONFIG_ADDR A:0xe63b684
y.create.l HWIO_PMIC_ARB_OBS3_CHNL366_CONFIG_ADDR A:0xe63b704
y.create.l HWIO_PMIC_ARB_OBS3_CHNL367_CONFIG_ADDR A:0xe63b784
y.create.l HWIO_PMIC_ARB_OBS3_CHNL368_CONFIG_ADDR A:0xe63b804
y.create.l HWIO_PMIC_ARB_OBS3_CHNL369_CONFIG_ADDR A:0xe63b884
y.create.l HWIO_PMIC_ARB_OBS3_CHNL370_CONFIG_ADDR A:0xe63b904
y.create.l HWIO_PMIC_ARB_OBS3_CHNL371_CONFIG_ADDR A:0xe63b984
y.create.l HWIO_PMIC_ARB_OBS3_CHNL372_CONFIG_ADDR A:0xe63ba04
y.create.l HWIO_PMIC_ARB_OBS3_CHNL373_CONFIG_ADDR A:0xe63ba84
y.create.l HWIO_PMIC_ARB_OBS3_CHNL374_CONFIG_ADDR A:0xe63bb04
y.create.l HWIO_PMIC_ARB_OBS3_CHNL375_CONFIG_ADDR A:0xe63bb84
y.create.l HWIO_PMIC_ARB_OBS3_CHNL376_CONFIG_ADDR A:0xe63bc04
y.create.l HWIO_PMIC_ARB_OBS3_CHNL377_CONFIG_ADDR A:0xe63bc84
y.create.l HWIO_PMIC_ARB_OBS3_CHNL378_CONFIG_ADDR A:0xe63bd04
y.create.l HWIO_PMIC_ARB_OBS3_CHNL379_CONFIG_ADDR A:0xe63bd84
y.create.l HWIO_PMIC_ARB_OBS3_CHNL380_CONFIG_ADDR A:0xe63be04
y.create.l HWIO_PMIC_ARB_OBS3_CHNL381_CONFIG_ADDR A:0xe63be84
y.create.l HWIO_PMIC_ARB_OBS3_CHNL382_CONFIG_ADDR A:0xe63bf04
y.create.l HWIO_PMIC_ARB_OBS3_CHNL383_CONFIG_ADDR A:0xe63bf84
y.create.l HWIO_PMIC_ARB_OBS3_CHNL384_CONFIG_ADDR A:0xe63c004
y.create.l HWIO_PMIC_ARB_OBS3_CHNL385_CONFIG_ADDR A:0xe63c084
y.create.l HWIO_PMIC_ARB_OBS3_CHNL386_CONFIG_ADDR A:0xe63c104
y.create.l HWIO_PMIC_ARB_OBS3_CHNL387_CONFIG_ADDR A:0xe63c184
y.create.l HWIO_PMIC_ARB_OBS3_CHNL388_CONFIG_ADDR A:0xe63c204
y.create.l HWIO_PMIC_ARB_OBS3_CHNL389_CONFIG_ADDR A:0xe63c284
y.create.l HWIO_PMIC_ARB_OBS3_CHNL390_CONFIG_ADDR A:0xe63c304
y.create.l HWIO_PMIC_ARB_OBS3_CHNL391_CONFIG_ADDR A:0xe63c384
y.create.l HWIO_PMIC_ARB_OBS3_CHNL392_CONFIG_ADDR A:0xe63c404
y.create.l HWIO_PMIC_ARB_OBS3_CHNL393_CONFIG_ADDR A:0xe63c484
y.create.l HWIO_PMIC_ARB_OBS3_CHNL394_CONFIG_ADDR A:0xe63c504
y.create.l HWIO_PMIC_ARB_OBS3_CHNL395_CONFIG_ADDR A:0xe63c584
y.create.l HWIO_PMIC_ARB_OBS3_CHNL396_CONFIG_ADDR A:0xe63c604
y.create.l HWIO_PMIC_ARB_OBS3_CHNL397_CONFIG_ADDR A:0xe63c684
y.create.l HWIO_PMIC_ARB_OBS3_CHNL398_CONFIG_ADDR A:0xe63c704
y.create.l HWIO_PMIC_ARB_OBS3_CHNL399_CONFIG_ADDR A:0xe63c784
y.create.l HWIO_PMIC_ARB_OBS3_CHNL400_CONFIG_ADDR A:0xe63c804
y.create.l HWIO_PMIC_ARB_OBS3_CHNL401_CONFIG_ADDR A:0xe63c884
y.create.l HWIO_PMIC_ARB_OBS3_CHNL402_CONFIG_ADDR A:0xe63c904
y.create.l HWIO_PMIC_ARB_OBS3_CHNL403_CONFIG_ADDR A:0xe63c984
y.create.l HWIO_PMIC_ARB_OBS3_CHNL404_CONFIG_ADDR A:0xe63ca04
y.create.l HWIO_PMIC_ARB_OBS3_CHNL405_CONFIG_ADDR A:0xe63ca84
y.create.l HWIO_PMIC_ARB_OBS3_CHNL406_CONFIG_ADDR A:0xe63cb04
y.create.l HWIO_PMIC_ARB_OBS3_CHNL407_CONFIG_ADDR A:0xe63cb84
y.create.l HWIO_PMIC_ARB_OBS3_CHNL408_CONFIG_ADDR A:0xe63cc04
y.create.l HWIO_PMIC_ARB_OBS3_CHNL409_CONFIG_ADDR A:0xe63cc84
y.create.l HWIO_PMIC_ARB_OBS3_CHNL410_CONFIG_ADDR A:0xe63cd04
y.create.l HWIO_PMIC_ARB_OBS3_CHNL411_CONFIG_ADDR A:0xe63cd84
y.create.l HWIO_PMIC_ARB_OBS3_CHNL412_CONFIG_ADDR A:0xe63ce04
y.create.l HWIO_PMIC_ARB_OBS3_CHNL413_CONFIG_ADDR A:0xe63ce84
y.create.l HWIO_PMIC_ARB_OBS3_CHNL414_CONFIG_ADDR A:0xe63cf04
y.create.l HWIO_PMIC_ARB_OBS3_CHNL415_CONFIG_ADDR A:0xe63cf84
y.create.l HWIO_PMIC_ARB_OBS3_CHNL416_CONFIG_ADDR A:0xe63d004
y.create.l HWIO_PMIC_ARB_OBS3_CHNL417_CONFIG_ADDR A:0xe63d084
y.create.l HWIO_PMIC_ARB_OBS3_CHNL418_CONFIG_ADDR A:0xe63d104
y.create.l HWIO_PMIC_ARB_OBS3_CHNL419_CONFIG_ADDR A:0xe63d184
y.create.l HWIO_PMIC_ARB_OBS3_CHNL420_CONFIG_ADDR A:0xe63d204
y.create.l HWIO_PMIC_ARB_OBS3_CHNL421_CONFIG_ADDR A:0xe63d284
y.create.l HWIO_PMIC_ARB_OBS3_CHNL422_CONFIG_ADDR A:0xe63d304
y.create.l HWIO_PMIC_ARB_OBS3_CHNL423_CONFIG_ADDR A:0xe63d384
y.create.l HWIO_PMIC_ARB_OBS3_CHNL424_CONFIG_ADDR A:0xe63d404
y.create.l HWIO_PMIC_ARB_OBS3_CHNL425_CONFIG_ADDR A:0xe63d484
y.create.l HWIO_PMIC_ARB_OBS3_CHNL426_CONFIG_ADDR A:0xe63d504
y.create.l HWIO_PMIC_ARB_OBS3_CHNL427_CONFIG_ADDR A:0xe63d584
y.create.l HWIO_PMIC_ARB_OBS3_CHNL428_CONFIG_ADDR A:0xe63d604
y.create.l HWIO_PMIC_ARB_OBS3_CHNL429_CONFIG_ADDR A:0xe63d684
y.create.l HWIO_PMIC_ARB_OBS3_CHNL430_CONFIG_ADDR A:0xe63d704
y.create.l HWIO_PMIC_ARB_OBS3_CHNL431_CONFIG_ADDR A:0xe63d784
y.create.l HWIO_PMIC_ARB_OBS3_CHNL432_CONFIG_ADDR A:0xe63d804
y.create.l HWIO_PMIC_ARB_OBS3_CHNL433_CONFIG_ADDR A:0xe63d884
y.create.l HWIO_PMIC_ARB_OBS3_CHNL434_CONFIG_ADDR A:0xe63d904
y.create.l HWIO_PMIC_ARB_OBS3_CHNL435_CONFIG_ADDR A:0xe63d984
y.create.l HWIO_PMIC_ARB_OBS3_CHNL436_CONFIG_ADDR A:0xe63da04
y.create.l HWIO_PMIC_ARB_OBS3_CHNL437_CONFIG_ADDR A:0xe63da84
y.create.l HWIO_PMIC_ARB_OBS3_CHNL438_CONFIG_ADDR A:0xe63db04
y.create.l HWIO_PMIC_ARB_OBS3_CHNL439_CONFIG_ADDR A:0xe63db84
y.create.l HWIO_PMIC_ARB_OBS3_CHNL440_CONFIG_ADDR A:0xe63dc04
y.create.l HWIO_PMIC_ARB_OBS3_CHNL441_CONFIG_ADDR A:0xe63dc84
y.create.l HWIO_PMIC_ARB_OBS3_CHNL442_CONFIG_ADDR A:0xe63dd04
y.create.l HWIO_PMIC_ARB_OBS3_CHNL443_CONFIG_ADDR A:0xe63dd84
y.create.l HWIO_PMIC_ARB_OBS3_CHNL444_CONFIG_ADDR A:0xe63de04
y.create.l HWIO_PMIC_ARB_OBS3_CHNL445_CONFIG_ADDR A:0xe63de84
y.create.l HWIO_PMIC_ARB_OBS3_CHNL446_CONFIG_ADDR A:0xe63df04
y.create.l HWIO_PMIC_ARB_OBS3_CHNL447_CONFIG_ADDR A:0xe63df84
y.create.l HWIO_PMIC_ARB_OBS3_CHNL448_CONFIG_ADDR A:0xe63e004
y.create.l HWIO_PMIC_ARB_OBS3_CHNL449_CONFIG_ADDR A:0xe63e084
y.create.l HWIO_PMIC_ARB_OBS3_CHNL450_CONFIG_ADDR A:0xe63e104
y.create.l HWIO_PMIC_ARB_OBS3_CHNL451_CONFIG_ADDR A:0xe63e184
y.create.l HWIO_PMIC_ARB_OBS3_CHNL452_CONFIG_ADDR A:0xe63e204
y.create.l HWIO_PMIC_ARB_OBS3_CHNL453_CONFIG_ADDR A:0xe63e284
y.create.l HWIO_PMIC_ARB_OBS3_CHNL454_CONFIG_ADDR A:0xe63e304
y.create.l HWIO_PMIC_ARB_OBS3_CHNL455_CONFIG_ADDR A:0xe63e384
y.create.l HWIO_PMIC_ARB_OBS3_CHNL456_CONFIG_ADDR A:0xe63e404
y.create.l HWIO_PMIC_ARB_OBS3_CHNL457_CONFIG_ADDR A:0xe63e484
y.create.l HWIO_PMIC_ARB_OBS3_CHNL458_CONFIG_ADDR A:0xe63e504
y.create.l HWIO_PMIC_ARB_OBS3_CHNL459_CONFIG_ADDR A:0xe63e584
y.create.l HWIO_PMIC_ARB_OBS3_CHNL460_CONFIG_ADDR A:0xe63e604
y.create.l HWIO_PMIC_ARB_OBS3_CHNL461_CONFIG_ADDR A:0xe63e684
y.create.l HWIO_PMIC_ARB_OBS3_CHNL462_CONFIG_ADDR A:0xe63e704
y.create.l HWIO_PMIC_ARB_OBS3_CHNL463_CONFIG_ADDR A:0xe63e784
y.create.l HWIO_PMIC_ARB_OBS3_CHNL464_CONFIG_ADDR A:0xe63e804
y.create.l HWIO_PMIC_ARB_OBS3_CHNL465_CONFIG_ADDR A:0xe63e884
y.create.l HWIO_PMIC_ARB_OBS3_CHNL466_CONFIG_ADDR A:0xe63e904
y.create.l HWIO_PMIC_ARB_OBS3_CHNL467_CONFIG_ADDR A:0xe63e984
y.create.l HWIO_PMIC_ARB_OBS3_CHNL468_CONFIG_ADDR A:0xe63ea04
y.create.l HWIO_PMIC_ARB_OBS3_CHNL469_CONFIG_ADDR A:0xe63ea84
y.create.l HWIO_PMIC_ARB_OBS3_CHNL470_CONFIG_ADDR A:0xe63eb04
y.create.l HWIO_PMIC_ARB_OBS3_CHNL471_CONFIG_ADDR A:0xe63eb84
y.create.l HWIO_PMIC_ARB_OBS3_CHNL472_CONFIG_ADDR A:0xe63ec04
y.create.l HWIO_PMIC_ARB_OBS3_CHNL473_CONFIG_ADDR A:0xe63ec84
y.create.l HWIO_PMIC_ARB_OBS3_CHNL474_CONFIG_ADDR A:0xe63ed04
y.create.l HWIO_PMIC_ARB_OBS3_CHNL475_CONFIG_ADDR A:0xe63ed84
y.create.l HWIO_PMIC_ARB_OBS3_CHNL476_CONFIG_ADDR A:0xe63ee04
y.create.l HWIO_PMIC_ARB_OBS3_CHNL477_CONFIG_ADDR A:0xe63ee84
y.create.l HWIO_PMIC_ARB_OBS3_CHNL478_CONFIG_ADDR A:0xe63ef04
y.create.l HWIO_PMIC_ARB_OBS3_CHNL479_CONFIG_ADDR A:0xe63ef84
y.create.l HWIO_PMIC_ARB_OBS3_CHNL480_CONFIG_ADDR A:0xe63f004
y.create.l HWIO_PMIC_ARB_OBS3_CHNL481_CONFIG_ADDR A:0xe63f084
y.create.l HWIO_PMIC_ARB_OBS3_CHNL482_CONFIG_ADDR A:0xe63f104
y.create.l HWIO_PMIC_ARB_OBS3_CHNL483_CONFIG_ADDR A:0xe63f184
y.create.l HWIO_PMIC_ARB_OBS3_CHNL484_CONFIG_ADDR A:0xe63f204
y.create.l HWIO_PMIC_ARB_OBS3_CHNL485_CONFIG_ADDR A:0xe63f284
y.create.l HWIO_PMIC_ARB_OBS3_CHNL486_CONFIG_ADDR A:0xe63f304
y.create.l HWIO_PMIC_ARB_OBS3_CHNL487_CONFIG_ADDR A:0xe63f384
y.create.l HWIO_PMIC_ARB_OBS3_CHNL488_CONFIG_ADDR A:0xe63f404
y.create.l HWIO_PMIC_ARB_OBS3_CHNL489_CONFIG_ADDR A:0xe63f484
y.create.l HWIO_PMIC_ARB_OBS3_CHNL490_CONFIG_ADDR A:0xe63f504
y.create.l HWIO_PMIC_ARB_OBS3_CHNL491_CONFIG_ADDR A:0xe63f584
y.create.l HWIO_PMIC_ARB_OBS3_CHNL492_CONFIG_ADDR A:0xe63f604
y.create.l HWIO_PMIC_ARB_OBS3_CHNL493_CONFIG_ADDR A:0xe63f684
y.create.l HWIO_PMIC_ARB_OBS3_CHNL494_CONFIG_ADDR A:0xe63f704
y.create.l HWIO_PMIC_ARB_OBS3_CHNL495_CONFIG_ADDR A:0xe63f784
y.create.l HWIO_PMIC_ARB_OBS3_CHNL496_CONFIG_ADDR A:0xe63f804
y.create.l HWIO_PMIC_ARB_OBS3_CHNL497_CONFIG_ADDR A:0xe63f884
y.create.l HWIO_PMIC_ARB_OBS3_CHNL498_CONFIG_ADDR A:0xe63f904
y.create.l HWIO_PMIC_ARB_OBS3_CHNL499_CONFIG_ADDR A:0xe63f984
y.create.l HWIO_PMIC_ARB_OBS3_CHNL500_CONFIG_ADDR A:0xe63fa04
y.create.l HWIO_PMIC_ARB_OBS3_CHNL501_CONFIG_ADDR A:0xe63fa84
y.create.l HWIO_PMIC_ARB_OBS3_CHNL502_CONFIG_ADDR A:0xe63fb04
y.create.l HWIO_PMIC_ARB_OBS3_CHNL503_CONFIG_ADDR A:0xe63fb84
y.create.l HWIO_PMIC_ARB_OBS3_CHNL504_CONFIG_ADDR A:0xe63fc04
y.create.l HWIO_PMIC_ARB_OBS3_CHNL505_CONFIG_ADDR A:0xe63fc84
y.create.l HWIO_PMIC_ARB_OBS3_CHNL506_CONFIG_ADDR A:0xe63fd04
y.create.l HWIO_PMIC_ARB_OBS3_CHNL507_CONFIG_ADDR A:0xe63fd84
y.create.l HWIO_PMIC_ARB_OBS3_CHNL508_CONFIG_ADDR A:0xe63fe04
y.create.l HWIO_PMIC_ARB_OBS3_CHNL509_CONFIG_ADDR A:0xe63fe84
y.create.l HWIO_PMIC_ARB_OBS3_CHNL510_CONFIG_ADDR A:0xe63ff04
y.create.l HWIO_PMIC_ARB_OBS3_CHNL511_CONFIG_ADDR A:0xe63ff84
y.create.l HWIO_PMIC_ARB_OBS4_CHNL0_CONFIG_ADDR A:0xe640004
y.create.l HWIO_PMIC_ARB_OBS4_CHNL1_CONFIG_ADDR A:0xe640084
y.create.l HWIO_PMIC_ARB_OBS4_CHNL2_CONFIG_ADDR A:0xe640104
y.create.l HWIO_PMIC_ARB_OBS4_CHNL3_CONFIG_ADDR A:0xe640184
y.create.l HWIO_PMIC_ARB_OBS4_CHNL4_CONFIG_ADDR A:0xe640204
y.create.l HWIO_PMIC_ARB_OBS4_CHNL5_CONFIG_ADDR A:0xe640284
y.create.l HWIO_PMIC_ARB_OBS4_CHNL6_CONFIG_ADDR A:0xe640304
y.create.l HWIO_PMIC_ARB_OBS4_CHNL7_CONFIG_ADDR A:0xe640384
y.create.l HWIO_PMIC_ARB_OBS4_CHNL8_CONFIG_ADDR A:0xe640404
y.create.l HWIO_PMIC_ARB_OBS4_CHNL9_CONFIG_ADDR A:0xe640484
y.create.l HWIO_PMIC_ARB_OBS4_CHNL10_CONFIG_ADDR A:0xe640504
y.create.l HWIO_PMIC_ARB_OBS4_CHNL11_CONFIG_ADDR A:0xe640584
y.create.l HWIO_PMIC_ARB_OBS4_CHNL12_CONFIG_ADDR A:0xe640604
y.create.l HWIO_PMIC_ARB_OBS4_CHNL13_CONFIG_ADDR A:0xe640684
y.create.l HWIO_PMIC_ARB_OBS4_CHNL14_CONFIG_ADDR A:0xe640704
y.create.l HWIO_PMIC_ARB_OBS4_CHNL15_CONFIG_ADDR A:0xe640784
y.create.l HWIO_PMIC_ARB_OBS4_CHNL16_CONFIG_ADDR A:0xe640804
y.create.l HWIO_PMIC_ARB_OBS4_CHNL17_CONFIG_ADDR A:0xe640884
y.create.l HWIO_PMIC_ARB_OBS4_CHNL18_CONFIG_ADDR A:0xe640904
y.create.l HWIO_PMIC_ARB_OBS4_CHNL19_CONFIG_ADDR A:0xe640984
y.create.l HWIO_PMIC_ARB_OBS4_CHNL20_CONFIG_ADDR A:0xe640a04
y.create.l HWIO_PMIC_ARB_OBS4_CHNL21_CONFIG_ADDR A:0xe640a84
y.create.l HWIO_PMIC_ARB_OBS4_CHNL22_CONFIG_ADDR A:0xe640b04
y.create.l HWIO_PMIC_ARB_OBS4_CHNL23_CONFIG_ADDR A:0xe640b84
y.create.l HWIO_PMIC_ARB_OBS4_CHNL24_CONFIG_ADDR A:0xe640c04
y.create.l HWIO_PMIC_ARB_OBS4_CHNL25_CONFIG_ADDR A:0xe640c84
y.create.l HWIO_PMIC_ARB_OBS4_CHNL26_CONFIG_ADDR A:0xe640d04
y.create.l HWIO_PMIC_ARB_OBS4_CHNL27_CONFIG_ADDR A:0xe640d84
y.create.l HWIO_PMIC_ARB_OBS4_CHNL28_CONFIG_ADDR A:0xe640e04
y.create.l HWIO_PMIC_ARB_OBS4_CHNL29_CONFIG_ADDR A:0xe640e84
y.create.l HWIO_PMIC_ARB_OBS4_CHNL30_CONFIG_ADDR A:0xe640f04
y.create.l HWIO_PMIC_ARB_OBS4_CHNL31_CONFIG_ADDR A:0xe640f84
y.create.l HWIO_PMIC_ARB_OBS4_CHNL32_CONFIG_ADDR A:0xe641004
y.create.l HWIO_PMIC_ARB_OBS4_CHNL33_CONFIG_ADDR A:0xe641084
y.create.l HWIO_PMIC_ARB_OBS4_CHNL34_CONFIG_ADDR A:0xe641104
y.create.l HWIO_PMIC_ARB_OBS4_CHNL35_CONFIG_ADDR A:0xe641184
y.create.l HWIO_PMIC_ARB_OBS4_CHNL36_CONFIG_ADDR A:0xe641204
y.create.l HWIO_PMIC_ARB_OBS4_CHNL37_CONFIG_ADDR A:0xe641284
y.create.l HWIO_PMIC_ARB_OBS4_CHNL38_CONFIG_ADDR A:0xe641304
y.create.l HWIO_PMIC_ARB_OBS4_CHNL39_CONFIG_ADDR A:0xe641384
y.create.l HWIO_PMIC_ARB_OBS4_CHNL40_CONFIG_ADDR A:0xe641404
y.create.l HWIO_PMIC_ARB_OBS4_CHNL41_CONFIG_ADDR A:0xe641484
y.create.l HWIO_PMIC_ARB_OBS4_CHNL42_CONFIG_ADDR A:0xe641504
y.create.l HWIO_PMIC_ARB_OBS4_CHNL43_CONFIG_ADDR A:0xe641584
y.create.l HWIO_PMIC_ARB_OBS4_CHNL44_CONFIG_ADDR A:0xe641604
y.create.l HWIO_PMIC_ARB_OBS4_CHNL45_CONFIG_ADDR A:0xe641684
y.create.l HWIO_PMIC_ARB_OBS4_CHNL46_CONFIG_ADDR A:0xe641704
y.create.l HWIO_PMIC_ARB_OBS4_CHNL47_CONFIG_ADDR A:0xe641784
y.create.l HWIO_PMIC_ARB_OBS4_CHNL48_CONFIG_ADDR A:0xe641804
y.create.l HWIO_PMIC_ARB_OBS4_CHNL49_CONFIG_ADDR A:0xe641884
y.create.l HWIO_PMIC_ARB_OBS4_CHNL50_CONFIG_ADDR A:0xe641904
y.create.l HWIO_PMIC_ARB_OBS4_CHNL51_CONFIG_ADDR A:0xe641984
y.create.l HWIO_PMIC_ARB_OBS4_CHNL52_CONFIG_ADDR A:0xe641a04
y.create.l HWIO_PMIC_ARB_OBS4_CHNL53_CONFIG_ADDR A:0xe641a84
y.create.l HWIO_PMIC_ARB_OBS4_CHNL54_CONFIG_ADDR A:0xe641b04
y.create.l HWIO_PMIC_ARB_OBS4_CHNL55_CONFIG_ADDR A:0xe641b84
y.create.l HWIO_PMIC_ARB_OBS4_CHNL56_CONFIG_ADDR A:0xe641c04
y.create.l HWIO_PMIC_ARB_OBS4_CHNL57_CONFIG_ADDR A:0xe641c84
y.create.l HWIO_PMIC_ARB_OBS4_CHNL58_CONFIG_ADDR A:0xe641d04
y.create.l HWIO_PMIC_ARB_OBS4_CHNL59_CONFIG_ADDR A:0xe641d84
y.create.l HWIO_PMIC_ARB_OBS4_CHNL60_CONFIG_ADDR A:0xe641e04
y.create.l HWIO_PMIC_ARB_OBS4_CHNL61_CONFIG_ADDR A:0xe641e84
y.create.l HWIO_PMIC_ARB_OBS4_CHNL62_CONFIG_ADDR A:0xe641f04
y.create.l HWIO_PMIC_ARB_OBS4_CHNL63_CONFIG_ADDR A:0xe641f84
y.create.l HWIO_PMIC_ARB_OBS4_CHNL64_CONFIG_ADDR A:0xe642004
y.create.l HWIO_PMIC_ARB_OBS4_CHNL65_CONFIG_ADDR A:0xe642084
y.create.l HWIO_PMIC_ARB_OBS4_CHNL66_CONFIG_ADDR A:0xe642104
y.create.l HWIO_PMIC_ARB_OBS4_CHNL67_CONFIG_ADDR A:0xe642184
y.create.l HWIO_PMIC_ARB_OBS4_CHNL68_CONFIG_ADDR A:0xe642204
y.create.l HWIO_PMIC_ARB_OBS4_CHNL69_CONFIG_ADDR A:0xe642284
y.create.l HWIO_PMIC_ARB_OBS4_CHNL70_CONFIG_ADDR A:0xe642304
y.create.l HWIO_PMIC_ARB_OBS4_CHNL71_CONFIG_ADDR A:0xe642384
y.create.l HWIO_PMIC_ARB_OBS4_CHNL72_CONFIG_ADDR A:0xe642404
y.create.l HWIO_PMIC_ARB_OBS4_CHNL73_CONFIG_ADDR A:0xe642484
y.create.l HWIO_PMIC_ARB_OBS4_CHNL74_CONFIG_ADDR A:0xe642504
y.create.l HWIO_PMIC_ARB_OBS4_CHNL75_CONFIG_ADDR A:0xe642584
y.create.l HWIO_PMIC_ARB_OBS4_CHNL76_CONFIG_ADDR A:0xe642604
y.create.l HWIO_PMIC_ARB_OBS4_CHNL77_CONFIG_ADDR A:0xe642684
y.create.l HWIO_PMIC_ARB_OBS4_CHNL78_CONFIG_ADDR A:0xe642704
y.create.l HWIO_PMIC_ARB_OBS4_CHNL79_CONFIG_ADDR A:0xe642784
y.create.l HWIO_PMIC_ARB_OBS4_CHNL80_CONFIG_ADDR A:0xe642804
y.create.l HWIO_PMIC_ARB_OBS4_CHNL81_CONFIG_ADDR A:0xe642884
y.create.l HWIO_PMIC_ARB_OBS4_CHNL82_CONFIG_ADDR A:0xe642904
y.create.l HWIO_PMIC_ARB_OBS4_CHNL83_CONFIG_ADDR A:0xe642984
y.create.l HWIO_PMIC_ARB_OBS4_CHNL84_CONFIG_ADDR A:0xe642a04
y.create.l HWIO_PMIC_ARB_OBS4_CHNL85_CONFIG_ADDR A:0xe642a84
y.create.l HWIO_PMIC_ARB_OBS4_CHNL86_CONFIG_ADDR A:0xe642b04
y.create.l HWIO_PMIC_ARB_OBS4_CHNL87_CONFIG_ADDR A:0xe642b84
y.create.l HWIO_PMIC_ARB_OBS4_CHNL88_CONFIG_ADDR A:0xe642c04
y.create.l HWIO_PMIC_ARB_OBS4_CHNL89_CONFIG_ADDR A:0xe642c84
y.create.l HWIO_PMIC_ARB_OBS4_CHNL90_CONFIG_ADDR A:0xe642d04
y.create.l HWIO_PMIC_ARB_OBS4_CHNL91_CONFIG_ADDR A:0xe642d84
y.create.l HWIO_PMIC_ARB_OBS4_CHNL92_CONFIG_ADDR A:0xe642e04
y.create.l HWIO_PMIC_ARB_OBS4_CHNL93_CONFIG_ADDR A:0xe642e84
y.create.l HWIO_PMIC_ARB_OBS4_CHNL94_CONFIG_ADDR A:0xe642f04
y.create.l HWIO_PMIC_ARB_OBS4_CHNL95_CONFIG_ADDR A:0xe642f84
y.create.l HWIO_PMIC_ARB_OBS4_CHNL96_CONFIG_ADDR A:0xe643004
y.create.l HWIO_PMIC_ARB_OBS4_CHNL97_CONFIG_ADDR A:0xe643084
y.create.l HWIO_PMIC_ARB_OBS4_CHNL98_CONFIG_ADDR A:0xe643104
y.create.l HWIO_PMIC_ARB_OBS4_CHNL99_CONFIG_ADDR A:0xe643184
y.create.l HWIO_PMIC_ARB_OBS4_CHNL100_CONFIG_ADDR A:0xe643204
y.create.l HWIO_PMIC_ARB_OBS4_CHNL101_CONFIG_ADDR A:0xe643284
y.create.l HWIO_PMIC_ARB_OBS4_CHNL102_CONFIG_ADDR A:0xe643304
y.create.l HWIO_PMIC_ARB_OBS4_CHNL103_CONFIG_ADDR A:0xe643384
y.create.l HWIO_PMIC_ARB_OBS4_CHNL104_CONFIG_ADDR A:0xe643404
y.create.l HWIO_PMIC_ARB_OBS4_CHNL105_CONFIG_ADDR A:0xe643484
y.create.l HWIO_PMIC_ARB_OBS4_CHNL106_CONFIG_ADDR A:0xe643504
y.create.l HWIO_PMIC_ARB_OBS4_CHNL107_CONFIG_ADDR A:0xe643584
y.create.l HWIO_PMIC_ARB_OBS4_CHNL108_CONFIG_ADDR A:0xe643604
y.create.l HWIO_PMIC_ARB_OBS4_CHNL109_CONFIG_ADDR A:0xe643684
y.create.l HWIO_PMIC_ARB_OBS4_CHNL110_CONFIG_ADDR A:0xe643704
y.create.l HWIO_PMIC_ARB_OBS4_CHNL111_CONFIG_ADDR A:0xe643784
y.create.l HWIO_PMIC_ARB_OBS4_CHNL112_CONFIG_ADDR A:0xe643804
y.create.l HWIO_PMIC_ARB_OBS4_CHNL113_CONFIG_ADDR A:0xe643884
y.create.l HWIO_PMIC_ARB_OBS4_CHNL114_CONFIG_ADDR A:0xe643904
y.create.l HWIO_PMIC_ARB_OBS4_CHNL115_CONFIG_ADDR A:0xe643984
y.create.l HWIO_PMIC_ARB_OBS4_CHNL116_CONFIG_ADDR A:0xe643a04
y.create.l HWIO_PMIC_ARB_OBS4_CHNL117_CONFIG_ADDR A:0xe643a84
y.create.l HWIO_PMIC_ARB_OBS4_CHNL118_CONFIG_ADDR A:0xe643b04
y.create.l HWIO_PMIC_ARB_OBS4_CHNL119_CONFIG_ADDR A:0xe643b84
y.create.l HWIO_PMIC_ARB_OBS4_CHNL120_CONFIG_ADDR A:0xe643c04
y.create.l HWIO_PMIC_ARB_OBS4_CHNL121_CONFIG_ADDR A:0xe643c84
y.create.l HWIO_PMIC_ARB_OBS4_CHNL122_CONFIG_ADDR A:0xe643d04
y.create.l HWIO_PMIC_ARB_OBS4_CHNL123_CONFIG_ADDR A:0xe643d84
y.create.l HWIO_PMIC_ARB_OBS4_CHNL124_CONFIG_ADDR A:0xe643e04
y.create.l HWIO_PMIC_ARB_OBS4_CHNL125_CONFIG_ADDR A:0xe643e84
y.create.l HWIO_PMIC_ARB_OBS4_CHNL126_CONFIG_ADDR A:0xe643f04
y.create.l HWIO_PMIC_ARB_OBS4_CHNL127_CONFIG_ADDR A:0xe643f84
y.create.l HWIO_PMIC_ARB_OBS4_CHNL128_CONFIG_ADDR A:0xe644004
y.create.l HWIO_PMIC_ARB_OBS4_CHNL129_CONFIG_ADDR A:0xe644084
y.create.l HWIO_PMIC_ARB_OBS4_CHNL130_CONFIG_ADDR A:0xe644104
y.create.l HWIO_PMIC_ARB_OBS4_CHNL131_CONFIG_ADDR A:0xe644184
y.create.l HWIO_PMIC_ARB_OBS4_CHNL132_CONFIG_ADDR A:0xe644204
y.create.l HWIO_PMIC_ARB_OBS4_CHNL133_CONFIG_ADDR A:0xe644284
y.create.l HWIO_PMIC_ARB_OBS4_CHNL134_CONFIG_ADDR A:0xe644304
y.create.l HWIO_PMIC_ARB_OBS4_CHNL135_CONFIG_ADDR A:0xe644384
y.create.l HWIO_PMIC_ARB_OBS4_CHNL136_CONFIG_ADDR A:0xe644404
y.create.l HWIO_PMIC_ARB_OBS4_CHNL137_CONFIG_ADDR A:0xe644484
y.create.l HWIO_PMIC_ARB_OBS4_CHNL138_CONFIG_ADDR A:0xe644504
y.create.l HWIO_PMIC_ARB_OBS4_CHNL139_CONFIG_ADDR A:0xe644584
y.create.l HWIO_PMIC_ARB_OBS4_CHNL140_CONFIG_ADDR A:0xe644604
y.create.l HWIO_PMIC_ARB_OBS4_CHNL141_CONFIG_ADDR A:0xe644684
y.create.l HWIO_PMIC_ARB_OBS4_CHNL142_CONFIG_ADDR A:0xe644704
y.create.l HWIO_PMIC_ARB_OBS4_CHNL143_CONFIG_ADDR A:0xe644784
y.create.l HWIO_PMIC_ARB_OBS4_CHNL144_CONFIG_ADDR A:0xe644804
y.create.l HWIO_PMIC_ARB_OBS4_CHNL145_CONFIG_ADDR A:0xe644884
y.create.l HWIO_PMIC_ARB_OBS4_CHNL146_CONFIG_ADDR A:0xe644904
y.create.l HWIO_PMIC_ARB_OBS4_CHNL147_CONFIG_ADDR A:0xe644984
y.create.l HWIO_PMIC_ARB_OBS4_CHNL148_CONFIG_ADDR A:0xe644a04
y.create.l HWIO_PMIC_ARB_OBS4_CHNL149_CONFIG_ADDR A:0xe644a84
y.create.l HWIO_PMIC_ARB_OBS4_CHNL150_CONFIG_ADDR A:0xe644b04
y.create.l HWIO_PMIC_ARB_OBS4_CHNL151_CONFIG_ADDR A:0xe644b84
y.create.l HWIO_PMIC_ARB_OBS4_CHNL152_CONFIG_ADDR A:0xe644c04
y.create.l HWIO_PMIC_ARB_OBS4_CHNL153_CONFIG_ADDR A:0xe644c84
y.create.l HWIO_PMIC_ARB_OBS4_CHNL154_CONFIG_ADDR A:0xe644d04
y.create.l HWIO_PMIC_ARB_OBS4_CHNL155_CONFIG_ADDR A:0xe644d84
y.create.l HWIO_PMIC_ARB_OBS4_CHNL156_CONFIG_ADDR A:0xe644e04
y.create.l HWIO_PMIC_ARB_OBS4_CHNL157_CONFIG_ADDR A:0xe644e84
y.create.l HWIO_PMIC_ARB_OBS4_CHNL158_CONFIG_ADDR A:0xe644f04
y.create.l HWIO_PMIC_ARB_OBS4_CHNL159_CONFIG_ADDR A:0xe644f84
y.create.l HWIO_PMIC_ARB_OBS4_CHNL160_CONFIG_ADDR A:0xe645004
y.create.l HWIO_PMIC_ARB_OBS4_CHNL161_CONFIG_ADDR A:0xe645084
y.create.l HWIO_PMIC_ARB_OBS4_CHNL162_CONFIG_ADDR A:0xe645104
y.create.l HWIO_PMIC_ARB_OBS4_CHNL163_CONFIG_ADDR A:0xe645184
y.create.l HWIO_PMIC_ARB_OBS4_CHNL164_CONFIG_ADDR A:0xe645204
y.create.l HWIO_PMIC_ARB_OBS4_CHNL165_CONFIG_ADDR A:0xe645284
y.create.l HWIO_PMIC_ARB_OBS4_CHNL166_CONFIG_ADDR A:0xe645304
y.create.l HWIO_PMIC_ARB_OBS4_CHNL167_CONFIG_ADDR A:0xe645384
y.create.l HWIO_PMIC_ARB_OBS4_CHNL168_CONFIG_ADDR A:0xe645404
y.create.l HWIO_PMIC_ARB_OBS4_CHNL169_CONFIG_ADDR A:0xe645484
y.create.l HWIO_PMIC_ARB_OBS4_CHNL170_CONFIG_ADDR A:0xe645504
y.create.l HWIO_PMIC_ARB_OBS4_CHNL171_CONFIG_ADDR A:0xe645584
y.create.l HWIO_PMIC_ARB_OBS4_CHNL172_CONFIG_ADDR A:0xe645604
y.create.l HWIO_PMIC_ARB_OBS4_CHNL173_CONFIG_ADDR A:0xe645684
y.create.l HWIO_PMIC_ARB_OBS4_CHNL174_CONFIG_ADDR A:0xe645704
y.create.l HWIO_PMIC_ARB_OBS4_CHNL175_CONFIG_ADDR A:0xe645784
y.create.l HWIO_PMIC_ARB_OBS4_CHNL176_CONFIG_ADDR A:0xe645804
y.create.l HWIO_PMIC_ARB_OBS4_CHNL177_CONFIG_ADDR A:0xe645884
y.create.l HWIO_PMIC_ARB_OBS4_CHNL178_CONFIG_ADDR A:0xe645904
y.create.l HWIO_PMIC_ARB_OBS4_CHNL179_CONFIG_ADDR A:0xe645984
y.create.l HWIO_PMIC_ARB_OBS4_CHNL180_CONFIG_ADDR A:0xe645a04
y.create.l HWIO_PMIC_ARB_OBS4_CHNL181_CONFIG_ADDR A:0xe645a84
y.create.l HWIO_PMIC_ARB_OBS4_CHNL182_CONFIG_ADDR A:0xe645b04
y.create.l HWIO_PMIC_ARB_OBS4_CHNL183_CONFIG_ADDR A:0xe645b84
y.create.l HWIO_PMIC_ARB_OBS4_CHNL184_CONFIG_ADDR A:0xe645c04
y.create.l HWIO_PMIC_ARB_OBS4_CHNL185_CONFIG_ADDR A:0xe645c84
y.create.l HWIO_PMIC_ARB_OBS4_CHNL186_CONFIG_ADDR A:0xe645d04
y.create.l HWIO_PMIC_ARB_OBS4_CHNL187_CONFIG_ADDR A:0xe645d84
y.create.l HWIO_PMIC_ARB_OBS4_CHNL188_CONFIG_ADDR A:0xe645e04
y.create.l HWIO_PMIC_ARB_OBS4_CHNL189_CONFIG_ADDR A:0xe645e84
y.create.l HWIO_PMIC_ARB_OBS4_CHNL190_CONFIG_ADDR A:0xe645f04
y.create.l HWIO_PMIC_ARB_OBS4_CHNL191_CONFIG_ADDR A:0xe645f84
y.create.l HWIO_PMIC_ARB_OBS4_CHNL192_CONFIG_ADDR A:0xe646004
y.create.l HWIO_PMIC_ARB_OBS4_CHNL193_CONFIG_ADDR A:0xe646084
y.create.l HWIO_PMIC_ARB_OBS4_CHNL194_CONFIG_ADDR A:0xe646104
y.create.l HWIO_PMIC_ARB_OBS4_CHNL195_CONFIG_ADDR A:0xe646184
y.create.l HWIO_PMIC_ARB_OBS4_CHNL196_CONFIG_ADDR A:0xe646204
y.create.l HWIO_PMIC_ARB_OBS4_CHNL197_CONFIG_ADDR A:0xe646284
y.create.l HWIO_PMIC_ARB_OBS4_CHNL198_CONFIG_ADDR A:0xe646304
y.create.l HWIO_PMIC_ARB_OBS4_CHNL199_CONFIG_ADDR A:0xe646384
y.create.l HWIO_PMIC_ARB_OBS4_CHNL200_CONFIG_ADDR A:0xe646404
y.create.l HWIO_PMIC_ARB_OBS4_CHNL201_CONFIG_ADDR A:0xe646484
y.create.l HWIO_PMIC_ARB_OBS4_CHNL202_CONFIG_ADDR A:0xe646504
y.create.l HWIO_PMIC_ARB_OBS4_CHNL203_CONFIG_ADDR A:0xe646584
y.create.l HWIO_PMIC_ARB_OBS4_CHNL204_CONFIG_ADDR A:0xe646604
y.create.l HWIO_PMIC_ARB_OBS4_CHNL205_CONFIG_ADDR A:0xe646684
y.create.l HWIO_PMIC_ARB_OBS4_CHNL206_CONFIG_ADDR A:0xe646704
y.create.l HWIO_PMIC_ARB_OBS4_CHNL207_CONFIG_ADDR A:0xe646784
y.create.l HWIO_PMIC_ARB_OBS4_CHNL208_CONFIG_ADDR A:0xe646804
y.create.l HWIO_PMIC_ARB_OBS4_CHNL209_CONFIG_ADDR A:0xe646884
y.create.l HWIO_PMIC_ARB_OBS4_CHNL210_CONFIG_ADDR A:0xe646904
y.create.l HWIO_PMIC_ARB_OBS4_CHNL211_CONFIG_ADDR A:0xe646984
y.create.l HWIO_PMIC_ARB_OBS4_CHNL212_CONFIG_ADDR A:0xe646a04
y.create.l HWIO_PMIC_ARB_OBS4_CHNL213_CONFIG_ADDR A:0xe646a84
y.create.l HWIO_PMIC_ARB_OBS4_CHNL214_CONFIG_ADDR A:0xe646b04
y.create.l HWIO_PMIC_ARB_OBS4_CHNL215_CONFIG_ADDR A:0xe646b84
y.create.l HWIO_PMIC_ARB_OBS4_CHNL216_CONFIG_ADDR A:0xe646c04
y.create.l HWIO_PMIC_ARB_OBS4_CHNL217_CONFIG_ADDR A:0xe646c84
y.create.l HWIO_PMIC_ARB_OBS4_CHNL218_CONFIG_ADDR A:0xe646d04
y.create.l HWIO_PMIC_ARB_OBS4_CHNL219_CONFIG_ADDR A:0xe646d84
y.create.l HWIO_PMIC_ARB_OBS4_CHNL220_CONFIG_ADDR A:0xe646e04
y.create.l HWIO_PMIC_ARB_OBS4_CHNL221_CONFIG_ADDR A:0xe646e84
y.create.l HWIO_PMIC_ARB_OBS4_CHNL222_CONFIG_ADDR A:0xe646f04
y.create.l HWIO_PMIC_ARB_OBS4_CHNL223_CONFIG_ADDR A:0xe646f84
y.create.l HWIO_PMIC_ARB_OBS4_CHNL224_CONFIG_ADDR A:0xe647004
y.create.l HWIO_PMIC_ARB_OBS4_CHNL225_CONFIG_ADDR A:0xe647084
y.create.l HWIO_PMIC_ARB_OBS4_CHNL226_CONFIG_ADDR A:0xe647104
y.create.l HWIO_PMIC_ARB_OBS4_CHNL227_CONFIG_ADDR A:0xe647184
y.create.l HWIO_PMIC_ARB_OBS4_CHNL228_CONFIG_ADDR A:0xe647204
y.create.l HWIO_PMIC_ARB_OBS4_CHNL229_CONFIG_ADDR A:0xe647284
y.create.l HWIO_PMIC_ARB_OBS4_CHNL230_CONFIG_ADDR A:0xe647304
y.create.l HWIO_PMIC_ARB_OBS4_CHNL231_CONFIG_ADDR A:0xe647384
y.create.l HWIO_PMIC_ARB_OBS4_CHNL232_CONFIG_ADDR A:0xe647404
y.create.l HWIO_PMIC_ARB_OBS4_CHNL233_CONFIG_ADDR A:0xe647484
y.create.l HWIO_PMIC_ARB_OBS4_CHNL234_CONFIG_ADDR A:0xe647504
y.create.l HWIO_PMIC_ARB_OBS4_CHNL235_CONFIG_ADDR A:0xe647584
y.create.l HWIO_PMIC_ARB_OBS4_CHNL236_CONFIG_ADDR A:0xe647604
y.create.l HWIO_PMIC_ARB_OBS4_CHNL237_CONFIG_ADDR A:0xe647684
y.create.l HWIO_PMIC_ARB_OBS4_CHNL238_CONFIG_ADDR A:0xe647704
y.create.l HWIO_PMIC_ARB_OBS4_CHNL239_CONFIG_ADDR A:0xe647784
y.create.l HWIO_PMIC_ARB_OBS4_CHNL240_CONFIG_ADDR A:0xe647804
y.create.l HWIO_PMIC_ARB_OBS4_CHNL241_CONFIG_ADDR A:0xe647884
y.create.l HWIO_PMIC_ARB_OBS4_CHNL242_CONFIG_ADDR A:0xe647904
y.create.l HWIO_PMIC_ARB_OBS4_CHNL243_CONFIG_ADDR A:0xe647984
y.create.l HWIO_PMIC_ARB_OBS4_CHNL244_CONFIG_ADDR A:0xe647a04
y.create.l HWIO_PMIC_ARB_OBS4_CHNL245_CONFIG_ADDR A:0xe647a84
y.create.l HWIO_PMIC_ARB_OBS4_CHNL246_CONFIG_ADDR A:0xe647b04
y.create.l HWIO_PMIC_ARB_OBS4_CHNL247_CONFIG_ADDR A:0xe647b84
y.create.l HWIO_PMIC_ARB_OBS4_CHNL248_CONFIG_ADDR A:0xe647c04
y.create.l HWIO_PMIC_ARB_OBS4_CHNL249_CONFIG_ADDR A:0xe647c84
y.create.l HWIO_PMIC_ARB_OBS4_CHNL250_CONFIG_ADDR A:0xe647d04
y.create.l HWIO_PMIC_ARB_OBS4_CHNL251_CONFIG_ADDR A:0xe647d84
y.create.l HWIO_PMIC_ARB_OBS4_CHNL252_CONFIG_ADDR A:0xe647e04
y.create.l HWIO_PMIC_ARB_OBS4_CHNL253_CONFIG_ADDR A:0xe647e84
y.create.l HWIO_PMIC_ARB_OBS4_CHNL254_CONFIG_ADDR A:0xe647f04
y.create.l HWIO_PMIC_ARB_OBS4_CHNL255_CONFIG_ADDR A:0xe647f84
y.create.l HWIO_PMIC_ARB_OBS4_CHNL256_CONFIG_ADDR A:0xe648004
y.create.l HWIO_PMIC_ARB_OBS4_CHNL257_CONFIG_ADDR A:0xe648084
y.create.l HWIO_PMIC_ARB_OBS4_CHNL258_CONFIG_ADDR A:0xe648104
y.create.l HWIO_PMIC_ARB_OBS4_CHNL259_CONFIG_ADDR A:0xe648184
y.create.l HWIO_PMIC_ARB_OBS4_CHNL260_CONFIG_ADDR A:0xe648204
y.create.l HWIO_PMIC_ARB_OBS4_CHNL261_CONFIG_ADDR A:0xe648284
y.create.l HWIO_PMIC_ARB_OBS4_CHNL262_CONFIG_ADDR A:0xe648304
y.create.l HWIO_PMIC_ARB_OBS4_CHNL263_CONFIG_ADDR A:0xe648384
y.create.l HWIO_PMIC_ARB_OBS4_CHNL264_CONFIG_ADDR A:0xe648404
y.create.l HWIO_PMIC_ARB_OBS4_CHNL265_CONFIG_ADDR A:0xe648484
y.create.l HWIO_PMIC_ARB_OBS4_CHNL266_CONFIG_ADDR A:0xe648504
y.create.l HWIO_PMIC_ARB_OBS4_CHNL267_CONFIG_ADDR A:0xe648584
y.create.l HWIO_PMIC_ARB_OBS4_CHNL268_CONFIG_ADDR A:0xe648604
y.create.l HWIO_PMIC_ARB_OBS4_CHNL269_CONFIG_ADDR A:0xe648684
y.create.l HWIO_PMIC_ARB_OBS4_CHNL270_CONFIG_ADDR A:0xe648704
y.create.l HWIO_PMIC_ARB_OBS4_CHNL271_CONFIG_ADDR A:0xe648784
y.create.l HWIO_PMIC_ARB_OBS4_CHNL272_CONFIG_ADDR A:0xe648804
y.create.l HWIO_PMIC_ARB_OBS4_CHNL273_CONFIG_ADDR A:0xe648884
y.create.l HWIO_PMIC_ARB_OBS4_CHNL274_CONFIG_ADDR A:0xe648904
y.create.l HWIO_PMIC_ARB_OBS4_CHNL275_CONFIG_ADDR A:0xe648984
y.create.l HWIO_PMIC_ARB_OBS4_CHNL276_CONFIG_ADDR A:0xe648a04
y.create.l HWIO_PMIC_ARB_OBS4_CHNL277_CONFIG_ADDR A:0xe648a84
y.create.l HWIO_PMIC_ARB_OBS4_CHNL278_CONFIG_ADDR A:0xe648b04
y.create.l HWIO_PMIC_ARB_OBS4_CHNL279_CONFIG_ADDR A:0xe648b84
y.create.l HWIO_PMIC_ARB_OBS4_CHNL280_CONFIG_ADDR A:0xe648c04
y.create.l HWIO_PMIC_ARB_OBS4_CHNL281_CONFIG_ADDR A:0xe648c84
y.create.l HWIO_PMIC_ARB_OBS4_CHNL282_CONFIG_ADDR A:0xe648d04
y.create.l HWIO_PMIC_ARB_OBS4_CHNL283_CONFIG_ADDR A:0xe648d84
y.create.l HWIO_PMIC_ARB_OBS4_CHNL284_CONFIG_ADDR A:0xe648e04
y.create.l HWIO_PMIC_ARB_OBS4_CHNL285_CONFIG_ADDR A:0xe648e84
y.create.l HWIO_PMIC_ARB_OBS4_CHNL286_CONFIG_ADDR A:0xe648f04
y.create.l HWIO_PMIC_ARB_OBS4_CHNL287_CONFIG_ADDR A:0xe648f84
y.create.l HWIO_PMIC_ARB_OBS4_CHNL288_CONFIG_ADDR A:0xe649004
y.create.l HWIO_PMIC_ARB_OBS4_CHNL289_CONFIG_ADDR A:0xe649084
y.create.l HWIO_PMIC_ARB_OBS4_CHNL290_CONFIG_ADDR A:0xe649104
y.create.l HWIO_PMIC_ARB_OBS4_CHNL291_CONFIG_ADDR A:0xe649184
y.create.l HWIO_PMIC_ARB_OBS4_CHNL292_CONFIG_ADDR A:0xe649204
y.create.l HWIO_PMIC_ARB_OBS4_CHNL293_CONFIG_ADDR A:0xe649284
y.create.l HWIO_PMIC_ARB_OBS4_CHNL294_CONFIG_ADDR A:0xe649304
y.create.l HWIO_PMIC_ARB_OBS4_CHNL295_CONFIG_ADDR A:0xe649384
y.create.l HWIO_PMIC_ARB_OBS4_CHNL296_CONFIG_ADDR A:0xe649404
y.create.l HWIO_PMIC_ARB_OBS4_CHNL297_CONFIG_ADDR A:0xe649484
y.create.l HWIO_PMIC_ARB_OBS4_CHNL298_CONFIG_ADDR A:0xe649504
y.create.l HWIO_PMIC_ARB_OBS4_CHNL299_CONFIG_ADDR A:0xe649584
y.create.l HWIO_PMIC_ARB_OBS4_CHNL300_CONFIG_ADDR A:0xe649604
y.create.l HWIO_PMIC_ARB_OBS4_CHNL301_CONFIG_ADDR A:0xe649684
y.create.l HWIO_PMIC_ARB_OBS4_CHNL302_CONFIG_ADDR A:0xe649704
y.create.l HWIO_PMIC_ARB_OBS4_CHNL303_CONFIG_ADDR A:0xe649784
y.create.l HWIO_PMIC_ARB_OBS4_CHNL304_CONFIG_ADDR A:0xe649804
y.create.l HWIO_PMIC_ARB_OBS4_CHNL305_CONFIG_ADDR A:0xe649884
y.create.l HWIO_PMIC_ARB_OBS4_CHNL306_CONFIG_ADDR A:0xe649904
y.create.l HWIO_PMIC_ARB_OBS4_CHNL307_CONFIG_ADDR A:0xe649984
y.create.l HWIO_PMIC_ARB_OBS4_CHNL308_CONFIG_ADDR A:0xe649a04
y.create.l HWIO_PMIC_ARB_OBS4_CHNL309_CONFIG_ADDR A:0xe649a84
y.create.l HWIO_PMIC_ARB_OBS4_CHNL310_CONFIG_ADDR A:0xe649b04
y.create.l HWIO_PMIC_ARB_OBS4_CHNL311_CONFIG_ADDR A:0xe649b84
y.create.l HWIO_PMIC_ARB_OBS4_CHNL312_CONFIG_ADDR A:0xe649c04
y.create.l HWIO_PMIC_ARB_OBS4_CHNL313_CONFIG_ADDR A:0xe649c84
y.create.l HWIO_PMIC_ARB_OBS4_CHNL314_CONFIG_ADDR A:0xe649d04
y.create.l HWIO_PMIC_ARB_OBS4_CHNL315_CONFIG_ADDR A:0xe649d84
y.create.l HWIO_PMIC_ARB_OBS4_CHNL316_CONFIG_ADDR A:0xe649e04
y.create.l HWIO_PMIC_ARB_OBS4_CHNL317_CONFIG_ADDR A:0xe649e84
y.create.l HWIO_PMIC_ARB_OBS4_CHNL318_CONFIG_ADDR A:0xe649f04
y.create.l HWIO_PMIC_ARB_OBS4_CHNL319_CONFIG_ADDR A:0xe649f84
y.create.l HWIO_PMIC_ARB_OBS4_CHNL320_CONFIG_ADDR A:0xe64a004
y.create.l HWIO_PMIC_ARB_OBS4_CHNL321_CONFIG_ADDR A:0xe64a084
y.create.l HWIO_PMIC_ARB_OBS4_CHNL322_CONFIG_ADDR A:0xe64a104
y.create.l HWIO_PMIC_ARB_OBS4_CHNL323_CONFIG_ADDR A:0xe64a184
y.create.l HWIO_PMIC_ARB_OBS4_CHNL324_CONFIG_ADDR A:0xe64a204
y.create.l HWIO_PMIC_ARB_OBS4_CHNL325_CONFIG_ADDR A:0xe64a284
y.create.l HWIO_PMIC_ARB_OBS4_CHNL326_CONFIG_ADDR A:0xe64a304
y.create.l HWIO_PMIC_ARB_OBS4_CHNL327_CONFIG_ADDR A:0xe64a384
y.create.l HWIO_PMIC_ARB_OBS4_CHNL328_CONFIG_ADDR A:0xe64a404
y.create.l HWIO_PMIC_ARB_OBS4_CHNL329_CONFIG_ADDR A:0xe64a484
y.create.l HWIO_PMIC_ARB_OBS4_CHNL330_CONFIG_ADDR A:0xe64a504
y.create.l HWIO_PMIC_ARB_OBS4_CHNL331_CONFIG_ADDR A:0xe64a584
y.create.l HWIO_PMIC_ARB_OBS4_CHNL332_CONFIG_ADDR A:0xe64a604
y.create.l HWIO_PMIC_ARB_OBS4_CHNL333_CONFIG_ADDR A:0xe64a684
y.create.l HWIO_PMIC_ARB_OBS4_CHNL334_CONFIG_ADDR A:0xe64a704
y.create.l HWIO_PMIC_ARB_OBS4_CHNL335_CONFIG_ADDR A:0xe64a784
y.create.l HWIO_PMIC_ARB_OBS4_CHNL336_CONFIG_ADDR A:0xe64a804
y.create.l HWIO_PMIC_ARB_OBS4_CHNL337_CONFIG_ADDR A:0xe64a884
y.create.l HWIO_PMIC_ARB_OBS4_CHNL338_CONFIG_ADDR A:0xe64a904
y.create.l HWIO_PMIC_ARB_OBS4_CHNL339_CONFIG_ADDR A:0xe64a984
y.create.l HWIO_PMIC_ARB_OBS4_CHNL340_CONFIG_ADDR A:0xe64aa04
y.create.l HWIO_PMIC_ARB_OBS4_CHNL341_CONFIG_ADDR A:0xe64aa84
y.create.l HWIO_PMIC_ARB_OBS4_CHNL342_CONFIG_ADDR A:0xe64ab04
y.create.l HWIO_PMIC_ARB_OBS4_CHNL343_CONFIG_ADDR A:0xe64ab84
y.create.l HWIO_PMIC_ARB_OBS4_CHNL344_CONFIG_ADDR A:0xe64ac04
y.create.l HWIO_PMIC_ARB_OBS4_CHNL345_CONFIG_ADDR A:0xe64ac84
y.create.l HWIO_PMIC_ARB_OBS4_CHNL346_CONFIG_ADDR A:0xe64ad04
y.create.l HWIO_PMIC_ARB_OBS4_CHNL347_CONFIG_ADDR A:0xe64ad84
y.create.l HWIO_PMIC_ARB_OBS4_CHNL348_CONFIG_ADDR A:0xe64ae04
y.create.l HWIO_PMIC_ARB_OBS4_CHNL349_CONFIG_ADDR A:0xe64ae84
y.create.l HWIO_PMIC_ARB_OBS4_CHNL350_CONFIG_ADDR A:0xe64af04
y.create.l HWIO_PMIC_ARB_OBS4_CHNL351_CONFIG_ADDR A:0xe64af84
y.create.l HWIO_PMIC_ARB_OBS4_CHNL352_CONFIG_ADDR A:0xe64b004
y.create.l HWIO_PMIC_ARB_OBS4_CHNL353_CONFIG_ADDR A:0xe64b084
y.create.l HWIO_PMIC_ARB_OBS4_CHNL354_CONFIG_ADDR A:0xe64b104
y.create.l HWIO_PMIC_ARB_OBS4_CHNL355_CONFIG_ADDR A:0xe64b184
y.create.l HWIO_PMIC_ARB_OBS4_CHNL356_CONFIG_ADDR A:0xe64b204
y.create.l HWIO_PMIC_ARB_OBS4_CHNL357_CONFIG_ADDR A:0xe64b284
y.create.l HWIO_PMIC_ARB_OBS4_CHNL358_CONFIG_ADDR A:0xe64b304
y.create.l HWIO_PMIC_ARB_OBS4_CHNL359_CONFIG_ADDR A:0xe64b384
y.create.l HWIO_PMIC_ARB_OBS4_CHNL360_CONFIG_ADDR A:0xe64b404
y.create.l HWIO_PMIC_ARB_OBS4_CHNL361_CONFIG_ADDR A:0xe64b484
y.create.l HWIO_PMIC_ARB_OBS4_CHNL362_CONFIG_ADDR A:0xe64b504
y.create.l HWIO_PMIC_ARB_OBS4_CHNL363_CONFIG_ADDR A:0xe64b584
y.create.l HWIO_PMIC_ARB_OBS4_CHNL364_CONFIG_ADDR A:0xe64b604
y.create.l HWIO_PMIC_ARB_OBS4_CHNL365_CONFIG_ADDR A:0xe64b684
y.create.l HWIO_PMIC_ARB_OBS4_CHNL366_CONFIG_ADDR A:0xe64b704
y.create.l HWIO_PMIC_ARB_OBS4_CHNL367_CONFIG_ADDR A:0xe64b784
y.create.l HWIO_PMIC_ARB_OBS4_CHNL368_CONFIG_ADDR A:0xe64b804
y.create.l HWIO_PMIC_ARB_OBS4_CHNL369_CONFIG_ADDR A:0xe64b884
y.create.l HWIO_PMIC_ARB_OBS4_CHNL370_CONFIG_ADDR A:0xe64b904
y.create.l HWIO_PMIC_ARB_OBS4_CHNL371_CONFIG_ADDR A:0xe64b984
y.create.l HWIO_PMIC_ARB_OBS4_CHNL372_CONFIG_ADDR A:0xe64ba04
y.create.l HWIO_PMIC_ARB_OBS4_CHNL373_CONFIG_ADDR A:0xe64ba84
y.create.l HWIO_PMIC_ARB_OBS4_CHNL374_CONFIG_ADDR A:0xe64bb04
y.create.l HWIO_PMIC_ARB_OBS4_CHNL375_CONFIG_ADDR A:0xe64bb84
y.create.l HWIO_PMIC_ARB_OBS4_CHNL376_CONFIG_ADDR A:0xe64bc04
y.create.l HWIO_PMIC_ARB_OBS4_CHNL377_CONFIG_ADDR A:0xe64bc84
y.create.l HWIO_PMIC_ARB_OBS4_CHNL378_CONFIG_ADDR A:0xe64bd04
y.create.l HWIO_PMIC_ARB_OBS4_CHNL379_CONFIG_ADDR A:0xe64bd84
y.create.l HWIO_PMIC_ARB_OBS4_CHNL380_CONFIG_ADDR A:0xe64be04
y.create.l HWIO_PMIC_ARB_OBS4_CHNL381_CONFIG_ADDR A:0xe64be84
y.create.l HWIO_PMIC_ARB_OBS4_CHNL382_CONFIG_ADDR A:0xe64bf04
y.create.l HWIO_PMIC_ARB_OBS4_CHNL383_CONFIG_ADDR A:0xe64bf84
y.create.l HWIO_PMIC_ARB_OBS4_CHNL384_CONFIG_ADDR A:0xe64c004
y.create.l HWIO_PMIC_ARB_OBS4_CHNL385_CONFIG_ADDR A:0xe64c084
y.create.l HWIO_PMIC_ARB_OBS4_CHNL386_CONFIG_ADDR A:0xe64c104
y.create.l HWIO_PMIC_ARB_OBS4_CHNL387_CONFIG_ADDR A:0xe64c184
y.create.l HWIO_PMIC_ARB_OBS4_CHNL388_CONFIG_ADDR A:0xe64c204
y.create.l HWIO_PMIC_ARB_OBS4_CHNL389_CONFIG_ADDR A:0xe64c284
y.create.l HWIO_PMIC_ARB_OBS4_CHNL390_CONFIG_ADDR A:0xe64c304
y.create.l HWIO_PMIC_ARB_OBS4_CHNL391_CONFIG_ADDR A:0xe64c384
y.create.l HWIO_PMIC_ARB_OBS4_CHNL392_CONFIG_ADDR A:0xe64c404
y.create.l HWIO_PMIC_ARB_OBS4_CHNL393_CONFIG_ADDR A:0xe64c484
y.create.l HWIO_PMIC_ARB_OBS4_CHNL394_CONFIG_ADDR A:0xe64c504
y.create.l HWIO_PMIC_ARB_OBS4_CHNL395_CONFIG_ADDR A:0xe64c584
y.create.l HWIO_PMIC_ARB_OBS4_CHNL396_CONFIG_ADDR A:0xe64c604
y.create.l HWIO_PMIC_ARB_OBS4_CHNL397_CONFIG_ADDR A:0xe64c684
y.create.l HWIO_PMIC_ARB_OBS4_CHNL398_CONFIG_ADDR A:0xe64c704
y.create.l HWIO_PMIC_ARB_OBS4_CHNL399_CONFIG_ADDR A:0xe64c784
y.create.l HWIO_PMIC_ARB_OBS4_CHNL400_CONFIG_ADDR A:0xe64c804
y.create.l HWIO_PMIC_ARB_OBS4_CHNL401_CONFIG_ADDR A:0xe64c884
y.create.l HWIO_PMIC_ARB_OBS4_CHNL402_CONFIG_ADDR A:0xe64c904
y.create.l HWIO_PMIC_ARB_OBS4_CHNL403_CONFIG_ADDR A:0xe64c984
y.create.l HWIO_PMIC_ARB_OBS4_CHNL404_CONFIG_ADDR A:0xe64ca04
y.create.l HWIO_PMIC_ARB_OBS4_CHNL405_CONFIG_ADDR A:0xe64ca84
y.create.l HWIO_PMIC_ARB_OBS4_CHNL406_CONFIG_ADDR A:0xe64cb04
y.create.l HWIO_PMIC_ARB_OBS4_CHNL407_CONFIG_ADDR A:0xe64cb84
y.create.l HWIO_PMIC_ARB_OBS4_CHNL408_CONFIG_ADDR A:0xe64cc04
y.create.l HWIO_PMIC_ARB_OBS4_CHNL409_CONFIG_ADDR A:0xe64cc84
y.create.l HWIO_PMIC_ARB_OBS4_CHNL410_CONFIG_ADDR A:0xe64cd04
y.create.l HWIO_PMIC_ARB_OBS4_CHNL411_CONFIG_ADDR A:0xe64cd84
y.create.l HWIO_PMIC_ARB_OBS4_CHNL412_CONFIG_ADDR A:0xe64ce04
y.create.l HWIO_PMIC_ARB_OBS4_CHNL413_CONFIG_ADDR A:0xe64ce84
y.create.l HWIO_PMIC_ARB_OBS4_CHNL414_CONFIG_ADDR A:0xe64cf04
y.create.l HWIO_PMIC_ARB_OBS4_CHNL415_CONFIG_ADDR A:0xe64cf84
y.create.l HWIO_PMIC_ARB_OBS4_CHNL416_CONFIG_ADDR A:0xe64d004
y.create.l HWIO_PMIC_ARB_OBS4_CHNL417_CONFIG_ADDR A:0xe64d084
y.create.l HWIO_PMIC_ARB_OBS4_CHNL418_CONFIG_ADDR A:0xe64d104
y.create.l HWIO_PMIC_ARB_OBS4_CHNL419_CONFIG_ADDR A:0xe64d184
y.create.l HWIO_PMIC_ARB_OBS4_CHNL420_CONFIG_ADDR A:0xe64d204
y.create.l HWIO_PMIC_ARB_OBS4_CHNL421_CONFIG_ADDR A:0xe64d284
y.create.l HWIO_PMIC_ARB_OBS4_CHNL422_CONFIG_ADDR A:0xe64d304
y.create.l HWIO_PMIC_ARB_OBS4_CHNL423_CONFIG_ADDR A:0xe64d384
y.create.l HWIO_PMIC_ARB_OBS4_CHNL424_CONFIG_ADDR A:0xe64d404
y.create.l HWIO_PMIC_ARB_OBS4_CHNL425_CONFIG_ADDR A:0xe64d484
y.create.l HWIO_PMIC_ARB_OBS4_CHNL426_CONFIG_ADDR A:0xe64d504
y.create.l HWIO_PMIC_ARB_OBS4_CHNL427_CONFIG_ADDR A:0xe64d584
y.create.l HWIO_PMIC_ARB_OBS4_CHNL428_CONFIG_ADDR A:0xe64d604
y.create.l HWIO_PMIC_ARB_OBS4_CHNL429_CONFIG_ADDR A:0xe64d684
y.create.l HWIO_PMIC_ARB_OBS4_CHNL430_CONFIG_ADDR A:0xe64d704
y.create.l HWIO_PMIC_ARB_OBS4_CHNL431_CONFIG_ADDR A:0xe64d784
y.create.l HWIO_PMIC_ARB_OBS4_CHNL432_CONFIG_ADDR A:0xe64d804
y.create.l HWIO_PMIC_ARB_OBS4_CHNL433_CONFIG_ADDR A:0xe64d884
y.create.l HWIO_PMIC_ARB_OBS4_CHNL434_CONFIG_ADDR A:0xe64d904
y.create.l HWIO_PMIC_ARB_OBS4_CHNL435_CONFIG_ADDR A:0xe64d984
y.create.l HWIO_PMIC_ARB_OBS4_CHNL436_CONFIG_ADDR A:0xe64da04
y.create.l HWIO_PMIC_ARB_OBS4_CHNL437_CONFIG_ADDR A:0xe64da84
y.create.l HWIO_PMIC_ARB_OBS4_CHNL438_CONFIG_ADDR A:0xe64db04
y.create.l HWIO_PMIC_ARB_OBS4_CHNL439_CONFIG_ADDR A:0xe64db84
y.create.l HWIO_PMIC_ARB_OBS4_CHNL440_CONFIG_ADDR A:0xe64dc04
y.create.l HWIO_PMIC_ARB_OBS4_CHNL441_CONFIG_ADDR A:0xe64dc84
y.create.l HWIO_PMIC_ARB_OBS4_CHNL442_CONFIG_ADDR A:0xe64dd04
y.create.l HWIO_PMIC_ARB_OBS4_CHNL443_CONFIG_ADDR A:0xe64dd84
y.create.l HWIO_PMIC_ARB_OBS4_CHNL444_CONFIG_ADDR A:0xe64de04
y.create.l HWIO_PMIC_ARB_OBS4_CHNL445_CONFIG_ADDR A:0xe64de84
y.create.l HWIO_PMIC_ARB_OBS4_CHNL446_CONFIG_ADDR A:0xe64df04
y.create.l HWIO_PMIC_ARB_OBS4_CHNL447_CONFIG_ADDR A:0xe64df84
y.create.l HWIO_PMIC_ARB_OBS4_CHNL448_CONFIG_ADDR A:0xe64e004
y.create.l HWIO_PMIC_ARB_OBS4_CHNL449_CONFIG_ADDR A:0xe64e084
y.create.l HWIO_PMIC_ARB_OBS4_CHNL450_CONFIG_ADDR A:0xe64e104
y.create.l HWIO_PMIC_ARB_OBS4_CHNL451_CONFIG_ADDR A:0xe64e184
y.create.l HWIO_PMIC_ARB_OBS4_CHNL452_CONFIG_ADDR A:0xe64e204
y.create.l HWIO_PMIC_ARB_OBS4_CHNL453_CONFIG_ADDR A:0xe64e284
y.create.l HWIO_PMIC_ARB_OBS4_CHNL454_CONFIG_ADDR A:0xe64e304
y.create.l HWIO_PMIC_ARB_OBS4_CHNL455_CONFIG_ADDR A:0xe64e384
y.create.l HWIO_PMIC_ARB_OBS4_CHNL456_CONFIG_ADDR A:0xe64e404
y.create.l HWIO_PMIC_ARB_OBS4_CHNL457_CONFIG_ADDR A:0xe64e484
y.create.l HWIO_PMIC_ARB_OBS4_CHNL458_CONFIG_ADDR A:0xe64e504
y.create.l HWIO_PMIC_ARB_OBS4_CHNL459_CONFIG_ADDR A:0xe64e584
y.create.l HWIO_PMIC_ARB_OBS4_CHNL460_CONFIG_ADDR A:0xe64e604
y.create.l HWIO_PMIC_ARB_OBS4_CHNL461_CONFIG_ADDR A:0xe64e684
y.create.l HWIO_PMIC_ARB_OBS4_CHNL462_CONFIG_ADDR A:0xe64e704
y.create.l HWIO_PMIC_ARB_OBS4_CHNL463_CONFIG_ADDR A:0xe64e784
y.create.l HWIO_PMIC_ARB_OBS4_CHNL464_CONFIG_ADDR A:0xe64e804
y.create.l HWIO_PMIC_ARB_OBS4_CHNL465_CONFIG_ADDR A:0xe64e884
y.create.l HWIO_PMIC_ARB_OBS4_CHNL466_CONFIG_ADDR A:0xe64e904
y.create.l HWIO_PMIC_ARB_OBS4_CHNL467_CONFIG_ADDR A:0xe64e984
y.create.l HWIO_PMIC_ARB_OBS4_CHNL468_CONFIG_ADDR A:0xe64ea04
y.create.l HWIO_PMIC_ARB_OBS4_CHNL469_CONFIG_ADDR A:0xe64ea84
y.create.l HWIO_PMIC_ARB_OBS4_CHNL470_CONFIG_ADDR A:0xe64eb04
y.create.l HWIO_PMIC_ARB_OBS4_CHNL471_CONFIG_ADDR A:0xe64eb84
y.create.l HWIO_PMIC_ARB_OBS4_CHNL472_CONFIG_ADDR A:0xe64ec04
y.create.l HWIO_PMIC_ARB_OBS4_CHNL473_CONFIG_ADDR A:0xe64ec84
y.create.l HWIO_PMIC_ARB_OBS4_CHNL474_CONFIG_ADDR A:0xe64ed04
y.create.l HWIO_PMIC_ARB_OBS4_CHNL475_CONFIG_ADDR A:0xe64ed84
y.create.l HWIO_PMIC_ARB_OBS4_CHNL476_CONFIG_ADDR A:0xe64ee04
y.create.l HWIO_PMIC_ARB_OBS4_CHNL477_CONFIG_ADDR A:0xe64ee84
y.create.l HWIO_PMIC_ARB_OBS4_CHNL478_CONFIG_ADDR A:0xe64ef04
y.create.l HWIO_PMIC_ARB_OBS4_CHNL479_CONFIG_ADDR A:0xe64ef84
y.create.l HWIO_PMIC_ARB_OBS4_CHNL480_CONFIG_ADDR A:0xe64f004
y.create.l HWIO_PMIC_ARB_OBS4_CHNL481_CONFIG_ADDR A:0xe64f084
y.create.l HWIO_PMIC_ARB_OBS4_CHNL482_CONFIG_ADDR A:0xe64f104
y.create.l HWIO_PMIC_ARB_OBS4_CHNL483_CONFIG_ADDR A:0xe64f184
y.create.l HWIO_PMIC_ARB_OBS4_CHNL484_CONFIG_ADDR A:0xe64f204
y.create.l HWIO_PMIC_ARB_OBS4_CHNL485_CONFIG_ADDR A:0xe64f284
y.create.l HWIO_PMIC_ARB_OBS4_CHNL486_CONFIG_ADDR A:0xe64f304
y.create.l HWIO_PMIC_ARB_OBS4_CHNL487_CONFIG_ADDR A:0xe64f384
y.create.l HWIO_PMIC_ARB_OBS4_CHNL488_CONFIG_ADDR A:0xe64f404
y.create.l HWIO_PMIC_ARB_OBS4_CHNL489_CONFIG_ADDR A:0xe64f484
y.create.l HWIO_PMIC_ARB_OBS4_CHNL490_CONFIG_ADDR A:0xe64f504
y.create.l HWIO_PMIC_ARB_OBS4_CHNL491_CONFIG_ADDR A:0xe64f584
y.create.l HWIO_PMIC_ARB_OBS4_CHNL492_CONFIG_ADDR A:0xe64f604
y.create.l HWIO_PMIC_ARB_OBS4_CHNL493_CONFIG_ADDR A:0xe64f684
y.create.l HWIO_PMIC_ARB_OBS4_CHNL494_CONFIG_ADDR A:0xe64f704
y.create.l HWIO_PMIC_ARB_OBS4_CHNL495_CONFIG_ADDR A:0xe64f784
y.create.l HWIO_PMIC_ARB_OBS4_CHNL496_CONFIG_ADDR A:0xe64f804
y.create.l HWIO_PMIC_ARB_OBS4_CHNL497_CONFIG_ADDR A:0xe64f884
y.create.l HWIO_PMIC_ARB_OBS4_CHNL498_CONFIG_ADDR A:0xe64f904
y.create.l HWIO_PMIC_ARB_OBS4_CHNL499_CONFIG_ADDR A:0xe64f984
y.create.l HWIO_PMIC_ARB_OBS4_CHNL500_CONFIG_ADDR A:0xe64fa04
y.create.l HWIO_PMIC_ARB_OBS4_CHNL501_CONFIG_ADDR A:0xe64fa84
y.create.l HWIO_PMIC_ARB_OBS4_CHNL502_CONFIG_ADDR A:0xe64fb04
y.create.l HWIO_PMIC_ARB_OBS4_CHNL503_CONFIG_ADDR A:0xe64fb84
y.create.l HWIO_PMIC_ARB_OBS4_CHNL504_CONFIG_ADDR A:0xe64fc04
y.create.l HWIO_PMIC_ARB_OBS4_CHNL505_CONFIG_ADDR A:0xe64fc84
y.create.l HWIO_PMIC_ARB_OBS4_CHNL506_CONFIG_ADDR A:0xe64fd04
y.create.l HWIO_PMIC_ARB_OBS4_CHNL507_CONFIG_ADDR A:0xe64fd84
y.create.l HWIO_PMIC_ARB_OBS4_CHNL508_CONFIG_ADDR A:0xe64fe04
y.create.l HWIO_PMIC_ARB_OBS4_CHNL509_CONFIG_ADDR A:0xe64fe84
y.create.l HWIO_PMIC_ARB_OBS4_CHNL510_CONFIG_ADDR A:0xe64ff04
y.create.l HWIO_PMIC_ARB_OBS4_CHNL511_CONFIG_ADDR A:0xe64ff84
y.create.l HWIO_PMIC_ARB_OBS5_CHNL0_CONFIG_ADDR A:0xe650004
y.create.l HWIO_PMIC_ARB_OBS5_CHNL1_CONFIG_ADDR A:0xe650084
y.create.l HWIO_PMIC_ARB_OBS5_CHNL2_CONFIG_ADDR A:0xe650104
y.create.l HWIO_PMIC_ARB_OBS5_CHNL3_CONFIG_ADDR A:0xe650184
y.create.l HWIO_PMIC_ARB_OBS5_CHNL4_CONFIG_ADDR A:0xe650204
y.create.l HWIO_PMIC_ARB_OBS5_CHNL5_CONFIG_ADDR A:0xe650284
y.create.l HWIO_PMIC_ARB_OBS5_CHNL6_CONFIG_ADDR A:0xe650304
y.create.l HWIO_PMIC_ARB_OBS5_CHNL7_CONFIG_ADDR A:0xe650384
y.create.l HWIO_PMIC_ARB_OBS5_CHNL8_CONFIG_ADDR A:0xe650404
y.create.l HWIO_PMIC_ARB_OBS5_CHNL9_CONFIG_ADDR A:0xe650484
y.create.l HWIO_PMIC_ARB_OBS5_CHNL10_CONFIG_ADDR A:0xe650504
y.create.l HWIO_PMIC_ARB_OBS5_CHNL11_CONFIG_ADDR A:0xe650584
y.create.l HWIO_PMIC_ARB_OBS5_CHNL12_CONFIG_ADDR A:0xe650604
y.create.l HWIO_PMIC_ARB_OBS5_CHNL13_CONFIG_ADDR A:0xe650684
y.create.l HWIO_PMIC_ARB_OBS5_CHNL14_CONFIG_ADDR A:0xe650704
y.create.l HWIO_PMIC_ARB_OBS5_CHNL15_CONFIG_ADDR A:0xe650784
y.create.l HWIO_PMIC_ARB_OBS5_CHNL16_CONFIG_ADDR A:0xe650804
y.create.l HWIO_PMIC_ARB_OBS5_CHNL17_CONFIG_ADDR A:0xe650884
y.create.l HWIO_PMIC_ARB_OBS5_CHNL18_CONFIG_ADDR A:0xe650904
y.create.l HWIO_PMIC_ARB_OBS5_CHNL19_CONFIG_ADDR A:0xe650984
y.create.l HWIO_PMIC_ARB_OBS5_CHNL20_CONFIG_ADDR A:0xe650a04
y.create.l HWIO_PMIC_ARB_OBS5_CHNL21_CONFIG_ADDR A:0xe650a84
y.create.l HWIO_PMIC_ARB_OBS5_CHNL22_CONFIG_ADDR A:0xe650b04
y.create.l HWIO_PMIC_ARB_OBS5_CHNL23_CONFIG_ADDR A:0xe650b84
y.create.l HWIO_PMIC_ARB_OBS5_CHNL24_CONFIG_ADDR A:0xe650c04
y.create.l HWIO_PMIC_ARB_OBS5_CHNL25_CONFIG_ADDR A:0xe650c84
y.create.l HWIO_PMIC_ARB_OBS5_CHNL26_CONFIG_ADDR A:0xe650d04
y.create.l HWIO_PMIC_ARB_OBS5_CHNL27_CONFIG_ADDR A:0xe650d84
y.create.l HWIO_PMIC_ARB_OBS5_CHNL28_CONFIG_ADDR A:0xe650e04
y.create.l HWIO_PMIC_ARB_OBS5_CHNL29_CONFIG_ADDR A:0xe650e84
y.create.l HWIO_PMIC_ARB_OBS5_CHNL30_CONFIG_ADDR A:0xe650f04
y.create.l HWIO_PMIC_ARB_OBS5_CHNL31_CONFIG_ADDR A:0xe650f84
y.create.l HWIO_PMIC_ARB_OBS5_CHNL32_CONFIG_ADDR A:0xe651004
y.create.l HWIO_PMIC_ARB_OBS5_CHNL33_CONFIG_ADDR A:0xe651084
y.create.l HWIO_PMIC_ARB_OBS5_CHNL34_CONFIG_ADDR A:0xe651104
y.create.l HWIO_PMIC_ARB_OBS5_CHNL35_CONFIG_ADDR A:0xe651184
y.create.l HWIO_PMIC_ARB_OBS5_CHNL36_CONFIG_ADDR A:0xe651204
y.create.l HWIO_PMIC_ARB_OBS5_CHNL37_CONFIG_ADDR A:0xe651284
y.create.l HWIO_PMIC_ARB_OBS5_CHNL38_CONFIG_ADDR A:0xe651304
y.create.l HWIO_PMIC_ARB_OBS5_CHNL39_CONFIG_ADDR A:0xe651384
y.create.l HWIO_PMIC_ARB_OBS5_CHNL40_CONFIG_ADDR A:0xe651404
y.create.l HWIO_PMIC_ARB_OBS5_CHNL41_CONFIG_ADDR A:0xe651484
y.create.l HWIO_PMIC_ARB_OBS5_CHNL42_CONFIG_ADDR A:0xe651504
y.create.l HWIO_PMIC_ARB_OBS5_CHNL43_CONFIG_ADDR A:0xe651584
y.create.l HWIO_PMIC_ARB_OBS5_CHNL44_CONFIG_ADDR A:0xe651604
y.create.l HWIO_PMIC_ARB_OBS5_CHNL45_CONFIG_ADDR A:0xe651684
y.create.l HWIO_PMIC_ARB_OBS5_CHNL46_CONFIG_ADDR A:0xe651704
y.create.l HWIO_PMIC_ARB_OBS5_CHNL47_CONFIG_ADDR A:0xe651784
y.create.l HWIO_PMIC_ARB_OBS5_CHNL48_CONFIG_ADDR A:0xe651804
y.create.l HWIO_PMIC_ARB_OBS5_CHNL49_CONFIG_ADDR A:0xe651884
y.create.l HWIO_PMIC_ARB_OBS5_CHNL50_CONFIG_ADDR A:0xe651904
y.create.l HWIO_PMIC_ARB_OBS5_CHNL51_CONFIG_ADDR A:0xe651984
y.create.l HWIO_PMIC_ARB_OBS5_CHNL52_CONFIG_ADDR A:0xe651a04
y.create.l HWIO_PMIC_ARB_OBS5_CHNL53_CONFIG_ADDR A:0xe651a84
y.create.l HWIO_PMIC_ARB_OBS5_CHNL54_CONFIG_ADDR A:0xe651b04
y.create.l HWIO_PMIC_ARB_OBS5_CHNL55_CONFIG_ADDR A:0xe651b84
y.create.l HWIO_PMIC_ARB_OBS5_CHNL56_CONFIG_ADDR A:0xe651c04
y.create.l HWIO_PMIC_ARB_OBS5_CHNL57_CONFIG_ADDR A:0xe651c84
y.create.l HWIO_PMIC_ARB_OBS5_CHNL58_CONFIG_ADDR A:0xe651d04
y.create.l HWIO_PMIC_ARB_OBS5_CHNL59_CONFIG_ADDR A:0xe651d84
y.create.l HWIO_PMIC_ARB_OBS5_CHNL60_CONFIG_ADDR A:0xe651e04
y.create.l HWIO_PMIC_ARB_OBS5_CHNL61_CONFIG_ADDR A:0xe651e84
y.create.l HWIO_PMIC_ARB_OBS5_CHNL62_CONFIG_ADDR A:0xe651f04
y.create.l HWIO_PMIC_ARB_OBS5_CHNL63_CONFIG_ADDR A:0xe651f84
y.create.l HWIO_PMIC_ARB_OBS5_CHNL64_CONFIG_ADDR A:0xe652004
y.create.l HWIO_PMIC_ARB_OBS5_CHNL65_CONFIG_ADDR A:0xe652084
y.create.l HWIO_PMIC_ARB_OBS5_CHNL66_CONFIG_ADDR A:0xe652104
y.create.l HWIO_PMIC_ARB_OBS5_CHNL67_CONFIG_ADDR A:0xe652184
y.create.l HWIO_PMIC_ARB_OBS5_CHNL68_CONFIG_ADDR A:0xe652204
y.create.l HWIO_PMIC_ARB_OBS5_CHNL69_CONFIG_ADDR A:0xe652284
y.create.l HWIO_PMIC_ARB_OBS5_CHNL70_CONFIG_ADDR A:0xe652304
y.create.l HWIO_PMIC_ARB_OBS5_CHNL71_CONFIG_ADDR A:0xe652384
y.create.l HWIO_PMIC_ARB_OBS5_CHNL72_CONFIG_ADDR A:0xe652404
y.create.l HWIO_PMIC_ARB_OBS5_CHNL73_CONFIG_ADDR A:0xe652484
y.create.l HWIO_PMIC_ARB_OBS5_CHNL74_CONFIG_ADDR A:0xe652504
y.create.l HWIO_PMIC_ARB_OBS5_CHNL75_CONFIG_ADDR A:0xe652584
y.create.l HWIO_PMIC_ARB_OBS5_CHNL76_CONFIG_ADDR A:0xe652604
y.create.l HWIO_PMIC_ARB_OBS5_CHNL77_CONFIG_ADDR A:0xe652684
y.create.l HWIO_PMIC_ARB_OBS5_CHNL78_CONFIG_ADDR A:0xe652704
y.create.l HWIO_PMIC_ARB_OBS5_CHNL79_CONFIG_ADDR A:0xe652784
y.create.l HWIO_PMIC_ARB_OBS5_CHNL80_CONFIG_ADDR A:0xe652804
y.create.l HWIO_PMIC_ARB_OBS5_CHNL81_CONFIG_ADDR A:0xe652884
y.create.l HWIO_PMIC_ARB_OBS5_CHNL82_CONFIG_ADDR A:0xe652904
y.create.l HWIO_PMIC_ARB_OBS5_CHNL83_CONFIG_ADDR A:0xe652984
y.create.l HWIO_PMIC_ARB_OBS5_CHNL84_CONFIG_ADDR A:0xe652a04
y.create.l HWIO_PMIC_ARB_OBS5_CHNL85_CONFIG_ADDR A:0xe652a84
y.create.l HWIO_PMIC_ARB_OBS5_CHNL86_CONFIG_ADDR A:0xe652b04
y.create.l HWIO_PMIC_ARB_OBS5_CHNL87_CONFIG_ADDR A:0xe652b84
y.create.l HWIO_PMIC_ARB_OBS5_CHNL88_CONFIG_ADDR A:0xe652c04
y.create.l HWIO_PMIC_ARB_OBS5_CHNL89_CONFIG_ADDR A:0xe652c84
y.create.l HWIO_PMIC_ARB_OBS5_CHNL90_CONFIG_ADDR A:0xe652d04
y.create.l HWIO_PMIC_ARB_OBS5_CHNL91_CONFIG_ADDR A:0xe652d84
y.create.l HWIO_PMIC_ARB_OBS5_CHNL92_CONFIG_ADDR A:0xe652e04
y.create.l HWIO_PMIC_ARB_OBS5_CHNL93_CONFIG_ADDR A:0xe652e84
y.create.l HWIO_PMIC_ARB_OBS5_CHNL94_CONFIG_ADDR A:0xe652f04
y.create.l HWIO_PMIC_ARB_OBS5_CHNL95_CONFIG_ADDR A:0xe652f84
y.create.l HWIO_PMIC_ARB_OBS5_CHNL96_CONFIG_ADDR A:0xe653004
y.create.l HWIO_PMIC_ARB_OBS5_CHNL97_CONFIG_ADDR A:0xe653084
y.create.l HWIO_PMIC_ARB_OBS5_CHNL98_CONFIG_ADDR A:0xe653104
y.create.l HWIO_PMIC_ARB_OBS5_CHNL99_CONFIG_ADDR A:0xe653184
y.create.l HWIO_PMIC_ARB_OBS5_CHNL100_CONFIG_ADDR A:0xe653204
y.create.l HWIO_PMIC_ARB_OBS5_CHNL101_CONFIG_ADDR A:0xe653284
y.create.l HWIO_PMIC_ARB_OBS5_CHNL102_CONFIG_ADDR A:0xe653304
y.create.l HWIO_PMIC_ARB_OBS5_CHNL103_CONFIG_ADDR A:0xe653384
y.create.l HWIO_PMIC_ARB_OBS5_CHNL104_CONFIG_ADDR A:0xe653404
y.create.l HWIO_PMIC_ARB_OBS5_CHNL105_CONFIG_ADDR A:0xe653484
y.create.l HWIO_PMIC_ARB_OBS5_CHNL106_CONFIG_ADDR A:0xe653504
y.create.l HWIO_PMIC_ARB_OBS5_CHNL107_CONFIG_ADDR A:0xe653584
y.create.l HWIO_PMIC_ARB_OBS5_CHNL108_CONFIG_ADDR A:0xe653604
y.create.l HWIO_PMIC_ARB_OBS5_CHNL109_CONFIG_ADDR A:0xe653684
y.create.l HWIO_PMIC_ARB_OBS5_CHNL110_CONFIG_ADDR A:0xe653704
y.create.l HWIO_PMIC_ARB_OBS5_CHNL111_CONFIG_ADDR A:0xe653784
y.create.l HWIO_PMIC_ARB_OBS5_CHNL112_CONFIG_ADDR A:0xe653804
y.create.l HWIO_PMIC_ARB_OBS5_CHNL113_CONFIG_ADDR A:0xe653884
y.create.l HWIO_PMIC_ARB_OBS5_CHNL114_CONFIG_ADDR A:0xe653904
y.create.l HWIO_PMIC_ARB_OBS5_CHNL115_CONFIG_ADDR A:0xe653984
y.create.l HWIO_PMIC_ARB_OBS5_CHNL116_CONFIG_ADDR A:0xe653a04
y.create.l HWIO_PMIC_ARB_OBS5_CHNL117_CONFIG_ADDR A:0xe653a84
y.create.l HWIO_PMIC_ARB_OBS5_CHNL118_CONFIG_ADDR A:0xe653b04
y.create.l HWIO_PMIC_ARB_OBS5_CHNL119_CONFIG_ADDR A:0xe653b84
y.create.l HWIO_PMIC_ARB_OBS5_CHNL120_CONFIG_ADDR A:0xe653c04
y.create.l HWIO_PMIC_ARB_OBS5_CHNL121_CONFIG_ADDR A:0xe653c84
y.create.l HWIO_PMIC_ARB_OBS5_CHNL122_CONFIG_ADDR A:0xe653d04
y.create.l HWIO_PMIC_ARB_OBS5_CHNL123_CONFIG_ADDR A:0xe653d84
y.create.l HWIO_PMIC_ARB_OBS5_CHNL124_CONFIG_ADDR A:0xe653e04
y.create.l HWIO_PMIC_ARB_OBS5_CHNL125_CONFIG_ADDR A:0xe653e84
y.create.l HWIO_PMIC_ARB_OBS5_CHNL126_CONFIG_ADDR A:0xe653f04
y.create.l HWIO_PMIC_ARB_OBS5_CHNL127_CONFIG_ADDR A:0xe653f84
y.create.l HWIO_PMIC_ARB_OBS5_CHNL128_CONFIG_ADDR A:0xe654004
y.create.l HWIO_PMIC_ARB_OBS5_CHNL129_CONFIG_ADDR A:0xe654084
y.create.l HWIO_PMIC_ARB_OBS5_CHNL130_CONFIG_ADDR A:0xe654104
y.create.l HWIO_PMIC_ARB_OBS5_CHNL131_CONFIG_ADDR A:0xe654184
y.create.l HWIO_PMIC_ARB_OBS5_CHNL132_CONFIG_ADDR A:0xe654204
y.create.l HWIO_PMIC_ARB_OBS5_CHNL133_CONFIG_ADDR A:0xe654284
y.create.l HWIO_PMIC_ARB_OBS5_CHNL134_CONFIG_ADDR A:0xe654304
y.create.l HWIO_PMIC_ARB_OBS5_CHNL135_CONFIG_ADDR A:0xe654384
y.create.l HWIO_PMIC_ARB_OBS5_CHNL136_CONFIG_ADDR A:0xe654404
y.create.l HWIO_PMIC_ARB_OBS5_CHNL137_CONFIG_ADDR A:0xe654484
y.create.l HWIO_PMIC_ARB_OBS5_CHNL138_CONFIG_ADDR A:0xe654504
y.create.l HWIO_PMIC_ARB_OBS5_CHNL139_CONFIG_ADDR A:0xe654584
y.create.l HWIO_PMIC_ARB_OBS5_CHNL140_CONFIG_ADDR A:0xe654604
y.create.l HWIO_PMIC_ARB_OBS5_CHNL141_CONFIG_ADDR A:0xe654684
y.create.l HWIO_PMIC_ARB_OBS5_CHNL142_CONFIG_ADDR A:0xe654704
y.create.l HWIO_PMIC_ARB_OBS5_CHNL143_CONFIG_ADDR A:0xe654784
y.create.l HWIO_PMIC_ARB_OBS5_CHNL144_CONFIG_ADDR A:0xe654804
y.create.l HWIO_PMIC_ARB_OBS5_CHNL145_CONFIG_ADDR A:0xe654884
y.create.l HWIO_PMIC_ARB_OBS5_CHNL146_CONFIG_ADDR A:0xe654904
y.create.l HWIO_PMIC_ARB_OBS5_CHNL147_CONFIG_ADDR A:0xe654984
y.create.l HWIO_PMIC_ARB_OBS5_CHNL148_CONFIG_ADDR A:0xe654a04
y.create.l HWIO_PMIC_ARB_OBS5_CHNL149_CONFIG_ADDR A:0xe654a84
y.create.l HWIO_PMIC_ARB_OBS5_CHNL150_CONFIG_ADDR A:0xe654b04
y.create.l HWIO_PMIC_ARB_OBS5_CHNL151_CONFIG_ADDR A:0xe654b84
y.create.l HWIO_PMIC_ARB_OBS5_CHNL152_CONFIG_ADDR A:0xe654c04
y.create.l HWIO_PMIC_ARB_OBS5_CHNL153_CONFIG_ADDR A:0xe654c84
y.create.l HWIO_PMIC_ARB_OBS5_CHNL154_CONFIG_ADDR A:0xe654d04
y.create.l HWIO_PMIC_ARB_OBS5_CHNL155_CONFIG_ADDR A:0xe654d84
y.create.l HWIO_PMIC_ARB_OBS5_CHNL156_CONFIG_ADDR A:0xe654e04
y.create.l HWIO_PMIC_ARB_OBS5_CHNL157_CONFIG_ADDR A:0xe654e84
y.create.l HWIO_PMIC_ARB_OBS5_CHNL158_CONFIG_ADDR A:0xe654f04
y.create.l HWIO_PMIC_ARB_OBS5_CHNL159_CONFIG_ADDR A:0xe654f84
y.create.l HWIO_PMIC_ARB_OBS5_CHNL160_CONFIG_ADDR A:0xe655004
y.create.l HWIO_PMIC_ARB_OBS5_CHNL161_CONFIG_ADDR A:0xe655084
y.create.l HWIO_PMIC_ARB_OBS5_CHNL162_CONFIG_ADDR A:0xe655104
y.create.l HWIO_PMIC_ARB_OBS5_CHNL163_CONFIG_ADDR A:0xe655184
y.create.l HWIO_PMIC_ARB_OBS5_CHNL164_CONFIG_ADDR A:0xe655204
y.create.l HWIO_PMIC_ARB_OBS5_CHNL165_CONFIG_ADDR A:0xe655284
y.create.l HWIO_PMIC_ARB_OBS5_CHNL166_CONFIG_ADDR A:0xe655304
y.create.l HWIO_PMIC_ARB_OBS5_CHNL167_CONFIG_ADDR A:0xe655384
y.create.l HWIO_PMIC_ARB_OBS5_CHNL168_CONFIG_ADDR A:0xe655404
y.create.l HWIO_PMIC_ARB_OBS5_CHNL169_CONFIG_ADDR A:0xe655484
y.create.l HWIO_PMIC_ARB_OBS5_CHNL170_CONFIG_ADDR A:0xe655504
y.create.l HWIO_PMIC_ARB_OBS5_CHNL171_CONFIG_ADDR A:0xe655584
y.create.l HWIO_PMIC_ARB_OBS5_CHNL172_CONFIG_ADDR A:0xe655604
y.create.l HWIO_PMIC_ARB_OBS5_CHNL173_CONFIG_ADDR A:0xe655684
y.create.l HWIO_PMIC_ARB_OBS5_CHNL174_CONFIG_ADDR A:0xe655704
y.create.l HWIO_PMIC_ARB_OBS5_CHNL175_CONFIG_ADDR A:0xe655784
y.create.l HWIO_PMIC_ARB_OBS5_CHNL176_CONFIG_ADDR A:0xe655804
y.create.l HWIO_PMIC_ARB_OBS5_CHNL177_CONFIG_ADDR A:0xe655884
y.create.l HWIO_PMIC_ARB_OBS5_CHNL178_CONFIG_ADDR A:0xe655904
y.create.l HWIO_PMIC_ARB_OBS5_CHNL179_CONFIG_ADDR A:0xe655984
y.create.l HWIO_PMIC_ARB_OBS5_CHNL180_CONFIG_ADDR A:0xe655a04
y.create.l HWIO_PMIC_ARB_OBS5_CHNL181_CONFIG_ADDR A:0xe655a84
y.create.l HWIO_PMIC_ARB_OBS5_CHNL182_CONFIG_ADDR A:0xe655b04
y.create.l HWIO_PMIC_ARB_OBS5_CHNL183_CONFIG_ADDR A:0xe655b84
y.create.l HWIO_PMIC_ARB_OBS5_CHNL184_CONFIG_ADDR A:0xe655c04
y.create.l HWIO_PMIC_ARB_OBS5_CHNL185_CONFIG_ADDR A:0xe655c84
y.create.l HWIO_PMIC_ARB_OBS5_CHNL186_CONFIG_ADDR A:0xe655d04
y.create.l HWIO_PMIC_ARB_OBS5_CHNL187_CONFIG_ADDR A:0xe655d84
y.create.l HWIO_PMIC_ARB_OBS5_CHNL188_CONFIG_ADDR A:0xe655e04
y.create.l HWIO_PMIC_ARB_OBS5_CHNL189_CONFIG_ADDR A:0xe655e84
y.create.l HWIO_PMIC_ARB_OBS5_CHNL190_CONFIG_ADDR A:0xe655f04
y.create.l HWIO_PMIC_ARB_OBS5_CHNL191_CONFIG_ADDR A:0xe655f84
y.create.l HWIO_PMIC_ARB_OBS5_CHNL192_CONFIG_ADDR A:0xe656004
y.create.l HWIO_PMIC_ARB_OBS5_CHNL193_CONFIG_ADDR A:0xe656084
y.create.l HWIO_PMIC_ARB_OBS5_CHNL194_CONFIG_ADDR A:0xe656104
y.create.l HWIO_PMIC_ARB_OBS5_CHNL195_CONFIG_ADDR A:0xe656184
y.create.l HWIO_PMIC_ARB_OBS5_CHNL196_CONFIG_ADDR A:0xe656204
y.create.l HWIO_PMIC_ARB_OBS5_CHNL197_CONFIG_ADDR A:0xe656284
y.create.l HWIO_PMIC_ARB_OBS5_CHNL198_CONFIG_ADDR A:0xe656304
y.create.l HWIO_PMIC_ARB_OBS5_CHNL199_CONFIG_ADDR A:0xe656384
y.create.l HWIO_PMIC_ARB_OBS5_CHNL200_CONFIG_ADDR A:0xe656404
y.create.l HWIO_PMIC_ARB_OBS5_CHNL201_CONFIG_ADDR A:0xe656484
y.create.l HWIO_PMIC_ARB_OBS5_CHNL202_CONFIG_ADDR A:0xe656504
y.create.l HWIO_PMIC_ARB_OBS5_CHNL203_CONFIG_ADDR A:0xe656584
y.create.l HWIO_PMIC_ARB_OBS5_CHNL204_CONFIG_ADDR A:0xe656604
y.create.l HWIO_PMIC_ARB_OBS5_CHNL205_CONFIG_ADDR A:0xe656684
y.create.l HWIO_PMIC_ARB_OBS5_CHNL206_CONFIG_ADDR A:0xe656704
y.create.l HWIO_PMIC_ARB_OBS5_CHNL207_CONFIG_ADDR A:0xe656784
y.create.l HWIO_PMIC_ARB_OBS5_CHNL208_CONFIG_ADDR A:0xe656804
y.create.l HWIO_PMIC_ARB_OBS5_CHNL209_CONFIG_ADDR A:0xe656884
y.create.l HWIO_PMIC_ARB_OBS5_CHNL210_CONFIG_ADDR A:0xe656904
y.create.l HWIO_PMIC_ARB_OBS5_CHNL211_CONFIG_ADDR A:0xe656984
y.create.l HWIO_PMIC_ARB_OBS5_CHNL212_CONFIG_ADDR A:0xe656a04
y.create.l HWIO_PMIC_ARB_OBS5_CHNL213_CONFIG_ADDR A:0xe656a84
y.create.l HWIO_PMIC_ARB_OBS5_CHNL214_CONFIG_ADDR A:0xe656b04
y.create.l HWIO_PMIC_ARB_OBS5_CHNL215_CONFIG_ADDR A:0xe656b84
y.create.l HWIO_PMIC_ARB_OBS5_CHNL216_CONFIG_ADDR A:0xe656c04
y.create.l HWIO_PMIC_ARB_OBS5_CHNL217_CONFIG_ADDR A:0xe656c84
y.create.l HWIO_PMIC_ARB_OBS5_CHNL218_CONFIG_ADDR A:0xe656d04
y.create.l HWIO_PMIC_ARB_OBS5_CHNL219_CONFIG_ADDR A:0xe656d84
y.create.l HWIO_PMIC_ARB_OBS5_CHNL220_CONFIG_ADDR A:0xe656e04
y.create.l HWIO_PMIC_ARB_OBS5_CHNL221_CONFIG_ADDR A:0xe656e84
y.create.l HWIO_PMIC_ARB_OBS5_CHNL222_CONFIG_ADDR A:0xe656f04
y.create.l HWIO_PMIC_ARB_OBS5_CHNL223_CONFIG_ADDR A:0xe656f84
y.create.l HWIO_PMIC_ARB_OBS5_CHNL224_CONFIG_ADDR A:0xe657004
y.create.l HWIO_PMIC_ARB_OBS5_CHNL225_CONFIG_ADDR A:0xe657084
y.create.l HWIO_PMIC_ARB_OBS5_CHNL226_CONFIG_ADDR A:0xe657104
y.create.l HWIO_PMIC_ARB_OBS5_CHNL227_CONFIG_ADDR A:0xe657184
y.create.l HWIO_PMIC_ARB_OBS5_CHNL228_CONFIG_ADDR A:0xe657204
y.create.l HWIO_PMIC_ARB_OBS5_CHNL229_CONFIG_ADDR A:0xe657284
y.create.l HWIO_PMIC_ARB_OBS5_CHNL230_CONFIG_ADDR A:0xe657304
y.create.l HWIO_PMIC_ARB_OBS5_CHNL231_CONFIG_ADDR A:0xe657384
y.create.l HWIO_PMIC_ARB_OBS5_CHNL232_CONFIG_ADDR A:0xe657404
y.create.l HWIO_PMIC_ARB_OBS5_CHNL233_CONFIG_ADDR A:0xe657484
y.create.l HWIO_PMIC_ARB_OBS5_CHNL234_CONFIG_ADDR A:0xe657504
y.create.l HWIO_PMIC_ARB_OBS5_CHNL235_CONFIG_ADDR A:0xe657584
y.create.l HWIO_PMIC_ARB_OBS5_CHNL236_CONFIG_ADDR A:0xe657604
y.create.l HWIO_PMIC_ARB_OBS5_CHNL237_CONFIG_ADDR A:0xe657684
y.create.l HWIO_PMIC_ARB_OBS5_CHNL238_CONFIG_ADDR A:0xe657704
y.create.l HWIO_PMIC_ARB_OBS5_CHNL239_CONFIG_ADDR A:0xe657784
y.create.l HWIO_PMIC_ARB_OBS5_CHNL240_CONFIG_ADDR A:0xe657804
y.create.l HWIO_PMIC_ARB_OBS5_CHNL241_CONFIG_ADDR A:0xe657884
y.create.l HWIO_PMIC_ARB_OBS5_CHNL242_CONFIG_ADDR A:0xe657904
y.create.l HWIO_PMIC_ARB_OBS5_CHNL243_CONFIG_ADDR A:0xe657984
y.create.l HWIO_PMIC_ARB_OBS5_CHNL244_CONFIG_ADDR A:0xe657a04
y.create.l HWIO_PMIC_ARB_OBS5_CHNL245_CONFIG_ADDR A:0xe657a84
y.create.l HWIO_PMIC_ARB_OBS5_CHNL246_CONFIG_ADDR A:0xe657b04
y.create.l HWIO_PMIC_ARB_OBS5_CHNL247_CONFIG_ADDR A:0xe657b84
y.create.l HWIO_PMIC_ARB_OBS5_CHNL248_CONFIG_ADDR A:0xe657c04
y.create.l HWIO_PMIC_ARB_OBS5_CHNL249_CONFIG_ADDR A:0xe657c84
y.create.l HWIO_PMIC_ARB_OBS5_CHNL250_CONFIG_ADDR A:0xe657d04
y.create.l HWIO_PMIC_ARB_OBS5_CHNL251_CONFIG_ADDR A:0xe657d84
y.create.l HWIO_PMIC_ARB_OBS5_CHNL252_CONFIG_ADDR A:0xe657e04
y.create.l HWIO_PMIC_ARB_OBS5_CHNL253_CONFIG_ADDR A:0xe657e84
y.create.l HWIO_PMIC_ARB_OBS5_CHNL254_CONFIG_ADDR A:0xe657f04
y.create.l HWIO_PMIC_ARB_OBS5_CHNL255_CONFIG_ADDR A:0xe657f84
y.create.l HWIO_PMIC_ARB_OBS5_CHNL256_CONFIG_ADDR A:0xe658004
y.create.l HWIO_PMIC_ARB_OBS5_CHNL257_CONFIG_ADDR A:0xe658084
y.create.l HWIO_PMIC_ARB_OBS5_CHNL258_CONFIG_ADDR A:0xe658104
y.create.l HWIO_PMIC_ARB_OBS5_CHNL259_CONFIG_ADDR A:0xe658184
y.create.l HWIO_PMIC_ARB_OBS5_CHNL260_CONFIG_ADDR A:0xe658204
y.create.l HWIO_PMIC_ARB_OBS5_CHNL261_CONFIG_ADDR A:0xe658284
y.create.l HWIO_PMIC_ARB_OBS5_CHNL262_CONFIG_ADDR A:0xe658304
y.create.l HWIO_PMIC_ARB_OBS5_CHNL263_CONFIG_ADDR A:0xe658384
y.create.l HWIO_PMIC_ARB_OBS5_CHNL264_CONFIG_ADDR A:0xe658404
y.create.l HWIO_PMIC_ARB_OBS5_CHNL265_CONFIG_ADDR A:0xe658484
y.create.l HWIO_PMIC_ARB_OBS5_CHNL266_CONFIG_ADDR A:0xe658504
y.create.l HWIO_PMIC_ARB_OBS5_CHNL267_CONFIG_ADDR A:0xe658584
y.create.l HWIO_PMIC_ARB_OBS5_CHNL268_CONFIG_ADDR A:0xe658604
y.create.l HWIO_PMIC_ARB_OBS5_CHNL269_CONFIG_ADDR A:0xe658684
y.create.l HWIO_PMIC_ARB_OBS5_CHNL270_CONFIG_ADDR A:0xe658704
y.create.l HWIO_PMIC_ARB_OBS5_CHNL271_CONFIG_ADDR A:0xe658784
y.create.l HWIO_PMIC_ARB_OBS5_CHNL272_CONFIG_ADDR A:0xe658804
y.create.l HWIO_PMIC_ARB_OBS5_CHNL273_CONFIG_ADDR A:0xe658884
y.create.l HWIO_PMIC_ARB_OBS5_CHNL274_CONFIG_ADDR A:0xe658904
y.create.l HWIO_PMIC_ARB_OBS5_CHNL275_CONFIG_ADDR A:0xe658984
y.create.l HWIO_PMIC_ARB_OBS5_CHNL276_CONFIG_ADDR A:0xe658a04
y.create.l HWIO_PMIC_ARB_OBS5_CHNL277_CONFIG_ADDR A:0xe658a84
y.create.l HWIO_PMIC_ARB_OBS5_CHNL278_CONFIG_ADDR A:0xe658b04
y.create.l HWIO_PMIC_ARB_OBS5_CHNL279_CONFIG_ADDR A:0xe658b84
y.create.l HWIO_PMIC_ARB_OBS5_CHNL280_CONFIG_ADDR A:0xe658c04
y.create.l HWIO_PMIC_ARB_OBS5_CHNL281_CONFIG_ADDR A:0xe658c84
y.create.l HWIO_PMIC_ARB_OBS5_CHNL282_CONFIG_ADDR A:0xe658d04
y.create.l HWIO_PMIC_ARB_OBS5_CHNL283_CONFIG_ADDR A:0xe658d84
y.create.l HWIO_PMIC_ARB_OBS5_CHNL284_CONFIG_ADDR A:0xe658e04
y.create.l HWIO_PMIC_ARB_OBS5_CHNL285_CONFIG_ADDR A:0xe658e84
y.create.l HWIO_PMIC_ARB_OBS5_CHNL286_CONFIG_ADDR A:0xe658f04
y.create.l HWIO_PMIC_ARB_OBS5_CHNL287_CONFIG_ADDR A:0xe658f84
y.create.l HWIO_PMIC_ARB_OBS5_CHNL288_CONFIG_ADDR A:0xe659004
y.create.l HWIO_PMIC_ARB_OBS5_CHNL289_CONFIG_ADDR A:0xe659084
y.create.l HWIO_PMIC_ARB_OBS5_CHNL290_CONFIG_ADDR A:0xe659104
y.create.l HWIO_PMIC_ARB_OBS5_CHNL291_CONFIG_ADDR A:0xe659184
y.create.l HWIO_PMIC_ARB_OBS5_CHNL292_CONFIG_ADDR A:0xe659204
y.create.l HWIO_PMIC_ARB_OBS5_CHNL293_CONFIG_ADDR A:0xe659284
y.create.l HWIO_PMIC_ARB_OBS5_CHNL294_CONFIG_ADDR A:0xe659304
y.create.l HWIO_PMIC_ARB_OBS5_CHNL295_CONFIG_ADDR A:0xe659384
y.create.l HWIO_PMIC_ARB_OBS5_CHNL296_CONFIG_ADDR A:0xe659404
y.create.l HWIO_PMIC_ARB_OBS5_CHNL297_CONFIG_ADDR A:0xe659484
y.create.l HWIO_PMIC_ARB_OBS5_CHNL298_CONFIG_ADDR A:0xe659504
y.create.l HWIO_PMIC_ARB_OBS5_CHNL299_CONFIG_ADDR A:0xe659584
y.create.l HWIO_PMIC_ARB_OBS5_CHNL300_CONFIG_ADDR A:0xe659604
y.create.l HWIO_PMIC_ARB_OBS5_CHNL301_CONFIG_ADDR A:0xe659684
y.create.l HWIO_PMIC_ARB_OBS5_CHNL302_CONFIG_ADDR A:0xe659704
y.create.l HWIO_PMIC_ARB_OBS5_CHNL303_CONFIG_ADDR A:0xe659784
y.create.l HWIO_PMIC_ARB_OBS5_CHNL304_CONFIG_ADDR A:0xe659804
y.create.l HWIO_PMIC_ARB_OBS5_CHNL305_CONFIG_ADDR A:0xe659884
y.create.l HWIO_PMIC_ARB_OBS5_CHNL306_CONFIG_ADDR A:0xe659904
y.create.l HWIO_PMIC_ARB_OBS5_CHNL307_CONFIG_ADDR A:0xe659984
y.create.l HWIO_PMIC_ARB_OBS5_CHNL308_CONFIG_ADDR A:0xe659a04
y.create.l HWIO_PMIC_ARB_OBS5_CHNL309_CONFIG_ADDR A:0xe659a84
y.create.l HWIO_PMIC_ARB_OBS5_CHNL310_CONFIG_ADDR A:0xe659b04
y.create.l HWIO_PMIC_ARB_OBS5_CHNL311_CONFIG_ADDR A:0xe659b84
y.create.l HWIO_PMIC_ARB_OBS5_CHNL312_CONFIG_ADDR A:0xe659c04
y.create.l HWIO_PMIC_ARB_OBS5_CHNL313_CONFIG_ADDR A:0xe659c84
y.create.l HWIO_PMIC_ARB_OBS5_CHNL314_CONFIG_ADDR A:0xe659d04
y.create.l HWIO_PMIC_ARB_OBS5_CHNL315_CONFIG_ADDR A:0xe659d84
y.create.l HWIO_PMIC_ARB_OBS5_CHNL316_CONFIG_ADDR A:0xe659e04
y.create.l HWIO_PMIC_ARB_OBS5_CHNL317_CONFIG_ADDR A:0xe659e84
y.create.l HWIO_PMIC_ARB_OBS5_CHNL318_CONFIG_ADDR A:0xe659f04
y.create.l HWIO_PMIC_ARB_OBS5_CHNL319_CONFIG_ADDR A:0xe659f84
y.create.l HWIO_PMIC_ARB_OBS5_CHNL320_CONFIG_ADDR A:0xe65a004
y.create.l HWIO_PMIC_ARB_OBS5_CHNL321_CONFIG_ADDR A:0xe65a084
y.create.l HWIO_PMIC_ARB_OBS5_CHNL322_CONFIG_ADDR A:0xe65a104
y.create.l HWIO_PMIC_ARB_OBS5_CHNL323_CONFIG_ADDR A:0xe65a184
y.create.l HWIO_PMIC_ARB_OBS5_CHNL324_CONFIG_ADDR A:0xe65a204
y.create.l HWIO_PMIC_ARB_OBS5_CHNL325_CONFIG_ADDR A:0xe65a284
y.create.l HWIO_PMIC_ARB_OBS5_CHNL326_CONFIG_ADDR A:0xe65a304
y.create.l HWIO_PMIC_ARB_OBS5_CHNL327_CONFIG_ADDR A:0xe65a384
y.create.l HWIO_PMIC_ARB_OBS5_CHNL328_CONFIG_ADDR A:0xe65a404
y.create.l HWIO_PMIC_ARB_OBS5_CHNL329_CONFIG_ADDR A:0xe65a484
y.create.l HWIO_PMIC_ARB_OBS5_CHNL330_CONFIG_ADDR A:0xe65a504
y.create.l HWIO_PMIC_ARB_OBS5_CHNL331_CONFIG_ADDR A:0xe65a584
y.create.l HWIO_PMIC_ARB_OBS5_CHNL332_CONFIG_ADDR A:0xe65a604
y.create.l HWIO_PMIC_ARB_OBS5_CHNL333_CONFIG_ADDR A:0xe65a684
y.create.l HWIO_PMIC_ARB_OBS5_CHNL334_CONFIG_ADDR A:0xe65a704
y.create.l HWIO_PMIC_ARB_OBS5_CHNL335_CONFIG_ADDR A:0xe65a784
y.create.l HWIO_PMIC_ARB_OBS5_CHNL336_CONFIG_ADDR A:0xe65a804
y.create.l HWIO_PMIC_ARB_OBS5_CHNL337_CONFIG_ADDR A:0xe65a884
y.create.l HWIO_PMIC_ARB_OBS5_CHNL338_CONFIG_ADDR A:0xe65a904
y.create.l HWIO_PMIC_ARB_OBS5_CHNL339_CONFIG_ADDR A:0xe65a984
y.create.l HWIO_PMIC_ARB_OBS5_CHNL340_CONFIG_ADDR A:0xe65aa04
y.create.l HWIO_PMIC_ARB_OBS5_CHNL341_CONFIG_ADDR A:0xe65aa84
y.create.l HWIO_PMIC_ARB_OBS5_CHNL342_CONFIG_ADDR A:0xe65ab04
y.create.l HWIO_PMIC_ARB_OBS5_CHNL343_CONFIG_ADDR A:0xe65ab84
y.create.l HWIO_PMIC_ARB_OBS5_CHNL344_CONFIG_ADDR A:0xe65ac04
y.create.l HWIO_PMIC_ARB_OBS5_CHNL345_CONFIG_ADDR A:0xe65ac84
y.create.l HWIO_PMIC_ARB_OBS5_CHNL346_CONFIG_ADDR A:0xe65ad04
y.create.l HWIO_PMIC_ARB_OBS5_CHNL347_CONFIG_ADDR A:0xe65ad84
y.create.l HWIO_PMIC_ARB_OBS5_CHNL348_CONFIG_ADDR A:0xe65ae04
y.create.l HWIO_PMIC_ARB_OBS5_CHNL349_CONFIG_ADDR A:0xe65ae84
y.create.l HWIO_PMIC_ARB_OBS5_CHNL350_CONFIG_ADDR A:0xe65af04
y.create.l HWIO_PMIC_ARB_OBS5_CHNL351_CONFIG_ADDR A:0xe65af84
y.create.l HWIO_PMIC_ARB_OBS5_CHNL352_CONFIG_ADDR A:0xe65b004
y.create.l HWIO_PMIC_ARB_OBS5_CHNL353_CONFIG_ADDR A:0xe65b084
y.create.l HWIO_PMIC_ARB_OBS5_CHNL354_CONFIG_ADDR A:0xe65b104
y.create.l HWIO_PMIC_ARB_OBS5_CHNL355_CONFIG_ADDR A:0xe65b184
y.create.l HWIO_PMIC_ARB_OBS5_CHNL356_CONFIG_ADDR A:0xe65b204
y.create.l HWIO_PMIC_ARB_OBS5_CHNL357_CONFIG_ADDR A:0xe65b284
y.create.l HWIO_PMIC_ARB_OBS5_CHNL358_CONFIG_ADDR A:0xe65b304
y.create.l HWIO_PMIC_ARB_OBS5_CHNL359_CONFIG_ADDR A:0xe65b384
y.create.l HWIO_PMIC_ARB_OBS5_CHNL360_CONFIG_ADDR A:0xe65b404
y.create.l HWIO_PMIC_ARB_OBS5_CHNL361_CONFIG_ADDR A:0xe65b484
y.create.l HWIO_PMIC_ARB_OBS5_CHNL362_CONFIG_ADDR A:0xe65b504
y.create.l HWIO_PMIC_ARB_OBS5_CHNL363_CONFIG_ADDR A:0xe65b584
y.create.l HWIO_PMIC_ARB_OBS5_CHNL364_CONFIG_ADDR A:0xe65b604
y.create.l HWIO_PMIC_ARB_OBS5_CHNL365_CONFIG_ADDR A:0xe65b684
y.create.l HWIO_PMIC_ARB_OBS5_CHNL366_CONFIG_ADDR A:0xe65b704
y.create.l HWIO_PMIC_ARB_OBS5_CHNL367_CONFIG_ADDR A:0xe65b784
y.create.l HWIO_PMIC_ARB_OBS5_CHNL368_CONFIG_ADDR A:0xe65b804
y.create.l HWIO_PMIC_ARB_OBS5_CHNL369_CONFIG_ADDR A:0xe65b884
y.create.l HWIO_PMIC_ARB_OBS5_CHNL370_CONFIG_ADDR A:0xe65b904
y.create.l HWIO_PMIC_ARB_OBS5_CHNL371_CONFIG_ADDR A:0xe65b984
y.create.l HWIO_PMIC_ARB_OBS5_CHNL372_CONFIG_ADDR A:0xe65ba04
y.create.l HWIO_PMIC_ARB_OBS5_CHNL373_CONFIG_ADDR A:0xe65ba84
y.create.l HWIO_PMIC_ARB_OBS5_CHNL374_CONFIG_ADDR A:0xe65bb04
y.create.l HWIO_PMIC_ARB_OBS5_CHNL375_CONFIG_ADDR A:0xe65bb84
y.create.l HWIO_PMIC_ARB_OBS5_CHNL376_CONFIG_ADDR A:0xe65bc04
y.create.l HWIO_PMIC_ARB_OBS5_CHNL377_CONFIG_ADDR A:0xe65bc84
y.create.l HWIO_PMIC_ARB_OBS5_CHNL378_CONFIG_ADDR A:0xe65bd04
y.create.l HWIO_PMIC_ARB_OBS5_CHNL379_CONFIG_ADDR A:0xe65bd84
y.create.l HWIO_PMIC_ARB_OBS5_CHNL380_CONFIG_ADDR A:0xe65be04
y.create.l HWIO_PMIC_ARB_OBS5_CHNL381_CONFIG_ADDR A:0xe65be84
y.create.l HWIO_PMIC_ARB_OBS5_CHNL382_CONFIG_ADDR A:0xe65bf04
y.create.l HWIO_PMIC_ARB_OBS5_CHNL383_CONFIG_ADDR A:0xe65bf84
y.create.l HWIO_PMIC_ARB_OBS5_CHNL384_CONFIG_ADDR A:0xe65c004
y.create.l HWIO_PMIC_ARB_OBS5_CHNL385_CONFIG_ADDR A:0xe65c084
y.create.l HWIO_PMIC_ARB_OBS5_CHNL386_CONFIG_ADDR A:0xe65c104
y.create.l HWIO_PMIC_ARB_OBS5_CHNL387_CONFIG_ADDR A:0xe65c184
y.create.l HWIO_PMIC_ARB_OBS5_CHNL388_CONFIG_ADDR A:0xe65c204
y.create.l HWIO_PMIC_ARB_OBS5_CHNL389_CONFIG_ADDR A:0xe65c284
y.create.l HWIO_PMIC_ARB_OBS5_CHNL390_CONFIG_ADDR A:0xe65c304
y.create.l HWIO_PMIC_ARB_OBS5_CHNL391_CONFIG_ADDR A:0xe65c384
y.create.l HWIO_PMIC_ARB_OBS5_CHNL392_CONFIG_ADDR A:0xe65c404
y.create.l HWIO_PMIC_ARB_OBS5_CHNL393_CONFIG_ADDR A:0xe65c484
y.create.l HWIO_PMIC_ARB_OBS5_CHNL394_CONFIG_ADDR A:0xe65c504
y.create.l HWIO_PMIC_ARB_OBS5_CHNL395_CONFIG_ADDR A:0xe65c584
y.create.l HWIO_PMIC_ARB_OBS5_CHNL396_CONFIG_ADDR A:0xe65c604
y.create.l HWIO_PMIC_ARB_OBS5_CHNL397_CONFIG_ADDR A:0xe65c684
y.create.l HWIO_PMIC_ARB_OBS5_CHNL398_CONFIG_ADDR A:0xe65c704
y.create.l HWIO_PMIC_ARB_OBS5_CHNL399_CONFIG_ADDR A:0xe65c784
y.create.l HWIO_PMIC_ARB_OBS5_CHNL400_CONFIG_ADDR A:0xe65c804
y.create.l HWIO_PMIC_ARB_OBS5_CHNL401_CONFIG_ADDR A:0xe65c884
y.create.l HWIO_PMIC_ARB_OBS5_CHNL402_CONFIG_ADDR A:0xe65c904
y.create.l HWIO_PMIC_ARB_OBS5_CHNL403_CONFIG_ADDR A:0xe65c984
y.create.l HWIO_PMIC_ARB_OBS5_CHNL404_CONFIG_ADDR A:0xe65ca04
y.create.l HWIO_PMIC_ARB_OBS5_CHNL405_CONFIG_ADDR A:0xe65ca84
y.create.l HWIO_PMIC_ARB_OBS5_CHNL406_CONFIG_ADDR A:0xe65cb04
y.create.l HWIO_PMIC_ARB_OBS5_CHNL407_CONFIG_ADDR A:0xe65cb84
y.create.l HWIO_PMIC_ARB_OBS5_CHNL408_CONFIG_ADDR A:0xe65cc04
y.create.l HWIO_PMIC_ARB_OBS5_CHNL409_CONFIG_ADDR A:0xe65cc84
y.create.l HWIO_PMIC_ARB_OBS5_CHNL410_CONFIG_ADDR A:0xe65cd04
y.create.l HWIO_PMIC_ARB_OBS5_CHNL411_CONFIG_ADDR A:0xe65cd84
y.create.l HWIO_PMIC_ARB_OBS5_CHNL412_CONFIG_ADDR A:0xe65ce04
y.create.l HWIO_PMIC_ARB_OBS5_CHNL413_CONFIG_ADDR A:0xe65ce84
y.create.l HWIO_PMIC_ARB_OBS5_CHNL414_CONFIG_ADDR A:0xe65cf04
y.create.l HWIO_PMIC_ARB_OBS5_CHNL415_CONFIG_ADDR A:0xe65cf84
y.create.l HWIO_PMIC_ARB_OBS5_CHNL416_CONFIG_ADDR A:0xe65d004
y.create.l HWIO_PMIC_ARB_OBS5_CHNL417_CONFIG_ADDR A:0xe65d084
y.create.l HWIO_PMIC_ARB_OBS5_CHNL418_CONFIG_ADDR A:0xe65d104
y.create.l HWIO_PMIC_ARB_OBS5_CHNL419_CONFIG_ADDR A:0xe65d184
y.create.l HWIO_PMIC_ARB_OBS5_CHNL420_CONFIG_ADDR A:0xe65d204
y.create.l HWIO_PMIC_ARB_OBS5_CHNL421_CONFIG_ADDR A:0xe65d284
y.create.l HWIO_PMIC_ARB_OBS5_CHNL422_CONFIG_ADDR A:0xe65d304
y.create.l HWIO_PMIC_ARB_OBS5_CHNL423_CONFIG_ADDR A:0xe65d384
y.create.l HWIO_PMIC_ARB_OBS5_CHNL424_CONFIG_ADDR A:0xe65d404
y.create.l HWIO_PMIC_ARB_OBS5_CHNL425_CONFIG_ADDR A:0xe65d484
y.create.l HWIO_PMIC_ARB_OBS5_CHNL426_CONFIG_ADDR A:0xe65d504
y.create.l HWIO_PMIC_ARB_OBS5_CHNL427_CONFIG_ADDR A:0xe65d584
y.create.l HWIO_PMIC_ARB_OBS5_CHNL428_CONFIG_ADDR A:0xe65d604
y.create.l HWIO_PMIC_ARB_OBS5_CHNL429_CONFIG_ADDR A:0xe65d684
y.create.l HWIO_PMIC_ARB_OBS5_CHNL430_CONFIG_ADDR A:0xe65d704
y.create.l HWIO_PMIC_ARB_OBS5_CHNL431_CONFIG_ADDR A:0xe65d784
y.create.l HWIO_PMIC_ARB_OBS5_CHNL432_CONFIG_ADDR A:0xe65d804
y.create.l HWIO_PMIC_ARB_OBS5_CHNL433_CONFIG_ADDR A:0xe65d884
y.create.l HWIO_PMIC_ARB_OBS5_CHNL434_CONFIG_ADDR A:0xe65d904
y.create.l HWIO_PMIC_ARB_OBS5_CHNL435_CONFIG_ADDR A:0xe65d984
y.create.l HWIO_PMIC_ARB_OBS5_CHNL436_CONFIG_ADDR A:0xe65da04
y.create.l HWIO_PMIC_ARB_OBS5_CHNL437_CONFIG_ADDR A:0xe65da84
y.create.l HWIO_PMIC_ARB_OBS5_CHNL438_CONFIG_ADDR A:0xe65db04
y.create.l HWIO_PMIC_ARB_OBS5_CHNL439_CONFIG_ADDR A:0xe65db84
y.create.l HWIO_PMIC_ARB_OBS5_CHNL440_CONFIG_ADDR A:0xe65dc04
y.create.l HWIO_PMIC_ARB_OBS5_CHNL441_CONFIG_ADDR A:0xe65dc84
y.create.l HWIO_PMIC_ARB_OBS5_CHNL442_CONFIG_ADDR A:0xe65dd04
y.create.l HWIO_PMIC_ARB_OBS5_CHNL443_CONFIG_ADDR A:0xe65dd84
y.create.l HWIO_PMIC_ARB_OBS5_CHNL444_CONFIG_ADDR A:0xe65de04
y.create.l HWIO_PMIC_ARB_OBS5_CHNL445_CONFIG_ADDR A:0xe65de84
y.create.l HWIO_PMIC_ARB_OBS5_CHNL446_CONFIG_ADDR A:0xe65df04
y.create.l HWIO_PMIC_ARB_OBS5_CHNL447_CONFIG_ADDR A:0xe65df84
y.create.l HWIO_PMIC_ARB_OBS5_CHNL448_CONFIG_ADDR A:0xe65e004
y.create.l HWIO_PMIC_ARB_OBS5_CHNL449_CONFIG_ADDR A:0xe65e084
y.create.l HWIO_PMIC_ARB_OBS5_CHNL450_CONFIG_ADDR A:0xe65e104
y.create.l HWIO_PMIC_ARB_OBS5_CHNL451_CONFIG_ADDR A:0xe65e184
y.create.l HWIO_PMIC_ARB_OBS5_CHNL452_CONFIG_ADDR A:0xe65e204
y.create.l HWIO_PMIC_ARB_OBS5_CHNL453_CONFIG_ADDR A:0xe65e284
y.create.l HWIO_PMIC_ARB_OBS5_CHNL454_CONFIG_ADDR A:0xe65e304
y.create.l HWIO_PMIC_ARB_OBS5_CHNL455_CONFIG_ADDR A:0xe65e384
y.create.l HWIO_PMIC_ARB_OBS5_CHNL456_CONFIG_ADDR A:0xe65e404
y.create.l HWIO_PMIC_ARB_OBS5_CHNL457_CONFIG_ADDR A:0xe65e484
y.create.l HWIO_PMIC_ARB_OBS5_CHNL458_CONFIG_ADDR A:0xe65e504
y.create.l HWIO_PMIC_ARB_OBS5_CHNL459_CONFIG_ADDR A:0xe65e584
y.create.l HWIO_PMIC_ARB_OBS5_CHNL460_CONFIG_ADDR A:0xe65e604
y.create.l HWIO_PMIC_ARB_OBS5_CHNL461_CONFIG_ADDR A:0xe65e684
y.create.l HWIO_PMIC_ARB_OBS5_CHNL462_CONFIG_ADDR A:0xe65e704
y.create.l HWIO_PMIC_ARB_OBS5_CHNL463_CONFIG_ADDR A:0xe65e784
y.create.l HWIO_PMIC_ARB_OBS5_CHNL464_CONFIG_ADDR A:0xe65e804
y.create.l HWIO_PMIC_ARB_OBS5_CHNL465_CONFIG_ADDR A:0xe65e884
y.create.l HWIO_PMIC_ARB_OBS5_CHNL466_CONFIG_ADDR A:0xe65e904
y.create.l HWIO_PMIC_ARB_OBS5_CHNL467_CONFIG_ADDR A:0xe65e984
y.create.l HWIO_PMIC_ARB_OBS5_CHNL468_CONFIG_ADDR A:0xe65ea04
y.create.l HWIO_PMIC_ARB_OBS5_CHNL469_CONFIG_ADDR A:0xe65ea84
y.create.l HWIO_PMIC_ARB_OBS5_CHNL470_CONFIG_ADDR A:0xe65eb04
y.create.l HWIO_PMIC_ARB_OBS5_CHNL471_CONFIG_ADDR A:0xe65eb84
y.create.l HWIO_PMIC_ARB_OBS5_CHNL472_CONFIG_ADDR A:0xe65ec04
y.create.l HWIO_PMIC_ARB_OBS5_CHNL473_CONFIG_ADDR A:0xe65ec84
y.create.l HWIO_PMIC_ARB_OBS5_CHNL474_CONFIG_ADDR A:0xe65ed04
y.create.l HWIO_PMIC_ARB_OBS5_CHNL475_CONFIG_ADDR A:0xe65ed84
y.create.l HWIO_PMIC_ARB_OBS5_CHNL476_CONFIG_ADDR A:0xe65ee04
y.create.l HWIO_PMIC_ARB_OBS5_CHNL477_CONFIG_ADDR A:0xe65ee84
y.create.l HWIO_PMIC_ARB_OBS5_CHNL478_CONFIG_ADDR A:0xe65ef04
y.create.l HWIO_PMIC_ARB_OBS5_CHNL479_CONFIG_ADDR A:0xe65ef84
y.create.l HWIO_PMIC_ARB_OBS5_CHNL480_CONFIG_ADDR A:0xe65f004
y.create.l HWIO_PMIC_ARB_OBS5_CHNL481_CONFIG_ADDR A:0xe65f084
y.create.l HWIO_PMIC_ARB_OBS5_CHNL482_CONFIG_ADDR A:0xe65f104
y.create.l HWIO_PMIC_ARB_OBS5_CHNL483_CONFIG_ADDR A:0xe65f184
y.create.l HWIO_PMIC_ARB_OBS5_CHNL484_CONFIG_ADDR A:0xe65f204
y.create.l HWIO_PMIC_ARB_OBS5_CHNL485_CONFIG_ADDR A:0xe65f284
y.create.l HWIO_PMIC_ARB_OBS5_CHNL486_CONFIG_ADDR A:0xe65f304
y.create.l HWIO_PMIC_ARB_OBS5_CHNL487_CONFIG_ADDR A:0xe65f384
y.create.l HWIO_PMIC_ARB_OBS5_CHNL488_CONFIG_ADDR A:0xe65f404
y.create.l HWIO_PMIC_ARB_OBS5_CHNL489_CONFIG_ADDR A:0xe65f484
y.create.l HWIO_PMIC_ARB_OBS5_CHNL490_CONFIG_ADDR A:0xe65f504
y.create.l HWIO_PMIC_ARB_OBS5_CHNL491_CONFIG_ADDR A:0xe65f584
y.create.l HWIO_PMIC_ARB_OBS5_CHNL492_CONFIG_ADDR A:0xe65f604
y.create.l HWIO_PMIC_ARB_OBS5_CHNL493_CONFIG_ADDR A:0xe65f684
y.create.l HWIO_PMIC_ARB_OBS5_CHNL494_CONFIG_ADDR A:0xe65f704
y.create.l HWIO_PMIC_ARB_OBS5_CHNL495_CONFIG_ADDR A:0xe65f784
y.create.l HWIO_PMIC_ARB_OBS5_CHNL496_CONFIG_ADDR A:0xe65f804
y.create.l HWIO_PMIC_ARB_OBS5_CHNL497_CONFIG_ADDR A:0xe65f884
y.create.l HWIO_PMIC_ARB_OBS5_CHNL498_CONFIG_ADDR A:0xe65f904
y.create.l HWIO_PMIC_ARB_OBS5_CHNL499_CONFIG_ADDR A:0xe65f984
y.create.l HWIO_PMIC_ARB_OBS5_CHNL500_CONFIG_ADDR A:0xe65fa04
y.create.l HWIO_PMIC_ARB_OBS5_CHNL501_CONFIG_ADDR A:0xe65fa84
y.create.l HWIO_PMIC_ARB_OBS5_CHNL502_CONFIG_ADDR A:0xe65fb04
y.create.l HWIO_PMIC_ARB_OBS5_CHNL503_CONFIG_ADDR A:0xe65fb84
y.create.l HWIO_PMIC_ARB_OBS5_CHNL504_CONFIG_ADDR A:0xe65fc04
y.create.l HWIO_PMIC_ARB_OBS5_CHNL505_CONFIG_ADDR A:0xe65fc84
y.create.l HWIO_PMIC_ARB_OBS5_CHNL506_CONFIG_ADDR A:0xe65fd04
y.create.l HWIO_PMIC_ARB_OBS5_CHNL507_CONFIG_ADDR A:0xe65fd84
y.create.l HWIO_PMIC_ARB_OBS5_CHNL508_CONFIG_ADDR A:0xe65fe04
y.create.l HWIO_PMIC_ARB_OBS5_CHNL509_CONFIG_ADDR A:0xe65fe84
y.create.l HWIO_PMIC_ARB_OBS5_CHNL510_CONFIG_ADDR A:0xe65ff04
y.create.l HWIO_PMIC_ARB_OBS5_CHNL511_CONFIG_ADDR A:0xe65ff84
y.create.l HWIO_PMIC_ARB_OBS6_CHNL0_CONFIG_ADDR A:0xe660004
y.create.l HWIO_PMIC_ARB_OBS6_CHNL1_CONFIG_ADDR A:0xe660084
y.create.l HWIO_PMIC_ARB_OBS6_CHNL2_CONFIG_ADDR A:0xe660104
y.create.l HWIO_PMIC_ARB_OBS6_CHNL3_CONFIG_ADDR A:0xe660184
y.create.l HWIO_PMIC_ARB_OBS6_CHNL4_CONFIG_ADDR A:0xe660204
y.create.l HWIO_PMIC_ARB_OBS6_CHNL5_CONFIG_ADDR A:0xe660284
y.create.l HWIO_PMIC_ARB_OBS6_CHNL6_CONFIG_ADDR A:0xe660304
y.create.l HWIO_PMIC_ARB_OBS6_CHNL7_CONFIG_ADDR A:0xe660384
y.create.l HWIO_PMIC_ARB_OBS6_CHNL8_CONFIG_ADDR A:0xe660404
y.create.l HWIO_PMIC_ARB_OBS6_CHNL9_CONFIG_ADDR A:0xe660484
y.create.l HWIO_PMIC_ARB_OBS6_CHNL10_CONFIG_ADDR A:0xe660504
y.create.l HWIO_PMIC_ARB_OBS6_CHNL11_CONFIG_ADDR A:0xe660584
y.create.l HWIO_PMIC_ARB_OBS6_CHNL12_CONFIG_ADDR A:0xe660604
y.create.l HWIO_PMIC_ARB_OBS6_CHNL13_CONFIG_ADDR A:0xe660684
y.create.l HWIO_PMIC_ARB_OBS6_CHNL14_CONFIG_ADDR A:0xe660704
y.create.l HWIO_PMIC_ARB_OBS6_CHNL15_CONFIG_ADDR A:0xe660784
y.create.l HWIO_PMIC_ARB_OBS6_CHNL16_CONFIG_ADDR A:0xe660804
y.create.l HWIO_PMIC_ARB_OBS6_CHNL17_CONFIG_ADDR A:0xe660884
y.create.l HWIO_PMIC_ARB_OBS6_CHNL18_CONFIG_ADDR A:0xe660904
y.create.l HWIO_PMIC_ARB_OBS6_CHNL19_CONFIG_ADDR A:0xe660984
y.create.l HWIO_PMIC_ARB_OBS6_CHNL20_CONFIG_ADDR A:0xe660a04
y.create.l HWIO_PMIC_ARB_OBS6_CHNL21_CONFIG_ADDR A:0xe660a84
y.create.l HWIO_PMIC_ARB_OBS6_CHNL22_CONFIG_ADDR A:0xe660b04
y.create.l HWIO_PMIC_ARB_OBS6_CHNL23_CONFIG_ADDR A:0xe660b84
y.create.l HWIO_PMIC_ARB_OBS6_CHNL24_CONFIG_ADDR A:0xe660c04
y.create.l HWIO_PMIC_ARB_OBS6_CHNL25_CONFIG_ADDR A:0xe660c84
y.create.l HWIO_PMIC_ARB_OBS6_CHNL26_CONFIG_ADDR A:0xe660d04
y.create.l HWIO_PMIC_ARB_OBS6_CHNL27_CONFIG_ADDR A:0xe660d84
y.create.l HWIO_PMIC_ARB_OBS6_CHNL28_CONFIG_ADDR A:0xe660e04
y.create.l HWIO_PMIC_ARB_OBS6_CHNL29_CONFIG_ADDR A:0xe660e84
y.create.l HWIO_PMIC_ARB_OBS6_CHNL30_CONFIG_ADDR A:0xe660f04
y.create.l HWIO_PMIC_ARB_OBS6_CHNL31_CONFIG_ADDR A:0xe660f84
y.create.l HWIO_PMIC_ARB_OBS6_CHNL32_CONFIG_ADDR A:0xe661004
y.create.l HWIO_PMIC_ARB_OBS6_CHNL33_CONFIG_ADDR A:0xe661084
y.create.l HWIO_PMIC_ARB_OBS6_CHNL34_CONFIG_ADDR A:0xe661104
y.create.l HWIO_PMIC_ARB_OBS6_CHNL35_CONFIG_ADDR A:0xe661184
y.create.l HWIO_PMIC_ARB_OBS6_CHNL36_CONFIG_ADDR A:0xe661204
y.create.l HWIO_PMIC_ARB_OBS6_CHNL37_CONFIG_ADDR A:0xe661284
y.create.l HWIO_PMIC_ARB_OBS6_CHNL38_CONFIG_ADDR A:0xe661304
y.create.l HWIO_PMIC_ARB_OBS6_CHNL39_CONFIG_ADDR A:0xe661384
y.create.l HWIO_PMIC_ARB_OBS6_CHNL40_CONFIG_ADDR A:0xe661404
y.create.l HWIO_PMIC_ARB_OBS6_CHNL41_CONFIG_ADDR A:0xe661484
y.create.l HWIO_PMIC_ARB_OBS6_CHNL42_CONFIG_ADDR A:0xe661504
y.create.l HWIO_PMIC_ARB_OBS6_CHNL43_CONFIG_ADDR A:0xe661584
y.create.l HWIO_PMIC_ARB_OBS6_CHNL44_CONFIG_ADDR A:0xe661604
y.create.l HWIO_PMIC_ARB_OBS6_CHNL45_CONFIG_ADDR A:0xe661684
y.create.l HWIO_PMIC_ARB_OBS6_CHNL46_CONFIG_ADDR A:0xe661704
y.create.l HWIO_PMIC_ARB_OBS6_CHNL47_CONFIG_ADDR A:0xe661784
y.create.l HWIO_PMIC_ARB_OBS6_CHNL48_CONFIG_ADDR A:0xe661804
y.create.l HWIO_PMIC_ARB_OBS6_CHNL49_CONFIG_ADDR A:0xe661884
y.create.l HWIO_PMIC_ARB_OBS6_CHNL50_CONFIG_ADDR A:0xe661904
y.create.l HWIO_PMIC_ARB_OBS6_CHNL51_CONFIG_ADDR A:0xe661984
y.create.l HWIO_PMIC_ARB_OBS6_CHNL52_CONFIG_ADDR A:0xe661a04
y.create.l HWIO_PMIC_ARB_OBS6_CHNL53_CONFIG_ADDR A:0xe661a84
y.create.l HWIO_PMIC_ARB_OBS6_CHNL54_CONFIG_ADDR A:0xe661b04
y.create.l HWIO_PMIC_ARB_OBS6_CHNL55_CONFIG_ADDR A:0xe661b84
y.create.l HWIO_PMIC_ARB_OBS6_CHNL56_CONFIG_ADDR A:0xe661c04
y.create.l HWIO_PMIC_ARB_OBS6_CHNL57_CONFIG_ADDR A:0xe661c84
y.create.l HWIO_PMIC_ARB_OBS6_CHNL58_CONFIG_ADDR A:0xe661d04
y.create.l HWIO_PMIC_ARB_OBS6_CHNL59_CONFIG_ADDR A:0xe661d84
y.create.l HWIO_PMIC_ARB_OBS6_CHNL60_CONFIG_ADDR A:0xe661e04
y.create.l HWIO_PMIC_ARB_OBS6_CHNL61_CONFIG_ADDR A:0xe661e84
y.create.l HWIO_PMIC_ARB_OBS6_CHNL62_CONFIG_ADDR A:0xe661f04
y.create.l HWIO_PMIC_ARB_OBS6_CHNL63_CONFIG_ADDR A:0xe661f84
y.create.l HWIO_PMIC_ARB_OBS6_CHNL64_CONFIG_ADDR A:0xe662004
y.create.l HWIO_PMIC_ARB_OBS6_CHNL65_CONFIG_ADDR A:0xe662084
y.create.l HWIO_PMIC_ARB_OBS6_CHNL66_CONFIG_ADDR A:0xe662104
y.create.l HWIO_PMIC_ARB_OBS6_CHNL67_CONFIG_ADDR A:0xe662184
y.create.l HWIO_PMIC_ARB_OBS6_CHNL68_CONFIG_ADDR A:0xe662204
y.create.l HWIO_PMIC_ARB_OBS6_CHNL69_CONFIG_ADDR A:0xe662284
y.create.l HWIO_PMIC_ARB_OBS6_CHNL70_CONFIG_ADDR A:0xe662304
y.create.l HWIO_PMIC_ARB_OBS6_CHNL71_CONFIG_ADDR A:0xe662384
y.create.l HWIO_PMIC_ARB_OBS6_CHNL72_CONFIG_ADDR A:0xe662404
y.create.l HWIO_PMIC_ARB_OBS6_CHNL73_CONFIG_ADDR A:0xe662484
y.create.l HWIO_PMIC_ARB_OBS6_CHNL74_CONFIG_ADDR A:0xe662504
y.create.l HWIO_PMIC_ARB_OBS6_CHNL75_CONFIG_ADDR A:0xe662584
y.create.l HWIO_PMIC_ARB_OBS6_CHNL76_CONFIG_ADDR A:0xe662604
y.create.l HWIO_PMIC_ARB_OBS6_CHNL77_CONFIG_ADDR A:0xe662684
y.create.l HWIO_PMIC_ARB_OBS6_CHNL78_CONFIG_ADDR A:0xe662704
y.create.l HWIO_PMIC_ARB_OBS6_CHNL79_CONFIG_ADDR A:0xe662784
y.create.l HWIO_PMIC_ARB_OBS6_CHNL80_CONFIG_ADDR A:0xe662804
y.create.l HWIO_PMIC_ARB_OBS6_CHNL81_CONFIG_ADDR A:0xe662884
y.create.l HWIO_PMIC_ARB_OBS6_CHNL82_CONFIG_ADDR A:0xe662904
y.create.l HWIO_PMIC_ARB_OBS6_CHNL83_CONFIG_ADDR A:0xe662984
y.create.l HWIO_PMIC_ARB_OBS6_CHNL84_CONFIG_ADDR A:0xe662a04
y.create.l HWIO_PMIC_ARB_OBS6_CHNL85_CONFIG_ADDR A:0xe662a84
y.create.l HWIO_PMIC_ARB_OBS6_CHNL86_CONFIG_ADDR A:0xe662b04
y.create.l HWIO_PMIC_ARB_OBS6_CHNL87_CONFIG_ADDR A:0xe662b84
y.create.l HWIO_PMIC_ARB_OBS6_CHNL88_CONFIG_ADDR A:0xe662c04
y.create.l HWIO_PMIC_ARB_OBS6_CHNL89_CONFIG_ADDR A:0xe662c84
y.create.l HWIO_PMIC_ARB_OBS6_CHNL90_CONFIG_ADDR A:0xe662d04
y.create.l HWIO_PMIC_ARB_OBS6_CHNL91_CONFIG_ADDR A:0xe662d84
y.create.l HWIO_PMIC_ARB_OBS6_CHNL92_CONFIG_ADDR A:0xe662e04
y.create.l HWIO_PMIC_ARB_OBS6_CHNL93_CONFIG_ADDR A:0xe662e84
y.create.l HWIO_PMIC_ARB_OBS6_CHNL94_CONFIG_ADDR A:0xe662f04
y.create.l HWIO_PMIC_ARB_OBS6_CHNL95_CONFIG_ADDR A:0xe662f84
y.create.l HWIO_PMIC_ARB_OBS6_CHNL96_CONFIG_ADDR A:0xe663004
y.create.l HWIO_PMIC_ARB_OBS6_CHNL97_CONFIG_ADDR A:0xe663084
y.create.l HWIO_PMIC_ARB_OBS6_CHNL98_CONFIG_ADDR A:0xe663104
y.create.l HWIO_PMIC_ARB_OBS6_CHNL99_CONFIG_ADDR A:0xe663184
y.create.l HWIO_PMIC_ARB_OBS6_CHNL100_CONFIG_ADDR A:0xe663204
y.create.l HWIO_PMIC_ARB_OBS6_CHNL101_CONFIG_ADDR A:0xe663284
y.create.l HWIO_PMIC_ARB_OBS6_CHNL102_CONFIG_ADDR A:0xe663304
y.create.l HWIO_PMIC_ARB_OBS6_CHNL103_CONFIG_ADDR A:0xe663384
y.create.l HWIO_PMIC_ARB_OBS6_CHNL104_CONFIG_ADDR A:0xe663404
y.create.l HWIO_PMIC_ARB_OBS6_CHNL105_CONFIG_ADDR A:0xe663484
y.create.l HWIO_PMIC_ARB_OBS6_CHNL106_CONFIG_ADDR A:0xe663504
y.create.l HWIO_PMIC_ARB_OBS6_CHNL107_CONFIG_ADDR A:0xe663584
y.create.l HWIO_PMIC_ARB_OBS6_CHNL108_CONFIG_ADDR A:0xe663604
y.create.l HWIO_PMIC_ARB_OBS6_CHNL109_CONFIG_ADDR A:0xe663684
y.create.l HWIO_PMIC_ARB_OBS6_CHNL110_CONFIG_ADDR A:0xe663704
y.create.l HWIO_PMIC_ARB_OBS6_CHNL111_CONFIG_ADDR A:0xe663784
y.create.l HWIO_PMIC_ARB_OBS6_CHNL112_CONFIG_ADDR A:0xe663804
y.create.l HWIO_PMIC_ARB_OBS6_CHNL113_CONFIG_ADDR A:0xe663884
y.create.l HWIO_PMIC_ARB_OBS6_CHNL114_CONFIG_ADDR A:0xe663904
y.create.l HWIO_PMIC_ARB_OBS6_CHNL115_CONFIG_ADDR A:0xe663984
y.create.l HWIO_PMIC_ARB_OBS6_CHNL116_CONFIG_ADDR A:0xe663a04
y.create.l HWIO_PMIC_ARB_OBS6_CHNL117_CONFIG_ADDR A:0xe663a84
y.create.l HWIO_PMIC_ARB_OBS6_CHNL118_CONFIG_ADDR A:0xe663b04
y.create.l HWIO_PMIC_ARB_OBS6_CHNL119_CONFIG_ADDR A:0xe663b84
y.create.l HWIO_PMIC_ARB_OBS6_CHNL120_CONFIG_ADDR A:0xe663c04
y.create.l HWIO_PMIC_ARB_OBS6_CHNL121_CONFIG_ADDR A:0xe663c84
y.create.l HWIO_PMIC_ARB_OBS6_CHNL122_CONFIG_ADDR A:0xe663d04
y.create.l HWIO_PMIC_ARB_OBS6_CHNL123_CONFIG_ADDR A:0xe663d84
y.create.l HWIO_PMIC_ARB_OBS6_CHNL124_CONFIG_ADDR A:0xe663e04
y.create.l HWIO_PMIC_ARB_OBS6_CHNL125_CONFIG_ADDR A:0xe663e84
y.create.l HWIO_PMIC_ARB_OBS6_CHNL126_CONFIG_ADDR A:0xe663f04
y.create.l HWIO_PMIC_ARB_OBS6_CHNL127_CONFIG_ADDR A:0xe663f84
y.create.l HWIO_PMIC_ARB_OBS6_CHNL128_CONFIG_ADDR A:0xe664004
y.create.l HWIO_PMIC_ARB_OBS6_CHNL129_CONFIG_ADDR A:0xe664084
y.create.l HWIO_PMIC_ARB_OBS6_CHNL130_CONFIG_ADDR A:0xe664104
y.create.l HWIO_PMIC_ARB_OBS6_CHNL131_CONFIG_ADDR A:0xe664184
y.create.l HWIO_PMIC_ARB_OBS6_CHNL132_CONFIG_ADDR A:0xe664204
y.create.l HWIO_PMIC_ARB_OBS6_CHNL133_CONFIG_ADDR A:0xe664284
y.create.l HWIO_PMIC_ARB_OBS6_CHNL134_CONFIG_ADDR A:0xe664304
y.create.l HWIO_PMIC_ARB_OBS6_CHNL135_CONFIG_ADDR A:0xe664384
y.create.l HWIO_PMIC_ARB_OBS6_CHNL136_CONFIG_ADDR A:0xe664404
y.create.l HWIO_PMIC_ARB_OBS6_CHNL137_CONFIG_ADDR A:0xe664484
y.create.l HWIO_PMIC_ARB_OBS6_CHNL138_CONFIG_ADDR A:0xe664504
y.create.l HWIO_PMIC_ARB_OBS6_CHNL139_CONFIG_ADDR A:0xe664584
y.create.l HWIO_PMIC_ARB_OBS6_CHNL140_CONFIG_ADDR A:0xe664604
y.create.l HWIO_PMIC_ARB_OBS6_CHNL141_CONFIG_ADDR A:0xe664684
y.create.l HWIO_PMIC_ARB_OBS6_CHNL142_CONFIG_ADDR A:0xe664704
y.create.l HWIO_PMIC_ARB_OBS6_CHNL143_CONFIG_ADDR A:0xe664784
y.create.l HWIO_PMIC_ARB_OBS6_CHNL144_CONFIG_ADDR A:0xe664804
y.create.l HWIO_PMIC_ARB_OBS6_CHNL145_CONFIG_ADDR A:0xe664884
y.create.l HWIO_PMIC_ARB_OBS6_CHNL146_CONFIG_ADDR A:0xe664904
y.create.l HWIO_PMIC_ARB_OBS6_CHNL147_CONFIG_ADDR A:0xe664984
y.create.l HWIO_PMIC_ARB_OBS6_CHNL148_CONFIG_ADDR A:0xe664a04
y.create.l HWIO_PMIC_ARB_OBS6_CHNL149_CONFIG_ADDR A:0xe664a84
y.create.l HWIO_PMIC_ARB_OBS6_CHNL150_CONFIG_ADDR A:0xe664b04
y.create.l HWIO_PMIC_ARB_OBS6_CHNL151_CONFIG_ADDR A:0xe664b84
y.create.l HWIO_PMIC_ARB_OBS6_CHNL152_CONFIG_ADDR A:0xe664c04
y.create.l HWIO_PMIC_ARB_OBS6_CHNL153_CONFIG_ADDR A:0xe664c84
y.create.l HWIO_PMIC_ARB_OBS6_CHNL154_CONFIG_ADDR A:0xe664d04
y.create.l HWIO_PMIC_ARB_OBS6_CHNL155_CONFIG_ADDR A:0xe664d84
y.create.l HWIO_PMIC_ARB_OBS6_CHNL156_CONFIG_ADDR A:0xe664e04
y.create.l HWIO_PMIC_ARB_OBS6_CHNL157_CONFIG_ADDR A:0xe664e84
y.create.l HWIO_PMIC_ARB_OBS6_CHNL158_CONFIG_ADDR A:0xe664f04
y.create.l HWIO_PMIC_ARB_OBS6_CHNL159_CONFIG_ADDR A:0xe664f84
y.create.l HWIO_PMIC_ARB_OBS6_CHNL160_CONFIG_ADDR A:0xe665004
y.create.l HWIO_PMIC_ARB_OBS6_CHNL161_CONFIG_ADDR A:0xe665084
y.create.l HWIO_PMIC_ARB_OBS6_CHNL162_CONFIG_ADDR A:0xe665104
y.create.l HWIO_PMIC_ARB_OBS6_CHNL163_CONFIG_ADDR A:0xe665184
y.create.l HWIO_PMIC_ARB_OBS6_CHNL164_CONFIG_ADDR A:0xe665204
y.create.l HWIO_PMIC_ARB_OBS6_CHNL165_CONFIG_ADDR A:0xe665284
y.create.l HWIO_PMIC_ARB_OBS6_CHNL166_CONFIG_ADDR A:0xe665304
y.create.l HWIO_PMIC_ARB_OBS6_CHNL167_CONFIG_ADDR A:0xe665384
y.create.l HWIO_PMIC_ARB_OBS6_CHNL168_CONFIG_ADDR A:0xe665404
y.create.l HWIO_PMIC_ARB_OBS6_CHNL169_CONFIG_ADDR A:0xe665484
y.create.l HWIO_PMIC_ARB_OBS6_CHNL170_CONFIG_ADDR A:0xe665504
y.create.l HWIO_PMIC_ARB_OBS6_CHNL171_CONFIG_ADDR A:0xe665584
y.create.l HWIO_PMIC_ARB_OBS6_CHNL172_CONFIG_ADDR A:0xe665604
y.create.l HWIO_PMIC_ARB_OBS6_CHNL173_CONFIG_ADDR A:0xe665684
y.create.l HWIO_PMIC_ARB_OBS6_CHNL174_CONFIG_ADDR A:0xe665704
y.create.l HWIO_PMIC_ARB_OBS6_CHNL175_CONFIG_ADDR A:0xe665784
y.create.l HWIO_PMIC_ARB_OBS6_CHNL176_CONFIG_ADDR A:0xe665804
y.create.l HWIO_PMIC_ARB_OBS6_CHNL177_CONFIG_ADDR A:0xe665884
y.create.l HWIO_PMIC_ARB_OBS6_CHNL178_CONFIG_ADDR A:0xe665904
y.create.l HWIO_PMIC_ARB_OBS6_CHNL179_CONFIG_ADDR A:0xe665984
y.create.l HWIO_PMIC_ARB_OBS6_CHNL180_CONFIG_ADDR A:0xe665a04
y.create.l HWIO_PMIC_ARB_OBS6_CHNL181_CONFIG_ADDR A:0xe665a84
y.create.l HWIO_PMIC_ARB_OBS6_CHNL182_CONFIG_ADDR A:0xe665b04
y.create.l HWIO_PMIC_ARB_OBS6_CHNL183_CONFIG_ADDR A:0xe665b84
y.create.l HWIO_PMIC_ARB_OBS6_CHNL184_CONFIG_ADDR A:0xe665c04
y.create.l HWIO_PMIC_ARB_OBS6_CHNL185_CONFIG_ADDR A:0xe665c84
y.create.l HWIO_PMIC_ARB_OBS6_CHNL186_CONFIG_ADDR A:0xe665d04
y.create.l HWIO_PMIC_ARB_OBS6_CHNL187_CONFIG_ADDR A:0xe665d84
y.create.l HWIO_PMIC_ARB_OBS6_CHNL188_CONFIG_ADDR A:0xe665e04
y.create.l HWIO_PMIC_ARB_OBS6_CHNL189_CONFIG_ADDR A:0xe665e84
y.create.l HWIO_PMIC_ARB_OBS6_CHNL190_CONFIG_ADDR A:0xe665f04
y.create.l HWIO_PMIC_ARB_OBS6_CHNL191_CONFIG_ADDR A:0xe665f84
y.create.l HWIO_PMIC_ARB_OBS6_CHNL192_CONFIG_ADDR A:0xe666004
y.create.l HWIO_PMIC_ARB_OBS6_CHNL193_CONFIG_ADDR A:0xe666084
y.create.l HWIO_PMIC_ARB_OBS6_CHNL194_CONFIG_ADDR A:0xe666104
y.create.l HWIO_PMIC_ARB_OBS6_CHNL195_CONFIG_ADDR A:0xe666184
y.create.l HWIO_PMIC_ARB_OBS6_CHNL196_CONFIG_ADDR A:0xe666204
y.create.l HWIO_PMIC_ARB_OBS6_CHNL197_CONFIG_ADDR A:0xe666284
y.create.l HWIO_PMIC_ARB_OBS6_CHNL198_CONFIG_ADDR A:0xe666304
y.create.l HWIO_PMIC_ARB_OBS6_CHNL199_CONFIG_ADDR A:0xe666384
y.create.l HWIO_PMIC_ARB_OBS6_CHNL200_CONFIG_ADDR A:0xe666404
y.create.l HWIO_PMIC_ARB_OBS6_CHNL201_CONFIG_ADDR A:0xe666484
y.create.l HWIO_PMIC_ARB_OBS6_CHNL202_CONFIG_ADDR A:0xe666504
y.create.l HWIO_PMIC_ARB_OBS6_CHNL203_CONFIG_ADDR A:0xe666584
y.create.l HWIO_PMIC_ARB_OBS6_CHNL204_CONFIG_ADDR A:0xe666604
y.create.l HWIO_PMIC_ARB_OBS6_CHNL205_CONFIG_ADDR A:0xe666684
y.create.l HWIO_PMIC_ARB_OBS6_CHNL206_CONFIG_ADDR A:0xe666704
y.create.l HWIO_PMIC_ARB_OBS6_CHNL207_CONFIG_ADDR A:0xe666784
y.create.l HWIO_PMIC_ARB_OBS6_CHNL208_CONFIG_ADDR A:0xe666804
y.create.l HWIO_PMIC_ARB_OBS6_CHNL209_CONFIG_ADDR A:0xe666884
y.create.l HWIO_PMIC_ARB_OBS6_CHNL210_CONFIG_ADDR A:0xe666904
y.create.l HWIO_PMIC_ARB_OBS6_CHNL211_CONFIG_ADDR A:0xe666984
y.create.l HWIO_PMIC_ARB_OBS6_CHNL212_CONFIG_ADDR A:0xe666a04
y.create.l HWIO_PMIC_ARB_OBS6_CHNL213_CONFIG_ADDR A:0xe666a84
y.create.l HWIO_PMIC_ARB_OBS6_CHNL214_CONFIG_ADDR A:0xe666b04
y.create.l HWIO_PMIC_ARB_OBS6_CHNL215_CONFIG_ADDR A:0xe666b84
y.create.l HWIO_PMIC_ARB_OBS6_CHNL216_CONFIG_ADDR A:0xe666c04
y.create.l HWIO_PMIC_ARB_OBS6_CHNL217_CONFIG_ADDR A:0xe666c84
y.create.l HWIO_PMIC_ARB_OBS6_CHNL218_CONFIG_ADDR A:0xe666d04
y.create.l HWIO_PMIC_ARB_OBS6_CHNL219_CONFIG_ADDR A:0xe666d84
y.create.l HWIO_PMIC_ARB_OBS6_CHNL220_CONFIG_ADDR A:0xe666e04
y.create.l HWIO_PMIC_ARB_OBS6_CHNL221_CONFIG_ADDR A:0xe666e84
y.create.l HWIO_PMIC_ARB_OBS6_CHNL222_CONFIG_ADDR A:0xe666f04
y.create.l HWIO_PMIC_ARB_OBS6_CHNL223_CONFIG_ADDR A:0xe666f84
y.create.l HWIO_PMIC_ARB_OBS6_CHNL224_CONFIG_ADDR A:0xe667004
y.create.l HWIO_PMIC_ARB_OBS6_CHNL225_CONFIG_ADDR A:0xe667084
y.create.l HWIO_PMIC_ARB_OBS6_CHNL226_CONFIG_ADDR A:0xe667104
y.create.l HWIO_PMIC_ARB_OBS6_CHNL227_CONFIG_ADDR A:0xe667184
y.create.l HWIO_PMIC_ARB_OBS6_CHNL228_CONFIG_ADDR A:0xe667204
y.create.l HWIO_PMIC_ARB_OBS6_CHNL229_CONFIG_ADDR A:0xe667284
y.create.l HWIO_PMIC_ARB_OBS6_CHNL230_CONFIG_ADDR A:0xe667304
y.create.l HWIO_PMIC_ARB_OBS6_CHNL231_CONFIG_ADDR A:0xe667384
y.create.l HWIO_PMIC_ARB_OBS6_CHNL232_CONFIG_ADDR A:0xe667404
y.create.l HWIO_PMIC_ARB_OBS6_CHNL233_CONFIG_ADDR A:0xe667484
y.create.l HWIO_PMIC_ARB_OBS6_CHNL234_CONFIG_ADDR A:0xe667504
y.create.l HWIO_PMIC_ARB_OBS6_CHNL235_CONFIG_ADDR A:0xe667584
y.create.l HWIO_PMIC_ARB_OBS6_CHNL236_CONFIG_ADDR A:0xe667604
y.create.l HWIO_PMIC_ARB_OBS6_CHNL237_CONFIG_ADDR A:0xe667684
y.create.l HWIO_PMIC_ARB_OBS6_CHNL238_CONFIG_ADDR A:0xe667704
y.create.l HWIO_PMIC_ARB_OBS6_CHNL239_CONFIG_ADDR A:0xe667784
y.create.l HWIO_PMIC_ARB_OBS6_CHNL240_CONFIG_ADDR A:0xe667804
y.create.l HWIO_PMIC_ARB_OBS6_CHNL241_CONFIG_ADDR A:0xe667884
y.create.l HWIO_PMIC_ARB_OBS6_CHNL242_CONFIG_ADDR A:0xe667904
y.create.l HWIO_PMIC_ARB_OBS6_CHNL243_CONFIG_ADDR A:0xe667984
y.create.l HWIO_PMIC_ARB_OBS6_CHNL244_CONFIG_ADDR A:0xe667a04
y.create.l HWIO_PMIC_ARB_OBS6_CHNL245_CONFIG_ADDR A:0xe667a84
y.create.l HWIO_PMIC_ARB_OBS6_CHNL246_CONFIG_ADDR A:0xe667b04
y.create.l HWIO_PMIC_ARB_OBS6_CHNL247_CONFIG_ADDR A:0xe667b84
y.create.l HWIO_PMIC_ARB_OBS6_CHNL248_CONFIG_ADDR A:0xe667c04
y.create.l HWIO_PMIC_ARB_OBS6_CHNL249_CONFIG_ADDR A:0xe667c84
y.create.l HWIO_PMIC_ARB_OBS6_CHNL250_CONFIG_ADDR A:0xe667d04
y.create.l HWIO_PMIC_ARB_OBS6_CHNL251_CONFIG_ADDR A:0xe667d84
y.create.l HWIO_PMIC_ARB_OBS6_CHNL252_CONFIG_ADDR A:0xe667e04
y.create.l HWIO_PMIC_ARB_OBS6_CHNL253_CONFIG_ADDR A:0xe667e84
y.create.l HWIO_PMIC_ARB_OBS6_CHNL254_CONFIG_ADDR A:0xe667f04
y.create.l HWIO_PMIC_ARB_OBS6_CHNL255_CONFIG_ADDR A:0xe667f84
y.create.l HWIO_PMIC_ARB_OBS6_CHNL256_CONFIG_ADDR A:0xe668004
y.create.l HWIO_PMIC_ARB_OBS6_CHNL257_CONFIG_ADDR A:0xe668084
y.create.l HWIO_PMIC_ARB_OBS6_CHNL258_CONFIG_ADDR A:0xe668104
y.create.l HWIO_PMIC_ARB_OBS6_CHNL259_CONFIG_ADDR A:0xe668184
y.create.l HWIO_PMIC_ARB_OBS6_CHNL260_CONFIG_ADDR A:0xe668204
y.create.l HWIO_PMIC_ARB_OBS6_CHNL261_CONFIG_ADDR A:0xe668284
y.create.l HWIO_PMIC_ARB_OBS6_CHNL262_CONFIG_ADDR A:0xe668304
y.create.l HWIO_PMIC_ARB_OBS6_CHNL263_CONFIG_ADDR A:0xe668384
y.create.l HWIO_PMIC_ARB_OBS6_CHNL264_CONFIG_ADDR A:0xe668404
y.create.l HWIO_PMIC_ARB_OBS6_CHNL265_CONFIG_ADDR A:0xe668484
y.create.l HWIO_PMIC_ARB_OBS6_CHNL266_CONFIG_ADDR A:0xe668504
y.create.l HWIO_PMIC_ARB_OBS6_CHNL267_CONFIG_ADDR A:0xe668584
y.create.l HWIO_PMIC_ARB_OBS6_CHNL268_CONFIG_ADDR A:0xe668604
y.create.l HWIO_PMIC_ARB_OBS6_CHNL269_CONFIG_ADDR A:0xe668684
y.create.l HWIO_PMIC_ARB_OBS6_CHNL270_CONFIG_ADDR A:0xe668704
y.create.l HWIO_PMIC_ARB_OBS6_CHNL271_CONFIG_ADDR A:0xe668784
y.create.l HWIO_PMIC_ARB_OBS6_CHNL272_CONFIG_ADDR A:0xe668804
y.create.l HWIO_PMIC_ARB_OBS6_CHNL273_CONFIG_ADDR A:0xe668884
y.create.l HWIO_PMIC_ARB_OBS6_CHNL274_CONFIG_ADDR A:0xe668904
y.create.l HWIO_PMIC_ARB_OBS6_CHNL275_CONFIG_ADDR A:0xe668984
y.create.l HWIO_PMIC_ARB_OBS6_CHNL276_CONFIG_ADDR A:0xe668a04
y.create.l HWIO_PMIC_ARB_OBS6_CHNL277_CONFIG_ADDR A:0xe668a84
y.create.l HWIO_PMIC_ARB_OBS6_CHNL278_CONFIG_ADDR A:0xe668b04
y.create.l HWIO_PMIC_ARB_OBS6_CHNL279_CONFIG_ADDR A:0xe668b84
y.create.l HWIO_PMIC_ARB_OBS6_CHNL280_CONFIG_ADDR A:0xe668c04
y.create.l HWIO_PMIC_ARB_OBS6_CHNL281_CONFIG_ADDR A:0xe668c84
y.create.l HWIO_PMIC_ARB_OBS6_CHNL282_CONFIG_ADDR A:0xe668d04
y.create.l HWIO_PMIC_ARB_OBS6_CHNL283_CONFIG_ADDR A:0xe668d84
y.create.l HWIO_PMIC_ARB_OBS6_CHNL284_CONFIG_ADDR A:0xe668e04
y.create.l HWIO_PMIC_ARB_OBS6_CHNL285_CONFIG_ADDR A:0xe668e84
y.create.l HWIO_PMIC_ARB_OBS6_CHNL286_CONFIG_ADDR A:0xe668f04
y.create.l HWIO_PMIC_ARB_OBS6_CHNL287_CONFIG_ADDR A:0xe668f84
y.create.l HWIO_PMIC_ARB_OBS6_CHNL288_CONFIG_ADDR A:0xe669004
y.create.l HWIO_PMIC_ARB_OBS6_CHNL289_CONFIG_ADDR A:0xe669084
y.create.l HWIO_PMIC_ARB_OBS6_CHNL290_CONFIG_ADDR A:0xe669104
y.create.l HWIO_PMIC_ARB_OBS6_CHNL291_CONFIG_ADDR A:0xe669184
y.create.l HWIO_PMIC_ARB_OBS6_CHNL292_CONFIG_ADDR A:0xe669204
y.create.l HWIO_PMIC_ARB_OBS6_CHNL293_CONFIG_ADDR A:0xe669284
y.create.l HWIO_PMIC_ARB_OBS6_CHNL294_CONFIG_ADDR A:0xe669304
y.create.l HWIO_PMIC_ARB_OBS6_CHNL295_CONFIG_ADDR A:0xe669384
y.create.l HWIO_PMIC_ARB_OBS6_CHNL296_CONFIG_ADDR A:0xe669404
y.create.l HWIO_PMIC_ARB_OBS6_CHNL297_CONFIG_ADDR A:0xe669484
y.create.l HWIO_PMIC_ARB_OBS6_CHNL298_CONFIG_ADDR A:0xe669504
y.create.l HWIO_PMIC_ARB_OBS6_CHNL299_CONFIG_ADDR A:0xe669584
y.create.l HWIO_PMIC_ARB_OBS6_CHNL300_CONFIG_ADDR A:0xe669604
y.create.l HWIO_PMIC_ARB_OBS6_CHNL301_CONFIG_ADDR A:0xe669684
y.create.l HWIO_PMIC_ARB_OBS6_CHNL302_CONFIG_ADDR A:0xe669704
y.create.l HWIO_PMIC_ARB_OBS6_CHNL303_CONFIG_ADDR A:0xe669784
y.create.l HWIO_PMIC_ARB_OBS6_CHNL304_CONFIG_ADDR A:0xe669804
y.create.l HWIO_PMIC_ARB_OBS6_CHNL305_CONFIG_ADDR A:0xe669884
y.create.l HWIO_PMIC_ARB_OBS6_CHNL306_CONFIG_ADDR A:0xe669904
y.create.l HWIO_PMIC_ARB_OBS6_CHNL307_CONFIG_ADDR A:0xe669984
y.create.l HWIO_PMIC_ARB_OBS6_CHNL308_CONFIG_ADDR A:0xe669a04
y.create.l HWIO_PMIC_ARB_OBS6_CHNL309_CONFIG_ADDR A:0xe669a84
y.create.l HWIO_PMIC_ARB_OBS6_CHNL310_CONFIG_ADDR A:0xe669b04
y.create.l HWIO_PMIC_ARB_OBS6_CHNL311_CONFIG_ADDR A:0xe669b84
y.create.l HWIO_PMIC_ARB_OBS6_CHNL312_CONFIG_ADDR A:0xe669c04
y.create.l HWIO_PMIC_ARB_OBS6_CHNL313_CONFIG_ADDR A:0xe669c84
y.create.l HWIO_PMIC_ARB_OBS6_CHNL314_CONFIG_ADDR A:0xe669d04
y.create.l HWIO_PMIC_ARB_OBS6_CHNL315_CONFIG_ADDR A:0xe669d84
y.create.l HWIO_PMIC_ARB_OBS6_CHNL316_CONFIG_ADDR A:0xe669e04
y.create.l HWIO_PMIC_ARB_OBS6_CHNL317_CONFIG_ADDR A:0xe669e84
y.create.l HWIO_PMIC_ARB_OBS6_CHNL318_CONFIG_ADDR A:0xe669f04
y.create.l HWIO_PMIC_ARB_OBS6_CHNL319_CONFIG_ADDR A:0xe669f84
y.create.l HWIO_PMIC_ARB_OBS6_CHNL320_CONFIG_ADDR A:0xe66a004
y.create.l HWIO_PMIC_ARB_OBS6_CHNL321_CONFIG_ADDR A:0xe66a084
y.create.l HWIO_PMIC_ARB_OBS6_CHNL322_CONFIG_ADDR A:0xe66a104
y.create.l HWIO_PMIC_ARB_OBS6_CHNL323_CONFIG_ADDR A:0xe66a184
y.create.l HWIO_PMIC_ARB_OBS6_CHNL324_CONFIG_ADDR A:0xe66a204
y.create.l HWIO_PMIC_ARB_OBS6_CHNL325_CONFIG_ADDR A:0xe66a284
y.create.l HWIO_PMIC_ARB_OBS6_CHNL326_CONFIG_ADDR A:0xe66a304
y.create.l HWIO_PMIC_ARB_OBS6_CHNL327_CONFIG_ADDR A:0xe66a384
y.create.l HWIO_PMIC_ARB_OBS6_CHNL328_CONFIG_ADDR A:0xe66a404
y.create.l HWIO_PMIC_ARB_OBS6_CHNL329_CONFIG_ADDR A:0xe66a484
y.create.l HWIO_PMIC_ARB_OBS6_CHNL330_CONFIG_ADDR A:0xe66a504
y.create.l HWIO_PMIC_ARB_OBS6_CHNL331_CONFIG_ADDR A:0xe66a584
y.create.l HWIO_PMIC_ARB_OBS6_CHNL332_CONFIG_ADDR A:0xe66a604
y.create.l HWIO_PMIC_ARB_OBS6_CHNL333_CONFIG_ADDR A:0xe66a684
y.create.l HWIO_PMIC_ARB_OBS6_CHNL334_CONFIG_ADDR A:0xe66a704
y.create.l HWIO_PMIC_ARB_OBS6_CHNL335_CONFIG_ADDR A:0xe66a784
y.create.l HWIO_PMIC_ARB_OBS6_CHNL336_CONFIG_ADDR A:0xe66a804
y.create.l HWIO_PMIC_ARB_OBS6_CHNL337_CONFIG_ADDR A:0xe66a884
y.create.l HWIO_PMIC_ARB_OBS6_CHNL338_CONFIG_ADDR A:0xe66a904
y.create.l HWIO_PMIC_ARB_OBS6_CHNL339_CONFIG_ADDR A:0xe66a984
y.create.l HWIO_PMIC_ARB_OBS6_CHNL340_CONFIG_ADDR A:0xe66aa04
y.create.l HWIO_PMIC_ARB_OBS6_CHNL341_CONFIG_ADDR A:0xe66aa84
y.create.l HWIO_PMIC_ARB_OBS6_CHNL342_CONFIG_ADDR A:0xe66ab04
y.create.l HWIO_PMIC_ARB_OBS6_CHNL343_CONFIG_ADDR A:0xe66ab84
y.create.l HWIO_PMIC_ARB_OBS6_CHNL344_CONFIG_ADDR A:0xe66ac04
y.create.l HWIO_PMIC_ARB_OBS6_CHNL345_CONFIG_ADDR A:0xe66ac84
y.create.l HWIO_PMIC_ARB_OBS6_CHNL346_CONFIG_ADDR A:0xe66ad04
y.create.l HWIO_PMIC_ARB_OBS6_CHNL347_CONFIG_ADDR A:0xe66ad84
y.create.l HWIO_PMIC_ARB_OBS6_CHNL348_CONFIG_ADDR A:0xe66ae04
y.create.l HWIO_PMIC_ARB_OBS6_CHNL349_CONFIG_ADDR A:0xe66ae84
y.create.l HWIO_PMIC_ARB_OBS6_CHNL350_CONFIG_ADDR A:0xe66af04
y.create.l HWIO_PMIC_ARB_OBS6_CHNL351_CONFIG_ADDR A:0xe66af84
y.create.l HWIO_PMIC_ARB_OBS6_CHNL352_CONFIG_ADDR A:0xe66b004
y.create.l HWIO_PMIC_ARB_OBS6_CHNL353_CONFIG_ADDR A:0xe66b084
y.create.l HWIO_PMIC_ARB_OBS6_CHNL354_CONFIG_ADDR A:0xe66b104
y.create.l HWIO_PMIC_ARB_OBS6_CHNL355_CONFIG_ADDR A:0xe66b184
y.create.l HWIO_PMIC_ARB_OBS6_CHNL356_CONFIG_ADDR A:0xe66b204
y.create.l HWIO_PMIC_ARB_OBS6_CHNL357_CONFIG_ADDR A:0xe66b284
y.create.l HWIO_PMIC_ARB_OBS6_CHNL358_CONFIG_ADDR A:0xe66b304
y.create.l HWIO_PMIC_ARB_OBS6_CHNL359_CONFIG_ADDR A:0xe66b384
y.create.l HWIO_PMIC_ARB_OBS6_CHNL360_CONFIG_ADDR A:0xe66b404
y.create.l HWIO_PMIC_ARB_OBS6_CHNL361_CONFIG_ADDR A:0xe66b484
y.create.l HWIO_PMIC_ARB_OBS6_CHNL362_CONFIG_ADDR A:0xe66b504
y.create.l HWIO_PMIC_ARB_OBS6_CHNL363_CONFIG_ADDR A:0xe66b584
y.create.l HWIO_PMIC_ARB_OBS6_CHNL364_CONFIG_ADDR A:0xe66b604
y.create.l HWIO_PMIC_ARB_OBS6_CHNL365_CONFIG_ADDR A:0xe66b684
y.create.l HWIO_PMIC_ARB_OBS6_CHNL366_CONFIG_ADDR A:0xe66b704
y.create.l HWIO_PMIC_ARB_OBS6_CHNL367_CONFIG_ADDR A:0xe66b784
y.create.l HWIO_PMIC_ARB_OBS6_CHNL368_CONFIG_ADDR A:0xe66b804
y.create.l HWIO_PMIC_ARB_OBS6_CHNL369_CONFIG_ADDR A:0xe66b884
y.create.l HWIO_PMIC_ARB_OBS6_CHNL370_CONFIG_ADDR A:0xe66b904
y.create.l HWIO_PMIC_ARB_OBS6_CHNL371_CONFIG_ADDR A:0xe66b984
y.create.l HWIO_PMIC_ARB_OBS6_CHNL372_CONFIG_ADDR A:0xe66ba04
y.create.l HWIO_PMIC_ARB_OBS6_CHNL373_CONFIG_ADDR A:0xe66ba84
y.create.l HWIO_PMIC_ARB_OBS6_CHNL374_CONFIG_ADDR A:0xe66bb04
y.create.l HWIO_PMIC_ARB_OBS6_CHNL375_CONFIG_ADDR A:0xe66bb84
y.create.l HWIO_PMIC_ARB_OBS6_CHNL376_CONFIG_ADDR A:0xe66bc04
y.create.l HWIO_PMIC_ARB_OBS6_CHNL377_CONFIG_ADDR A:0xe66bc84
y.create.l HWIO_PMIC_ARB_OBS6_CHNL378_CONFIG_ADDR A:0xe66bd04
y.create.l HWIO_PMIC_ARB_OBS6_CHNL379_CONFIG_ADDR A:0xe66bd84
y.create.l HWIO_PMIC_ARB_OBS6_CHNL380_CONFIG_ADDR A:0xe66be04
y.create.l HWIO_PMIC_ARB_OBS6_CHNL381_CONFIG_ADDR A:0xe66be84
y.create.l HWIO_PMIC_ARB_OBS6_CHNL382_CONFIG_ADDR A:0xe66bf04
y.create.l HWIO_PMIC_ARB_OBS6_CHNL383_CONFIG_ADDR A:0xe66bf84
y.create.l HWIO_PMIC_ARB_OBS6_CHNL384_CONFIG_ADDR A:0xe66c004
y.create.l HWIO_PMIC_ARB_OBS6_CHNL385_CONFIG_ADDR A:0xe66c084
y.create.l HWIO_PMIC_ARB_OBS6_CHNL386_CONFIG_ADDR A:0xe66c104
y.create.l HWIO_PMIC_ARB_OBS6_CHNL387_CONFIG_ADDR A:0xe66c184
y.create.l HWIO_PMIC_ARB_OBS6_CHNL388_CONFIG_ADDR A:0xe66c204
y.create.l HWIO_PMIC_ARB_OBS6_CHNL389_CONFIG_ADDR A:0xe66c284
y.create.l HWIO_PMIC_ARB_OBS6_CHNL390_CONFIG_ADDR A:0xe66c304
y.create.l HWIO_PMIC_ARB_OBS6_CHNL391_CONFIG_ADDR A:0xe66c384
y.create.l HWIO_PMIC_ARB_OBS6_CHNL392_CONFIG_ADDR A:0xe66c404
y.create.l HWIO_PMIC_ARB_OBS6_CHNL393_CONFIG_ADDR A:0xe66c484
y.create.l HWIO_PMIC_ARB_OBS6_CHNL394_CONFIG_ADDR A:0xe66c504
y.create.l HWIO_PMIC_ARB_OBS6_CHNL395_CONFIG_ADDR A:0xe66c584
y.create.l HWIO_PMIC_ARB_OBS6_CHNL396_CONFIG_ADDR A:0xe66c604
y.create.l HWIO_PMIC_ARB_OBS6_CHNL397_CONFIG_ADDR A:0xe66c684
y.create.l HWIO_PMIC_ARB_OBS6_CHNL398_CONFIG_ADDR A:0xe66c704
y.create.l HWIO_PMIC_ARB_OBS6_CHNL399_CONFIG_ADDR A:0xe66c784
y.create.l HWIO_PMIC_ARB_OBS6_CHNL400_CONFIG_ADDR A:0xe66c804
y.create.l HWIO_PMIC_ARB_OBS6_CHNL401_CONFIG_ADDR A:0xe66c884
y.create.l HWIO_PMIC_ARB_OBS6_CHNL402_CONFIG_ADDR A:0xe66c904
y.create.l HWIO_PMIC_ARB_OBS6_CHNL403_CONFIG_ADDR A:0xe66c984
y.create.l HWIO_PMIC_ARB_OBS6_CHNL404_CONFIG_ADDR A:0xe66ca04
y.create.l HWIO_PMIC_ARB_OBS6_CHNL405_CONFIG_ADDR A:0xe66ca84
y.create.l HWIO_PMIC_ARB_OBS6_CHNL406_CONFIG_ADDR A:0xe66cb04
y.create.l HWIO_PMIC_ARB_OBS6_CHNL407_CONFIG_ADDR A:0xe66cb84
y.create.l HWIO_PMIC_ARB_OBS6_CHNL408_CONFIG_ADDR A:0xe66cc04
y.create.l HWIO_PMIC_ARB_OBS6_CHNL409_CONFIG_ADDR A:0xe66cc84
y.create.l HWIO_PMIC_ARB_OBS6_CHNL410_CONFIG_ADDR A:0xe66cd04
y.create.l HWIO_PMIC_ARB_OBS6_CHNL411_CONFIG_ADDR A:0xe66cd84
y.create.l HWIO_PMIC_ARB_OBS6_CHNL412_CONFIG_ADDR A:0xe66ce04
y.create.l HWIO_PMIC_ARB_OBS6_CHNL413_CONFIG_ADDR A:0xe66ce84
y.create.l HWIO_PMIC_ARB_OBS6_CHNL414_CONFIG_ADDR A:0xe66cf04
y.create.l HWIO_PMIC_ARB_OBS6_CHNL415_CONFIG_ADDR A:0xe66cf84
y.create.l HWIO_PMIC_ARB_OBS6_CHNL416_CONFIG_ADDR A:0xe66d004
y.create.l HWIO_PMIC_ARB_OBS6_CHNL417_CONFIG_ADDR A:0xe66d084
y.create.l HWIO_PMIC_ARB_OBS6_CHNL418_CONFIG_ADDR A:0xe66d104
y.create.l HWIO_PMIC_ARB_OBS6_CHNL419_CONFIG_ADDR A:0xe66d184
y.create.l HWIO_PMIC_ARB_OBS6_CHNL420_CONFIG_ADDR A:0xe66d204
y.create.l HWIO_PMIC_ARB_OBS6_CHNL421_CONFIG_ADDR A:0xe66d284
y.create.l HWIO_PMIC_ARB_OBS6_CHNL422_CONFIG_ADDR A:0xe66d304
y.create.l HWIO_PMIC_ARB_OBS6_CHNL423_CONFIG_ADDR A:0xe66d384
y.create.l HWIO_PMIC_ARB_OBS6_CHNL424_CONFIG_ADDR A:0xe66d404
y.create.l HWIO_PMIC_ARB_OBS6_CHNL425_CONFIG_ADDR A:0xe66d484
y.create.l HWIO_PMIC_ARB_OBS6_CHNL426_CONFIG_ADDR A:0xe66d504
y.create.l HWIO_PMIC_ARB_OBS6_CHNL427_CONFIG_ADDR A:0xe66d584
y.create.l HWIO_PMIC_ARB_OBS6_CHNL428_CONFIG_ADDR A:0xe66d604
y.create.l HWIO_PMIC_ARB_OBS6_CHNL429_CONFIG_ADDR A:0xe66d684
y.create.l HWIO_PMIC_ARB_OBS6_CHNL430_CONFIG_ADDR A:0xe66d704
y.create.l HWIO_PMIC_ARB_OBS6_CHNL431_CONFIG_ADDR A:0xe66d784
y.create.l HWIO_PMIC_ARB_OBS6_CHNL432_CONFIG_ADDR A:0xe66d804
y.create.l HWIO_PMIC_ARB_OBS6_CHNL433_CONFIG_ADDR A:0xe66d884
y.create.l HWIO_PMIC_ARB_OBS6_CHNL434_CONFIG_ADDR A:0xe66d904
y.create.l HWIO_PMIC_ARB_OBS6_CHNL435_CONFIG_ADDR A:0xe66d984
y.create.l HWIO_PMIC_ARB_OBS6_CHNL436_CONFIG_ADDR A:0xe66da04
y.create.l HWIO_PMIC_ARB_OBS6_CHNL437_CONFIG_ADDR A:0xe66da84
y.create.l HWIO_PMIC_ARB_OBS6_CHNL438_CONFIG_ADDR A:0xe66db04
y.create.l HWIO_PMIC_ARB_OBS6_CHNL439_CONFIG_ADDR A:0xe66db84
y.create.l HWIO_PMIC_ARB_OBS6_CHNL440_CONFIG_ADDR A:0xe66dc04
y.create.l HWIO_PMIC_ARB_OBS6_CHNL441_CONFIG_ADDR A:0xe66dc84
y.create.l HWIO_PMIC_ARB_OBS6_CHNL442_CONFIG_ADDR A:0xe66dd04
y.create.l HWIO_PMIC_ARB_OBS6_CHNL443_CONFIG_ADDR A:0xe66dd84
y.create.l HWIO_PMIC_ARB_OBS6_CHNL444_CONFIG_ADDR A:0xe66de04
y.create.l HWIO_PMIC_ARB_OBS6_CHNL445_CONFIG_ADDR A:0xe66de84
y.create.l HWIO_PMIC_ARB_OBS6_CHNL446_CONFIG_ADDR A:0xe66df04
y.create.l HWIO_PMIC_ARB_OBS6_CHNL447_CONFIG_ADDR A:0xe66df84
y.create.l HWIO_PMIC_ARB_OBS6_CHNL448_CONFIG_ADDR A:0xe66e004
y.create.l HWIO_PMIC_ARB_OBS6_CHNL449_CONFIG_ADDR A:0xe66e084
y.create.l HWIO_PMIC_ARB_OBS6_CHNL450_CONFIG_ADDR A:0xe66e104
y.create.l HWIO_PMIC_ARB_OBS6_CHNL451_CONFIG_ADDR A:0xe66e184
y.create.l HWIO_PMIC_ARB_OBS6_CHNL452_CONFIG_ADDR A:0xe66e204
y.create.l HWIO_PMIC_ARB_OBS6_CHNL453_CONFIG_ADDR A:0xe66e284
y.create.l HWIO_PMIC_ARB_OBS6_CHNL454_CONFIG_ADDR A:0xe66e304
y.create.l HWIO_PMIC_ARB_OBS6_CHNL455_CONFIG_ADDR A:0xe66e384
y.create.l HWIO_PMIC_ARB_OBS6_CHNL456_CONFIG_ADDR A:0xe66e404
y.create.l HWIO_PMIC_ARB_OBS6_CHNL457_CONFIG_ADDR A:0xe66e484
y.create.l HWIO_PMIC_ARB_OBS6_CHNL458_CONFIG_ADDR A:0xe66e504
y.create.l HWIO_PMIC_ARB_OBS6_CHNL459_CONFIG_ADDR A:0xe66e584
y.create.l HWIO_PMIC_ARB_OBS6_CHNL460_CONFIG_ADDR A:0xe66e604
y.create.l HWIO_PMIC_ARB_OBS6_CHNL461_CONFIG_ADDR A:0xe66e684
y.create.l HWIO_PMIC_ARB_OBS6_CHNL462_CONFIG_ADDR A:0xe66e704
y.create.l HWIO_PMIC_ARB_OBS6_CHNL463_CONFIG_ADDR A:0xe66e784
y.create.l HWIO_PMIC_ARB_OBS6_CHNL464_CONFIG_ADDR A:0xe66e804
y.create.l HWIO_PMIC_ARB_OBS6_CHNL465_CONFIG_ADDR A:0xe66e884
y.create.l HWIO_PMIC_ARB_OBS6_CHNL466_CONFIG_ADDR A:0xe66e904
y.create.l HWIO_PMIC_ARB_OBS6_CHNL467_CONFIG_ADDR A:0xe66e984
y.create.l HWIO_PMIC_ARB_OBS6_CHNL468_CONFIG_ADDR A:0xe66ea04
y.create.l HWIO_PMIC_ARB_OBS6_CHNL469_CONFIG_ADDR A:0xe66ea84
y.create.l HWIO_PMIC_ARB_OBS6_CHNL470_CONFIG_ADDR A:0xe66eb04
y.create.l HWIO_PMIC_ARB_OBS6_CHNL471_CONFIG_ADDR A:0xe66eb84
y.create.l HWIO_PMIC_ARB_OBS6_CHNL472_CONFIG_ADDR A:0xe66ec04
y.create.l HWIO_PMIC_ARB_OBS6_CHNL473_CONFIG_ADDR A:0xe66ec84
y.create.l HWIO_PMIC_ARB_OBS6_CHNL474_CONFIG_ADDR A:0xe66ed04
y.create.l HWIO_PMIC_ARB_OBS6_CHNL475_CONFIG_ADDR A:0xe66ed84
y.create.l HWIO_PMIC_ARB_OBS6_CHNL476_CONFIG_ADDR A:0xe66ee04
y.create.l HWIO_PMIC_ARB_OBS6_CHNL477_CONFIG_ADDR A:0xe66ee84
y.create.l HWIO_PMIC_ARB_OBS6_CHNL478_CONFIG_ADDR A:0xe66ef04
y.create.l HWIO_PMIC_ARB_OBS6_CHNL479_CONFIG_ADDR A:0xe66ef84
y.create.l HWIO_PMIC_ARB_OBS6_CHNL480_CONFIG_ADDR A:0xe66f004
y.create.l HWIO_PMIC_ARB_OBS6_CHNL481_CONFIG_ADDR A:0xe66f084
y.create.l HWIO_PMIC_ARB_OBS6_CHNL482_CONFIG_ADDR A:0xe66f104
y.create.l HWIO_PMIC_ARB_OBS6_CHNL483_CONFIG_ADDR A:0xe66f184
y.create.l HWIO_PMIC_ARB_OBS6_CHNL484_CONFIG_ADDR A:0xe66f204
y.create.l HWIO_PMIC_ARB_OBS6_CHNL485_CONFIG_ADDR A:0xe66f284
y.create.l HWIO_PMIC_ARB_OBS6_CHNL486_CONFIG_ADDR A:0xe66f304
y.create.l HWIO_PMIC_ARB_OBS6_CHNL487_CONFIG_ADDR A:0xe66f384
y.create.l HWIO_PMIC_ARB_OBS6_CHNL488_CONFIG_ADDR A:0xe66f404
y.create.l HWIO_PMIC_ARB_OBS6_CHNL489_CONFIG_ADDR A:0xe66f484
y.create.l HWIO_PMIC_ARB_OBS6_CHNL490_CONFIG_ADDR A:0xe66f504
y.create.l HWIO_PMIC_ARB_OBS6_CHNL491_CONFIG_ADDR A:0xe66f584
y.create.l HWIO_PMIC_ARB_OBS6_CHNL492_CONFIG_ADDR A:0xe66f604
y.create.l HWIO_PMIC_ARB_OBS6_CHNL493_CONFIG_ADDR A:0xe66f684
y.create.l HWIO_PMIC_ARB_OBS6_CHNL494_CONFIG_ADDR A:0xe66f704
y.create.l HWIO_PMIC_ARB_OBS6_CHNL495_CONFIG_ADDR A:0xe66f784
y.create.l HWIO_PMIC_ARB_OBS6_CHNL496_CONFIG_ADDR A:0xe66f804
y.create.l HWIO_PMIC_ARB_OBS6_CHNL497_CONFIG_ADDR A:0xe66f884
y.create.l HWIO_PMIC_ARB_OBS6_CHNL498_CONFIG_ADDR A:0xe66f904
y.create.l HWIO_PMIC_ARB_OBS6_CHNL499_CONFIG_ADDR A:0xe66f984
y.create.l HWIO_PMIC_ARB_OBS6_CHNL500_CONFIG_ADDR A:0xe66fa04
y.create.l HWIO_PMIC_ARB_OBS6_CHNL501_CONFIG_ADDR A:0xe66fa84
y.create.l HWIO_PMIC_ARB_OBS6_CHNL502_CONFIG_ADDR A:0xe66fb04
y.create.l HWIO_PMIC_ARB_OBS6_CHNL503_CONFIG_ADDR A:0xe66fb84
y.create.l HWIO_PMIC_ARB_OBS6_CHNL504_CONFIG_ADDR A:0xe66fc04
y.create.l HWIO_PMIC_ARB_OBS6_CHNL505_CONFIG_ADDR A:0xe66fc84
y.create.l HWIO_PMIC_ARB_OBS6_CHNL506_CONFIG_ADDR A:0xe66fd04
y.create.l HWIO_PMIC_ARB_OBS6_CHNL507_CONFIG_ADDR A:0xe66fd84
y.create.l HWIO_PMIC_ARB_OBS6_CHNL508_CONFIG_ADDR A:0xe66fe04
y.create.l HWIO_PMIC_ARB_OBS6_CHNL509_CONFIG_ADDR A:0xe66fe84
y.create.l HWIO_PMIC_ARB_OBS6_CHNL510_CONFIG_ADDR A:0xe66ff04
y.create.l HWIO_PMIC_ARB_OBS6_CHNL511_CONFIG_ADDR A:0xe66ff84
y.create.l HWIO_PMIC_ARB_OBS0_CHNL0_STATUS_ADDR A:0xe600008
y.create.l HWIO_PMIC_ARB_OBS0_CHNL1_STATUS_ADDR A:0xe600088
y.create.l HWIO_PMIC_ARB_OBS0_CHNL2_STATUS_ADDR A:0xe600108
y.create.l HWIO_PMIC_ARB_OBS0_CHNL3_STATUS_ADDR A:0xe600188
y.create.l HWIO_PMIC_ARB_OBS0_CHNL4_STATUS_ADDR A:0xe600208
y.create.l HWIO_PMIC_ARB_OBS0_CHNL5_STATUS_ADDR A:0xe600288
y.create.l HWIO_PMIC_ARB_OBS0_CHNL6_STATUS_ADDR A:0xe600308
y.create.l HWIO_PMIC_ARB_OBS0_CHNL7_STATUS_ADDR A:0xe600388
y.create.l HWIO_PMIC_ARB_OBS0_CHNL8_STATUS_ADDR A:0xe600408
y.create.l HWIO_PMIC_ARB_OBS0_CHNL9_STATUS_ADDR A:0xe600488
y.create.l HWIO_PMIC_ARB_OBS0_CHNL10_STATUS_ADDR A:0xe600508
y.create.l HWIO_PMIC_ARB_OBS0_CHNL11_STATUS_ADDR A:0xe600588
y.create.l HWIO_PMIC_ARB_OBS0_CHNL12_STATUS_ADDR A:0xe600608
y.create.l HWIO_PMIC_ARB_OBS0_CHNL13_STATUS_ADDR A:0xe600688
y.create.l HWIO_PMIC_ARB_OBS0_CHNL14_STATUS_ADDR A:0xe600708
y.create.l HWIO_PMIC_ARB_OBS0_CHNL15_STATUS_ADDR A:0xe600788
y.create.l HWIO_PMIC_ARB_OBS0_CHNL16_STATUS_ADDR A:0xe600808
y.create.l HWIO_PMIC_ARB_OBS0_CHNL17_STATUS_ADDR A:0xe600888
y.create.l HWIO_PMIC_ARB_OBS0_CHNL18_STATUS_ADDR A:0xe600908
y.create.l HWIO_PMIC_ARB_OBS0_CHNL19_STATUS_ADDR A:0xe600988
y.create.l HWIO_PMIC_ARB_OBS0_CHNL20_STATUS_ADDR A:0xe600a08
y.create.l HWIO_PMIC_ARB_OBS0_CHNL21_STATUS_ADDR A:0xe600a88
y.create.l HWIO_PMIC_ARB_OBS0_CHNL22_STATUS_ADDR A:0xe600b08
y.create.l HWIO_PMIC_ARB_OBS0_CHNL23_STATUS_ADDR A:0xe600b88
y.create.l HWIO_PMIC_ARB_OBS0_CHNL24_STATUS_ADDR A:0xe600c08
y.create.l HWIO_PMIC_ARB_OBS0_CHNL25_STATUS_ADDR A:0xe600c88
y.create.l HWIO_PMIC_ARB_OBS0_CHNL26_STATUS_ADDR A:0xe600d08
y.create.l HWIO_PMIC_ARB_OBS0_CHNL27_STATUS_ADDR A:0xe600d88
y.create.l HWIO_PMIC_ARB_OBS0_CHNL28_STATUS_ADDR A:0xe600e08
y.create.l HWIO_PMIC_ARB_OBS0_CHNL29_STATUS_ADDR A:0xe600e88
y.create.l HWIO_PMIC_ARB_OBS0_CHNL30_STATUS_ADDR A:0xe600f08
y.create.l HWIO_PMIC_ARB_OBS0_CHNL31_STATUS_ADDR A:0xe600f88
y.create.l HWIO_PMIC_ARB_OBS0_CHNL32_STATUS_ADDR A:0xe601008
y.create.l HWIO_PMIC_ARB_OBS0_CHNL33_STATUS_ADDR A:0xe601088
y.create.l HWIO_PMIC_ARB_OBS0_CHNL34_STATUS_ADDR A:0xe601108
y.create.l HWIO_PMIC_ARB_OBS0_CHNL35_STATUS_ADDR A:0xe601188
y.create.l HWIO_PMIC_ARB_OBS0_CHNL36_STATUS_ADDR A:0xe601208
y.create.l HWIO_PMIC_ARB_OBS0_CHNL37_STATUS_ADDR A:0xe601288
y.create.l HWIO_PMIC_ARB_OBS0_CHNL38_STATUS_ADDR A:0xe601308
y.create.l HWIO_PMIC_ARB_OBS0_CHNL39_STATUS_ADDR A:0xe601388
y.create.l HWIO_PMIC_ARB_OBS0_CHNL40_STATUS_ADDR A:0xe601408
y.create.l HWIO_PMIC_ARB_OBS0_CHNL41_STATUS_ADDR A:0xe601488
y.create.l HWIO_PMIC_ARB_OBS0_CHNL42_STATUS_ADDR A:0xe601508
y.create.l HWIO_PMIC_ARB_OBS0_CHNL43_STATUS_ADDR A:0xe601588
y.create.l HWIO_PMIC_ARB_OBS0_CHNL44_STATUS_ADDR A:0xe601608
y.create.l HWIO_PMIC_ARB_OBS0_CHNL45_STATUS_ADDR A:0xe601688
y.create.l HWIO_PMIC_ARB_OBS0_CHNL46_STATUS_ADDR A:0xe601708
y.create.l HWIO_PMIC_ARB_OBS0_CHNL47_STATUS_ADDR A:0xe601788
y.create.l HWIO_PMIC_ARB_OBS0_CHNL48_STATUS_ADDR A:0xe601808
y.create.l HWIO_PMIC_ARB_OBS0_CHNL49_STATUS_ADDR A:0xe601888
y.create.l HWIO_PMIC_ARB_OBS0_CHNL50_STATUS_ADDR A:0xe601908
y.create.l HWIO_PMIC_ARB_OBS0_CHNL51_STATUS_ADDR A:0xe601988
y.create.l HWIO_PMIC_ARB_OBS0_CHNL52_STATUS_ADDR A:0xe601a08
y.create.l HWIO_PMIC_ARB_OBS0_CHNL53_STATUS_ADDR A:0xe601a88
y.create.l HWIO_PMIC_ARB_OBS0_CHNL54_STATUS_ADDR A:0xe601b08
y.create.l HWIO_PMIC_ARB_OBS0_CHNL55_STATUS_ADDR A:0xe601b88
y.create.l HWIO_PMIC_ARB_OBS0_CHNL56_STATUS_ADDR A:0xe601c08
y.create.l HWIO_PMIC_ARB_OBS0_CHNL57_STATUS_ADDR A:0xe601c88
y.create.l HWIO_PMIC_ARB_OBS0_CHNL58_STATUS_ADDR A:0xe601d08
y.create.l HWIO_PMIC_ARB_OBS0_CHNL59_STATUS_ADDR A:0xe601d88
y.create.l HWIO_PMIC_ARB_OBS0_CHNL60_STATUS_ADDR A:0xe601e08
y.create.l HWIO_PMIC_ARB_OBS0_CHNL61_STATUS_ADDR A:0xe601e88
y.create.l HWIO_PMIC_ARB_OBS0_CHNL62_STATUS_ADDR A:0xe601f08
y.create.l HWIO_PMIC_ARB_OBS0_CHNL63_STATUS_ADDR A:0xe601f88
y.create.l HWIO_PMIC_ARB_OBS0_CHNL64_STATUS_ADDR A:0xe602008
y.create.l HWIO_PMIC_ARB_OBS0_CHNL65_STATUS_ADDR A:0xe602088
y.create.l HWIO_PMIC_ARB_OBS0_CHNL66_STATUS_ADDR A:0xe602108
y.create.l HWIO_PMIC_ARB_OBS0_CHNL67_STATUS_ADDR A:0xe602188
y.create.l HWIO_PMIC_ARB_OBS0_CHNL68_STATUS_ADDR A:0xe602208
y.create.l HWIO_PMIC_ARB_OBS0_CHNL69_STATUS_ADDR A:0xe602288
y.create.l HWIO_PMIC_ARB_OBS0_CHNL70_STATUS_ADDR A:0xe602308
y.create.l HWIO_PMIC_ARB_OBS0_CHNL71_STATUS_ADDR A:0xe602388
y.create.l HWIO_PMIC_ARB_OBS0_CHNL72_STATUS_ADDR A:0xe602408
y.create.l HWIO_PMIC_ARB_OBS0_CHNL73_STATUS_ADDR A:0xe602488
y.create.l HWIO_PMIC_ARB_OBS0_CHNL74_STATUS_ADDR A:0xe602508
y.create.l HWIO_PMIC_ARB_OBS0_CHNL75_STATUS_ADDR A:0xe602588
y.create.l HWIO_PMIC_ARB_OBS0_CHNL76_STATUS_ADDR A:0xe602608
y.create.l HWIO_PMIC_ARB_OBS0_CHNL77_STATUS_ADDR A:0xe602688
y.create.l HWIO_PMIC_ARB_OBS0_CHNL78_STATUS_ADDR A:0xe602708
y.create.l HWIO_PMIC_ARB_OBS0_CHNL79_STATUS_ADDR A:0xe602788
y.create.l HWIO_PMIC_ARB_OBS0_CHNL80_STATUS_ADDR A:0xe602808
y.create.l HWIO_PMIC_ARB_OBS0_CHNL81_STATUS_ADDR A:0xe602888
y.create.l HWIO_PMIC_ARB_OBS0_CHNL82_STATUS_ADDR A:0xe602908
y.create.l HWIO_PMIC_ARB_OBS0_CHNL83_STATUS_ADDR A:0xe602988
y.create.l HWIO_PMIC_ARB_OBS0_CHNL84_STATUS_ADDR A:0xe602a08
y.create.l HWIO_PMIC_ARB_OBS0_CHNL85_STATUS_ADDR A:0xe602a88
y.create.l HWIO_PMIC_ARB_OBS0_CHNL86_STATUS_ADDR A:0xe602b08
y.create.l HWIO_PMIC_ARB_OBS0_CHNL87_STATUS_ADDR A:0xe602b88
y.create.l HWIO_PMIC_ARB_OBS0_CHNL88_STATUS_ADDR A:0xe602c08
y.create.l HWIO_PMIC_ARB_OBS0_CHNL89_STATUS_ADDR A:0xe602c88
y.create.l HWIO_PMIC_ARB_OBS0_CHNL90_STATUS_ADDR A:0xe602d08
y.create.l HWIO_PMIC_ARB_OBS0_CHNL91_STATUS_ADDR A:0xe602d88
y.create.l HWIO_PMIC_ARB_OBS0_CHNL92_STATUS_ADDR A:0xe602e08
y.create.l HWIO_PMIC_ARB_OBS0_CHNL93_STATUS_ADDR A:0xe602e88
y.create.l HWIO_PMIC_ARB_OBS0_CHNL94_STATUS_ADDR A:0xe602f08
y.create.l HWIO_PMIC_ARB_OBS0_CHNL95_STATUS_ADDR A:0xe602f88
y.create.l HWIO_PMIC_ARB_OBS0_CHNL96_STATUS_ADDR A:0xe603008
y.create.l HWIO_PMIC_ARB_OBS0_CHNL97_STATUS_ADDR A:0xe603088
y.create.l HWIO_PMIC_ARB_OBS0_CHNL98_STATUS_ADDR A:0xe603108
y.create.l HWIO_PMIC_ARB_OBS0_CHNL99_STATUS_ADDR A:0xe603188
y.create.l HWIO_PMIC_ARB_OBS0_CHNL100_STATUS_ADDR A:0xe603208
y.create.l HWIO_PMIC_ARB_OBS0_CHNL101_STATUS_ADDR A:0xe603288
y.create.l HWIO_PMIC_ARB_OBS0_CHNL102_STATUS_ADDR A:0xe603308
y.create.l HWIO_PMIC_ARB_OBS0_CHNL103_STATUS_ADDR A:0xe603388
y.create.l HWIO_PMIC_ARB_OBS0_CHNL104_STATUS_ADDR A:0xe603408
y.create.l HWIO_PMIC_ARB_OBS0_CHNL105_STATUS_ADDR A:0xe603488
y.create.l HWIO_PMIC_ARB_OBS0_CHNL106_STATUS_ADDR A:0xe603508
y.create.l HWIO_PMIC_ARB_OBS0_CHNL107_STATUS_ADDR A:0xe603588
y.create.l HWIO_PMIC_ARB_OBS0_CHNL108_STATUS_ADDR A:0xe603608
y.create.l HWIO_PMIC_ARB_OBS0_CHNL109_STATUS_ADDR A:0xe603688
y.create.l HWIO_PMIC_ARB_OBS0_CHNL110_STATUS_ADDR A:0xe603708
y.create.l HWIO_PMIC_ARB_OBS0_CHNL111_STATUS_ADDR A:0xe603788
y.create.l HWIO_PMIC_ARB_OBS0_CHNL112_STATUS_ADDR A:0xe603808
y.create.l HWIO_PMIC_ARB_OBS0_CHNL113_STATUS_ADDR A:0xe603888
y.create.l HWIO_PMIC_ARB_OBS0_CHNL114_STATUS_ADDR A:0xe603908
y.create.l HWIO_PMIC_ARB_OBS0_CHNL115_STATUS_ADDR A:0xe603988
y.create.l HWIO_PMIC_ARB_OBS0_CHNL116_STATUS_ADDR A:0xe603a08
y.create.l HWIO_PMIC_ARB_OBS0_CHNL117_STATUS_ADDR A:0xe603a88
y.create.l HWIO_PMIC_ARB_OBS0_CHNL118_STATUS_ADDR A:0xe603b08
y.create.l HWIO_PMIC_ARB_OBS0_CHNL119_STATUS_ADDR A:0xe603b88
y.create.l HWIO_PMIC_ARB_OBS0_CHNL120_STATUS_ADDR A:0xe603c08
y.create.l HWIO_PMIC_ARB_OBS0_CHNL121_STATUS_ADDR A:0xe603c88
y.create.l HWIO_PMIC_ARB_OBS0_CHNL122_STATUS_ADDR A:0xe603d08
y.create.l HWIO_PMIC_ARB_OBS0_CHNL123_STATUS_ADDR A:0xe603d88
y.create.l HWIO_PMIC_ARB_OBS0_CHNL124_STATUS_ADDR A:0xe603e08
y.create.l HWIO_PMIC_ARB_OBS0_CHNL125_STATUS_ADDR A:0xe603e88
y.create.l HWIO_PMIC_ARB_OBS0_CHNL126_STATUS_ADDR A:0xe603f08
y.create.l HWIO_PMIC_ARB_OBS0_CHNL127_STATUS_ADDR A:0xe603f88
y.create.l HWIO_PMIC_ARB_OBS0_CHNL128_STATUS_ADDR A:0xe604008
y.create.l HWIO_PMIC_ARB_OBS0_CHNL129_STATUS_ADDR A:0xe604088
y.create.l HWIO_PMIC_ARB_OBS0_CHNL130_STATUS_ADDR A:0xe604108
y.create.l HWIO_PMIC_ARB_OBS0_CHNL131_STATUS_ADDR A:0xe604188
y.create.l HWIO_PMIC_ARB_OBS0_CHNL132_STATUS_ADDR A:0xe604208
y.create.l HWIO_PMIC_ARB_OBS0_CHNL133_STATUS_ADDR A:0xe604288
y.create.l HWIO_PMIC_ARB_OBS0_CHNL134_STATUS_ADDR A:0xe604308
y.create.l HWIO_PMIC_ARB_OBS0_CHNL135_STATUS_ADDR A:0xe604388
y.create.l HWIO_PMIC_ARB_OBS0_CHNL136_STATUS_ADDR A:0xe604408
y.create.l HWIO_PMIC_ARB_OBS0_CHNL137_STATUS_ADDR A:0xe604488
y.create.l HWIO_PMIC_ARB_OBS0_CHNL138_STATUS_ADDR A:0xe604508
y.create.l HWIO_PMIC_ARB_OBS0_CHNL139_STATUS_ADDR A:0xe604588
y.create.l HWIO_PMIC_ARB_OBS0_CHNL140_STATUS_ADDR A:0xe604608
y.create.l HWIO_PMIC_ARB_OBS0_CHNL141_STATUS_ADDR A:0xe604688
y.create.l HWIO_PMIC_ARB_OBS0_CHNL142_STATUS_ADDR A:0xe604708
y.create.l HWIO_PMIC_ARB_OBS0_CHNL143_STATUS_ADDR A:0xe604788
y.create.l HWIO_PMIC_ARB_OBS0_CHNL144_STATUS_ADDR A:0xe604808
y.create.l HWIO_PMIC_ARB_OBS0_CHNL145_STATUS_ADDR A:0xe604888
y.create.l HWIO_PMIC_ARB_OBS0_CHNL146_STATUS_ADDR A:0xe604908
y.create.l HWIO_PMIC_ARB_OBS0_CHNL147_STATUS_ADDR A:0xe604988
y.create.l HWIO_PMIC_ARB_OBS0_CHNL148_STATUS_ADDR A:0xe604a08
y.create.l HWIO_PMIC_ARB_OBS0_CHNL149_STATUS_ADDR A:0xe604a88
y.create.l HWIO_PMIC_ARB_OBS0_CHNL150_STATUS_ADDR A:0xe604b08
y.create.l HWIO_PMIC_ARB_OBS0_CHNL151_STATUS_ADDR A:0xe604b88
y.create.l HWIO_PMIC_ARB_OBS0_CHNL152_STATUS_ADDR A:0xe604c08
y.create.l HWIO_PMIC_ARB_OBS0_CHNL153_STATUS_ADDR A:0xe604c88
y.create.l HWIO_PMIC_ARB_OBS0_CHNL154_STATUS_ADDR A:0xe604d08
y.create.l HWIO_PMIC_ARB_OBS0_CHNL155_STATUS_ADDR A:0xe604d88
y.create.l HWIO_PMIC_ARB_OBS0_CHNL156_STATUS_ADDR A:0xe604e08
y.create.l HWIO_PMIC_ARB_OBS0_CHNL157_STATUS_ADDR A:0xe604e88
y.create.l HWIO_PMIC_ARB_OBS0_CHNL158_STATUS_ADDR A:0xe604f08
y.create.l HWIO_PMIC_ARB_OBS0_CHNL159_STATUS_ADDR A:0xe604f88
y.create.l HWIO_PMIC_ARB_OBS0_CHNL160_STATUS_ADDR A:0xe605008
y.create.l HWIO_PMIC_ARB_OBS0_CHNL161_STATUS_ADDR A:0xe605088
y.create.l HWIO_PMIC_ARB_OBS0_CHNL162_STATUS_ADDR A:0xe605108
y.create.l HWIO_PMIC_ARB_OBS0_CHNL163_STATUS_ADDR A:0xe605188
y.create.l HWIO_PMIC_ARB_OBS0_CHNL164_STATUS_ADDR A:0xe605208
y.create.l HWIO_PMIC_ARB_OBS0_CHNL165_STATUS_ADDR A:0xe605288
y.create.l HWIO_PMIC_ARB_OBS0_CHNL166_STATUS_ADDR A:0xe605308
y.create.l HWIO_PMIC_ARB_OBS0_CHNL167_STATUS_ADDR A:0xe605388
y.create.l HWIO_PMIC_ARB_OBS0_CHNL168_STATUS_ADDR A:0xe605408
y.create.l HWIO_PMIC_ARB_OBS0_CHNL169_STATUS_ADDR A:0xe605488
y.create.l HWIO_PMIC_ARB_OBS0_CHNL170_STATUS_ADDR A:0xe605508
y.create.l HWIO_PMIC_ARB_OBS0_CHNL171_STATUS_ADDR A:0xe605588
y.create.l HWIO_PMIC_ARB_OBS0_CHNL172_STATUS_ADDR A:0xe605608
y.create.l HWIO_PMIC_ARB_OBS0_CHNL173_STATUS_ADDR A:0xe605688
y.create.l HWIO_PMIC_ARB_OBS0_CHNL174_STATUS_ADDR A:0xe605708
y.create.l HWIO_PMIC_ARB_OBS0_CHNL175_STATUS_ADDR A:0xe605788
y.create.l HWIO_PMIC_ARB_OBS0_CHNL176_STATUS_ADDR A:0xe605808
y.create.l HWIO_PMIC_ARB_OBS0_CHNL177_STATUS_ADDR A:0xe605888
y.create.l HWIO_PMIC_ARB_OBS0_CHNL178_STATUS_ADDR A:0xe605908
y.create.l HWIO_PMIC_ARB_OBS0_CHNL179_STATUS_ADDR A:0xe605988
y.create.l HWIO_PMIC_ARB_OBS0_CHNL180_STATUS_ADDR A:0xe605a08
y.create.l HWIO_PMIC_ARB_OBS0_CHNL181_STATUS_ADDR A:0xe605a88
y.create.l HWIO_PMIC_ARB_OBS0_CHNL182_STATUS_ADDR A:0xe605b08
y.create.l HWIO_PMIC_ARB_OBS0_CHNL183_STATUS_ADDR A:0xe605b88
y.create.l HWIO_PMIC_ARB_OBS0_CHNL184_STATUS_ADDR A:0xe605c08
y.create.l HWIO_PMIC_ARB_OBS0_CHNL185_STATUS_ADDR A:0xe605c88
y.create.l HWIO_PMIC_ARB_OBS0_CHNL186_STATUS_ADDR A:0xe605d08
y.create.l HWIO_PMIC_ARB_OBS0_CHNL187_STATUS_ADDR A:0xe605d88
y.create.l HWIO_PMIC_ARB_OBS0_CHNL188_STATUS_ADDR A:0xe605e08
y.create.l HWIO_PMIC_ARB_OBS0_CHNL189_STATUS_ADDR A:0xe605e88
y.create.l HWIO_PMIC_ARB_OBS0_CHNL190_STATUS_ADDR A:0xe605f08
y.create.l HWIO_PMIC_ARB_OBS0_CHNL191_STATUS_ADDR A:0xe605f88
y.create.l HWIO_PMIC_ARB_OBS0_CHNL192_STATUS_ADDR A:0xe606008
y.create.l HWIO_PMIC_ARB_OBS0_CHNL193_STATUS_ADDR A:0xe606088
y.create.l HWIO_PMIC_ARB_OBS0_CHNL194_STATUS_ADDR A:0xe606108
y.create.l HWIO_PMIC_ARB_OBS0_CHNL195_STATUS_ADDR A:0xe606188
y.create.l HWIO_PMIC_ARB_OBS0_CHNL196_STATUS_ADDR A:0xe606208
y.create.l HWIO_PMIC_ARB_OBS0_CHNL197_STATUS_ADDR A:0xe606288
y.create.l HWIO_PMIC_ARB_OBS0_CHNL198_STATUS_ADDR A:0xe606308
y.create.l HWIO_PMIC_ARB_OBS0_CHNL199_STATUS_ADDR A:0xe606388
y.create.l HWIO_PMIC_ARB_OBS0_CHNL200_STATUS_ADDR A:0xe606408
y.create.l HWIO_PMIC_ARB_OBS0_CHNL201_STATUS_ADDR A:0xe606488
y.create.l HWIO_PMIC_ARB_OBS0_CHNL202_STATUS_ADDR A:0xe606508
y.create.l HWIO_PMIC_ARB_OBS0_CHNL203_STATUS_ADDR A:0xe606588
y.create.l HWIO_PMIC_ARB_OBS0_CHNL204_STATUS_ADDR A:0xe606608
y.create.l HWIO_PMIC_ARB_OBS0_CHNL205_STATUS_ADDR A:0xe606688
y.create.l HWIO_PMIC_ARB_OBS0_CHNL206_STATUS_ADDR A:0xe606708
y.create.l HWIO_PMIC_ARB_OBS0_CHNL207_STATUS_ADDR A:0xe606788
y.create.l HWIO_PMIC_ARB_OBS0_CHNL208_STATUS_ADDR A:0xe606808
y.create.l HWIO_PMIC_ARB_OBS0_CHNL209_STATUS_ADDR A:0xe606888
y.create.l HWIO_PMIC_ARB_OBS0_CHNL210_STATUS_ADDR A:0xe606908
y.create.l HWIO_PMIC_ARB_OBS0_CHNL211_STATUS_ADDR A:0xe606988
y.create.l HWIO_PMIC_ARB_OBS0_CHNL212_STATUS_ADDR A:0xe606a08
y.create.l HWIO_PMIC_ARB_OBS0_CHNL213_STATUS_ADDR A:0xe606a88
y.create.l HWIO_PMIC_ARB_OBS0_CHNL214_STATUS_ADDR A:0xe606b08
y.create.l HWIO_PMIC_ARB_OBS0_CHNL215_STATUS_ADDR A:0xe606b88
y.create.l HWIO_PMIC_ARB_OBS0_CHNL216_STATUS_ADDR A:0xe606c08
y.create.l HWIO_PMIC_ARB_OBS0_CHNL217_STATUS_ADDR A:0xe606c88
y.create.l HWIO_PMIC_ARB_OBS0_CHNL218_STATUS_ADDR A:0xe606d08
y.create.l HWIO_PMIC_ARB_OBS0_CHNL219_STATUS_ADDR A:0xe606d88
y.create.l HWIO_PMIC_ARB_OBS0_CHNL220_STATUS_ADDR A:0xe606e08
y.create.l HWIO_PMIC_ARB_OBS0_CHNL221_STATUS_ADDR A:0xe606e88
y.create.l HWIO_PMIC_ARB_OBS0_CHNL222_STATUS_ADDR A:0xe606f08
y.create.l HWIO_PMIC_ARB_OBS0_CHNL223_STATUS_ADDR A:0xe606f88
y.create.l HWIO_PMIC_ARB_OBS0_CHNL224_STATUS_ADDR A:0xe607008
y.create.l HWIO_PMIC_ARB_OBS0_CHNL225_STATUS_ADDR A:0xe607088
y.create.l HWIO_PMIC_ARB_OBS0_CHNL226_STATUS_ADDR A:0xe607108
y.create.l HWIO_PMIC_ARB_OBS0_CHNL227_STATUS_ADDR A:0xe607188
y.create.l HWIO_PMIC_ARB_OBS0_CHNL228_STATUS_ADDR A:0xe607208
y.create.l HWIO_PMIC_ARB_OBS0_CHNL229_STATUS_ADDR A:0xe607288
y.create.l HWIO_PMIC_ARB_OBS0_CHNL230_STATUS_ADDR A:0xe607308
y.create.l HWIO_PMIC_ARB_OBS0_CHNL231_STATUS_ADDR A:0xe607388
y.create.l HWIO_PMIC_ARB_OBS0_CHNL232_STATUS_ADDR A:0xe607408
y.create.l HWIO_PMIC_ARB_OBS0_CHNL233_STATUS_ADDR A:0xe607488
y.create.l HWIO_PMIC_ARB_OBS0_CHNL234_STATUS_ADDR A:0xe607508
y.create.l HWIO_PMIC_ARB_OBS0_CHNL235_STATUS_ADDR A:0xe607588
y.create.l HWIO_PMIC_ARB_OBS0_CHNL236_STATUS_ADDR A:0xe607608
y.create.l HWIO_PMIC_ARB_OBS0_CHNL237_STATUS_ADDR A:0xe607688
y.create.l HWIO_PMIC_ARB_OBS0_CHNL238_STATUS_ADDR A:0xe607708
y.create.l HWIO_PMIC_ARB_OBS0_CHNL239_STATUS_ADDR A:0xe607788
y.create.l HWIO_PMIC_ARB_OBS0_CHNL240_STATUS_ADDR A:0xe607808
y.create.l HWIO_PMIC_ARB_OBS0_CHNL241_STATUS_ADDR A:0xe607888
y.create.l HWIO_PMIC_ARB_OBS0_CHNL242_STATUS_ADDR A:0xe607908
y.create.l HWIO_PMIC_ARB_OBS0_CHNL243_STATUS_ADDR A:0xe607988
y.create.l HWIO_PMIC_ARB_OBS0_CHNL244_STATUS_ADDR A:0xe607a08
y.create.l HWIO_PMIC_ARB_OBS0_CHNL245_STATUS_ADDR A:0xe607a88
y.create.l HWIO_PMIC_ARB_OBS0_CHNL246_STATUS_ADDR A:0xe607b08
y.create.l HWIO_PMIC_ARB_OBS0_CHNL247_STATUS_ADDR A:0xe607b88
y.create.l HWIO_PMIC_ARB_OBS0_CHNL248_STATUS_ADDR A:0xe607c08
y.create.l HWIO_PMIC_ARB_OBS0_CHNL249_STATUS_ADDR A:0xe607c88
y.create.l HWIO_PMIC_ARB_OBS0_CHNL250_STATUS_ADDR A:0xe607d08
y.create.l HWIO_PMIC_ARB_OBS0_CHNL251_STATUS_ADDR A:0xe607d88
y.create.l HWIO_PMIC_ARB_OBS0_CHNL252_STATUS_ADDR A:0xe607e08
y.create.l HWIO_PMIC_ARB_OBS0_CHNL253_STATUS_ADDR A:0xe607e88
y.create.l HWIO_PMIC_ARB_OBS0_CHNL254_STATUS_ADDR A:0xe607f08
y.create.l HWIO_PMIC_ARB_OBS0_CHNL255_STATUS_ADDR A:0xe607f88
y.create.l HWIO_PMIC_ARB_OBS0_CHNL256_STATUS_ADDR A:0xe608008
y.create.l HWIO_PMIC_ARB_OBS0_CHNL257_STATUS_ADDR A:0xe608088
y.create.l HWIO_PMIC_ARB_OBS0_CHNL258_STATUS_ADDR A:0xe608108
y.create.l HWIO_PMIC_ARB_OBS0_CHNL259_STATUS_ADDR A:0xe608188
y.create.l HWIO_PMIC_ARB_OBS0_CHNL260_STATUS_ADDR A:0xe608208
y.create.l HWIO_PMIC_ARB_OBS0_CHNL261_STATUS_ADDR A:0xe608288
y.create.l HWIO_PMIC_ARB_OBS0_CHNL262_STATUS_ADDR A:0xe608308
y.create.l HWIO_PMIC_ARB_OBS0_CHNL263_STATUS_ADDR A:0xe608388
y.create.l HWIO_PMIC_ARB_OBS0_CHNL264_STATUS_ADDR A:0xe608408
y.create.l HWIO_PMIC_ARB_OBS0_CHNL265_STATUS_ADDR A:0xe608488
y.create.l HWIO_PMIC_ARB_OBS0_CHNL266_STATUS_ADDR A:0xe608508
y.create.l HWIO_PMIC_ARB_OBS0_CHNL267_STATUS_ADDR A:0xe608588
y.create.l HWIO_PMIC_ARB_OBS0_CHNL268_STATUS_ADDR A:0xe608608
y.create.l HWIO_PMIC_ARB_OBS0_CHNL269_STATUS_ADDR A:0xe608688
y.create.l HWIO_PMIC_ARB_OBS0_CHNL270_STATUS_ADDR A:0xe608708
y.create.l HWIO_PMIC_ARB_OBS0_CHNL271_STATUS_ADDR A:0xe608788
y.create.l HWIO_PMIC_ARB_OBS0_CHNL272_STATUS_ADDR A:0xe608808
y.create.l HWIO_PMIC_ARB_OBS0_CHNL273_STATUS_ADDR A:0xe608888
y.create.l HWIO_PMIC_ARB_OBS0_CHNL274_STATUS_ADDR A:0xe608908
y.create.l HWIO_PMIC_ARB_OBS0_CHNL275_STATUS_ADDR A:0xe608988
y.create.l HWIO_PMIC_ARB_OBS0_CHNL276_STATUS_ADDR A:0xe608a08
y.create.l HWIO_PMIC_ARB_OBS0_CHNL277_STATUS_ADDR A:0xe608a88
y.create.l HWIO_PMIC_ARB_OBS0_CHNL278_STATUS_ADDR A:0xe608b08
y.create.l HWIO_PMIC_ARB_OBS0_CHNL279_STATUS_ADDR A:0xe608b88
y.create.l HWIO_PMIC_ARB_OBS0_CHNL280_STATUS_ADDR A:0xe608c08
y.create.l HWIO_PMIC_ARB_OBS0_CHNL281_STATUS_ADDR A:0xe608c88
y.create.l HWIO_PMIC_ARB_OBS0_CHNL282_STATUS_ADDR A:0xe608d08
y.create.l HWIO_PMIC_ARB_OBS0_CHNL283_STATUS_ADDR A:0xe608d88
y.create.l HWIO_PMIC_ARB_OBS0_CHNL284_STATUS_ADDR A:0xe608e08
y.create.l HWIO_PMIC_ARB_OBS0_CHNL285_STATUS_ADDR A:0xe608e88
y.create.l HWIO_PMIC_ARB_OBS0_CHNL286_STATUS_ADDR A:0xe608f08
y.create.l HWIO_PMIC_ARB_OBS0_CHNL287_STATUS_ADDR A:0xe608f88
y.create.l HWIO_PMIC_ARB_OBS0_CHNL288_STATUS_ADDR A:0xe609008
y.create.l HWIO_PMIC_ARB_OBS0_CHNL289_STATUS_ADDR A:0xe609088
y.create.l HWIO_PMIC_ARB_OBS0_CHNL290_STATUS_ADDR A:0xe609108
y.create.l HWIO_PMIC_ARB_OBS0_CHNL291_STATUS_ADDR A:0xe609188
y.create.l HWIO_PMIC_ARB_OBS0_CHNL292_STATUS_ADDR A:0xe609208
y.create.l HWIO_PMIC_ARB_OBS0_CHNL293_STATUS_ADDR A:0xe609288
y.create.l HWIO_PMIC_ARB_OBS0_CHNL294_STATUS_ADDR A:0xe609308
y.create.l HWIO_PMIC_ARB_OBS0_CHNL295_STATUS_ADDR A:0xe609388
y.create.l HWIO_PMIC_ARB_OBS0_CHNL296_STATUS_ADDR A:0xe609408
y.create.l HWIO_PMIC_ARB_OBS0_CHNL297_STATUS_ADDR A:0xe609488
y.create.l HWIO_PMIC_ARB_OBS0_CHNL298_STATUS_ADDR A:0xe609508
y.create.l HWIO_PMIC_ARB_OBS0_CHNL299_STATUS_ADDR A:0xe609588
y.create.l HWIO_PMIC_ARB_OBS0_CHNL300_STATUS_ADDR A:0xe609608
y.create.l HWIO_PMIC_ARB_OBS0_CHNL301_STATUS_ADDR A:0xe609688
y.create.l HWIO_PMIC_ARB_OBS0_CHNL302_STATUS_ADDR A:0xe609708
y.create.l HWIO_PMIC_ARB_OBS0_CHNL303_STATUS_ADDR A:0xe609788
y.create.l HWIO_PMIC_ARB_OBS0_CHNL304_STATUS_ADDR A:0xe609808
y.create.l HWIO_PMIC_ARB_OBS0_CHNL305_STATUS_ADDR A:0xe609888
y.create.l HWIO_PMIC_ARB_OBS0_CHNL306_STATUS_ADDR A:0xe609908
y.create.l HWIO_PMIC_ARB_OBS0_CHNL307_STATUS_ADDR A:0xe609988
y.create.l HWIO_PMIC_ARB_OBS0_CHNL308_STATUS_ADDR A:0xe609a08
y.create.l HWIO_PMIC_ARB_OBS0_CHNL309_STATUS_ADDR A:0xe609a88
y.create.l HWIO_PMIC_ARB_OBS0_CHNL310_STATUS_ADDR A:0xe609b08
y.create.l HWIO_PMIC_ARB_OBS0_CHNL311_STATUS_ADDR A:0xe609b88
y.create.l HWIO_PMIC_ARB_OBS0_CHNL312_STATUS_ADDR A:0xe609c08
y.create.l HWIO_PMIC_ARB_OBS0_CHNL313_STATUS_ADDR A:0xe609c88
y.create.l HWIO_PMIC_ARB_OBS0_CHNL314_STATUS_ADDR A:0xe609d08
y.create.l HWIO_PMIC_ARB_OBS0_CHNL315_STATUS_ADDR A:0xe609d88
y.create.l HWIO_PMIC_ARB_OBS0_CHNL316_STATUS_ADDR A:0xe609e08
y.create.l HWIO_PMIC_ARB_OBS0_CHNL317_STATUS_ADDR A:0xe609e88
y.create.l HWIO_PMIC_ARB_OBS0_CHNL318_STATUS_ADDR A:0xe609f08
y.create.l HWIO_PMIC_ARB_OBS0_CHNL319_STATUS_ADDR A:0xe609f88
y.create.l HWIO_PMIC_ARB_OBS0_CHNL320_STATUS_ADDR A:0xe60a008
y.create.l HWIO_PMIC_ARB_OBS0_CHNL321_STATUS_ADDR A:0xe60a088
y.create.l HWIO_PMIC_ARB_OBS0_CHNL322_STATUS_ADDR A:0xe60a108
y.create.l HWIO_PMIC_ARB_OBS0_CHNL323_STATUS_ADDR A:0xe60a188
y.create.l HWIO_PMIC_ARB_OBS0_CHNL324_STATUS_ADDR A:0xe60a208
y.create.l HWIO_PMIC_ARB_OBS0_CHNL325_STATUS_ADDR A:0xe60a288
y.create.l HWIO_PMIC_ARB_OBS0_CHNL326_STATUS_ADDR A:0xe60a308
y.create.l HWIO_PMIC_ARB_OBS0_CHNL327_STATUS_ADDR A:0xe60a388
y.create.l HWIO_PMIC_ARB_OBS0_CHNL328_STATUS_ADDR A:0xe60a408
y.create.l HWIO_PMIC_ARB_OBS0_CHNL329_STATUS_ADDR A:0xe60a488
y.create.l HWIO_PMIC_ARB_OBS0_CHNL330_STATUS_ADDR A:0xe60a508
y.create.l HWIO_PMIC_ARB_OBS0_CHNL331_STATUS_ADDR A:0xe60a588
y.create.l HWIO_PMIC_ARB_OBS0_CHNL332_STATUS_ADDR A:0xe60a608
y.create.l HWIO_PMIC_ARB_OBS0_CHNL333_STATUS_ADDR A:0xe60a688
y.create.l HWIO_PMIC_ARB_OBS0_CHNL334_STATUS_ADDR A:0xe60a708
y.create.l HWIO_PMIC_ARB_OBS0_CHNL335_STATUS_ADDR A:0xe60a788
y.create.l HWIO_PMIC_ARB_OBS0_CHNL336_STATUS_ADDR A:0xe60a808
y.create.l HWIO_PMIC_ARB_OBS0_CHNL337_STATUS_ADDR A:0xe60a888
y.create.l HWIO_PMIC_ARB_OBS0_CHNL338_STATUS_ADDR A:0xe60a908
y.create.l HWIO_PMIC_ARB_OBS0_CHNL339_STATUS_ADDR A:0xe60a988
y.create.l HWIO_PMIC_ARB_OBS0_CHNL340_STATUS_ADDR A:0xe60aa08
y.create.l HWIO_PMIC_ARB_OBS0_CHNL341_STATUS_ADDR A:0xe60aa88
y.create.l HWIO_PMIC_ARB_OBS0_CHNL342_STATUS_ADDR A:0xe60ab08
y.create.l HWIO_PMIC_ARB_OBS0_CHNL343_STATUS_ADDR A:0xe60ab88
y.create.l HWIO_PMIC_ARB_OBS0_CHNL344_STATUS_ADDR A:0xe60ac08
y.create.l HWIO_PMIC_ARB_OBS0_CHNL345_STATUS_ADDR A:0xe60ac88
y.create.l HWIO_PMIC_ARB_OBS0_CHNL346_STATUS_ADDR A:0xe60ad08
y.create.l HWIO_PMIC_ARB_OBS0_CHNL347_STATUS_ADDR A:0xe60ad88
y.create.l HWIO_PMIC_ARB_OBS0_CHNL348_STATUS_ADDR A:0xe60ae08
y.create.l HWIO_PMIC_ARB_OBS0_CHNL349_STATUS_ADDR A:0xe60ae88
y.create.l HWIO_PMIC_ARB_OBS0_CHNL350_STATUS_ADDR A:0xe60af08
y.create.l HWIO_PMIC_ARB_OBS0_CHNL351_STATUS_ADDR A:0xe60af88
y.create.l HWIO_PMIC_ARB_OBS0_CHNL352_STATUS_ADDR A:0xe60b008
y.create.l HWIO_PMIC_ARB_OBS0_CHNL353_STATUS_ADDR A:0xe60b088
y.create.l HWIO_PMIC_ARB_OBS0_CHNL354_STATUS_ADDR A:0xe60b108
y.create.l HWIO_PMIC_ARB_OBS0_CHNL355_STATUS_ADDR A:0xe60b188
y.create.l HWIO_PMIC_ARB_OBS0_CHNL356_STATUS_ADDR A:0xe60b208
y.create.l HWIO_PMIC_ARB_OBS0_CHNL357_STATUS_ADDR A:0xe60b288
y.create.l HWIO_PMIC_ARB_OBS0_CHNL358_STATUS_ADDR A:0xe60b308
y.create.l HWIO_PMIC_ARB_OBS0_CHNL359_STATUS_ADDR A:0xe60b388
y.create.l HWIO_PMIC_ARB_OBS0_CHNL360_STATUS_ADDR A:0xe60b408
y.create.l HWIO_PMIC_ARB_OBS0_CHNL361_STATUS_ADDR A:0xe60b488
y.create.l HWIO_PMIC_ARB_OBS0_CHNL362_STATUS_ADDR A:0xe60b508
y.create.l HWIO_PMIC_ARB_OBS0_CHNL363_STATUS_ADDR A:0xe60b588
y.create.l HWIO_PMIC_ARB_OBS0_CHNL364_STATUS_ADDR A:0xe60b608
y.create.l HWIO_PMIC_ARB_OBS0_CHNL365_STATUS_ADDR A:0xe60b688
y.create.l HWIO_PMIC_ARB_OBS0_CHNL366_STATUS_ADDR A:0xe60b708
y.create.l HWIO_PMIC_ARB_OBS0_CHNL367_STATUS_ADDR A:0xe60b788
y.create.l HWIO_PMIC_ARB_OBS0_CHNL368_STATUS_ADDR A:0xe60b808
y.create.l HWIO_PMIC_ARB_OBS0_CHNL369_STATUS_ADDR A:0xe60b888
y.create.l HWIO_PMIC_ARB_OBS0_CHNL370_STATUS_ADDR A:0xe60b908
y.create.l HWIO_PMIC_ARB_OBS0_CHNL371_STATUS_ADDR A:0xe60b988
y.create.l HWIO_PMIC_ARB_OBS0_CHNL372_STATUS_ADDR A:0xe60ba08
y.create.l HWIO_PMIC_ARB_OBS0_CHNL373_STATUS_ADDR A:0xe60ba88
y.create.l HWIO_PMIC_ARB_OBS0_CHNL374_STATUS_ADDR A:0xe60bb08
y.create.l HWIO_PMIC_ARB_OBS0_CHNL375_STATUS_ADDR A:0xe60bb88
y.create.l HWIO_PMIC_ARB_OBS0_CHNL376_STATUS_ADDR A:0xe60bc08
y.create.l HWIO_PMIC_ARB_OBS0_CHNL377_STATUS_ADDR A:0xe60bc88
y.create.l HWIO_PMIC_ARB_OBS0_CHNL378_STATUS_ADDR A:0xe60bd08
y.create.l HWIO_PMIC_ARB_OBS0_CHNL379_STATUS_ADDR A:0xe60bd88
y.create.l HWIO_PMIC_ARB_OBS0_CHNL380_STATUS_ADDR A:0xe60be08
y.create.l HWIO_PMIC_ARB_OBS0_CHNL381_STATUS_ADDR A:0xe60be88
y.create.l HWIO_PMIC_ARB_OBS0_CHNL382_STATUS_ADDR A:0xe60bf08
y.create.l HWIO_PMIC_ARB_OBS0_CHNL383_STATUS_ADDR A:0xe60bf88
y.create.l HWIO_PMIC_ARB_OBS0_CHNL384_STATUS_ADDR A:0xe60c008
y.create.l HWIO_PMIC_ARB_OBS0_CHNL385_STATUS_ADDR A:0xe60c088
y.create.l HWIO_PMIC_ARB_OBS0_CHNL386_STATUS_ADDR A:0xe60c108
y.create.l HWIO_PMIC_ARB_OBS0_CHNL387_STATUS_ADDR A:0xe60c188
y.create.l HWIO_PMIC_ARB_OBS0_CHNL388_STATUS_ADDR A:0xe60c208
y.create.l HWIO_PMIC_ARB_OBS0_CHNL389_STATUS_ADDR A:0xe60c288
y.create.l HWIO_PMIC_ARB_OBS0_CHNL390_STATUS_ADDR A:0xe60c308
y.create.l HWIO_PMIC_ARB_OBS0_CHNL391_STATUS_ADDR A:0xe60c388
y.create.l HWIO_PMIC_ARB_OBS0_CHNL392_STATUS_ADDR A:0xe60c408
y.create.l HWIO_PMIC_ARB_OBS0_CHNL393_STATUS_ADDR A:0xe60c488
y.create.l HWIO_PMIC_ARB_OBS0_CHNL394_STATUS_ADDR A:0xe60c508
y.create.l HWIO_PMIC_ARB_OBS0_CHNL395_STATUS_ADDR A:0xe60c588
y.create.l HWIO_PMIC_ARB_OBS0_CHNL396_STATUS_ADDR A:0xe60c608
y.create.l HWIO_PMIC_ARB_OBS0_CHNL397_STATUS_ADDR A:0xe60c688
y.create.l HWIO_PMIC_ARB_OBS0_CHNL398_STATUS_ADDR A:0xe60c708
y.create.l HWIO_PMIC_ARB_OBS0_CHNL399_STATUS_ADDR A:0xe60c788
y.create.l HWIO_PMIC_ARB_OBS0_CHNL400_STATUS_ADDR A:0xe60c808
y.create.l HWIO_PMIC_ARB_OBS0_CHNL401_STATUS_ADDR A:0xe60c888
y.create.l HWIO_PMIC_ARB_OBS0_CHNL402_STATUS_ADDR A:0xe60c908
y.create.l HWIO_PMIC_ARB_OBS0_CHNL403_STATUS_ADDR A:0xe60c988
y.create.l HWIO_PMIC_ARB_OBS0_CHNL404_STATUS_ADDR A:0xe60ca08
y.create.l HWIO_PMIC_ARB_OBS0_CHNL405_STATUS_ADDR A:0xe60ca88
y.create.l HWIO_PMIC_ARB_OBS0_CHNL406_STATUS_ADDR A:0xe60cb08
y.create.l HWIO_PMIC_ARB_OBS0_CHNL407_STATUS_ADDR A:0xe60cb88
y.create.l HWIO_PMIC_ARB_OBS0_CHNL408_STATUS_ADDR A:0xe60cc08
y.create.l HWIO_PMIC_ARB_OBS0_CHNL409_STATUS_ADDR A:0xe60cc88
y.create.l HWIO_PMIC_ARB_OBS0_CHNL410_STATUS_ADDR A:0xe60cd08
y.create.l HWIO_PMIC_ARB_OBS0_CHNL411_STATUS_ADDR A:0xe60cd88
y.create.l HWIO_PMIC_ARB_OBS0_CHNL412_STATUS_ADDR A:0xe60ce08
y.create.l HWIO_PMIC_ARB_OBS0_CHNL413_STATUS_ADDR A:0xe60ce88
y.create.l HWIO_PMIC_ARB_OBS0_CHNL414_STATUS_ADDR A:0xe60cf08
y.create.l HWIO_PMIC_ARB_OBS0_CHNL415_STATUS_ADDR A:0xe60cf88
y.create.l HWIO_PMIC_ARB_OBS0_CHNL416_STATUS_ADDR A:0xe60d008
y.create.l HWIO_PMIC_ARB_OBS0_CHNL417_STATUS_ADDR A:0xe60d088
y.create.l HWIO_PMIC_ARB_OBS0_CHNL418_STATUS_ADDR A:0xe60d108
y.create.l HWIO_PMIC_ARB_OBS0_CHNL419_STATUS_ADDR A:0xe60d188
y.create.l HWIO_PMIC_ARB_OBS0_CHNL420_STATUS_ADDR A:0xe60d208
y.create.l HWIO_PMIC_ARB_OBS0_CHNL421_STATUS_ADDR A:0xe60d288
y.create.l HWIO_PMIC_ARB_OBS0_CHNL422_STATUS_ADDR A:0xe60d308
y.create.l HWIO_PMIC_ARB_OBS0_CHNL423_STATUS_ADDR A:0xe60d388
y.create.l HWIO_PMIC_ARB_OBS0_CHNL424_STATUS_ADDR A:0xe60d408
y.create.l HWIO_PMIC_ARB_OBS0_CHNL425_STATUS_ADDR A:0xe60d488
y.create.l HWIO_PMIC_ARB_OBS0_CHNL426_STATUS_ADDR A:0xe60d508
y.create.l HWIO_PMIC_ARB_OBS0_CHNL427_STATUS_ADDR A:0xe60d588
y.create.l HWIO_PMIC_ARB_OBS0_CHNL428_STATUS_ADDR A:0xe60d608
y.create.l HWIO_PMIC_ARB_OBS0_CHNL429_STATUS_ADDR A:0xe60d688
y.create.l HWIO_PMIC_ARB_OBS0_CHNL430_STATUS_ADDR A:0xe60d708
y.create.l HWIO_PMIC_ARB_OBS0_CHNL431_STATUS_ADDR A:0xe60d788
y.create.l HWIO_PMIC_ARB_OBS0_CHNL432_STATUS_ADDR A:0xe60d808
y.create.l HWIO_PMIC_ARB_OBS0_CHNL433_STATUS_ADDR A:0xe60d888
y.create.l HWIO_PMIC_ARB_OBS0_CHNL434_STATUS_ADDR A:0xe60d908
y.create.l HWIO_PMIC_ARB_OBS0_CHNL435_STATUS_ADDR A:0xe60d988
y.create.l HWIO_PMIC_ARB_OBS0_CHNL436_STATUS_ADDR A:0xe60da08
y.create.l HWIO_PMIC_ARB_OBS0_CHNL437_STATUS_ADDR A:0xe60da88
y.create.l HWIO_PMIC_ARB_OBS0_CHNL438_STATUS_ADDR A:0xe60db08
y.create.l HWIO_PMIC_ARB_OBS0_CHNL439_STATUS_ADDR A:0xe60db88
y.create.l HWIO_PMIC_ARB_OBS0_CHNL440_STATUS_ADDR A:0xe60dc08
y.create.l HWIO_PMIC_ARB_OBS0_CHNL441_STATUS_ADDR A:0xe60dc88
y.create.l HWIO_PMIC_ARB_OBS0_CHNL442_STATUS_ADDR A:0xe60dd08
y.create.l HWIO_PMIC_ARB_OBS0_CHNL443_STATUS_ADDR A:0xe60dd88
y.create.l HWIO_PMIC_ARB_OBS0_CHNL444_STATUS_ADDR A:0xe60de08
y.create.l HWIO_PMIC_ARB_OBS0_CHNL445_STATUS_ADDR A:0xe60de88
y.create.l HWIO_PMIC_ARB_OBS0_CHNL446_STATUS_ADDR A:0xe60df08
y.create.l HWIO_PMIC_ARB_OBS0_CHNL447_STATUS_ADDR A:0xe60df88
y.create.l HWIO_PMIC_ARB_OBS0_CHNL448_STATUS_ADDR A:0xe60e008
y.create.l HWIO_PMIC_ARB_OBS0_CHNL449_STATUS_ADDR A:0xe60e088
y.create.l HWIO_PMIC_ARB_OBS0_CHNL450_STATUS_ADDR A:0xe60e108
y.create.l HWIO_PMIC_ARB_OBS0_CHNL451_STATUS_ADDR A:0xe60e188
y.create.l HWIO_PMIC_ARB_OBS0_CHNL452_STATUS_ADDR A:0xe60e208
y.create.l HWIO_PMIC_ARB_OBS0_CHNL453_STATUS_ADDR A:0xe60e288
y.create.l HWIO_PMIC_ARB_OBS0_CHNL454_STATUS_ADDR A:0xe60e308
y.create.l HWIO_PMIC_ARB_OBS0_CHNL455_STATUS_ADDR A:0xe60e388
y.create.l HWIO_PMIC_ARB_OBS0_CHNL456_STATUS_ADDR A:0xe60e408
y.create.l HWIO_PMIC_ARB_OBS0_CHNL457_STATUS_ADDR A:0xe60e488
y.create.l HWIO_PMIC_ARB_OBS0_CHNL458_STATUS_ADDR A:0xe60e508
y.create.l HWIO_PMIC_ARB_OBS0_CHNL459_STATUS_ADDR A:0xe60e588
y.create.l HWIO_PMIC_ARB_OBS0_CHNL460_STATUS_ADDR A:0xe60e608
y.create.l HWIO_PMIC_ARB_OBS0_CHNL461_STATUS_ADDR A:0xe60e688
y.create.l HWIO_PMIC_ARB_OBS0_CHNL462_STATUS_ADDR A:0xe60e708
y.create.l HWIO_PMIC_ARB_OBS0_CHNL463_STATUS_ADDR A:0xe60e788
y.create.l HWIO_PMIC_ARB_OBS0_CHNL464_STATUS_ADDR A:0xe60e808
y.create.l HWIO_PMIC_ARB_OBS0_CHNL465_STATUS_ADDR A:0xe60e888
y.create.l HWIO_PMIC_ARB_OBS0_CHNL466_STATUS_ADDR A:0xe60e908
y.create.l HWIO_PMIC_ARB_OBS0_CHNL467_STATUS_ADDR A:0xe60e988
y.create.l HWIO_PMIC_ARB_OBS0_CHNL468_STATUS_ADDR A:0xe60ea08
y.create.l HWIO_PMIC_ARB_OBS0_CHNL469_STATUS_ADDR A:0xe60ea88
y.create.l HWIO_PMIC_ARB_OBS0_CHNL470_STATUS_ADDR A:0xe60eb08
y.create.l HWIO_PMIC_ARB_OBS0_CHNL471_STATUS_ADDR A:0xe60eb88
y.create.l HWIO_PMIC_ARB_OBS0_CHNL472_STATUS_ADDR A:0xe60ec08
y.create.l HWIO_PMIC_ARB_OBS0_CHNL473_STATUS_ADDR A:0xe60ec88
y.create.l HWIO_PMIC_ARB_OBS0_CHNL474_STATUS_ADDR A:0xe60ed08
y.create.l HWIO_PMIC_ARB_OBS0_CHNL475_STATUS_ADDR A:0xe60ed88
y.create.l HWIO_PMIC_ARB_OBS0_CHNL476_STATUS_ADDR A:0xe60ee08
y.create.l HWIO_PMIC_ARB_OBS0_CHNL477_STATUS_ADDR A:0xe60ee88
y.create.l HWIO_PMIC_ARB_OBS0_CHNL478_STATUS_ADDR A:0xe60ef08
y.create.l HWIO_PMIC_ARB_OBS0_CHNL479_STATUS_ADDR A:0xe60ef88
y.create.l HWIO_PMIC_ARB_OBS0_CHNL480_STATUS_ADDR A:0xe60f008
y.create.l HWIO_PMIC_ARB_OBS0_CHNL481_STATUS_ADDR A:0xe60f088
y.create.l HWIO_PMIC_ARB_OBS0_CHNL482_STATUS_ADDR A:0xe60f108
y.create.l HWIO_PMIC_ARB_OBS0_CHNL483_STATUS_ADDR A:0xe60f188
y.create.l HWIO_PMIC_ARB_OBS0_CHNL484_STATUS_ADDR A:0xe60f208
y.create.l HWIO_PMIC_ARB_OBS0_CHNL485_STATUS_ADDR A:0xe60f288
y.create.l HWIO_PMIC_ARB_OBS0_CHNL486_STATUS_ADDR A:0xe60f308
y.create.l HWIO_PMIC_ARB_OBS0_CHNL487_STATUS_ADDR A:0xe60f388
y.create.l HWIO_PMIC_ARB_OBS0_CHNL488_STATUS_ADDR A:0xe60f408
y.create.l HWIO_PMIC_ARB_OBS0_CHNL489_STATUS_ADDR A:0xe60f488
y.create.l HWIO_PMIC_ARB_OBS0_CHNL490_STATUS_ADDR A:0xe60f508
y.create.l HWIO_PMIC_ARB_OBS0_CHNL491_STATUS_ADDR A:0xe60f588
y.create.l HWIO_PMIC_ARB_OBS0_CHNL492_STATUS_ADDR A:0xe60f608
y.create.l HWIO_PMIC_ARB_OBS0_CHNL493_STATUS_ADDR A:0xe60f688
y.create.l HWIO_PMIC_ARB_OBS0_CHNL494_STATUS_ADDR A:0xe60f708
y.create.l HWIO_PMIC_ARB_OBS0_CHNL495_STATUS_ADDR A:0xe60f788
y.create.l HWIO_PMIC_ARB_OBS0_CHNL496_STATUS_ADDR A:0xe60f808
y.create.l HWIO_PMIC_ARB_OBS0_CHNL497_STATUS_ADDR A:0xe60f888
y.create.l HWIO_PMIC_ARB_OBS0_CHNL498_STATUS_ADDR A:0xe60f908
y.create.l HWIO_PMIC_ARB_OBS0_CHNL499_STATUS_ADDR A:0xe60f988
y.create.l HWIO_PMIC_ARB_OBS0_CHNL500_STATUS_ADDR A:0xe60fa08
y.create.l HWIO_PMIC_ARB_OBS0_CHNL501_STATUS_ADDR A:0xe60fa88
y.create.l HWIO_PMIC_ARB_OBS0_CHNL502_STATUS_ADDR A:0xe60fb08
y.create.l HWIO_PMIC_ARB_OBS0_CHNL503_STATUS_ADDR A:0xe60fb88
y.create.l HWIO_PMIC_ARB_OBS0_CHNL504_STATUS_ADDR A:0xe60fc08
y.create.l HWIO_PMIC_ARB_OBS0_CHNL505_STATUS_ADDR A:0xe60fc88
y.create.l HWIO_PMIC_ARB_OBS0_CHNL506_STATUS_ADDR A:0xe60fd08
y.create.l HWIO_PMIC_ARB_OBS0_CHNL507_STATUS_ADDR A:0xe60fd88
y.create.l HWIO_PMIC_ARB_OBS0_CHNL508_STATUS_ADDR A:0xe60fe08
y.create.l HWIO_PMIC_ARB_OBS0_CHNL509_STATUS_ADDR A:0xe60fe88
y.create.l HWIO_PMIC_ARB_OBS0_CHNL510_STATUS_ADDR A:0xe60ff08
y.create.l HWIO_PMIC_ARB_OBS0_CHNL511_STATUS_ADDR A:0xe60ff88
y.create.l HWIO_PMIC_ARB_OBS1_CHNL0_STATUS_ADDR A:0xe610008
y.create.l HWIO_PMIC_ARB_OBS1_CHNL1_STATUS_ADDR A:0xe610088
y.create.l HWIO_PMIC_ARB_OBS1_CHNL2_STATUS_ADDR A:0xe610108
y.create.l HWIO_PMIC_ARB_OBS1_CHNL3_STATUS_ADDR A:0xe610188
y.create.l HWIO_PMIC_ARB_OBS1_CHNL4_STATUS_ADDR A:0xe610208
y.create.l HWIO_PMIC_ARB_OBS1_CHNL5_STATUS_ADDR A:0xe610288
y.create.l HWIO_PMIC_ARB_OBS1_CHNL6_STATUS_ADDR A:0xe610308
y.create.l HWIO_PMIC_ARB_OBS1_CHNL7_STATUS_ADDR A:0xe610388
y.create.l HWIO_PMIC_ARB_OBS1_CHNL8_STATUS_ADDR A:0xe610408
y.create.l HWIO_PMIC_ARB_OBS1_CHNL9_STATUS_ADDR A:0xe610488
y.create.l HWIO_PMIC_ARB_OBS1_CHNL10_STATUS_ADDR A:0xe610508
y.create.l HWIO_PMIC_ARB_OBS1_CHNL11_STATUS_ADDR A:0xe610588
y.create.l HWIO_PMIC_ARB_OBS1_CHNL12_STATUS_ADDR A:0xe610608
y.create.l HWIO_PMIC_ARB_OBS1_CHNL13_STATUS_ADDR A:0xe610688
y.create.l HWIO_PMIC_ARB_OBS1_CHNL14_STATUS_ADDR A:0xe610708
y.create.l HWIO_PMIC_ARB_OBS1_CHNL15_STATUS_ADDR A:0xe610788
y.create.l HWIO_PMIC_ARB_OBS1_CHNL16_STATUS_ADDR A:0xe610808
y.create.l HWIO_PMIC_ARB_OBS1_CHNL17_STATUS_ADDR A:0xe610888
y.create.l HWIO_PMIC_ARB_OBS1_CHNL18_STATUS_ADDR A:0xe610908
y.create.l HWIO_PMIC_ARB_OBS1_CHNL19_STATUS_ADDR A:0xe610988
y.create.l HWIO_PMIC_ARB_OBS1_CHNL20_STATUS_ADDR A:0xe610a08
y.create.l HWIO_PMIC_ARB_OBS1_CHNL21_STATUS_ADDR A:0xe610a88
y.create.l HWIO_PMIC_ARB_OBS1_CHNL22_STATUS_ADDR A:0xe610b08
y.create.l HWIO_PMIC_ARB_OBS1_CHNL23_STATUS_ADDR A:0xe610b88
y.create.l HWIO_PMIC_ARB_OBS1_CHNL24_STATUS_ADDR A:0xe610c08
y.create.l HWIO_PMIC_ARB_OBS1_CHNL25_STATUS_ADDR A:0xe610c88
y.create.l HWIO_PMIC_ARB_OBS1_CHNL26_STATUS_ADDR A:0xe610d08
y.create.l HWIO_PMIC_ARB_OBS1_CHNL27_STATUS_ADDR A:0xe610d88
y.create.l HWIO_PMIC_ARB_OBS1_CHNL28_STATUS_ADDR A:0xe610e08
y.create.l HWIO_PMIC_ARB_OBS1_CHNL29_STATUS_ADDR A:0xe610e88
y.create.l HWIO_PMIC_ARB_OBS1_CHNL30_STATUS_ADDR A:0xe610f08
y.create.l HWIO_PMIC_ARB_OBS1_CHNL31_STATUS_ADDR A:0xe610f88
y.create.l HWIO_PMIC_ARB_OBS1_CHNL32_STATUS_ADDR A:0xe611008
y.create.l HWIO_PMIC_ARB_OBS1_CHNL33_STATUS_ADDR A:0xe611088
y.create.l HWIO_PMIC_ARB_OBS1_CHNL34_STATUS_ADDR A:0xe611108
y.create.l HWIO_PMIC_ARB_OBS1_CHNL35_STATUS_ADDR A:0xe611188
y.create.l HWIO_PMIC_ARB_OBS1_CHNL36_STATUS_ADDR A:0xe611208
y.create.l HWIO_PMIC_ARB_OBS1_CHNL37_STATUS_ADDR A:0xe611288
y.create.l HWIO_PMIC_ARB_OBS1_CHNL38_STATUS_ADDR A:0xe611308
y.create.l HWIO_PMIC_ARB_OBS1_CHNL39_STATUS_ADDR A:0xe611388
y.create.l HWIO_PMIC_ARB_OBS1_CHNL40_STATUS_ADDR A:0xe611408
y.create.l HWIO_PMIC_ARB_OBS1_CHNL41_STATUS_ADDR A:0xe611488
y.create.l HWIO_PMIC_ARB_OBS1_CHNL42_STATUS_ADDR A:0xe611508
y.create.l HWIO_PMIC_ARB_OBS1_CHNL43_STATUS_ADDR A:0xe611588
y.create.l HWIO_PMIC_ARB_OBS1_CHNL44_STATUS_ADDR A:0xe611608
y.create.l HWIO_PMIC_ARB_OBS1_CHNL45_STATUS_ADDR A:0xe611688
y.create.l HWIO_PMIC_ARB_OBS1_CHNL46_STATUS_ADDR A:0xe611708
y.create.l HWIO_PMIC_ARB_OBS1_CHNL47_STATUS_ADDR A:0xe611788
y.create.l HWIO_PMIC_ARB_OBS1_CHNL48_STATUS_ADDR A:0xe611808
y.create.l HWIO_PMIC_ARB_OBS1_CHNL49_STATUS_ADDR A:0xe611888
y.create.l HWIO_PMIC_ARB_OBS1_CHNL50_STATUS_ADDR A:0xe611908
y.create.l HWIO_PMIC_ARB_OBS1_CHNL51_STATUS_ADDR A:0xe611988
y.create.l HWIO_PMIC_ARB_OBS1_CHNL52_STATUS_ADDR A:0xe611a08
y.create.l HWIO_PMIC_ARB_OBS1_CHNL53_STATUS_ADDR A:0xe611a88
y.create.l HWIO_PMIC_ARB_OBS1_CHNL54_STATUS_ADDR A:0xe611b08
y.create.l HWIO_PMIC_ARB_OBS1_CHNL55_STATUS_ADDR A:0xe611b88
y.create.l HWIO_PMIC_ARB_OBS1_CHNL56_STATUS_ADDR A:0xe611c08
y.create.l HWIO_PMIC_ARB_OBS1_CHNL57_STATUS_ADDR A:0xe611c88
y.create.l HWIO_PMIC_ARB_OBS1_CHNL58_STATUS_ADDR A:0xe611d08
y.create.l HWIO_PMIC_ARB_OBS1_CHNL59_STATUS_ADDR A:0xe611d88
y.create.l HWIO_PMIC_ARB_OBS1_CHNL60_STATUS_ADDR A:0xe611e08
y.create.l HWIO_PMIC_ARB_OBS1_CHNL61_STATUS_ADDR A:0xe611e88
y.create.l HWIO_PMIC_ARB_OBS1_CHNL62_STATUS_ADDR A:0xe611f08
y.create.l HWIO_PMIC_ARB_OBS1_CHNL63_STATUS_ADDR A:0xe611f88
y.create.l HWIO_PMIC_ARB_OBS1_CHNL64_STATUS_ADDR A:0xe612008
y.create.l HWIO_PMIC_ARB_OBS1_CHNL65_STATUS_ADDR A:0xe612088
y.create.l HWIO_PMIC_ARB_OBS1_CHNL66_STATUS_ADDR A:0xe612108
y.create.l HWIO_PMIC_ARB_OBS1_CHNL67_STATUS_ADDR A:0xe612188
y.create.l HWIO_PMIC_ARB_OBS1_CHNL68_STATUS_ADDR A:0xe612208
y.create.l HWIO_PMIC_ARB_OBS1_CHNL69_STATUS_ADDR A:0xe612288
y.create.l HWIO_PMIC_ARB_OBS1_CHNL70_STATUS_ADDR A:0xe612308
y.create.l HWIO_PMIC_ARB_OBS1_CHNL71_STATUS_ADDR A:0xe612388
y.create.l HWIO_PMIC_ARB_OBS1_CHNL72_STATUS_ADDR A:0xe612408
y.create.l HWIO_PMIC_ARB_OBS1_CHNL73_STATUS_ADDR A:0xe612488
y.create.l HWIO_PMIC_ARB_OBS1_CHNL74_STATUS_ADDR A:0xe612508
y.create.l HWIO_PMIC_ARB_OBS1_CHNL75_STATUS_ADDR A:0xe612588
y.create.l HWIO_PMIC_ARB_OBS1_CHNL76_STATUS_ADDR A:0xe612608
y.create.l HWIO_PMIC_ARB_OBS1_CHNL77_STATUS_ADDR A:0xe612688
y.create.l HWIO_PMIC_ARB_OBS1_CHNL78_STATUS_ADDR A:0xe612708
y.create.l HWIO_PMIC_ARB_OBS1_CHNL79_STATUS_ADDR A:0xe612788
y.create.l HWIO_PMIC_ARB_OBS1_CHNL80_STATUS_ADDR A:0xe612808
y.create.l HWIO_PMIC_ARB_OBS1_CHNL81_STATUS_ADDR A:0xe612888
y.create.l HWIO_PMIC_ARB_OBS1_CHNL82_STATUS_ADDR A:0xe612908
y.create.l HWIO_PMIC_ARB_OBS1_CHNL83_STATUS_ADDR A:0xe612988
y.create.l HWIO_PMIC_ARB_OBS1_CHNL84_STATUS_ADDR A:0xe612a08
y.create.l HWIO_PMIC_ARB_OBS1_CHNL85_STATUS_ADDR A:0xe612a88
y.create.l HWIO_PMIC_ARB_OBS1_CHNL86_STATUS_ADDR A:0xe612b08
y.create.l HWIO_PMIC_ARB_OBS1_CHNL87_STATUS_ADDR A:0xe612b88
y.create.l HWIO_PMIC_ARB_OBS1_CHNL88_STATUS_ADDR A:0xe612c08
y.create.l HWIO_PMIC_ARB_OBS1_CHNL89_STATUS_ADDR A:0xe612c88
y.create.l HWIO_PMIC_ARB_OBS1_CHNL90_STATUS_ADDR A:0xe612d08
y.create.l HWIO_PMIC_ARB_OBS1_CHNL91_STATUS_ADDR A:0xe612d88
y.create.l HWIO_PMIC_ARB_OBS1_CHNL92_STATUS_ADDR A:0xe612e08
y.create.l HWIO_PMIC_ARB_OBS1_CHNL93_STATUS_ADDR A:0xe612e88
y.create.l HWIO_PMIC_ARB_OBS1_CHNL94_STATUS_ADDR A:0xe612f08
y.create.l HWIO_PMIC_ARB_OBS1_CHNL95_STATUS_ADDR A:0xe612f88
y.create.l HWIO_PMIC_ARB_OBS1_CHNL96_STATUS_ADDR A:0xe613008
y.create.l HWIO_PMIC_ARB_OBS1_CHNL97_STATUS_ADDR A:0xe613088
y.create.l HWIO_PMIC_ARB_OBS1_CHNL98_STATUS_ADDR A:0xe613108
y.create.l HWIO_PMIC_ARB_OBS1_CHNL99_STATUS_ADDR A:0xe613188
y.create.l HWIO_PMIC_ARB_OBS1_CHNL100_STATUS_ADDR A:0xe613208
y.create.l HWIO_PMIC_ARB_OBS1_CHNL101_STATUS_ADDR A:0xe613288
y.create.l HWIO_PMIC_ARB_OBS1_CHNL102_STATUS_ADDR A:0xe613308
y.create.l HWIO_PMIC_ARB_OBS1_CHNL103_STATUS_ADDR A:0xe613388
y.create.l HWIO_PMIC_ARB_OBS1_CHNL104_STATUS_ADDR A:0xe613408
y.create.l HWIO_PMIC_ARB_OBS1_CHNL105_STATUS_ADDR A:0xe613488
y.create.l HWIO_PMIC_ARB_OBS1_CHNL106_STATUS_ADDR A:0xe613508
y.create.l HWIO_PMIC_ARB_OBS1_CHNL107_STATUS_ADDR A:0xe613588
y.create.l HWIO_PMIC_ARB_OBS1_CHNL108_STATUS_ADDR A:0xe613608
y.create.l HWIO_PMIC_ARB_OBS1_CHNL109_STATUS_ADDR A:0xe613688
y.create.l HWIO_PMIC_ARB_OBS1_CHNL110_STATUS_ADDR A:0xe613708
y.create.l HWIO_PMIC_ARB_OBS1_CHNL111_STATUS_ADDR A:0xe613788
y.create.l HWIO_PMIC_ARB_OBS1_CHNL112_STATUS_ADDR A:0xe613808
y.create.l HWIO_PMIC_ARB_OBS1_CHNL113_STATUS_ADDR A:0xe613888
y.create.l HWIO_PMIC_ARB_OBS1_CHNL114_STATUS_ADDR A:0xe613908
y.create.l HWIO_PMIC_ARB_OBS1_CHNL115_STATUS_ADDR A:0xe613988
y.create.l HWIO_PMIC_ARB_OBS1_CHNL116_STATUS_ADDR A:0xe613a08
y.create.l HWIO_PMIC_ARB_OBS1_CHNL117_STATUS_ADDR A:0xe613a88
y.create.l HWIO_PMIC_ARB_OBS1_CHNL118_STATUS_ADDR A:0xe613b08
y.create.l HWIO_PMIC_ARB_OBS1_CHNL119_STATUS_ADDR A:0xe613b88
y.create.l HWIO_PMIC_ARB_OBS1_CHNL120_STATUS_ADDR A:0xe613c08
y.create.l HWIO_PMIC_ARB_OBS1_CHNL121_STATUS_ADDR A:0xe613c88
y.create.l HWIO_PMIC_ARB_OBS1_CHNL122_STATUS_ADDR A:0xe613d08
y.create.l HWIO_PMIC_ARB_OBS1_CHNL123_STATUS_ADDR A:0xe613d88
y.create.l HWIO_PMIC_ARB_OBS1_CHNL124_STATUS_ADDR A:0xe613e08
y.create.l HWIO_PMIC_ARB_OBS1_CHNL125_STATUS_ADDR A:0xe613e88
y.create.l HWIO_PMIC_ARB_OBS1_CHNL126_STATUS_ADDR A:0xe613f08
y.create.l HWIO_PMIC_ARB_OBS1_CHNL127_STATUS_ADDR A:0xe613f88
y.create.l HWIO_PMIC_ARB_OBS1_CHNL128_STATUS_ADDR A:0xe614008
y.create.l HWIO_PMIC_ARB_OBS1_CHNL129_STATUS_ADDR A:0xe614088
y.create.l HWIO_PMIC_ARB_OBS1_CHNL130_STATUS_ADDR A:0xe614108
y.create.l HWIO_PMIC_ARB_OBS1_CHNL131_STATUS_ADDR A:0xe614188
y.create.l HWIO_PMIC_ARB_OBS1_CHNL132_STATUS_ADDR A:0xe614208
y.create.l HWIO_PMIC_ARB_OBS1_CHNL133_STATUS_ADDR A:0xe614288
y.create.l HWIO_PMIC_ARB_OBS1_CHNL134_STATUS_ADDR A:0xe614308
y.create.l HWIO_PMIC_ARB_OBS1_CHNL135_STATUS_ADDR A:0xe614388
y.create.l HWIO_PMIC_ARB_OBS1_CHNL136_STATUS_ADDR A:0xe614408
y.create.l HWIO_PMIC_ARB_OBS1_CHNL137_STATUS_ADDR A:0xe614488
y.create.l HWIO_PMIC_ARB_OBS1_CHNL138_STATUS_ADDR A:0xe614508
y.create.l HWIO_PMIC_ARB_OBS1_CHNL139_STATUS_ADDR A:0xe614588
y.create.l HWIO_PMIC_ARB_OBS1_CHNL140_STATUS_ADDR A:0xe614608
y.create.l HWIO_PMIC_ARB_OBS1_CHNL141_STATUS_ADDR A:0xe614688
y.create.l HWIO_PMIC_ARB_OBS1_CHNL142_STATUS_ADDR A:0xe614708
y.create.l HWIO_PMIC_ARB_OBS1_CHNL143_STATUS_ADDR A:0xe614788
y.create.l HWIO_PMIC_ARB_OBS1_CHNL144_STATUS_ADDR A:0xe614808
y.create.l HWIO_PMIC_ARB_OBS1_CHNL145_STATUS_ADDR A:0xe614888
y.create.l HWIO_PMIC_ARB_OBS1_CHNL146_STATUS_ADDR A:0xe614908
y.create.l HWIO_PMIC_ARB_OBS1_CHNL147_STATUS_ADDR A:0xe614988
y.create.l HWIO_PMIC_ARB_OBS1_CHNL148_STATUS_ADDR A:0xe614a08
y.create.l HWIO_PMIC_ARB_OBS1_CHNL149_STATUS_ADDR A:0xe614a88
y.create.l HWIO_PMIC_ARB_OBS1_CHNL150_STATUS_ADDR A:0xe614b08
y.create.l HWIO_PMIC_ARB_OBS1_CHNL151_STATUS_ADDR A:0xe614b88
y.create.l HWIO_PMIC_ARB_OBS1_CHNL152_STATUS_ADDR A:0xe614c08
y.create.l HWIO_PMIC_ARB_OBS1_CHNL153_STATUS_ADDR A:0xe614c88
y.create.l HWIO_PMIC_ARB_OBS1_CHNL154_STATUS_ADDR A:0xe614d08
y.create.l HWIO_PMIC_ARB_OBS1_CHNL155_STATUS_ADDR A:0xe614d88
y.create.l HWIO_PMIC_ARB_OBS1_CHNL156_STATUS_ADDR A:0xe614e08
y.create.l HWIO_PMIC_ARB_OBS1_CHNL157_STATUS_ADDR A:0xe614e88
y.create.l HWIO_PMIC_ARB_OBS1_CHNL158_STATUS_ADDR A:0xe614f08
y.create.l HWIO_PMIC_ARB_OBS1_CHNL159_STATUS_ADDR A:0xe614f88
y.create.l HWIO_PMIC_ARB_OBS1_CHNL160_STATUS_ADDR A:0xe615008
y.create.l HWIO_PMIC_ARB_OBS1_CHNL161_STATUS_ADDR A:0xe615088
y.create.l HWIO_PMIC_ARB_OBS1_CHNL162_STATUS_ADDR A:0xe615108
y.create.l HWIO_PMIC_ARB_OBS1_CHNL163_STATUS_ADDR A:0xe615188
y.create.l HWIO_PMIC_ARB_OBS1_CHNL164_STATUS_ADDR A:0xe615208
y.create.l HWIO_PMIC_ARB_OBS1_CHNL165_STATUS_ADDR A:0xe615288
y.create.l HWIO_PMIC_ARB_OBS1_CHNL166_STATUS_ADDR A:0xe615308
y.create.l HWIO_PMIC_ARB_OBS1_CHNL167_STATUS_ADDR A:0xe615388
y.create.l HWIO_PMIC_ARB_OBS1_CHNL168_STATUS_ADDR A:0xe615408
y.create.l HWIO_PMIC_ARB_OBS1_CHNL169_STATUS_ADDR A:0xe615488
y.create.l HWIO_PMIC_ARB_OBS1_CHNL170_STATUS_ADDR A:0xe615508
y.create.l HWIO_PMIC_ARB_OBS1_CHNL171_STATUS_ADDR A:0xe615588
y.create.l HWIO_PMIC_ARB_OBS1_CHNL172_STATUS_ADDR A:0xe615608
y.create.l HWIO_PMIC_ARB_OBS1_CHNL173_STATUS_ADDR A:0xe615688
y.create.l HWIO_PMIC_ARB_OBS1_CHNL174_STATUS_ADDR A:0xe615708
y.create.l HWIO_PMIC_ARB_OBS1_CHNL175_STATUS_ADDR A:0xe615788
y.create.l HWIO_PMIC_ARB_OBS1_CHNL176_STATUS_ADDR A:0xe615808
y.create.l HWIO_PMIC_ARB_OBS1_CHNL177_STATUS_ADDR A:0xe615888
y.create.l HWIO_PMIC_ARB_OBS1_CHNL178_STATUS_ADDR A:0xe615908
y.create.l HWIO_PMIC_ARB_OBS1_CHNL179_STATUS_ADDR A:0xe615988
y.create.l HWIO_PMIC_ARB_OBS1_CHNL180_STATUS_ADDR A:0xe615a08
y.create.l HWIO_PMIC_ARB_OBS1_CHNL181_STATUS_ADDR A:0xe615a88
y.create.l HWIO_PMIC_ARB_OBS1_CHNL182_STATUS_ADDR A:0xe615b08
y.create.l HWIO_PMIC_ARB_OBS1_CHNL183_STATUS_ADDR A:0xe615b88
y.create.l HWIO_PMIC_ARB_OBS1_CHNL184_STATUS_ADDR A:0xe615c08
y.create.l HWIO_PMIC_ARB_OBS1_CHNL185_STATUS_ADDR A:0xe615c88
y.create.l HWIO_PMIC_ARB_OBS1_CHNL186_STATUS_ADDR A:0xe615d08
y.create.l HWIO_PMIC_ARB_OBS1_CHNL187_STATUS_ADDR A:0xe615d88
y.create.l HWIO_PMIC_ARB_OBS1_CHNL188_STATUS_ADDR A:0xe615e08
y.create.l HWIO_PMIC_ARB_OBS1_CHNL189_STATUS_ADDR A:0xe615e88
y.create.l HWIO_PMIC_ARB_OBS1_CHNL190_STATUS_ADDR A:0xe615f08
y.create.l HWIO_PMIC_ARB_OBS1_CHNL191_STATUS_ADDR A:0xe615f88
y.create.l HWIO_PMIC_ARB_OBS1_CHNL192_STATUS_ADDR A:0xe616008
y.create.l HWIO_PMIC_ARB_OBS1_CHNL193_STATUS_ADDR A:0xe616088
y.create.l HWIO_PMIC_ARB_OBS1_CHNL194_STATUS_ADDR A:0xe616108
y.create.l HWIO_PMIC_ARB_OBS1_CHNL195_STATUS_ADDR A:0xe616188
y.create.l HWIO_PMIC_ARB_OBS1_CHNL196_STATUS_ADDR A:0xe616208
y.create.l HWIO_PMIC_ARB_OBS1_CHNL197_STATUS_ADDR A:0xe616288
y.create.l HWIO_PMIC_ARB_OBS1_CHNL198_STATUS_ADDR A:0xe616308
y.create.l HWIO_PMIC_ARB_OBS1_CHNL199_STATUS_ADDR A:0xe616388
y.create.l HWIO_PMIC_ARB_OBS1_CHNL200_STATUS_ADDR A:0xe616408
y.create.l HWIO_PMIC_ARB_OBS1_CHNL201_STATUS_ADDR A:0xe616488
y.create.l HWIO_PMIC_ARB_OBS1_CHNL202_STATUS_ADDR A:0xe616508
y.create.l HWIO_PMIC_ARB_OBS1_CHNL203_STATUS_ADDR A:0xe616588
y.create.l HWIO_PMIC_ARB_OBS1_CHNL204_STATUS_ADDR A:0xe616608
y.create.l HWIO_PMIC_ARB_OBS1_CHNL205_STATUS_ADDR A:0xe616688
y.create.l HWIO_PMIC_ARB_OBS1_CHNL206_STATUS_ADDR A:0xe616708
y.create.l HWIO_PMIC_ARB_OBS1_CHNL207_STATUS_ADDR A:0xe616788
y.create.l HWIO_PMIC_ARB_OBS1_CHNL208_STATUS_ADDR A:0xe616808
y.create.l HWIO_PMIC_ARB_OBS1_CHNL209_STATUS_ADDR A:0xe616888
y.create.l HWIO_PMIC_ARB_OBS1_CHNL210_STATUS_ADDR A:0xe616908
y.create.l HWIO_PMIC_ARB_OBS1_CHNL211_STATUS_ADDR A:0xe616988
y.create.l HWIO_PMIC_ARB_OBS1_CHNL212_STATUS_ADDR A:0xe616a08
y.create.l HWIO_PMIC_ARB_OBS1_CHNL213_STATUS_ADDR A:0xe616a88
y.create.l HWIO_PMIC_ARB_OBS1_CHNL214_STATUS_ADDR A:0xe616b08
y.create.l HWIO_PMIC_ARB_OBS1_CHNL215_STATUS_ADDR A:0xe616b88
y.create.l HWIO_PMIC_ARB_OBS1_CHNL216_STATUS_ADDR A:0xe616c08
y.create.l HWIO_PMIC_ARB_OBS1_CHNL217_STATUS_ADDR A:0xe616c88
y.create.l HWIO_PMIC_ARB_OBS1_CHNL218_STATUS_ADDR A:0xe616d08
y.create.l HWIO_PMIC_ARB_OBS1_CHNL219_STATUS_ADDR A:0xe616d88
y.create.l HWIO_PMIC_ARB_OBS1_CHNL220_STATUS_ADDR A:0xe616e08
y.create.l HWIO_PMIC_ARB_OBS1_CHNL221_STATUS_ADDR A:0xe616e88
y.create.l HWIO_PMIC_ARB_OBS1_CHNL222_STATUS_ADDR A:0xe616f08
y.create.l HWIO_PMIC_ARB_OBS1_CHNL223_STATUS_ADDR A:0xe616f88
y.create.l HWIO_PMIC_ARB_OBS1_CHNL224_STATUS_ADDR A:0xe617008
y.create.l HWIO_PMIC_ARB_OBS1_CHNL225_STATUS_ADDR A:0xe617088
y.create.l HWIO_PMIC_ARB_OBS1_CHNL226_STATUS_ADDR A:0xe617108
y.create.l HWIO_PMIC_ARB_OBS1_CHNL227_STATUS_ADDR A:0xe617188
y.create.l HWIO_PMIC_ARB_OBS1_CHNL228_STATUS_ADDR A:0xe617208
y.create.l HWIO_PMIC_ARB_OBS1_CHNL229_STATUS_ADDR A:0xe617288
y.create.l HWIO_PMIC_ARB_OBS1_CHNL230_STATUS_ADDR A:0xe617308
y.create.l HWIO_PMIC_ARB_OBS1_CHNL231_STATUS_ADDR A:0xe617388
y.create.l HWIO_PMIC_ARB_OBS1_CHNL232_STATUS_ADDR A:0xe617408
y.create.l HWIO_PMIC_ARB_OBS1_CHNL233_STATUS_ADDR A:0xe617488
y.create.l HWIO_PMIC_ARB_OBS1_CHNL234_STATUS_ADDR A:0xe617508
y.create.l HWIO_PMIC_ARB_OBS1_CHNL235_STATUS_ADDR A:0xe617588
y.create.l HWIO_PMIC_ARB_OBS1_CHNL236_STATUS_ADDR A:0xe617608
y.create.l HWIO_PMIC_ARB_OBS1_CHNL237_STATUS_ADDR A:0xe617688
y.create.l HWIO_PMIC_ARB_OBS1_CHNL238_STATUS_ADDR A:0xe617708
y.create.l HWIO_PMIC_ARB_OBS1_CHNL239_STATUS_ADDR A:0xe617788
y.create.l HWIO_PMIC_ARB_OBS1_CHNL240_STATUS_ADDR A:0xe617808
y.create.l HWIO_PMIC_ARB_OBS1_CHNL241_STATUS_ADDR A:0xe617888
y.create.l HWIO_PMIC_ARB_OBS1_CHNL242_STATUS_ADDR A:0xe617908
y.create.l HWIO_PMIC_ARB_OBS1_CHNL243_STATUS_ADDR A:0xe617988
y.create.l HWIO_PMIC_ARB_OBS1_CHNL244_STATUS_ADDR A:0xe617a08
y.create.l HWIO_PMIC_ARB_OBS1_CHNL245_STATUS_ADDR A:0xe617a88
y.create.l HWIO_PMIC_ARB_OBS1_CHNL246_STATUS_ADDR A:0xe617b08
y.create.l HWIO_PMIC_ARB_OBS1_CHNL247_STATUS_ADDR A:0xe617b88
y.create.l HWIO_PMIC_ARB_OBS1_CHNL248_STATUS_ADDR A:0xe617c08
y.create.l HWIO_PMIC_ARB_OBS1_CHNL249_STATUS_ADDR A:0xe617c88
y.create.l HWIO_PMIC_ARB_OBS1_CHNL250_STATUS_ADDR A:0xe617d08
y.create.l HWIO_PMIC_ARB_OBS1_CHNL251_STATUS_ADDR A:0xe617d88
y.create.l HWIO_PMIC_ARB_OBS1_CHNL252_STATUS_ADDR A:0xe617e08
y.create.l HWIO_PMIC_ARB_OBS1_CHNL253_STATUS_ADDR A:0xe617e88
y.create.l HWIO_PMIC_ARB_OBS1_CHNL254_STATUS_ADDR A:0xe617f08
y.create.l HWIO_PMIC_ARB_OBS1_CHNL255_STATUS_ADDR A:0xe617f88
y.create.l HWIO_PMIC_ARB_OBS1_CHNL256_STATUS_ADDR A:0xe618008
y.create.l HWIO_PMIC_ARB_OBS1_CHNL257_STATUS_ADDR A:0xe618088
y.create.l HWIO_PMIC_ARB_OBS1_CHNL258_STATUS_ADDR A:0xe618108
y.create.l HWIO_PMIC_ARB_OBS1_CHNL259_STATUS_ADDR A:0xe618188
y.create.l HWIO_PMIC_ARB_OBS1_CHNL260_STATUS_ADDR A:0xe618208
y.create.l HWIO_PMIC_ARB_OBS1_CHNL261_STATUS_ADDR A:0xe618288
y.create.l HWIO_PMIC_ARB_OBS1_CHNL262_STATUS_ADDR A:0xe618308
y.create.l HWIO_PMIC_ARB_OBS1_CHNL263_STATUS_ADDR A:0xe618388
y.create.l HWIO_PMIC_ARB_OBS1_CHNL264_STATUS_ADDR A:0xe618408
y.create.l HWIO_PMIC_ARB_OBS1_CHNL265_STATUS_ADDR A:0xe618488
y.create.l HWIO_PMIC_ARB_OBS1_CHNL266_STATUS_ADDR A:0xe618508
y.create.l HWIO_PMIC_ARB_OBS1_CHNL267_STATUS_ADDR A:0xe618588
y.create.l HWIO_PMIC_ARB_OBS1_CHNL268_STATUS_ADDR A:0xe618608
y.create.l HWIO_PMIC_ARB_OBS1_CHNL269_STATUS_ADDR A:0xe618688
y.create.l HWIO_PMIC_ARB_OBS1_CHNL270_STATUS_ADDR A:0xe618708
y.create.l HWIO_PMIC_ARB_OBS1_CHNL271_STATUS_ADDR A:0xe618788
y.create.l HWIO_PMIC_ARB_OBS1_CHNL272_STATUS_ADDR A:0xe618808
y.create.l HWIO_PMIC_ARB_OBS1_CHNL273_STATUS_ADDR A:0xe618888
y.create.l HWIO_PMIC_ARB_OBS1_CHNL274_STATUS_ADDR A:0xe618908
y.create.l HWIO_PMIC_ARB_OBS1_CHNL275_STATUS_ADDR A:0xe618988
y.create.l HWIO_PMIC_ARB_OBS1_CHNL276_STATUS_ADDR A:0xe618a08
y.create.l HWIO_PMIC_ARB_OBS1_CHNL277_STATUS_ADDR A:0xe618a88
y.create.l HWIO_PMIC_ARB_OBS1_CHNL278_STATUS_ADDR A:0xe618b08
y.create.l HWIO_PMIC_ARB_OBS1_CHNL279_STATUS_ADDR A:0xe618b88
y.create.l HWIO_PMIC_ARB_OBS1_CHNL280_STATUS_ADDR A:0xe618c08
y.create.l HWIO_PMIC_ARB_OBS1_CHNL281_STATUS_ADDR A:0xe618c88
y.create.l HWIO_PMIC_ARB_OBS1_CHNL282_STATUS_ADDR A:0xe618d08
y.create.l HWIO_PMIC_ARB_OBS1_CHNL283_STATUS_ADDR A:0xe618d88
y.create.l HWIO_PMIC_ARB_OBS1_CHNL284_STATUS_ADDR A:0xe618e08
y.create.l HWIO_PMIC_ARB_OBS1_CHNL285_STATUS_ADDR A:0xe618e88
y.create.l HWIO_PMIC_ARB_OBS1_CHNL286_STATUS_ADDR A:0xe618f08
y.create.l HWIO_PMIC_ARB_OBS1_CHNL287_STATUS_ADDR A:0xe618f88
y.create.l HWIO_PMIC_ARB_OBS1_CHNL288_STATUS_ADDR A:0xe619008
y.create.l HWIO_PMIC_ARB_OBS1_CHNL289_STATUS_ADDR A:0xe619088
y.create.l HWIO_PMIC_ARB_OBS1_CHNL290_STATUS_ADDR A:0xe619108
y.create.l HWIO_PMIC_ARB_OBS1_CHNL291_STATUS_ADDR A:0xe619188
y.create.l HWIO_PMIC_ARB_OBS1_CHNL292_STATUS_ADDR A:0xe619208
y.create.l HWIO_PMIC_ARB_OBS1_CHNL293_STATUS_ADDR A:0xe619288
y.create.l HWIO_PMIC_ARB_OBS1_CHNL294_STATUS_ADDR A:0xe619308
y.create.l HWIO_PMIC_ARB_OBS1_CHNL295_STATUS_ADDR A:0xe619388
y.create.l HWIO_PMIC_ARB_OBS1_CHNL296_STATUS_ADDR A:0xe619408
y.create.l HWIO_PMIC_ARB_OBS1_CHNL297_STATUS_ADDR A:0xe619488
y.create.l HWIO_PMIC_ARB_OBS1_CHNL298_STATUS_ADDR A:0xe619508
y.create.l HWIO_PMIC_ARB_OBS1_CHNL299_STATUS_ADDR A:0xe619588
y.create.l HWIO_PMIC_ARB_OBS1_CHNL300_STATUS_ADDR A:0xe619608
y.create.l HWIO_PMIC_ARB_OBS1_CHNL301_STATUS_ADDR A:0xe619688
y.create.l HWIO_PMIC_ARB_OBS1_CHNL302_STATUS_ADDR A:0xe619708
y.create.l HWIO_PMIC_ARB_OBS1_CHNL303_STATUS_ADDR A:0xe619788
y.create.l HWIO_PMIC_ARB_OBS1_CHNL304_STATUS_ADDR A:0xe619808
y.create.l HWIO_PMIC_ARB_OBS1_CHNL305_STATUS_ADDR A:0xe619888
y.create.l HWIO_PMIC_ARB_OBS1_CHNL306_STATUS_ADDR A:0xe619908
y.create.l HWIO_PMIC_ARB_OBS1_CHNL307_STATUS_ADDR A:0xe619988
y.create.l HWIO_PMIC_ARB_OBS1_CHNL308_STATUS_ADDR A:0xe619a08
y.create.l HWIO_PMIC_ARB_OBS1_CHNL309_STATUS_ADDR A:0xe619a88
y.create.l HWIO_PMIC_ARB_OBS1_CHNL310_STATUS_ADDR A:0xe619b08
y.create.l HWIO_PMIC_ARB_OBS1_CHNL311_STATUS_ADDR A:0xe619b88
y.create.l HWIO_PMIC_ARB_OBS1_CHNL312_STATUS_ADDR A:0xe619c08
y.create.l HWIO_PMIC_ARB_OBS1_CHNL313_STATUS_ADDR A:0xe619c88
y.create.l HWIO_PMIC_ARB_OBS1_CHNL314_STATUS_ADDR A:0xe619d08
y.create.l HWIO_PMIC_ARB_OBS1_CHNL315_STATUS_ADDR A:0xe619d88
y.create.l HWIO_PMIC_ARB_OBS1_CHNL316_STATUS_ADDR A:0xe619e08
y.create.l HWIO_PMIC_ARB_OBS1_CHNL317_STATUS_ADDR A:0xe619e88
y.create.l HWIO_PMIC_ARB_OBS1_CHNL318_STATUS_ADDR A:0xe619f08
y.create.l HWIO_PMIC_ARB_OBS1_CHNL319_STATUS_ADDR A:0xe619f88
y.create.l HWIO_PMIC_ARB_OBS1_CHNL320_STATUS_ADDR A:0xe61a008
y.create.l HWIO_PMIC_ARB_OBS1_CHNL321_STATUS_ADDR A:0xe61a088
y.create.l HWIO_PMIC_ARB_OBS1_CHNL322_STATUS_ADDR A:0xe61a108
y.create.l HWIO_PMIC_ARB_OBS1_CHNL323_STATUS_ADDR A:0xe61a188
y.create.l HWIO_PMIC_ARB_OBS1_CHNL324_STATUS_ADDR A:0xe61a208
y.create.l HWIO_PMIC_ARB_OBS1_CHNL325_STATUS_ADDR A:0xe61a288
y.create.l HWIO_PMIC_ARB_OBS1_CHNL326_STATUS_ADDR A:0xe61a308
y.create.l HWIO_PMIC_ARB_OBS1_CHNL327_STATUS_ADDR A:0xe61a388
y.create.l HWIO_PMIC_ARB_OBS1_CHNL328_STATUS_ADDR A:0xe61a408
y.create.l HWIO_PMIC_ARB_OBS1_CHNL329_STATUS_ADDR A:0xe61a488
y.create.l HWIO_PMIC_ARB_OBS1_CHNL330_STATUS_ADDR A:0xe61a508
y.create.l HWIO_PMIC_ARB_OBS1_CHNL331_STATUS_ADDR A:0xe61a588
y.create.l HWIO_PMIC_ARB_OBS1_CHNL332_STATUS_ADDR A:0xe61a608
y.create.l HWIO_PMIC_ARB_OBS1_CHNL333_STATUS_ADDR A:0xe61a688
y.create.l HWIO_PMIC_ARB_OBS1_CHNL334_STATUS_ADDR A:0xe61a708
y.create.l HWIO_PMIC_ARB_OBS1_CHNL335_STATUS_ADDR A:0xe61a788
y.create.l HWIO_PMIC_ARB_OBS1_CHNL336_STATUS_ADDR A:0xe61a808
y.create.l HWIO_PMIC_ARB_OBS1_CHNL337_STATUS_ADDR A:0xe61a888
y.create.l HWIO_PMIC_ARB_OBS1_CHNL338_STATUS_ADDR A:0xe61a908
y.create.l HWIO_PMIC_ARB_OBS1_CHNL339_STATUS_ADDR A:0xe61a988
y.create.l HWIO_PMIC_ARB_OBS1_CHNL340_STATUS_ADDR A:0xe61aa08
y.create.l HWIO_PMIC_ARB_OBS1_CHNL341_STATUS_ADDR A:0xe61aa88
y.create.l HWIO_PMIC_ARB_OBS1_CHNL342_STATUS_ADDR A:0xe61ab08
y.create.l HWIO_PMIC_ARB_OBS1_CHNL343_STATUS_ADDR A:0xe61ab88
y.create.l HWIO_PMIC_ARB_OBS1_CHNL344_STATUS_ADDR A:0xe61ac08
y.create.l HWIO_PMIC_ARB_OBS1_CHNL345_STATUS_ADDR A:0xe61ac88
y.create.l HWIO_PMIC_ARB_OBS1_CHNL346_STATUS_ADDR A:0xe61ad08
y.create.l HWIO_PMIC_ARB_OBS1_CHNL347_STATUS_ADDR A:0xe61ad88
y.create.l HWIO_PMIC_ARB_OBS1_CHNL348_STATUS_ADDR A:0xe61ae08
y.create.l HWIO_PMIC_ARB_OBS1_CHNL349_STATUS_ADDR A:0xe61ae88
y.create.l HWIO_PMIC_ARB_OBS1_CHNL350_STATUS_ADDR A:0xe61af08
y.create.l HWIO_PMIC_ARB_OBS1_CHNL351_STATUS_ADDR A:0xe61af88
y.create.l HWIO_PMIC_ARB_OBS1_CHNL352_STATUS_ADDR A:0xe61b008
y.create.l HWIO_PMIC_ARB_OBS1_CHNL353_STATUS_ADDR A:0xe61b088
y.create.l HWIO_PMIC_ARB_OBS1_CHNL354_STATUS_ADDR A:0xe61b108
y.create.l HWIO_PMIC_ARB_OBS1_CHNL355_STATUS_ADDR A:0xe61b188
y.create.l HWIO_PMIC_ARB_OBS1_CHNL356_STATUS_ADDR A:0xe61b208
y.create.l HWIO_PMIC_ARB_OBS1_CHNL357_STATUS_ADDR A:0xe61b288
y.create.l HWIO_PMIC_ARB_OBS1_CHNL358_STATUS_ADDR A:0xe61b308
y.create.l HWIO_PMIC_ARB_OBS1_CHNL359_STATUS_ADDR A:0xe61b388
y.create.l HWIO_PMIC_ARB_OBS1_CHNL360_STATUS_ADDR A:0xe61b408
y.create.l HWIO_PMIC_ARB_OBS1_CHNL361_STATUS_ADDR A:0xe61b488
y.create.l HWIO_PMIC_ARB_OBS1_CHNL362_STATUS_ADDR A:0xe61b508
y.create.l HWIO_PMIC_ARB_OBS1_CHNL363_STATUS_ADDR A:0xe61b588
y.create.l HWIO_PMIC_ARB_OBS1_CHNL364_STATUS_ADDR A:0xe61b608
y.create.l HWIO_PMIC_ARB_OBS1_CHNL365_STATUS_ADDR A:0xe61b688
y.create.l HWIO_PMIC_ARB_OBS1_CHNL366_STATUS_ADDR A:0xe61b708
y.create.l HWIO_PMIC_ARB_OBS1_CHNL367_STATUS_ADDR A:0xe61b788
y.create.l HWIO_PMIC_ARB_OBS1_CHNL368_STATUS_ADDR A:0xe61b808
y.create.l HWIO_PMIC_ARB_OBS1_CHNL369_STATUS_ADDR A:0xe61b888
y.create.l HWIO_PMIC_ARB_OBS1_CHNL370_STATUS_ADDR A:0xe61b908
y.create.l HWIO_PMIC_ARB_OBS1_CHNL371_STATUS_ADDR A:0xe61b988
y.create.l HWIO_PMIC_ARB_OBS1_CHNL372_STATUS_ADDR A:0xe61ba08
y.create.l HWIO_PMIC_ARB_OBS1_CHNL373_STATUS_ADDR A:0xe61ba88
y.create.l HWIO_PMIC_ARB_OBS1_CHNL374_STATUS_ADDR A:0xe61bb08
y.create.l HWIO_PMIC_ARB_OBS1_CHNL375_STATUS_ADDR A:0xe61bb88
y.create.l HWIO_PMIC_ARB_OBS1_CHNL376_STATUS_ADDR A:0xe61bc08
y.create.l HWIO_PMIC_ARB_OBS1_CHNL377_STATUS_ADDR A:0xe61bc88
y.create.l HWIO_PMIC_ARB_OBS1_CHNL378_STATUS_ADDR A:0xe61bd08
y.create.l HWIO_PMIC_ARB_OBS1_CHNL379_STATUS_ADDR A:0xe61bd88
y.create.l HWIO_PMIC_ARB_OBS1_CHNL380_STATUS_ADDR A:0xe61be08
y.create.l HWIO_PMIC_ARB_OBS1_CHNL381_STATUS_ADDR A:0xe61be88
y.create.l HWIO_PMIC_ARB_OBS1_CHNL382_STATUS_ADDR A:0xe61bf08
y.create.l HWIO_PMIC_ARB_OBS1_CHNL383_STATUS_ADDR A:0xe61bf88
y.create.l HWIO_PMIC_ARB_OBS1_CHNL384_STATUS_ADDR A:0xe61c008
y.create.l HWIO_PMIC_ARB_OBS1_CHNL385_STATUS_ADDR A:0xe61c088
y.create.l HWIO_PMIC_ARB_OBS1_CHNL386_STATUS_ADDR A:0xe61c108
y.create.l HWIO_PMIC_ARB_OBS1_CHNL387_STATUS_ADDR A:0xe61c188
y.create.l HWIO_PMIC_ARB_OBS1_CHNL388_STATUS_ADDR A:0xe61c208
y.create.l HWIO_PMIC_ARB_OBS1_CHNL389_STATUS_ADDR A:0xe61c288
y.create.l HWIO_PMIC_ARB_OBS1_CHNL390_STATUS_ADDR A:0xe61c308
y.create.l HWIO_PMIC_ARB_OBS1_CHNL391_STATUS_ADDR A:0xe61c388
y.create.l HWIO_PMIC_ARB_OBS1_CHNL392_STATUS_ADDR A:0xe61c408
y.create.l HWIO_PMIC_ARB_OBS1_CHNL393_STATUS_ADDR A:0xe61c488
y.create.l HWIO_PMIC_ARB_OBS1_CHNL394_STATUS_ADDR A:0xe61c508
y.create.l HWIO_PMIC_ARB_OBS1_CHNL395_STATUS_ADDR A:0xe61c588
y.create.l HWIO_PMIC_ARB_OBS1_CHNL396_STATUS_ADDR A:0xe61c608
y.create.l HWIO_PMIC_ARB_OBS1_CHNL397_STATUS_ADDR A:0xe61c688
y.create.l HWIO_PMIC_ARB_OBS1_CHNL398_STATUS_ADDR A:0xe61c708
y.create.l HWIO_PMIC_ARB_OBS1_CHNL399_STATUS_ADDR A:0xe61c788
y.create.l HWIO_PMIC_ARB_OBS1_CHNL400_STATUS_ADDR A:0xe61c808
y.create.l HWIO_PMIC_ARB_OBS1_CHNL401_STATUS_ADDR A:0xe61c888
y.create.l HWIO_PMIC_ARB_OBS1_CHNL402_STATUS_ADDR A:0xe61c908
y.create.l HWIO_PMIC_ARB_OBS1_CHNL403_STATUS_ADDR A:0xe61c988
y.create.l HWIO_PMIC_ARB_OBS1_CHNL404_STATUS_ADDR A:0xe61ca08
y.create.l HWIO_PMIC_ARB_OBS1_CHNL405_STATUS_ADDR A:0xe61ca88
y.create.l HWIO_PMIC_ARB_OBS1_CHNL406_STATUS_ADDR A:0xe61cb08
y.create.l HWIO_PMIC_ARB_OBS1_CHNL407_STATUS_ADDR A:0xe61cb88
y.create.l HWIO_PMIC_ARB_OBS1_CHNL408_STATUS_ADDR A:0xe61cc08
y.create.l HWIO_PMIC_ARB_OBS1_CHNL409_STATUS_ADDR A:0xe61cc88
y.create.l HWIO_PMIC_ARB_OBS1_CHNL410_STATUS_ADDR A:0xe61cd08
y.create.l HWIO_PMIC_ARB_OBS1_CHNL411_STATUS_ADDR A:0xe61cd88
y.create.l HWIO_PMIC_ARB_OBS1_CHNL412_STATUS_ADDR A:0xe61ce08
y.create.l HWIO_PMIC_ARB_OBS1_CHNL413_STATUS_ADDR A:0xe61ce88
y.create.l HWIO_PMIC_ARB_OBS1_CHNL414_STATUS_ADDR A:0xe61cf08
y.create.l HWIO_PMIC_ARB_OBS1_CHNL415_STATUS_ADDR A:0xe61cf88
y.create.l HWIO_PMIC_ARB_OBS1_CHNL416_STATUS_ADDR A:0xe61d008
y.create.l HWIO_PMIC_ARB_OBS1_CHNL417_STATUS_ADDR A:0xe61d088
y.create.l HWIO_PMIC_ARB_OBS1_CHNL418_STATUS_ADDR A:0xe61d108
y.create.l HWIO_PMIC_ARB_OBS1_CHNL419_STATUS_ADDR A:0xe61d188
y.create.l HWIO_PMIC_ARB_OBS1_CHNL420_STATUS_ADDR A:0xe61d208
y.create.l HWIO_PMIC_ARB_OBS1_CHNL421_STATUS_ADDR A:0xe61d288
y.create.l HWIO_PMIC_ARB_OBS1_CHNL422_STATUS_ADDR A:0xe61d308
y.create.l HWIO_PMIC_ARB_OBS1_CHNL423_STATUS_ADDR A:0xe61d388
y.create.l HWIO_PMIC_ARB_OBS1_CHNL424_STATUS_ADDR A:0xe61d408
y.create.l HWIO_PMIC_ARB_OBS1_CHNL425_STATUS_ADDR A:0xe61d488
y.create.l HWIO_PMIC_ARB_OBS1_CHNL426_STATUS_ADDR A:0xe61d508
y.create.l HWIO_PMIC_ARB_OBS1_CHNL427_STATUS_ADDR A:0xe61d588
y.create.l HWIO_PMIC_ARB_OBS1_CHNL428_STATUS_ADDR A:0xe61d608
y.create.l HWIO_PMIC_ARB_OBS1_CHNL429_STATUS_ADDR A:0xe61d688
y.create.l HWIO_PMIC_ARB_OBS1_CHNL430_STATUS_ADDR A:0xe61d708
y.create.l HWIO_PMIC_ARB_OBS1_CHNL431_STATUS_ADDR A:0xe61d788
y.create.l HWIO_PMIC_ARB_OBS1_CHNL432_STATUS_ADDR A:0xe61d808
y.create.l HWIO_PMIC_ARB_OBS1_CHNL433_STATUS_ADDR A:0xe61d888
y.create.l HWIO_PMIC_ARB_OBS1_CHNL434_STATUS_ADDR A:0xe61d908
y.create.l HWIO_PMIC_ARB_OBS1_CHNL435_STATUS_ADDR A:0xe61d988
y.create.l HWIO_PMIC_ARB_OBS1_CHNL436_STATUS_ADDR A:0xe61da08
y.create.l HWIO_PMIC_ARB_OBS1_CHNL437_STATUS_ADDR A:0xe61da88
y.create.l HWIO_PMIC_ARB_OBS1_CHNL438_STATUS_ADDR A:0xe61db08
y.create.l HWIO_PMIC_ARB_OBS1_CHNL439_STATUS_ADDR A:0xe61db88
y.create.l HWIO_PMIC_ARB_OBS1_CHNL440_STATUS_ADDR A:0xe61dc08
y.create.l HWIO_PMIC_ARB_OBS1_CHNL441_STATUS_ADDR A:0xe61dc88
y.create.l HWIO_PMIC_ARB_OBS1_CHNL442_STATUS_ADDR A:0xe61dd08
y.create.l HWIO_PMIC_ARB_OBS1_CHNL443_STATUS_ADDR A:0xe61dd88
y.create.l HWIO_PMIC_ARB_OBS1_CHNL444_STATUS_ADDR A:0xe61de08
y.create.l HWIO_PMIC_ARB_OBS1_CHNL445_STATUS_ADDR A:0xe61de88
y.create.l HWIO_PMIC_ARB_OBS1_CHNL446_STATUS_ADDR A:0xe61df08
y.create.l HWIO_PMIC_ARB_OBS1_CHNL447_STATUS_ADDR A:0xe61df88
y.create.l HWIO_PMIC_ARB_OBS1_CHNL448_STATUS_ADDR A:0xe61e008
y.create.l HWIO_PMIC_ARB_OBS1_CHNL449_STATUS_ADDR A:0xe61e088
y.create.l HWIO_PMIC_ARB_OBS1_CHNL450_STATUS_ADDR A:0xe61e108
y.create.l HWIO_PMIC_ARB_OBS1_CHNL451_STATUS_ADDR A:0xe61e188
y.create.l HWIO_PMIC_ARB_OBS1_CHNL452_STATUS_ADDR A:0xe61e208
y.create.l HWIO_PMIC_ARB_OBS1_CHNL453_STATUS_ADDR A:0xe61e288
y.create.l HWIO_PMIC_ARB_OBS1_CHNL454_STATUS_ADDR A:0xe61e308
y.create.l HWIO_PMIC_ARB_OBS1_CHNL455_STATUS_ADDR A:0xe61e388
y.create.l HWIO_PMIC_ARB_OBS1_CHNL456_STATUS_ADDR A:0xe61e408
y.create.l HWIO_PMIC_ARB_OBS1_CHNL457_STATUS_ADDR A:0xe61e488
y.create.l HWIO_PMIC_ARB_OBS1_CHNL458_STATUS_ADDR A:0xe61e508
y.create.l HWIO_PMIC_ARB_OBS1_CHNL459_STATUS_ADDR A:0xe61e588
y.create.l HWIO_PMIC_ARB_OBS1_CHNL460_STATUS_ADDR A:0xe61e608
y.create.l HWIO_PMIC_ARB_OBS1_CHNL461_STATUS_ADDR A:0xe61e688
y.create.l HWIO_PMIC_ARB_OBS1_CHNL462_STATUS_ADDR A:0xe61e708
y.create.l HWIO_PMIC_ARB_OBS1_CHNL463_STATUS_ADDR A:0xe61e788
y.create.l HWIO_PMIC_ARB_OBS1_CHNL464_STATUS_ADDR A:0xe61e808
y.create.l HWIO_PMIC_ARB_OBS1_CHNL465_STATUS_ADDR A:0xe61e888
y.create.l HWIO_PMIC_ARB_OBS1_CHNL466_STATUS_ADDR A:0xe61e908
y.create.l HWIO_PMIC_ARB_OBS1_CHNL467_STATUS_ADDR A:0xe61e988
y.create.l HWIO_PMIC_ARB_OBS1_CHNL468_STATUS_ADDR A:0xe61ea08
y.create.l HWIO_PMIC_ARB_OBS1_CHNL469_STATUS_ADDR A:0xe61ea88
y.create.l HWIO_PMIC_ARB_OBS1_CHNL470_STATUS_ADDR A:0xe61eb08
y.create.l HWIO_PMIC_ARB_OBS1_CHNL471_STATUS_ADDR A:0xe61eb88
y.create.l HWIO_PMIC_ARB_OBS1_CHNL472_STATUS_ADDR A:0xe61ec08
y.create.l HWIO_PMIC_ARB_OBS1_CHNL473_STATUS_ADDR A:0xe61ec88
y.create.l HWIO_PMIC_ARB_OBS1_CHNL474_STATUS_ADDR A:0xe61ed08
y.create.l HWIO_PMIC_ARB_OBS1_CHNL475_STATUS_ADDR A:0xe61ed88
y.create.l HWIO_PMIC_ARB_OBS1_CHNL476_STATUS_ADDR A:0xe61ee08
y.create.l HWIO_PMIC_ARB_OBS1_CHNL477_STATUS_ADDR A:0xe61ee88
y.create.l HWIO_PMIC_ARB_OBS1_CHNL478_STATUS_ADDR A:0xe61ef08
y.create.l HWIO_PMIC_ARB_OBS1_CHNL479_STATUS_ADDR A:0xe61ef88
y.create.l HWIO_PMIC_ARB_OBS1_CHNL480_STATUS_ADDR A:0xe61f008
y.create.l HWIO_PMIC_ARB_OBS1_CHNL481_STATUS_ADDR A:0xe61f088
y.create.l HWIO_PMIC_ARB_OBS1_CHNL482_STATUS_ADDR A:0xe61f108
y.create.l HWIO_PMIC_ARB_OBS1_CHNL483_STATUS_ADDR A:0xe61f188
y.create.l HWIO_PMIC_ARB_OBS1_CHNL484_STATUS_ADDR A:0xe61f208
y.create.l HWIO_PMIC_ARB_OBS1_CHNL485_STATUS_ADDR A:0xe61f288
y.create.l HWIO_PMIC_ARB_OBS1_CHNL486_STATUS_ADDR A:0xe61f308
y.create.l HWIO_PMIC_ARB_OBS1_CHNL487_STATUS_ADDR A:0xe61f388
y.create.l HWIO_PMIC_ARB_OBS1_CHNL488_STATUS_ADDR A:0xe61f408
y.create.l HWIO_PMIC_ARB_OBS1_CHNL489_STATUS_ADDR A:0xe61f488
y.create.l HWIO_PMIC_ARB_OBS1_CHNL490_STATUS_ADDR A:0xe61f508
y.create.l HWIO_PMIC_ARB_OBS1_CHNL491_STATUS_ADDR A:0xe61f588
y.create.l HWIO_PMIC_ARB_OBS1_CHNL492_STATUS_ADDR A:0xe61f608
y.create.l HWIO_PMIC_ARB_OBS1_CHNL493_STATUS_ADDR A:0xe61f688
y.create.l HWIO_PMIC_ARB_OBS1_CHNL494_STATUS_ADDR A:0xe61f708
y.create.l HWIO_PMIC_ARB_OBS1_CHNL495_STATUS_ADDR A:0xe61f788
y.create.l HWIO_PMIC_ARB_OBS1_CHNL496_STATUS_ADDR A:0xe61f808
y.create.l HWIO_PMIC_ARB_OBS1_CHNL497_STATUS_ADDR A:0xe61f888
y.create.l HWIO_PMIC_ARB_OBS1_CHNL498_STATUS_ADDR A:0xe61f908
y.create.l HWIO_PMIC_ARB_OBS1_CHNL499_STATUS_ADDR A:0xe61f988
y.create.l HWIO_PMIC_ARB_OBS1_CHNL500_STATUS_ADDR A:0xe61fa08
y.create.l HWIO_PMIC_ARB_OBS1_CHNL501_STATUS_ADDR A:0xe61fa88
y.create.l HWIO_PMIC_ARB_OBS1_CHNL502_STATUS_ADDR A:0xe61fb08
y.create.l HWIO_PMIC_ARB_OBS1_CHNL503_STATUS_ADDR A:0xe61fb88
y.create.l HWIO_PMIC_ARB_OBS1_CHNL504_STATUS_ADDR A:0xe61fc08
y.create.l HWIO_PMIC_ARB_OBS1_CHNL505_STATUS_ADDR A:0xe61fc88
y.create.l HWIO_PMIC_ARB_OBS1_CHNL506_STATUS_ADDR A:0xe61fd08
y.create.l HWIO_PMIC_ARB_OBS1_CHNL507_STATUS_ADDR A:0xe61fd88
y.create.l HWIO_PMIC_ARB_OBS1_CHNL508_STATUS_ADDR A:0xe61fe08
y.create.l HWIO_PMIC_ARB_OBS1_CHNL509_STATUS_ADDR A:0xe61fe88
y.create.l HWIO_PMIC_ARB_OBS1_CHNL510_STATUS_ADDR A:0xe61ff08
y.create.l HWIO_PMIC_ARB_OBS1_CHNL511_STATUS_ADDR A:0xe61ff88
y.create.l HWIO_PMIC_ARB_OBS2_CHNL0_STATUS_ADDR A:0xe620008
y.create.l HWIO_PMIC_ARB_OBS2_CHNL1_STATUS_ADDR A:0xe620088
y.create.l HWIO_PMIC_ARB_OBS2_CHNL2_STATUS_ADDR A:0xe620108
y.create.l HWIO_PMIC_ARB_OBS2_CHNL3_STATUS_ADDR A:0xe620188
y.create.l HWIO_PMIC_ARB_OBS2_CHNL4_STATUS_ADDR A:0xe620208
y.create.l HWIO_PMIC_ARB_OBS2_CHNL5_STATUS_ADDR A:0xe620288
y.create.l HWIO_PMIC_ARB_OBS2_CHNL6_STATUS_ADDR A:0xe620308
y.create.l HWIO_PMIC_ARB_OBS2_CHNL7_STATUS_ADDR A:0xe620388
y.create.l HWIO_PMIC_ARB_OBS2_CHNL8_STATUS_ADDR A:0xe620408
y.create.l HWIO_PMIC_ARB_OBS2_CHNL9_STATUS_ADDR A:0xe620488
y.create.l HWIO_PMIC_ARB_OBS2_CHNL10_STATUS_ADDR A:0xe620508
y.create.l HWIO_PMIC_ARB_OBS2_CHNL11_STATUS_ADDR A:0xe620588
y.create.l HWIO_PMIC_ARB_OBS2_CHNL12_STATUS_ADDR A:0xe620608
y.create.l HWIO_PMIC_ARB_OBS2_CHNL13_STATUS_ADDR A:0xe620688
y.create.l HWIO_PMIC_ARB_OBS2_CHNL14_STATUS_ADDR A:0xe620708
y.create.l HWIO_PMIC_ARB_OBS2_CHNL15_STATUS_ADDR A:0xe620788
y.create.l HWIO_PMIC_ARB_OBS2_CHNL16_STATUS_ADDR A:0xe620808
y.create.l HWIO_PMIC_ARB_OBS2_CHNL17_STATUS_ADDR A:0xe620888
y.create.l HWIO_PMIC_ARB_OBS2_CHNL18_STATUS_ADDR A:0xe620908
y.create.l HWIO_PMIC_ARB_OBS2_CHNL19_STATUS_ADDR A:0xe620988
y.create.l HWIO_PMIC_ARB_OBS2_CHNL20_STATUS_ADDR A:0xe620a08
y.create.l HWIO_PMIC_ARB_OBS2_CHNL21_STATUS_ADDR A:0xe620a88
y.create.l HWIO_PMIC_ARB_OBS2_CHNL22_STATUS_ADDR A:0xe620b08
y.create.l HWIO_PMIC_ARB_OBS2_CHNL23_STATUS_ADDR A:0xe620b88
y.create.l HWIO_PMIC_ARB_OBS2_CHNL24_STATUS_ADDR A:0xe620c08
y.create.l HWIO_PMIC_ARB_OBS2_CHNL25_STATUS_ADDR A:0xe620c88
y.create.l HWIO_PMIC_ARB_OBS2_CHNL26_STATUS_ADDR A:0xe620d08
y.create.l HWIO_PMIC_ARB_OBS2_CHNL27_STATUS_ADDR A:0xe620d88
y.create.l HWIO_PMIC_ARB_OBS2_CHNL28_STATUS_ADDR A:0xe620e08
y.create.l HWIO_PMIC_ARB_OBS2_CHNL29_STATUS_ADDR A:0xe620e88
y.create.l HWIO_PMIC_ARB_OBS2_CHNL30_STATUS_ADDR A:0xe620f08
y.create.l HWIO_PMIC_ARB_OBS2_CHNL31_STATUS_ADDR A:0xe620f88
y.create.l HWIO_PMIC_ARB_OBS2_CHNL32_STATUS_ADDR A:0xe621008
y.create.l HWIO_PMIC_ARB_OBS2_CHNL33_STATUS_ADDR A:0xe621088
y.create.l HWIO_PMIC_ARB_OBS2_CHNL34_STATUS_ADDR A:0xe621108
y.create.l HWIO_PMIC_ARB_OBS2_CHNL35_STATUS_ADDR A:0xe621188
y.create.l HWIO_PMIC_ARB_OBS2_CHNL36_STATUS_ADDR A:0xe621208
y.create.l HWIO_PMIC_ARB_OBS2_CHNL37_STATUS_ADDR A:0xe621288
y.create.l HWIO_PMIC_ARB_OBS2_CHNL38_STATUS_ADDR A:0xe621308
y.create.l HWIO_PMIC_ARB_OBS2_CHNL39_STATUS_ADDR A:0xe621388
y.create.l HWIO_PMIC_ARB_OBS2_CHNL40_STATUS_ADDR A:0xe621408
y.create.l HWIO_PMIC_ARB_OBS2_CHNL41_STATUS_ADDR A:0xe621488
y.create.l HWIO_PMIC_ARB_OBS2_CHNL42_STATUS_ADDR A:0xe621508
y.create.l HWIO_PMIC_ARB_OBS2_CHNL43_STATUS_ADDR A:0xe621588
y.create.l HWIO_PMIC_ARB_OBS2_CHNL44_STATUS_ADDR A:0xe621608
y.create.l HWIO_PMIC_ARB_OBS2_CHNL45_STATUS_ADDR A:0xe621688
y.create.l HWIO_PMIC_ARB_OBS2_CHNL46_STATUS_ADDR A:0xe621708
y.create.l HWIO_PMIC_ARB_OBS2_CHNL47_STATUS_ADDR A:0xe621788
y.create.l HWIO_PMIC_ARB_OBS2_CHNL48_STATUS_ADDR A:0xe621808
y.create.l HWIO_PMIC_ARB_OBS2_CHNL49_STATUS_ADDR A:0xe621888
y.create.l HWIO_PMIC_ARB_OBS2_CHNL50_STATUS_ADDR A:0xe621908
y.create.l HWIO_PMIC_ARB_OBS2_CHNL51_STATUS_ADDR A:0xe621988
y.create.l HWIO_PMIC_ARB_OBS2_CHNL52_STATUS_ADDR A:0xe621a08
y.create.l HWIO_PMIC_ARB_OBS2_CHNL53_STATUS_ADDR A:0xe621a88
y.create.l HWIO_PMIC_ARB_OBS2_CHNL54_STATUS_ADDR A:0xe621b08
y.create.l HWIO_PMIC_ARB_OBS2_CHNL55_STATUS_ADDR A:0xe621b88
y.create.l HWIO_PMIC_ARB_OBS2_CHNL56_STATUS_ADDR A:0xe621c08
y.create.l HWIO_PMIC_ARB_OBS2_CHNL57_STATUS_ADDR A:0xe621c88
y.create.l HWIO_PMIC_ARB_OBS2_CHNL58_STATUS_ADDR A:0xe621d08
y.create.l HWIO_PMIC_ARB_OBS2_CHNL59_STATUS_ADDR A:0xe621d88
y.create.l HWIO_PMIC_ARB_OBS2_CHNL60_STATUS_ADDR A:0xe621e08
y.create.l HWIO_PMIC_ARB_OBS2_CHNL61_STATUS_ADDR A:0xe621e88
y.create.l HWIO_PMIC_ARB_OBS2_CHNL62_STATUS_ADDR A:0xe621f08
y.create.l HWIO_PMIC_ARB_OBS2_CHNL63_STATUS_ADDR A:0xe621f88
y.create.l HWIO_PMIC_ARB_OBS2_CHNL64_STATUS_ADDR A:0xe622008
y.create.l HWIO_PMIC_ARB_OBS2_CHNL65_STATUS_ADDR A:0xe622088
y.create.l HWIO_PMIC_ARB_OBS2_CHNL66_STATUS_ADDR A:0xe622108
y.create.l HWIO_PMIC_ARB_OBS2_CHNL67_STATUS_ADDR A:0xe622188
y.create.l HWIO_PMIC_ARB_OBS2_CHNL68_STATUS_ADDR A:0xe622208
y.create.l HWIO_PMIC_ARB_OBS2_CHNL69_STATUS_ADDR A:0xe622288
y.create.l HWIO_PMIC_ARB_OBS2_CHNL70_STATUS_ADDR A:0xe622308
y.create.l HWIO_PMIC_ARB_OBS2_CHNL71_STATUS_ADDR A:0xe622388
y.create.l HWIO_PMIC_ARB_OBS2_CHNL72_STATUS_ADDR A:0xe622408
y.create.l HWIO_PMIC_ARB_OBS2_CHNL73_STATUS_ADDR A:0xe622488
y.create.l HWIO_PMIC_ARB_OBS2_CHNL74_STATUS_ADDR A:0xe622508
y.create.l HWIO_PMIC_ARB_OBS2_CHNL75_STATUS_ADDR A:0xe622588
y.create.l HWIO_PMIC_ARB_OBS2_CHNL76_STATUS_ADDR A:0xe622608
y.create.l HWIO_PMIC_ARB_OBS2_CHNL77_STATUS_ADDR A:0xe622688
y.create.l HWIO_PMIC_ARB_OBS2_CHNL78_STATUS_ADDR A:0xe622708
y.create.l HWIO_PMIC_ARB_OBS2_CHNL79_STATUS_ADDR A:0xe622788
y.create.l HWIO_PMIC_ARB_OBS2_CHNL80_STATUS_ADDR A:0xe622808
y.create.l HWIO_PMIC_ARB_OBS2_CHNL81_STATUS_ADDR A:0xe622888
y.create.l HWIO_PMIC_ARB_OBS2_CHNL82_STATUS_ADDR A:0xe622908
y.create.l HWIO_PMIC_ARB_OBS2_CHNL83_STATUS_ADDR A:0xe622988
y.create.l HWIO_PMIC_ARB_OBS2_CHNL84_STATUS_ADDR A:0xe622a08
y.create.l HWIO_PMIC_ARB_OBS2_CHNL85_STATUS_ADDR A:0xe622a88
y.create.l HWIO_PMIC_ARB_OBS2_CHNL86_STATUS_ADDR A:0xe622b08
y.create.l HWIO_PMIC_ARB_OBS2_CHNL87_STATUS_ADDR A:0xe622b88
y.create.l HWIO_PMIC_ARB_OBS2_CHNL88_STATUS_ADDR A:0xe622c08
y.create.l HWIO_PMIC_ARB_OBS2_CHNL89_STATUS_ADDR A:0xe622c88
y.create.l HWIO_PMIC_ARB_OBS2_CHNL90_STATUS_ADDR A:0xe622d08
y.create.l HWIO_PMIC_ARB_OBS2_CHNL91_STATUS_ADDR A:0xe622d88
y.create.l HWIO_PMIC_ARB_OBS2_CHNL92_STATUS_ADDR A:0xe622e08
y.create.l HWIO_PMIC_ARB_OBS2_CHNL93_STATUS_ADDR A:0xe622e88
y.create.l HWIO_PMIC_ARB_OBS2_CHNL94_STATUS_ADDR A:0xe622f08
y.create.l HWIO_PMIC_ARB_OBS2_CHNL95_STATUS_ADDR A:0xe622f88
y.create.l HWIO_PMIC_ARB_OBS2_CHNL96_STATUS_ADDR A:0xe623008
y.create.l HWIO_PMIC_ARB_OBS2_CHNL97_STATUS_ADDR A:0xe623088
y.create.l HWIO_PMIC_ARB_OBS2_CHNL98_STATUS_ADDR A:0xe623108
y.create.l HWIO_PMIC_ARB_OBS2_CHNL99_STATUS_ADDR A:0xe623188
y.create.l HWIO_PMIC_ARB_OBS2_CHNL100_STATUS_ADDR A:0xe623208
y.create.l HWIO_PMIC_ARB_OBS2_CHNL101_STATUS_ADDR A:0xe623288
y.create.l HWIO_PMIC_ARB_OBS2_CHNL102_STATUS_ADDR A:0xe623308
y.create.l HWIO_PMIC_ARB_OBS2_CHNL103_STATUS_ADDR A:0xe623388
y.create.l HWIO_PMIC_ARB_OBS2_CHNL104_STATUS_ADDR A:0xe623408
y.create.l HWIO_PMIC_ARB_OBS2_CHNL105_STATUS_ADDR A:0xe623488
y.create.l HWIO_PMIC_ARB_OBS2_CHNL106_STATUS_ADDR A:0xe623508
y.create.l HWIO_PMIC_ARB_OBS2_CHNL107_STATUS_ADDR A:0xe623588
y.create.l HWIO_PMIC_ARB_OBS2_CHNL108_STATUS_ADDR A:0xe623608
y.create.l HWIO_PMIC_ARB_OBS2_CHNL109_STATUS_ADDR A:0xe623688
y.create.l HWIO_PMIC_ARB_OBS2_CHNL110_STATUS_ADDR A:0xe623708
y.create.l HWIO_PMIC_ARB_OBS2_CHNL111_STATUS_ADDR A:0xe623788
y.create.l HWIO_PMIC_ARB_OBS2_CHNL112_STATUS_ADDR A:0xe623808
y.create.l HWIO_PMIC_ARB_OBS2_CHNL113_STATUS_ADDR A:0xe623888
y.create.l HWIO_PMIC_ARB_OBS2_CHNL114_STATUS_ADDR A:0xe623908
y.create.l HWIO_PMIC_ARB_OBS2_CHNL115_STATUS_ADDR A:0xe623988
y.create.l HWIO_PMIC_ARB_OBS2_CHNL116_STATUS_ADDR A:0xe623a08
y.create.l HWIO_PMIC_ARB_OBS2_CHNL117_STATUS_ADDR A:0xe623a88
y.create.l HWIO_PMIC_ARB_OBS2_CHNL118_STATUS_ADDR A:0xe623b08
y.create.l HWIO_PMIC_ARB_OBS2_CHNL119_STATUS_ADDR A:0xe623b88
y.create.l HWIO_PMIC_ARB_OBS2_CHNL120_STATUS_ADDR A:0xe623c08
y.create.l HWIO_PMIC_ARB_OBS2_CHNL121_STATUS_ADDR A:0xe623c88
y.create.l HWIO_PMIC_ARB_OBS2_CHNL122_STATUS_ADDR A:0xe623d08
y.create.l HWIO_PMIC_ARB_OBS2_CHNL123_STATUS_ADDR A:0xe623d88
y.create.l HWIO_PMIC_ARB_OBS2_CHNL124_STATUS_ADDR A:0xe623e08
y.create.l HWIO_PMIC_ARB_OBS2_CHNL125_STATUS_ADDR A:0xe623e88
y.create.l HWIO_PMIC_ARB_OBS2_CHNL126_STATUS_ADDR A:0xe623f08
y.create.l HWIO_PMIC_ARB_OBS2_CHNL127_STATUS_ADDR A:0xe623f88
y.create.l HWIO_PMIC_ARB_OBS2_CHNL128_STATUS_ADDR A:0xe624008
y.create.l HWIO_PMIC_ARB_OBS2_CHNL129_STATUS_ADDR A:0xe624088
y.create.l HWIO_PMIC_ARB_OBS2_CHNL130_STATUS_ADDR A:0xe624108
y.create.l HWIO_PMIC_ARB_OBS2_CHNL131_STATUS_ADDR A:0xe624188
y.create.l HWIO_PMIC_ARB_OBS2_CHNL132_STATUS_ADDR A:0xe624208
y.create.l HWIO_PMIC_ARB_OBS2_CHNL133_STATUS_ADDR A:0xe624288
y.create.l HWIO_PMIC_ARB_OBS2_CHNL134_STATUS_ADDR A:0xe624308
y.create.l HWIO_PMIC_ARB_OBS2_CHNL135_STATUS_ADDR A:0xe624388
y.create.l HWIO_PMIC_ARB_OBS2_CHNL136_STATUS_ADDR A:0xe624408
y.create.l HWIO_PMIC_ARB_OBS2_CHNL137_STATUS_ADDR A:0xe624488
y.create.l HWIO_PMIC_ARB_OBS2_CHNL138_STATUS_ADDR A:0xe624508
y.create.l HWIO_PMIC_ARB_OBS2_CHNL139_STATUS_ADDR A:0xe624588
y.create.l HWIO_PMIC_ARB_OBS2_CHNL140_STATUS_ADDR A:0xe624608
y.create.l HWIO_PMIC_ARB_OBS2_CHNL141_STATUS_ADDR A:0xe624688
y.create.l HWIO_PMIC_ARB_OBS2_CHNL142_STATUS_ADDR A:0xe624708
y.create.l HWIO_PMIC_ARB_OBS2_CHNL143_STATUS_ADDR A:0xe624788
y.create.l HWIO_PMIC_ARB_OBS2_CHNL144_STATUS_ADDR A:0xe624808
y.create.l HWIO_PMIC_ARB_OBS2_CHNL145_STATUS_ADDR A:0xe624888
y.create.l HWIO_PMIC_ARB_OBS2_CHNL146_STATUS_ADDR A:0xe624908
y.create.l HWIO_PMIC_ARB_OBS2_CHNL147_STATUS_ADDR A:0xe624988
y.create.l HWIO_PMIC_ARB_OBS2_CHNL148_STATUS_ADDR A:0xe624a08
y.create.l HWIO_PMIC_ARB_OBS2_CHNL149_STATUS_ADDR A:0xe624a88
y.create.l HWIO_PMIC_ARB_OBS2_CHNL150_STATUS_ADDR A:0xe624b08
y.create.l HWIO_PMIC_ARB_OBS2_CHNL151_STATUS_ADDR A:0xe624b88
y.create.l HWIO_PMIC_ARB_OBS2_CHNL152_STATUS_ADDR A:0xe624c08
y.create.l HWIO_PMIC_ARB_OBS2_CHNL153_STATUS_ADDR A:0xe624c88
y.create.l HWIO_PMIC_ARB_OBS2_CHNL154_STATUS_ADDR A:0xe624d08
y.create.l HWIO_PMIC_ARB_OBS2_CHNL155_STATUS_ADDR A:0xe624d88
y.create.l HWIO_PMIC_ARB_OBS2_CHNL156_STATUS_ADDR A:0xe624e08
y.create.l HWIO_PMIC_ARB_OBS2_CHNL157_STATUS_ADDR A:0xe624e88
y.create.l HWIO_PMIC_ARB_OBS2_CHNL158_STATUS_ADDR A:0xe624f08
y.create.l HWIO_PMIC_ARB_OBS2_CHNL159_STATUS_ADDR A:0xe624f88
y.create.l HWIO_PMIC_ARB_OBS2_CHNL160_STATUS_ADDR A:0xe625008
y.create.l HWIO_PMIC_ARB_OBS2_CHNL161_STATUS_ADDR A:0xe625088
y.create.l HWIO_PMIC_ARB_OBS2_CHNL162_STATUS_ADDR A:0xe625108
y.create.l HWIO_PMIC_ARB_OBS2_CHNL163_STATUS_ADDR A:0xe625188
y.create.l HWIO_PMIC_ARB_OBS2_CHNL164_STATUS_ADDR A:0xe625208
y.create.l HWIO_PMIC_ARB_OBS2_CHNL165_STATUS_ADDR A:0xe625288
y.create.l HWIO_PMIC_ARB_OBS2_CHNL166_STATUS_ADDR A:0xe625308
y.create.l HWIO_PMIC_ARB_OBS2_CHNL167_STATUS_ADDR A:0xe625388
y.create.l HWIO_PMIC_ARB_OBS2_CHNL168_STATUS_ADDR A:0xe625408
y.create.l HWIO_PMIC_ARB_OBS2_CHNL169_STATUS_ADDR A:0xe625488
y.create.l HWIO_PMIC_ARB_OBS2_CHNL170_STATUS_ADDR A:0xe625508
y.create.l HWIO_PMIC_ARB_OBS2_CHNL171_STATUS_ADDR A:0xe625588
y.create.l HWIO_PMIC_ARB_OBS2_CHNL172_STATUS_ADDR A:0xe625608
y.create.l HWIO_PMIC_ARB_OBS2_CHNL173_STATUS_ADDR A:0xe625688
y.create.l HWIO_PMIC_ARB_OBS2_CHNL174_STATUS_ADDR A:0xe625708
y.create.l HWIO_PMIC_ARB_OBS2_CHNL175_STATUS_ADDR A:0xe625788
y.create.l HWIO_PMIC_ARB_OBS2_CHNL176_STATUS_ADDR A:0xe625808
y.create.l HWIO_PMIC_ARB_OBS2_CHNL177_STATUS_ADDR A:0xe625888
y.create.l HWIO_PMIC_ARB_OBS2_CHNL178_STATUS_ADDR A:0xe625908
y.create.l HWIO_PMIC_ARB_OBS2_CHNL179_STATUS_ADDR A:0xe625988
y.create.l HWIO_PMIC_ARB_OBS2_CHNL180_STATUS_ADDR A:0xe625a08
y.create.l HWIO_PMIC_ARB_OBS2_CHNL181_STATUS_ADDR A:0xe625a88
y.create.l HWIO_PMIC_ARB_OBS2_CHNL182_STATUS_ADDR A:0xe625b08
y.create.l HWIO_PMIC_ARB_OBS2_CHNL183_STATUS_ADDR A:0xe625b88
y.create.l HWIO_PMIC_ARB_OBS2_CHNL184_STATUS_ADDR A:0xe625c08
y.create.l HWIO_PMIC_ARB_OBS2_CHNL185_STATUS_ADDR A:0xe625c88
y.create.l HWIO_PMIC_ARB_OBS2_CHNL186_STATUS_ADDR A:0xe625d08
y.create.l HWIO_PMIC_ARB_OBS2_CHNL187_STATUS_ADDR A:0xe625d88
y.create.l HWIO_PMIC_ARB_OBS2_CHNL188_STATUS_ADDR A:0xe625e08
y.create.l HWIO_PMIC_ARB_OBS2_CHNL189_STATUS_ADDR A:0xe625e88
y.create.l HWIO_PMIC_ARB_OBS2_CHNL190_STATUS_ADDR A:0xe625f08
y.create.l HWIO_PMIC_ARB_OBS2_CHNL191_STATUS_ADDR A:0xe625f88
y.create.l HWIO_PMIC_ARB_OBS2_CHNL192_STATUS_ADDR A:0xe626008
y.create.l HWIO_PMIC_ARB_OBS2_CHNL193_STATUS_ADDR A:0xe626088
y.create.l HWIO_PMIC_ARB_OBS2_CHNL194_STATUS_ADDR A:0xe626108
y.create.l HWIO_PMIC_ARB_OBS2_CHNL195_STATUS_ADDR A:0xe626188
y.create.l HWIO_PMIC_ARB_OBS2_CHNL196_STATUS_ADDR A:0xe626208
y.create.l HWIO_PMIC_ARB_OBS2_CHNL197_STATUS_ADDR A:0xe626288
y.create.l HWIO_PMIC_ARB_OBS2_CHNL198_STATUS_ADDR A:0xe626308
y.create.l HWIO_PMIC_ARB_OBS2_CHNL199_STATUS_ADDR A:0xe626388
y.create.l HWIO_PMIC_ARB_OBS2_CHNL200_STATUS_ADDR A:0xe626408
y.create.l HWIO_PMIC_ARB_OBS2_CHNL201_STATUS_ADDR A:0xe626488
y.create.l HWIO_PMIC_ARB_OBS2_CHNL202_STATUS_ADDR A:0xe626508
y.create.l HWIO_PMIC_ARB_OBS2_CHNL203_STATUS_ADDR A:0xe626588
y.create.l HWIO_PMIC_ARB_OBS2_CHNL204_STATUS_ADDR A:0xe626608
y.create.l HWIO_PMIC_ARB_OBS2_CHNL205_STATUS_ADDR A:0xe626688
y.create.l HWIO_PMIC_ARB_OBS2_CHNL206_STATUS_ADDR A:0xe626708
y.create.l HWIO_PMIC_ARB_OBS2_CHNL207_STATUS_ADDR A:0xe626788
y.create.l HWIO_PMIC_ARB_OBS2_CHNL208_STATUS_ADDR A:0xe626808
y.create.l HWIO_PMIC_ARB_OBS2_CHNL209_STATUS_ADDR A:0xe626888
y.create.l HWIO_PMIC_ARB_OBS2_CHNL210_STATUS_ADDR A:0xe626908
y.create.l HWIO_PMIC_ARB_OBS2_CHNL211_STATUS_ADDR A:0xe626988
y.create.l HWIO_PMIC_ARB_OBS2_CHNL212_STATUS_ADDR A:0xe626a08
y.create.l HWIO_PMIC_ARB_OBS2_CHNL213_STATUS_ADDR A:0xe626a88
y.create.l HWIO_PMIC_ARB_OBS2_CHNL214_STATUS_ADDR A:0xe626b08
y.create.l HWIO_PMIC_ARB_OBS2_CHNL215_STATUS_ADDR A:0xe626b88
y.create.l HWIO_PMIC_ARB_OBS2_CHNL216_STATUS_ADDR A:0xe626c08
y.create.l HWIO_PMIC_ARB_OBS2_CHNL217_STATUS_ADDR A:0xe626c88
y.create.l HWIO_PMIC_ARB_OBS2_CHNL218_STATUS_ADDR A:0xe626d08
y.create.l HWIO_PMIC_ARB_OBS2_CHNL219_STATUS_ADDR A:0xe626d88
y.create.l HWIO_PMIC_ARB_OBS2_CHNL220_STATUS_ADDR A:0xe626e08
y.create.l HWIO_PMIC_ARB_OBS2_CHNL221_STATUS_ADDR A:0xe626e88
y.create.l HWIO_PMIC_ARB_OBS2_CHNL222_STATUS_ADDR A:0xe626f08
y.create.l HWIO_PMIC_ARB_OBS2_CHNL223_STATUS_ADDR A:0xe626f88
y.create.l HWIO_PMIC_ARB_OBS2_CHNL224_STATUS_ADDR A:0xe627008
y.create.l HWIO_PMIC_ARB_OBS2_CHNL225_STATUS_ADDR A:0xe627088
y.create.l HWIO_PMIC_ARB_OBS2_CHNL226_STATUS_ADDR A:0xe627108
y.create.l HWIO_PMIC_ARB_OBS2_CHNL227_STATUS_ADDR A:0xe627188
y.create.l HWIO_PMIC_ARB_OBS2_CHNL228_STATUS_ADDR A:0xe627208
y.create.l HWIO_PMIC_ARB_OBS2_CHNL229_STATUS_ADDR A:0xe627288
y.create.l HWIO_PMIC_ARB_OBS2_CHNL230_STATUS_ADDR A:0xe627308
y.create.l HWIO_PMIC_ARB_OBS2_CHNL231_STATUS_ADDR A:0xe627388
y.create.l HWIO_PMIC_ARB_OBS2_CHNL232_STATUS_ADDR A:0xe627408
y.create.l HWIO_PMIC_ARB_OBS2_CHNL233_STATUS_ADDR A:0xe627488
y.create.l HWIO_PMIC_ARB_OBS2_CHNL234_STATUS_ADDR A:0xe627508
y.create.l HWIO_PMIC_ARB_OBS2_CHNL235_STATUS_ADDR A:0xe627588
y.create.l HWIO_PMIC_ARB_OBS2_CHNL236_STATUS_ADDR A:0xe627608
y.create.l HWIO_PMIC_ARB_OBS2_CHNL237_STATUS_ADDR A:0xe627688
y.create.l HWIO_PMIC_ARB_OBS2_CHNL238_STATUS_ADDR A:0xe627708
y.create.l HWIO_PMIC_ARB_OBS2_CHNL239_STATUS_ADDR A:0xe627788
y.create.l HWIO_PMIC_ARB_OBS2_CHNL240_STATUS_ADDR A:0xe627808
y.create.l HWIO_PMIC_ARB_OBS2_CHNL241_STATUS_ADDR A:0xe627888
y.create.l HWIO_PMIC_ARB_OBS2_CHNL242_STATUS_ADDR A:0xe627908
y.create.l HWIO_PMIC_ARB_OBS2_CHNL243_STATUS_ADDR A:0xe627988
y.create.l HWIO_PMIC_ARB_OBS2_CHNL244_STATUS_ADDR A:0xe627a08
y.create.l HWIO_PMIC_ARB_OBS2_CHNL245_STATUS_ADDR A:0xe627a88
y.create.l HWIO_PMIC_ARB_OBS2_CHNL246_STATUS_ADDR A:0xe627b08
y.create.l HWIO_PMIC_ARB_OBS2_CHNL247_STATUS_ADDR A:0xe627b88
y.create.l HWIO_PMIC_ARB_OBS2_CHNL248_STATUS_ADDR A:0xe627c08
y.create.l HWIO_PMIC_ARB_OBS2_CHNL249_STATUS_ADDR A:0xe627c88
y.create.l HWIO_PMIC_ARB_OBS2_CHNL250_STATUS_ADDR A:0xe627d08
y.create.l HWIO_PMIC_ARB_OBS2_CHNL251_STATUS_ADDR A:0xe627d88
y.create.l HWIO_PMIC_ARB_OBS2_CHNL252_STATUS_ADDR A:0xe627e08
y.create.l HWIO_PMIC_ARB_OBS2_CHNL253_STATUS_ADDR A:0xe627e88
y.create.l HWIO_PMIC_ARB_OBS2_CHNL254_STATUS_ADDR A:0xe627f08
y.create.l HWIO_PMIC_ARB_OBS2_CHNL255_STATUS_ADDR A:0xe627f88
y.create.l HWIO_PMIC_ARB_OBS2_CHNL256_STATUS_ADDR A:0xe628008
y.create.l HWIO_PMIC_ARB_OBS2_CHNL257_STATUS_ADDR A:0xe628088
y.create.l HWIO_PMIC_ARB_OBS2_CHNL258_STATUS_ADDR A:0xe628108
y.create.l HWIO_PMIC_ARB_OBS2_CHNL259_STATUS_ADDR A:0xe628188
y.create.l HWIO_PMIC_ARB_OBS2_CHNL260_STATUS_ADDR A:0xe628208
y.create.l HWIO_PMIC_ARB_OBS2_CHNL261_STATUS_ADDR A:0xe628288
y.create.l HWIO_PMIC_ARB_OBS2_CHNL262_STATUS_ADDR A:0xe628308
y.create.l HWIO_PMIC_ARB_OBS2_CHNL263_STATUS_ADDR A:0xe628388
y.create.l HWIO_PMIC_ARB_OBS2_CHNL264_STATUS_ADDR A:0xe628408
y.create.l HWIO_PMIC_ARB_OBS2_CHNL265_STATUS_ADDR A:0xe628488
y.create.l HWIO_PMIC_ARB_OBS2_CHNL266_STATUS_ADDR A:0xe628508
y.create.l HWIO_PMIC_ARB_OBS2_CHNL267_STATUS_ADDR A:0xe628588
y.create.l HWIO_PMIC_ARB_OBS2_CHNL268_STATUS_ADDR A:0xe628608
y.create.l HWIO_PMIC_ARB_OBS2_CHNL269_STATUS_ADDR A:0xe628688
y.create.l HWIO_PMIC_ARB_OBS2_CHNL270_STATUS_ADDR A:0xe628708
y.create.l HWIO_PMIC_ARB_OBS2_CHNL271_STATUS_ADDR A:0xe628788
y.create.l HWIO_PMIC_ARB_OBS2_CHNL272_STATUS_ADDR A:0xe628808
y.create.l HWIO_PMIC_ARB_OBS2_CHNL273_STATUS_ADDR A:0xe628888
y.create.l HWIO_PMIC_ARB_OBS2_CHNL274_STATUS_ADDR A:0xe628908
y.create.l HWIO_PMIC_ARB_OBS2_CHNL275_STATUS_ADDR A:0xe628988
y.create.l HWIO_PMIC_ARB_OBS2_CHNL276_STATUS_ADDR A:0xe628a08
y.create.l HWIO_PMIC_ARB_OBS2_CHNL277_STATUS_ADDR A:0xe628a88
y.create.l HWIO_PMIC_ARB_OBS2_CHNL278_STATUS_ADDR A:0xe628b08
y.create.l HWIO_PMIC_ARB_OBS2_CHNL279_STATUS_ADDR A:0xe628b88
y.create.l HWIO_PMIC_ARB_OBS2_CHNL280_STATUS_ADDR A:0xe628c08
y.create.l HWIO_PMIC_ARB_OBS2_CHNL281_STATUS_ADDR A:0xe628c88
y.create.l HWIO_PMIC_ARB_OBS2_CHNL282_STATUS_ADDR A:0xe628d08
y.create.l HWIO_PMIC_ARB_OBS2_CHNL283_STATUS_ADDR A:0xe628d88
y.create.l HWIO_PMIC_ARB_OBS2_CHNL284_STATUS_ADDR A:0xe628e08
y.create.l HWIO_PMIC_ARB_OBS2_CHNL285_STATUS_ADDR A:0xe628e88
y.create.l HWIO_PMIC_ARB_OBS2_CHNL286_STATUS_ADDR A:0xe628f08
y.create.l HWIO_PMIC_ARB_OBS2_CHNL287_STATUS_ADDR A:0xe628f88
y.create.l HWIO_PMIC_ARB_OBS2_CHNL288_STATUS_ADDR A:0xe629008
y.create.l HWIO_PMIC_ARB_OBS2_CHNL289_STATUS_ADDR A:0xe629088
y.create.l HWIO_PMIC_ARB_OBS2_CHNL290_STATUS_ADDR A:0xe629108
y.create.l HWIO_PMIC_ARB_OBS2_CHNL291_STATUS_ADDR A:0xe629188
y.create.l HWIO_PMIC_ARB_OBS2_CHNL292_STATUS_ADDR A:0xe629208
y.create.l HWIO_PMIC_ARB_OBS2_CHNL293_STATUS_ADDR A:0xe629288
y.create.l HWIO_PMIC_ARB_OBS2_CHNL294_STATUS_ADDR A:0xe629308
y.create.l HWIO_PMIC_ARB_OBS2_CHNL295_STATUS_ADDR A:0xe629388
y.create.l HWIO_PMIC_ARB_OBS2_CHNL296_STATUS_ADDR A:0xe629408
y.create.l HWIO_PMIC_ARB_OBS2_CHNL297_STATUS_ADDR A:0xe629488
y.create.l HWIO_PMIC_ARB_OBS2_CHNL298_STATUS_ADDR A:0xe629508
y.create.l HWIO_PMIC_ARB_OBS2_CHNL299_STATUS_ADDR A:0xe629588
y.create.l HWIO_PMIC_ARB_OBS2_CHNL300_STATUS_ADDR A:0xe629608
y.create.l HWIO_PMIC_ARB_OBS2_CHNL301_STATUS_ADDR A:0xe629688
y.create.l HWIO_PMIC_ARB_OBS2_CHNL302_STATUS_ADDR A:0xe629708
y.create.l HWIO_PMIC_ARB_OBS2_CHNL303_STATUS_ADDR A:0xe629788
y.create.l HWIO_PMIC_ARB_OBS2_CHNL304_STATUS_ADDR A:0xe629808
y.create.l HWIO_PMIC_ARB_OBS2_CHNL305_STATUS_ADDR A:0xe629888
y.create.l HWIO_PMIC_ARB_OBS2_CHNL306_STATUS_ADDR A:0xe629908
y.create.l HWIO_PMIC_ARB_OBS2_CHNL307_STATUS_ADDR A:0xe629988
y.create.l HWIO_PMIC_ARB_OBS2_CHNL308_STATUS_ADDR A:0xe629a08
y.create.l HWIO_PMIC_ARB_OBS2_CHNL309_STATUS_ADDR A:0xe629a88
y.create.l HWIO_PMIC_ARB_OBS2_CHNL310_STATUS_ADDR A:0xe629b08
y.create.l HWIO_PMIC_ARB_OBS2_CHNL311_STATUS_ADDR A:0xe629b88
y.create.l HWIO_PMIC_ARB_OBS2_CHNL312_STATUS_ADDR A:0xe629c08
y.create.l HWIO_PMIC_ARB_OBS2_CHNL313_STATUS_ADDR A:0xe629c88
y.create.l HWIO_PMIC_ARB_OBS2_CHNL314_STATUS_ADDR A:0xe629d08
y.create.l HWIO_PMIC_ARB_OBS2_CHNL315_STATUS_ADDR A:0xe629d88
y.create.l HWIO_PMIC_ARB_OBS2_CHNL316_STATUS_ADDR A:0xe629e08
y.create.l HWIO_PMIC_ARB_OBS2_CHNL317_STATUS_ADDR A:0xe629e88
y.create.l HWIO_PMIC_ARB_OBS2_CHNL318_STATUS_ADDR A:0xe629f08
y.create.l HWIO_PMIC_ARB_OBS2_CHNL319_STATUS_ADDR A:0xe629f88
y.create.l HWIO_PMIC_ARB_OBS2_CHNL320_STATUS_ADDR A:0xe62a008
y.create.l HWIO_PMIC_ARB_OBS2_CHNL321_STATUS_ADDR A:0xe62a088
y.create.l HWIO_PMIC_ARB_OBS2_CHNL322_STATUS_ADDR A:0xe62a108
y.create.l HWIO_PMIC_ARB_OBS2_CHNL323_STATUS_ADDR A:0xe62a188
y.create.l HWIO_PMIC_ARB_OBS2_CHNL324_STATUS_ADDR A:0xe62a208
y.create.l HWIO_PMIC_ARB_OBS2_CHNL325_STATUS_ADDR A:0xe62a288
y.create.l HWIO_PMIC_ARB_OBS2_CHNL326_STATUS_ADDR A:0xe62a308
y.create.l HWIO_PMIC_ARB_OBS2_CHNL327_STATUS_ADDR A:0xe62a388
y.create.l HWIO_PMIC_ARB_OBS2_CHNL328_STATUS_ADDR A:0xe62a408
y.create.l HWIO_PMIC_ARB_OBS2_CHNL329_STATUS_ADDR A:0xe62a488
y.create.l HWIO_PMIC_ARB_OBS2_CHNL330_STATUS_ADDR A:0xe62a508
y.create.l HWIO_PMIC_ARB_OBS2_CHNL331_STATUS_ADDR A:0xe62a588
y.create.l HWIO_PMIC_ARB_OBS2_CHNL332_STATUS_ADDR A:0xe62a608
y.create.l HWIO_PMIC_ARB_OBS2_CHNL333_STATUS_ADDR A:0xe62a688
y.create.l HWIO_PMIC_ARB_OBS2_CHNL334_STATUS_ADDR A:0xe62a708
y.create.l HWIO_PMIC_ARB_OBS2_CHNL335_STATUS_ADDR A:0xe62a788
y.create.l HWIO_PMIC_ARB_OBS2_CHNL336_STATUS_ADDR A:0xe62a808
y.create.l HWIO_PMIC_ARB_OBS2_CHNL337_STATUS_ADDR A:0xe62a888
y.create.l HWIO_PMIC_ARB_OBS2_CHNL338_STATUS_ADDR A:0xe62a908
y.create.l HWIO_PMIC_ARB_OBS2_CHNL339_STATUS_ADDR A:0xe62a988
y.create.l HWIO_PMIC_ARB_OBS2_CHNL340_STATUS_ADDR A:0xe62aa08
y.create.l HWIO_PMIC_ARB_OBS2_CHNL341_STATUS_ADDR A:0xe62aa88
y.create.l HWIO_PMIC_ARB_OBS2_CHNL342_STATUS_ADDR A:0xe62ab08
y.create.l HWIO_PMIC_ARB_OBS2_CHNL343_STATUS_ADDR A:0xe62ab88
y.create.l HWIO_PMIC_ARB_OBS2_CHNL344_STATUS_ADDR A:0xe62ac08
y.create.l HWIO_PMIC_ARB_OBS2_CHNL345_STATUS_ADDR A:0xe62ac88
y.create.l HWIO_PMIC_ARB_OBS2_CHNL346_STATUS_ADDR A:0xe62ad08
y.create.l HWIO_PMIC_ARB_OBS2_CHNL347_STATUS_ADDR A:0xe62ad88
y.create.l HWIO_PMIC_ARB_OBS2_CHNL348_STATUS_ADDR A:0xe62ae08
y.create.l HWIO_PMIC_ARB_OBS2_CHNL349_STATUS_ADDR A:0xe62ae88
y.create.l HWIO_PMIC_ARB_OBS2_CHNL350_STATUS_ADDR A:0xe62af08
y.create.l HWIO_PMIC_ARB_OBS2_CHNL351_STATUS_ADDR A:0xe62af88
y.create.l HWIO_PMIC_ARB_OBS2_CHNL352_STATUS_ADDR A:0xe62b008
y.create.l HWIO_PMIC_ARB_OBS2_CHNL353_STATUS_ADDR A:0xe62b088
y.create.l HWIO_PMIC_ARB_OBS2_CHNL354_STATUS_ADDR A:0xe62b108
y.create.l HWIO_PMIC_ARB_OBS2_CHNL355_STATUS_ADDR A:0xe62b188
y.create.l HWIO_PMIC_ARB_OBS2_CHNL356_STATUS_ADDR A:0xe62b208
y.create.l HWIO_PMIC_ARB_OBS2_CHNL357_STATUS_ADDR A:0xe62b288
y.create.l HWIO_PMIC_ARB_OBS2_CHNL358_STATUS_ADDR A:0xe62b308
y.create.l HWIO_PMIC_ARB_OBS2_CHNL359_STATUS_ADDR A:0xe62b388
y.create.l HWIO_PMIC_ARB_OBS2_CHNL360_STATUS_ADDR A:0xe62b408
y.create.l HWIO_PMIC_ARB_OBS2_CHNL361_STATUS_ADDR A:0xe62b488
y.create.l HWIO_PMIC_ARB_OBS2_CHNL362_STATUS_ADDR A:0xe62b508
y.create.l HWIO_PMIC_ARB_OBS2_CHNL363_STATUS_ADDR A:0xe62b588
y.create.l HWIO_PMIC_ARB_OBS2_CHNL364_STATUS_ADDR A:0xe62b608
y.create.l HWIO_PMIC_ARB_OBS2_CHNL365_STATUS_ADDR A:0xe62b688
y.create.l HWIO_PMIC_ARB_OBS2_CHNL366_STATUS_ADDR A:0xe62b708
y.create.l HWIO_PMIC_ARB_OBS2_CHNL367_STATUS_ADDR A:0xe62b788
y.create.l HWIO_PMIC_ARB_OBS2_CHNL368_STATUS_ADDR A:0xe62b808
y.create.l HWIO_PMIC_ARB_OBS2_CHNL369_STATUS_ADDR A:0xe62b888
y.create.l HWIO_PMIC_ARB_OBS2_CHNL370_STATUS_ADDR A:0xe62b908
y.create.l HWIO_PMIC_ARB_OBS2_CHNL371_STATUS_ADDR A:0xe62b988
y.create.l HWIO_PMIC_ARB_OBS2_CHNL372_STATUS_ADDR A:0xe62ba08
y.create.l HWIO_PMIC_ARB_OBS2_CHNL373_STATUS_ADDR A:0xe62ba88
y.create.l HWIO_PMIC_ARB_OBS2_CHNL374_STATUS_ADDR A:0xe62bb08
y.create.l HWIO_PMIC_ARB_OBS2_CHNL375_STATUS_ADDR A:0xe62bb88
y.create.l HWIO_PMIC_ARB_OBS2_CHNL376_STATUS_ADDR A:0xe62bc08
y.create.l HWIO_PMIC_ARB_OBS2_CHNL377_STATUS_ADDR A:0xe62bc88
y.create.l HWIO_PMIC_ARB_OBS2_CHNL378_STATUS_ADDR A:0xe62bd08
y.create.l HWIO_PMIC_ARB_OBS2_CHNL379_STATUS_ADDR A:0xe62bd88
y.create.l HWIO_PMIC_ARB_OBS2_CHNL380_STATUS_ADDR A:0xe62be08
y.create.l HWIO_PMIC_ARB_OBS2_CHNL381_STATUS_ADDR A:0xe62be88
y.create.l HWIO_PMIC_ARB_OBS2_CHNL382_STATUS_ADDR A:0xe62bf08
y.create.l HWIO_PMIC_ARB_OBS2_CHNL383_STATUS_ADDR A:0xe62bf88
y.create.l HWIO_PMIC_ARB_OBS2_CHNL384_STATUS_ADDR A:0xe62c008
y.create.l HWIO_PMIC_ARB_OBS2_CHNL385_STATUS_ADDR A:0xe62c088
y.create.l HWIO_PMIC_ARB_OBS2_CHNL386_STATUS_ADDR A:0xe62c108
y.create.l HWIO_PMIC_ARB_OBS2_CHNL387_STATUS_ADDR A:0xe62c188
y.create.l HWIO_PMIC_ARB_OBS2_CHNL388_STATUS_ADDR A:0xe62c208
y.create.l HWIO_PMIC_ARB_OBS2_CHNL389_STATUS_ADDR A:0xe62c288
y.create.l HWIO_PMIC_ARB_OBS2_CHNL390_STATUS_ADDR A:0xe62c308
y.create.l HWIO_PMIC_ARB_OBS2_CHNL391_STATUS_ADDR A:0xe62c388
y.create.l HWIO_PMIC_ARB_OBS2_CHNL392_STATUS_ADDR A:0xe62c408
y.create.l HWIO_PMIC_ARB_OBS2_CHNL393_STATUS_ADDR A:0xe62c488
y.create.l HWIO_PMIC_ARB_OBS2_CHNL394_STATUS_ADDR A:0xe62c508
y.create.l HWIO_PMIC_ARB_OBS2_CHNL395_STATUS_ADDR A:0xe62c588
y.create.l HWIO_PMIC_ARB_OBS2_CHNL396_STATUS_ADDR A:0xe62c608
y.create.l HWIO_PMIC_ARB_OBS2_CHNL397_STATUS_ADDR A:0xe62c688
y.create.l HWIO_PMIC_ARB_OBS2_CHNL398_STATUS_ADDR A:0xe62c708
y.create.l HWIO_PMIC_ARB_OBS2_CHNL399_STATUS_ADDR A:0xe62c788
y.create.l HWIO_PMIC_ARB_OBS2_CHNL400_STATUS_ADDR A:0xe62c808
y.create.l HWIO_PMIC_ARB_OBS2_CHNL401_STATUS_ADDR A:0xe62c888
y.create.l HWIO_PMIC_ARB_OBS2_CHNL402_STATUS_ADDR A:0xe62c908
y.create.l HWIO_PMIC_ARB_OBS2_CHNL403_STATUS_ADDR A:0xe62c988
y.create.l HWIO_PMIC_ARB_OBS2_CHNL404_STATUS_ADDR A:0xe62ca08
y.create.l HWIO_PMIC_ARB_OBS2_CHNL405_STATUS_ADDR A:0xe62ca88
y.create.l HWIO_PMIC_ARB_OBS2_CHNL406_STATUS_ADDR A:0xe62cb08
y.create.l HWIO_PMIC_ARB_OBS2_CHNL407_STATUS_ADDR A:0xe62cb88
y.create.l HWIO_PMIC_ARB_OBS2_CHNL408_STATUS_ADDR A:0xe62cc08
y.create.l HWIO_PMIC_ARB_OBS2_CHNL409_STATUS_ADDR A:0xe62cc88
y.create.l HWIO_PMIC_ARB_OBS2_CHNL410_STATUS_ADDR A:0xe62cd08
y.create.l HWIO_PMIC_ARB_OBS2_CHNL411_STATUS_ADDR A:0xe62cd88
y.create.l HWIO_PMIC_ARB_OBS2_CHNL412_STATUS_ADDR A:0xe62ce08
y.create.l HWIO_PMIC_ARB_OBS2_CHNL413_STATUS_ADDR A:0xe62ce88
y.create.l HWIO_PMIC_ARB_OBS2_CHNL414_STATUS_ADDR A:0xe62cf08
y.create.l HWIO_PMIC_ARB_OBS2_CHNL415_STATUS_ADDR A:0xe62cf88
y.create.l HWIO_PMIC_ARB_OBS2_CHNL416_STATUS_ADDR A:0xe62d008
y.create.l HWIO_PMIC_ARB_OBS2_CHNL417_STATUS_ADDR A:0xe62d088
y.create.l HWIO_PMIC_ARB_OBS2_CHNL418_STATUS_ADDR A:0xe62d108
y.create.l HWIO_PMIC_ARB_OBS2_CHNL419_STATUS_ADDR A:0xe62d188
y.create.l HWIO_PMIC_ARB_OBS2_CHNL420_STATUS_ADDR A:0xe62d208
y.create.l HWIO_PMIC_ARB_OBS2_CHNL421_STATUS_ADDR A:0xe62d288
y.create.l HWIO_PMIC_ARB_OBS2_CHNL422_STATUS_ADDR A:0xe62d308
y.create.l HWIO_PMIC_ARB_OBS2_CHNL423_STATUS_ADDR A:0xe62d388
y.create.l HWIO_PMIC_ARB_OBS2_CHNL424_STATUS_ADDR A:0xe62d408
y.create.l HWIO_PMIC_ARB_OBS2_CHNL425_STATUS_ADDR A:0xe62d488
y.create.l HWIO_PMIC_ARB_OBS2_CHNL426_STATUS_ADDR A:0xe62d508
y.create.l HWIO_PMIC_ARB_OBS2_CHNL427_STATUS_ADDR A:0xe62d588
y.create.l HWIO_PMIC_ARB_OBS2_CHNL428_STATUS_ADDR A:0xe62d608
y.create.l HWIO_PMIC_ARB_OBS2_CHNL429_STATUS_ADDR A:0xe62d688
y.create.l HWIO_PMIC_ARB_OBS2_CHNL430_STATUS_ADDR A:0xe62d708
y.create.l HWIO_PMIC_ARB_OBS2_CHNL431_STATUS_ADDR A:0xe62d788
y.create.l HWIO_PMIC_ARB_OBS2_CHNL432_STATUS_ADDR A:0xe62d808
y.create.l HWIO_PMIC_ARB_OBS2_CHNL433_STATUS_ADDR A:0xe62d888
y.create.l HWIO_PMIC_ARB_OBS2_CHNL434_STATUS_ADDR A:0xe62d908
y.create.l HWIO_PMIC_ARB_OBS2_CHNL435_STATUS_ADDR A:0xe62d988
y.create.l HWIO_PMIC_ARB_OBS2_CHNL436_STATUS_ADDR A:0xe62da08
y.create.l HWIO_PMIC_ARB_OBS2_CHNL437_STATUS_ADDR A:0xe62da88
y.create.l HWIO_PMIC_ARB_OBS2_CHNL438_STATUS_ADDR A:0xe62db08
y.create.l HWIO_PMIC_ARB_OBS2_CHNL439_STATUS_ADDR A:0xe62db88
y.create.l HWIO_PMIC_ARB_OBS2_CHNL440_STATUS_ADDR A:0xe62dc08
y.create.l HWIO_PMIC_ARB_OBS2_CHNL441_STATUS_ADDR A:0xe62dc88
y.create.l HWIO_PMIC_ARB_OBS2_CHNL442_STATUS_ADDR A:0xe62dd08
y.create.l HWIO_PMIC_ARB_OBS2_CHNL443_STATUS_ADDR A:0xe62dd88
y.create.l HWIO_PMIC_ARB_OBS2_CHNL444_STATUS_ADDR A:0xe62de08
y.create.l HWIO_PMIC_ARB_OBS2_CHNL445_STATUS_ADDR A:0xe62de88
y.create.l HWIO_PMIC_ARB_OBS2_CHNL446_STATUS_ADDR A:0xe62df08
y.create.l HWIO_PMIC_ARB_OBS2_CHNL447_STATUS_ADDR A:0xe62df88
y.create.l HWIO_PMIC_ARB_OBS2_CHNL448_STATUS_ADDR A:0xe62e008
y.create.l HWIO_PMIC_ARB_OBS2_CHNL449_STATUS_ADDR A:0xe62e088
y.create.l HWIO_PMIC_ARB_OBS2_CHNL450_STATUS_ADDR A:0xe62e108
y.create.l HWIO_PMIC_ARB_OBS2_CHNL451_STATUS_ADDR A:0xe62e188
y.create.l HWIO_PMIC_ARB_OBS2_CHNL452_STATUS_ADDR A:0xe62e208
y.create.l HWIO_PMIC_ARB_OBS2_CHNL453_STATUS_ADDR A:0xe62e288
y.create.l HWIO_PMIC_ARB_OBS2_CHNL454_STATUS_ADDR A:0xe62e308
y.create.l HWIO_PMIC_ARB_OBS2_CHNL455_STATUS_ADDR A:0xe62e388
y.create.l HWIO_PMIC_ARB_OBS2_CHNL456_STATUS_ADDR A:0xe62e408
y.create.l HWIO_PMIC_ARB_OBS2_CHNL457_STATUS_ADDR A:0xe62e488
y.create.l HWIO_PMIC_ARB_OBS2_CHNL458_STATUS_ADDR A:0xe62e508
y.create.l HWIO_PMIC_ARB_OBS2_CHNL459_STATUS_ADDR A:0xe62e588
y.create.l HWIO_PMIC_ARB_OBS2_CHNL460_STATUS_ADDR A:0xe62e608
y.create.l HWIO_PMIC_ARB_OBS2_CHNL461_STATUS_ADDR A:0xe62e688
y.create.l HWIO_PMIC_ARB_OBS2_CHNL462_STATUS_ADDR A:0xe62e708
y.create.l HWIO_PMIC_ARB_OBS2_CHNL463_STATUS_ADDR A:0xe62e788
y.create.l HWIO_PMIC_ARB_OBS2_CHNL464_STATUS_ADDR A:0xe62e808
y.create.l HWIO_PMIC_ARB_OBS2_CHNL465_STATUS_ADDR A:0xe62e888
y.create.l HWIO_PMIC_ARB_OBS2_CHNL466_STATUS_ADDR A:0xe62e908
y.create.l HWIO_PMIC_ARB_OBS2_CHNL467_STATUS_ADDR A:0xe62e988
y.create.l HWIO_PMIC_ARB_OBS2_CHNL468_STATUS_ADDR A:0xe62ea08
y.create.l HWIO_PMIC_ARB_OBS2_CHNL469_STATUS_ADDR A:0xe62ea88
y.create.l HWIO_PMIC_ARB_OBS2_CHNL470_STATUS_ADDR A:0xe62eb08
y.create.l HWIO_PMIC_ARB_OBS2_CHNL471_STATUS_ADDR A:0xe62eb88
y.create.l HWIO_PMIC_ARB_OBS2_CHNL472_STATUS_ADDR A:0xe62ec08
y.create.l HWIO_PMIC_ARB_OBS2_CHNL473_STATUS_ADDR A:0xe62ec88
y.create.l HWIO_PMIC_ARB_OBS2_CHNL474_STATUS_ADDR A:0xe62ed08
y.create.l HWIO_PMIC_ARB_OBS2_CHNL475_STATUS_ADDR A:0xe62ed88
y.create.l HWIO_PMIC_ARB_OBS2_CHNL476_STATUS_ADDR A:0xe62ee08
y.create.l HWIO_PMIC_ARB_OBS2_CHNL477_STATUS_ADDR A:0xe62ee88
y.create.l HWIO_PMIC_ARB_OBS2_CHNL478_STATUS_ADDR A:0xe62ef08
y.create.l HWIO_PMIC_ARB_OBS2_CHNL479_STATUS_ADDR A:0xe62ef88
y.create.l HWIO_PMIC_ARB_OBS2_CHNL480_STATUS_ADDR A:0xe62f008
y.create.l HWIO_PMIC_ARB_OBS2_CHNL481_STATUS_ADDR A:0xe62f088
y.create.l HWIO_PMIC_ARB_OBS2_CHNL482_STATUS_ADDR A:0xe62f108
y.create.l HWIO_PMIC_ARB_OBS2_CHNL483_STATUS_ADDR A:0xe62f188
y.create.l HWIO_PMIC_ARB_OBS2_CHNL484_STATUS_ADDR A:0xe62f208
y.create.l HWIO_PMIC_ARB_OBS2_CHNL485_STATUS_ADDR A:0xe62f288
y.create.l HWIO_PMIC_ARB_OBS2_CHNL486_STATUS_ADDR A:0xe62f308
y.create.l HWIO_PMIC_ARB_OBS2_CHNL487_STATUS_ADDR A:0xe62f388
y.create.l HWIO_PMIC_ARB_OBS2_CHNL488_STATUS_ADDR A:0xe62f408
y.create.l HWIO_PMIC_ARB_OBS2_CHNL489_STATUS_ADDR A:0xe62f488
y.create.l HWIO_PMIC_ARB_OBS2_CHNL490_STATUS_ADDR A:0xe62f508
y.create.l HWIO_PMIC_ARB_OBS2_CHNL491_STATUS_ADDR A:0xe62f588
y.create.l HWIO_PMIC_ARB_OBS2_CHNL492_STATUS_ADDR A:0xe62f608
y.create.l HWIO_PMIC_ARB_OBS2_CHNL493_STATUS_ADDR A:0xe62f688
y.create.l HWIO_PMIC_ARB_OBS2_CHNL494_STATUS_ADDR A:0xe62f708
y.create.l HWIO_PMIC_ARB_OBS2_CHNL495_STATUS_ADDR A:0xe62f788
y.create.l HWIO_PMIC_ARB_OBS2_CHNL496_STATUS_ADDR A:0xe62f808
y.create.l HWIO_PMIC_ARB_OBS2_CHNL497_STATUS_ADDR A:0xe62f888
y.create.l HWIO_PMIC_ARB_OBS2_CHNL498_STATUS_ADDR A:0xe62f908
y.create.l HWIO_PMIC_ARB_OBS2_CHNL499_STATUS_ADDR A:0xe62f988
y.create.l HWIO_PMIC_ARB_OBS2_CHNL500_STATUS_ADDR A:0xe62fa08
y.create.l HWIO_PMIC_ARB_OBS2_CHNL501_STATUS_ADDR A:0xe62fa88
y.create.l HWIO_PMIC_ARB_OBS2_CHNL502_STATUS_ADDR A:0xe62fb08
y.create.l HWIO_PMIC_ARB_OBS2_CHNL503_STATUS_ADDR A:0xe62fb88
y.create.l HWIO_PMIC_ARB_OBS2_CHNL504_STATUS_ADDR A:0xe62fc08
y.create.l HWIO_PMIC_ARB_OBS2_CHNL505_STATUS_ADDR A:0xe62fc88
y.create.l HWIO_PMIC_ARB_OBS2_CHNL506_STATUS_ADDR A:0xe62fd08
y.create.l HWIO_PMIC_ARB_OBS2_CHNL507_STATUS_ADDR A:0xe62fd88
y.create.l HWIO_PMIC_ARB_OBS2_CHNL508_STATUS_ADDR A:0xe62fe08
y.create.l HWIO_PMIC_ARB_OBS2_CHNL509_STATUS_ADDR A:0xe62fe88
y.create.l HWIO_PMIC_ARB_OBS2_CHNL510_STATUS_ADDR A:0xe62ff08
y.create.l HWIO_PMIC_ARB_OBS2_CHNL511_STATUS_ADDR A:0xe62ff88
y.create.l HWIO_PMIC_ARB_OBS3_CHNL0_STATUS_ADDR A:0xe630008
y.create.l HWIO_PMIC_ARB_OBS3_CHNL1_STATUS_ADDR A:0xe630088
y.create.l HWIO_PMIC_ARB_OBS3_CHNL2_STATUS_ADDR A:0xe630108
y.create.l HWIO_PMIC_ARB_OBS3_CHNL3_STATUS_ADDR A:0xe630188
y.create.l HWIO_PMIC_ARB_OBS3_CHNL4_STATUS_ADDR A:0xe630208
y.create.l HWIO_PMIC_ARB_OBS3_CHNL5_STATUS_ADDR A:0xe630288
y.create.l HWIO_PMIC_ARB_OBS3_CHNL6_STATUS_ADDR A:0xe630308
y.create.l HWIO_PMIC_ARB_OBS3_CHNL7_STATUS_ADDR A:0xe630388
y.create.l HWIO_PMIC_ARB_OBS3_CHNL8_STATUS_ADDR A:0xe630408
y.create.l HWIO_PMIC_ARB_OBS3_CHNL9_STATUS_ADDR A:0xe630488
y.create.l HWIO_PMIC_ARB_OBS3_CHNL10_STATUS_ADDR A:0xe630508
y.create.l HWIO_PMIC_ARB_OBS3_CHNL11_STATUS_ADDR A:0xe630588
y.create.l HWIO_PMIC_ARB_OBS3_CHNL12_STATUS_ADDR A:0xe630608
y.create.l HWIO_PMIC_ARB_OBS3_CHNL13_STATUS_ADDR A:0xe630688
y.create.l HWIO_PMIC_ARB_OBS3_CHNL14_STATUS_ADDR A:0xe630708
y.create.l HWIO_PMIC_ARB_OBS3_CHNL15_STATUS_ADDR A:0xe630788
y.create.l HWIO_PMIC_ARB_OBS3_CHNL16_STATUS_ADDR A:0xe630808
y.create.l HWIO_PMIC_ARB_OBS3_CHNL17_STATUS_ADDR A:0xe630888
y.create.l HWIO_PMIC_ARB_OBS3_CHNL18_STATUS_ADDR A:0xe630908
y.create.l HWIO_PMIC_ARB_OBS3_CHNL19_STATUS_ADDR A:0xe630988
y.create.l HWIO_PMIC_ARB_OBS3_CHNL20_STATUS_ADDR A:0xe630a08
y.create.l HWIO_PMIC_ARB_OBS3_CHNL21_STATUS_ADDR A:0xe630a88
y.create.l HWIO_PMIC_ARB_OBS3_CHNL22_STATUS_ADDR A:0xe630b08
y.create.l HWIO_PMIC_ARB_OBS3_CHNL23_STATUS_ADDR A:0xe630b88
y.create.l HWIO_PMIC_ARB_OBS3_CHNL24_STATUS_ADDR A:0xe630c08
y.create.l HWIO_PMIC_ARB_OBS3_CHNL25_STATUS_ADDR A:0xe630c88
y.create.l HWIO_PMIC_ARB_OBS3_CHNL26_STATUS_ADDR A:0xe630d08
y.create.l HWIO_PMIC_ARB_OBS3_CHNL27_STATUS_ADDR A:0xe630d88
y.create.l HWIO_PMIC_ARB_OBS3_CHNL28_STATUS_ADDR A:0xe630e08
y.create.l HWIO_PMIC_ARB_OBS3_CHNL29_STATUS_ADDR A:0xe630e88
y.create.l HWIO_PMIC_ARB_OBS3_CHNL30_STATUS_ADDR A:0xe630f08
y.create.l HWIO_PMIC_ARB_OBS3_CHNL31_STATUS_ADDR A:0xe630f88
y.create.l HWIO_PMIC_ARB_OBS3_CHNL32_STATUS_ADDR A:0xe631008
y.create.l HWIO_PMIC_ARB_OBS3_CHNL33_STATUS_ADDR A:0xe631088
y.create.l HWIO_PMIC_ARB_OBS3_CHNL34_STATUS_ADDR A:0xe631108
y.create.l HWIO_PMIC_ARB_OBS3_CHNL35_STATUS_ADDR A:0xe631188
y.create.l HWIO_PMIC_ARB_OBS3_CHNL36_STATUS_ADDR A:0xe631208
y.create.l HWIO_PMIC_ARB_OBS3_CHNL37_STATUS_ADDR A:0xe631288
y.create.l HWIO_PMIC_ARB_OBS3_CHNL38_STATUS_ADDR A:0xe631308
y.create.l HWIO_PMIC_ARB_OBS3_CHNL39_STATUS_ADDR A:0xe631388
y.create.l HWIO_PMIC_ARB_OBS3_CHNL40_STATUS_ADDR A:0xe631408
y.create.l HWIO_PMIC_ARB_OBS3_CHNL41_STATUS_ADDR A:0xe631488
y.create.l HWIO_PMIC_ARB_OBS3_CHNL42_STATUS_ADDR A:0xe631508
y.create.l HWIO_PMIC_ARB_OBS3_CHNL43_STATUS_ADDR A:0xe631588
y.create.l HWIO_PMIC_ARB_OBS3_CHNL44_STATUS_ADDR A:0xe631608
y.create.l HWIO_PMIC_ARB_OBS3_CHNL45_STATUS_ADDR A:0xe631688
y.create.l HWIO_PMIC_ARB_OBS3_CHNL46_STATUS_ADDR A:0xe631708
y.create.l HWIO_PMIC_ARB_OBS3_CHNL47_STATUS_ADDR A:0xe631788
y.create.l HWIO_PMIC_ARB_OBS3_CHNL48_STATUS_ADDR A:0xe631808
y.create.l HWIO_PMIC_ARB_OBS3_CHNL49_STATUS_ADDR A:0xe631888
y.create.l HWIO_PMIC_ARB_OBS3_CHNL50_STATUS_ADDR A:0xe631908
y.create.l HWIO_PMIC_ARB_OBS3_CHNL51_STATUS_ADDR A:0xe631988
y.create.l HWIO_PMIC_ARB_OBS3_CHNL52_STATUS_ADDR A:0xe631a08
y.create.l HWIO_PMIC_ARB_OBS3_CHNL53_STATUS_ADDR A:0xe631a88
y.create.l HWIO_PMIC_ARB_OBS3_CHNL54_STATUS_ADDR A:0xe631b08
y.create.l HWIO_PMIC_ARB_OBS3_CHNL55_STATUS_ADDR A:0xe631b88
y.create.l HWIO_PMIC_ARB_OBS3_CHNL56_STATUS_ADDR A:0xe631c08
y.create.l HWIO_PMIC_ARB_OBS3_CHNL57_STATUS_ADDR A:0xe631c88
y.create.l HWIO_PMIC_ARB_OBS3_CHNL58_STATUS_ADDR A:0xe631d08
y.create.l HWIO_PMIC_ARB_OBS3_CHNL59_STATUS_ADDR A:0xe631d88
y.create.l HWIO_PMIC_ARB_OBS3_CHNL60_STATUS_ADDR A:0xe631e08
y.create.l HWIO_PMIC_ARB_OBS3_CHNL61_STATUS_ADDR A:0xe631e88
y.create.l HWIO_PMIC_ARB_OBS3_CHNL62_STATUS_ADDR A:0xe631f08
y.create.l HWIO_PMIC_ARB_OBS3_CHNL63_STATUS_ADDR A:0xe631f88
y.create.l HWIO_PMIC_ARB_OBS3_CHNL64_STATUS_ADDR A:0xe632008
y.create.l HWIO_PMIC_ARB_OBS3_CHNL65_STATUS_ADDR A:0xe632088
y.create.l HWIO_PMIC_ARB_OBS3_CHNL66_STATUS_ADDR A:0xe632108
y.create.l HWIO_PMIC_ARB_OBS3_CHNL67_STATUS_ADDR A:0xe632188
y.create.l HWIO_PMIC_ARB_OBS3_CHNL68_STATUS_ADDR A:0xe632208
y.create.l HWIO_PMIC_ARB_OBS3_CHNL69_STATUS_ADDR A:0xe632288
y.create.l HWIO_PMIC_ARB_OBS3_CHNL70_STATUS_ADDR A:0xe632308
y.create.l HWIO_PMIC_ARB_OBS3_CHNL71_STATUS_ADDR A:0xe632388
y.create.l HWIO_PMIC_ARB_OBS3_CHNL72_STATUS_ADDR A:0xe632408
y.create.l HWIO_PMIC_ARB_OBS3_CHNL73_STATUS_ADDR A:0xe632488
y.create.l HWIO_PMIC_ARB_OBS3_CHNL74_STATUS_ADDR A:0xe632508
y.create.l HWIO_PMIC_ARB_OBS3_CHNL75_STATUS_ADDR A:0xe632588
y.create.l HWIO_PMIC_ARB_OBS3_CHNL76_STATUS_ADDR A:0xe632608
y.create.l HWIO_PMIC_ARB_OBS3_CHNL77_STATUS_ADDR A:0xe632688
y.create.l HWIO_PMIC_ARB_OBS3_CHNL78_STATUS_ADDR A:0xe632708
y.create.l HWIO_PMIC_ARB_OBS3_CHNL79_STATUS_ADDR A:0xe632788
y.create.l HWIO_PMIC_ARB_OBS3_CHNL80_STATUS_ADDR A:0xe632808
y.create.l HWIO_PMIC_ARB_OBS3_CHNL81_STATUS_ADDR A:0xe632888
y.create.l HWIO_PMIC_ARB_OBS3_CHNL82_STATUS_ADDR A:0xe632908
y.create.l HWIO_PMIC_ARB_OBS3_CHNL83_STATUS_ADDR A:0xe632988
y.create.l HWIO_PMIC_ARB_OBS3_CHNL84_STATUS_ADDR A:0xe632a08
y.create.l HWIO_PMIC_ARB_OBS3_CHNL85_STATUS_ADDR A:0xe632a88
y.create.l HWIO_PMIC_ARB_OBS3_CHNL86_STATUS_ADDR A:0xe632b08
y.create.l HWIO_PMIC_ARB_OBS3_CHNL87_STATUS_ADDR A:0xe632b88
y.create.l HWIO_PMIC_ARB_OBS3_CHNL88_STATUS_ADDR A:0xe632c08
y.create.l HWIO_PMIC_ARB_OBS3_CHNL89_STATUS_ADDR A:0xe632c88
y.create.l HWIO_PMIC_ARB_OBS3_CHNL90_STATUS_ADDR A:0xe632d08
y.create.l HWIO_PMIC_ARB_OBS3_CHNL91_STATUS_ADDR A:0xe632d88
y.create.l HWIO_PMIC_ARB_OBS3_CHNL92_STATUS_ADDR A:0xe632e08
y.create.l HWIO_PMIC_ARB_OBS3_CHNL93_STATUS_ADDR A:0xe632e88
y.create.l HWIO_PMIC_ARB_OBS3_CHNL94_STATUS_ADDR A:0xe632f08
y.create.l HWIO_PMIC_ARB_OBS3_CHNL95_STATUS_ADDR A:0xe632f88
y.create.l HWIO_PMIC_ARB_OBS3_CHNL96_STATUS_ADDR A:0xe633008
y.create.l HWIO_PMIC_ARB_OBS3_CHNL97_STATUS_ADDR A:0xe633088
y.create.l HWIO_PMIC_ARB_OBS3_CHNL98_STATUS_ADDR A:0xe633108
y.create.l HWIO_PMIC_ARB_OBS3_CHNL99_STATUS_ADDR A:0xe633188
y.create.l HWIO_PMIC_ARB_OBS3_CHNL100_STATUS_ADDR A:0xe633208
y.create.l HWIO_PMIC_ARB_OBS3_CHNL101_STATUS_ADDR A:0xe633288
y.create.l HWIO_PMIC_ARB_OBS3_CHNL102_STATUS_ADDR A:0xe633308
y.create.l HWIO_PMIC_ARB_OBS3_CHNL103_STATUS_ADDR A:0xe633388
y.create.l HWIO_PMIC_ARB_OBS3_CHNL104_STATUS_ADDR A:0xe633408
y.create.l HWIO_PMIC_ARB_OBS3_CHNL105_STATUS_ADDR A:0xe633488
y.create.l HWIO_PMIC_ARB_OBS3_CHNL106_STATUS_ADDR A:0xe633508
y.create.l HWIO_PMIC_ARB_OBS3_CHNL107_STATUS_ADDR A:0xe633588
y.create.l HWIO_PMIC_ARB_OBS3_CHNL108_STATUS_ADDR A:0xe633608
y.create.l HWIO_PMIC_ARB_OBS3_CHNL109_STATUS_ADDR A:0xe633688
y.create.l HWIO_PMIC_ARB_OBS3_CHNL110_STATUS_ADDR A:0xe633708
y.create.l HWIO_PMIC_ARB_OBS3_CHNL111_STATUS_ADDR A:0xe633788
y.create.l HWIO_PMIC_ARB_OBS3_CHNL112_STATUS_ADDR A:0xe633808
y.create.l HWIO_PMIC_ARB_OBS3_CHNL113_STATUS_ADDR A:0xe633888
y.create.l HWIO_PMIC_ARB_OBS3_CHNL114_STATUS_ADDR A:0xe633908
y.create.l HWIO_PMIC_ARB_OBS3_CHNL115_STATUS_ADDR A:0xe633988
y.create.l HWIO_PMIC_ARB_OBS3_CHNL116_STATUS_ADDR A:0xe633a08
y.create.l HWIO_PMIC_ARB_OBS3_CHNL117_STATUS_ADDR A:0xe633a88
y.create.l HWIO_PMIC_ARB_OBS3_CHNL118_STATUS_ADDR A:0xe633b08
y.create.l HWIO_PMIC_ARB_OBS3_CHNL119_STATUS_ADDR A:0xe633b88
y.create.l HWIO_PMIC_ARB_OBS3_CHNL120_STATUS_ADDR A:0xe633c08
y.create.l HWIO_PMIC_ARB_OBS3_CHNL121_STATUS_ADDR A:0xe633c88
y.create.l HWIO_PMIC_ARB_OBS3_CHNL122_STATUS_ADDR A:0xe633d08
y.create.l HWIO_PMIC_ARB_OBS3_CHNL123_STATUS_ADDR A:0xe633d88
y.create.l HWIO_PMIC_ARB_OBS3_CHNL124_STATUS_ADDR A:0xe633e08
y.create.l HWIO_PMIC_ARB_OBS3_CHNL125_STATUS_ADDR A:0xe633e88
y.create.l HWIO_PMIC_ARB_OBS3_CHNL126_STATUS_ADDR A:0xe633f08
y.create.l HWIO_PMIC_ARB_OBS3_CHNL127_STATUS_ADDR A:0xe633f88
y.create.l HWIO_PMIC_ARB_OBS3_CHNL128_STATUS_ADDR A:0xe634008
y.create.l HWIO_PMIC_ARB_OBS3_CHNL129_STATUS_ADDR A:0xe634088
y.create.l HWIO_PMIC_ARB_OBS3_CHNL130_STATUS_ADDR A:0xe634108
y.create.l HWIO_PMIC_ARB_OBS3_CHNL131_STATUS_ADDR A:0xe634188
y.create.l HWIO_PMIC_ARB_OBS3_CHNL132_STATUS_ADDR A:0xe634208
y.create.l HWIO_PMIC_ARB_OBS3_CHNL133_STATUS_ADDR A:0xe634288
y.create.l HWIO_PMIC_ARB_OBS3_CHNL134_STATUS_ADDR A:0xe634308
y.create.l HWIO_PMIC_ARB_OBS3_CHNL135_STATUS_ADDR A:0xe634388
y.create.l HWIO_PMIC_ARB_OBS3_CHNL136_STATUS_ADDR A:0xe634408
y.create.l HWIO_PMIC_ARB_OBS3_CHNL137_STATUS_ADDR A:0xe634488
y.create.l HWIO_PMIC_ARB_OBS3_CHNL138_STATUS_ADDR A:0xe634508
y.create.l HWIO_PMIC_ARB_OBS3_CHNL139_STATUS_ADDR A:0xe634588
y.create.l HWIO_PMIC_ARB_OBS3_CHNL140_STATUS_ADDR A:0xe634608
y.create.l HWIO_PMIC_ARB_OBS3_CHNL141_STATUS_ADDR A:0xe634688
y.create.l HWIO_PMIC_ARB_OBS3_CHNL142_STATUS_ADDR A:0xe634708
y.create.l HWIO_PMIC_ARB_OBS3_CHNL143_STATUS_ADDR A:0xe634788
y.create.l HWIO_PMIC_ARB_OBS3_CHNL144_STATUS_ADDR A:0xe634808
y.create.l HWIO_PMIC_ARB_OBS3_CHNL145_STATUS_ADDR A:0xe634888
y.create.l HWIO_PMIC_ARB_OBS3_CHNL146_STATUS_ADDR A:0xe634908
y.create.l HWIO_PMIC_ARB_OBS3_CHNL147_STATUS_ADDR A:0xe634988
y.create.l HWIO_PMIC_ARB_OBS3_CHNL148_STATUS_ADDR A:0xe634a08
y.create.l HWIO_PMIC_ARB_OBS3_CHNL149_STATUS_ADDR A:0xe634a88
y.create.l HWIO_PMIC_ARB_OBS3_CHNL150_STATUS_ADDR A:0xe634b08
y.create.l HWIO_PMIC_ARB_OBS3_CHNL151_STATUS_ADDR A:0xe634b88
y.create.l HWIO_PMIC_ARB_OBS3_CHNL152_STATUS_ADDR A:0xe634c08
y.create.l HWIO_PMIC_ARB_OBS3_CHNL153_STATUS_ADDR A:0xe634c88
y.create.l HWIO_PMIC_ARB_OBS3_CHNL154_STATUS_ADDR A:0xe634d08
y.create.l HWIO_PMIC_ARB_OBS3_CHNL155_STATUS_ADDR A:0xe634d88
y.create.l HWIO_PMIC_ARB_OBS3_CHNL156_STATUS_ADDR A:0xe634e08
y.create.l HWIO_PMIC_ARB_OBS3_CHNL157_STATUS_ADDR A:0xe634e88
y.create.l HWIO_PMIC_ARB_OBS3_CHNL158_STATUS_ADDR A:0xe634f08
y.create.l HWIO_PMIC_ARB_OBS3_CHNL159_STATUS_ADDR A:0xe634f88
y.create.l HWIO_PMIC_ARB_OBS3_CHNL160_STATUS_ADDR A:0xe635008
y.create.l HWIO_PMIC_ARB_OBS3_CHNL161_STATUS_ADDR A:0xe635088
y.create.l HWIO_PMIC_ARB_OBS3_CHNL162_STATUS_ADDR A:0xe635108
y.create.l HWIO_PMIC_ARB_OBS3_CHNL163_STATUS_ADDR A:0xe635188
y.create.l HWIO_PMIC_ARB_OBS3_CHNL164_STATUS_ADDR A:0xe635208
y.create.l HWIO_PMIC_ARB_OBS3_CHNL165_STATUS_ADDR A:0xe635288
y.create.l HWIO_PMIC_ARB_OBS3_CHNL166_STATUS_ADDR A:0xe635308
y.create.l HWIO_PMIC_ARB_OBS3_CHNL167_STATUS_ADDR A:0xe635388
y.create.l HWIO_PMIC_ARB_OBS3_CHNL168_STATUS_ADDR A:0xe635408
y.create.l HWIO_PMIC_ARB_OBS3_CHNL169_STATUS_ADDR A:0xe635488
y.create.l HWIO_PMIC_ARB_OBS3_CHNL170_STATUS_ADDR A:0xe635508
y.create.l HWIO_PMIC_ARB_OBS3_CHNL171_STATUS_ADDR A:0xe635588
y.create.l HWIO_PMIC_ARB_OBS3_CHNL172_STATUS_ADDR A:0xe635608
y.create.l HWIO_PMIC_ARB_OBS3_CHNL173_STATUS_ADDR A:0xe635688
y.create.l HWIO_PMIC_ARB_OBS3_CHNL174_STATUS_ADDR A:0xe635708
y.create.l HWIO_PMIC_ARB_OBS3_CHNL175_STATUS_ADDR A:0xe635788
y.create.l HWIO_PMIC_ARB_OBS3_CHNL176_STATUS_ADDR A:0xe635808
y.create.l HWIO_PMIC_ARB_OBS3_CHNL177_STATUS_ADDR A:0xe635888
y.create.l HWIO_PMIC_ARB_OBS3_CHNL178_STATUS_ADDR A:0xe635908
y.create.l HWIO_PMIC_ARB_OBS3_CHNL179_STATUS_ADDR A:0xe635988
y.create.l HWIO_PMIC_ARB_OBS3_CHNL180_STATUS_ADDR A:0xe635a08
y.create.l HWIO_PMIC_ARB_OBS3_CHNL181_STATUS_ADDR A:0xe635a88
y.create.l HWIO_PMIC_ARB_OBS3_CHNL182_STATUS_ADDR A:0xe635b08
y.create.l HWIO_PMIC_ARB_OBS3_CHNL183_STATUS_ADDR A:0xe635b88
y.create.l HWIO_PMIC_ARB_OBS3_CHNL184_STATUS_ADDR A:0xe635c08
y.create.l HWIO_PMIC_ARB_OBS3_CHNL185_STATUS_ADDR A:0xe635c88
y.create.l HWIO_PMIC_ARB_OBS3_CHNL186_STATUS_ADDR A:0xe635d08
y.create.l HWIO_PMIC_ARB_OBS3_CHNL187_STATUS_ADDR A:0xe635d88
y.create.l HWIO_PMIC_ARB_OBS3_CHNL188_STATUS_ADDR A:0xe635e08
y.create.l HWIO_PMIC_ARB_OBS3_CHNL189_STATUS_ADDR A:0xe635e88
y.create.l HWIO_PMIC_ARB_OBS3_CHNL190_STATUS_ADDR A:0xe635f08
y.create.l HWIO_PMIC_ARB_OBS3_CHNL191_STATUS_ADDR A:0xe635f88
y.create.l HWIO_PMIC_ARB_OBS3_CHNL192_STATUS_ADDR A:0xe636008
y.create.l HWIO_PMIC_ARB_OBS3_CHNL193_STATUS_ADDR A:0xe636088
y.create.l HWIO_PMIC_ARB_OBS3_CHNL194_STATUS_ADDR A:0xe636108
y.create.l HWIO_PMIC_ARB_OBS3_CHNL195_STATUS_ADDR A:0xe636188
y.create.l HWIO_PMIC_ARB_OBS3_CHNL196_STATUS_ADDR A:0xe636208
y.create.l HWIO_PMIC_ARB_OBS3_CHNL197_STATUS_ADDR A:0xe636288
y.create.l HWIO_PMIC_ARB_OBS3_CHNL198_STATUS_ADDR A:0xe636308
y.create.l HWIO_PMIC_ARB_OBS3_CHNL199_STATUS_ADDR A:0xe636388
y.create.l HWIO_PMIC_ARB_OBS3_CHNL200_STATUS_ADDR A:0xe636408
y.create.l HWIO_PMIC_ARB_OBS3_CHNL201_STATUS_ADDR A:0xe636488
y.create.l HWIO_PMIC_ARB_OBS3_CHNL202_STATUS_ADDR A:0xe636508
y.create.l HWIO_PMIC_ARB_OBS3_CHNL203_STATUS_ADDR A:0xe636588
y.create.l HWIO_PMIC_ARB_OBS3_CHNL204_STATUS_ADDR A:0xe636608
y.create.l HWIO_PMIC_ARB_OBS3_CHNL205_STATUS_ADDR A:0xe636688
y.create.l HWIO_PMIC_ARB_OBS3_CHNL206_STATUS_ADDR A:0xe636708
y.create.l HWIO_PMIC_ARB_OBS3_CHNL207_STATUS_ADDR A:0xe636788
y.create.l HWIO_PMIC_ARB_OBS3_CHNL208_STATUS_ADDR A:0xe636808
y.create.l HWIO_PMIC_ARB_OBS3_CHNL209_STATUS_ADDR A:0xe636888
y.create.l HWIO_PMIC_ARB_OBS3_CHNL210_STATUS_ADDR A:0xe636908
y.create.l HWIO_PMIC_ARB_OBS3_CHNL211_STATUS_ADDR A:0xe636988
y.create.l HWIO_PMIC_ARB_OBS3_CHNL212_STATUS_ADDR A:0xe636a08
y.create.l HWIO_PMIC_ARB_OBS3_CHNL213_STATUS_ADDR A:0xe636a88
y.create.l HWIO_PMIC_ARB_OBS3_CHNL214_STATUS_ADDR A:0xe636b08
y.create.l HWIO_PMIC_ARB_OBS3_CHNL215_STATUS_ADDR A:0xe636b88
y.create.l HWIO_PMIC_ARB_OBS3_CHNL216_STATUS_ADDR A:0xe636c08
y.create.l HWIO_PMIC_ARB_OBS3_CHNL217_STATUS_ADDR A:0xe636c88
y.create.l HWIO_PMIC_ARB_OBS3_CHNL218_STATUS_ADDR A:0xe636d08
y.create.l HWIO_PMIC_ARB_OBS3_CHNL219_STATUS_ADDR A:0xe636d88
y.create.l HWIO_PMIC_ARB_OBS3_CHNL220_STATUS_ADDR A:0xe636e08
y.create.l HWIO_PMIC_ARB_OBS3_CHNL221_STATUS_ADDR A:0xe636e88
y.create.l HWIO_PMIC_ARB_OBS3_CHNL222_STATUS_ADDR A:0xe636f08
y.create.l HWIO_PMIC_ARB_OBS3_CHNL223_STATUS_ADDR A:0xe636f88
y.create.l HWIO_PMIC_ARB_OBS3_CHNL224_STATUS_ADDR A:0xe637008
y.create.l HWIO_PMIC_ARB_OBS3_CHNL225_STATUS_ADDR A:0xe637088
y.create.l HWIO_PMIC_ARB_OBS3_CHNL226_STATUS_ADDR A:0xe637108
y.create.l HWIO_PMIC_ARB_OBS3_CHNL227_STATUS_ADDR A:0xe637188
y.create.l HWIO_PMIC_ARB_OBS3_CHNL228_STATUS_ADDR A:0xe637208
y.create.l HWIO_PMIC_ARB_OBS3_CHNL229_STATUS_ADDR A:0xe637288
y.create.l HWIO_PMIC_ARB_OBS3_CHNL230_STATUS_ADDR A:0xe637308
y.create.l HWIO_PMIC_ARB_OBS3_CHNL231_STATUS_ADDR A:0xe637388
y.create.l HWIO_PMIC_ARB_OBS3_CHNL232_STATUS_ADDR A:0xe637408
y.create.l HWIO_PMIC_ARB_OBS3_CHNL233_STATUS_ADDR A:0xe637488
y.create.l HWIO_PMIC_ARB_OBS3_CHNL234_STATUS_ADDR A:0xe637508
y.create.l HWIO_PMIC_ARB_OBS3_CHNL235_STATUS_ADDR A:0xe637588
y.create.l HWIO_PMIC_ARB_OBS3_CHNL236_STATUS_ADDR A:0xe637608
y.create.l HWIO_PMIC_ARB_OBS3_CHNL237_STATUS_ADDR A:0xe637688
y.create.l HWIO_PMIC_ARB_OBS3_CHNL238_STATUS_ADDR A:0xe637708
y.create.l HWIO_PMIC_ARB_OBS3_CHNL239_STATUS_ADDR A:0xe637788
y.create.l HWIO_PMIC_ARB_OBS3_CHNL240_STATUS_ADDR A:0xe637808
y.create.l HWIO_PMIC_ARB_OBS3_CHNL241_STATUS_ADDR A:0xe637888
y.create.l HWIO_PMIC_ARB_OBS3_CHNL242_STATUS_ADDR A:0xe637908
y.create.l HWIO_PMIC_ARB_OBS3_CHNL243_STATUS_ADDR A:0xe637988
y.create.l HWIO_PMIC_ARB_OBS3_CHNL244_STATUS_ADDR A:0xe637a08
y.create.l HWIO_PMIC_ARB_OBS3_CHNL245_STATUS_ADDR A:0xe637a88
y.create.l HWIO_PMIC_ARB_OBS3_CHNL246_STATUS_ADDR A:0xe637b08
y.create.l HWIO_PMIC_ARB_OBS3_CHNL247_STATUS_ADDR A:0xe637b88
y.create.l HWIO_PMIC_ARB_OBS3_CHNL248_STATUS_ADDR A:0xe637c08
y.create.l HWIO_PMIC_ARB_OBS3_CHNL249_STATUS_ADDR A:0xe637c88
y.create.l HWIO_PMIC_ARB_OBS3_CHNL250_STATUS_ADDR A:0xe637d08
y.create.l HWIO_PMIC_ARB_OBS3_CHNL251_STATUS_ADDR A:0xe637d88
y.create.l HWIO_PMIC_ARB_OBS3_CHNL252_STATUS_ADDR A:0xe637e08
y.create.l HWIO_PMIC_ARB_OBS3_CHNL253_STATUS_ADDR A:0xe637e88
y.create.l HWIO_PMIC_ARB_OBS3_CHNL254_STATUS_ADDR A:0xe637f08
y.create.l HWIO_PMIC_ARB_OBS3_CHNL255_STATUS_ADDR A:0xe637f88
y.create.l HWIO_PMIC_ARB_OBS3_CHNL256_STATUS_ADDR A:0xe638008
y.create.l HWIO_PMIC_ARB_OBS3_CHNL257_STATUS_ADDR A:0xe638088
y.create.l HWIO_PMIC_ARB_OBS3_CHNL258_STATUS_ADDR A:0xe638108
y.create.l HWIO_PMIC_ARB_OBS3_CHNL259_STATUS_ADDR A:0xe638188
y.create.l HWIO_PMIC_ARB_OBS3_CHNL260_STATUS_ADDR A:0xe638208
y.create.l HWIO_PMIC_ARB_OBS3_CHNL261_STATUS_ADDR A:0xe638288
y.create.l HWIO_PMIC_ARB_OBS3_CHNL262_STATUS_ADDR A:0xe638308
y.create.l HWIO_PMIC_ARB_OBS3_CHNL263_STATUS_ADDR A:0xe638388
y.create.l HWIO_PMIC_ARB_OBS3_CHNL264_STATUS_ADDR A:0xe638408
y.create.l HWIO_PMIC_ARB_OBS3_CHNL265_STATUS_ADDR A:0xe638488
y.create.l HWIO_PMIC_ARB_OBS3_CHNL266_STATUS_ADDR A:0xe638508
y.create.l HWIO_PMIC_ARB_OBS3_CHNL267_STATUS_ADDR A:0xe638588
y.create.l HWIO_PMIC_ARB_OBS3_CHNL268_STATUS_ADDR A:0xe638608
y.create.l HWIO_PMIC_ARB_OBS3_CHNL269_STATUS_ADDR A:0xe638688
y.create.l HWIO_PMIC_ARB_OBS3_CHNL270_STATUS_ADDR A:0xe638708
y.create.l HWIO_PMIC_ARB_OBS3_CHNL271_STATUS_ADDR A:0xe638788
y.create.l HWIO_PMIC_ARB_OBS3_CHNL272_STATUS_ADDR A:0xe638808
y.create.l HWIO_PMIC_ARB_OBS3_CHNL273_STATUS_ADDR A:0xe638888
y.create.l HWIO_PMIC_ARB_OBS3_CHNL274_STATUS_ADDR A:0xe638908
y.create.l HWIO_PMIC_ARB_OBS3_CHNL275_STATUS_ADDR A:0xe638988
y.create.l HWIO_PMIC_ARB_OBS3_CHNL276_STATUS_ADDR A:0xe638a08
y.create.l HWIO_PMIC_ARB_OBS3_CHNL277_STATUS_ADDR A:0xe638a88
y.create.l HWIO_PMIC_ARB_OBS3_CHNL278_STATUS_ADDR A:0xe638b08
y.create.l HWIO_PMIC_ARB_OBS3_CHNL279_STATUS_ADDR A:0xe638b88
y.create.l HWIO_PMIC_ARB_OBS3_CHNL280_STATUS_ADDR A:0xe638c08
y.create.l HWIO_PMIC_ARB_OBS3_CHNL281_STATUS_ADDR A:0xe638c88
y.create.l HWIO_PMIC_ARB_OBS3_CHNL282_STATUS_ADDR A:0xe638d08
y.create.l HWIO_PMIC_ARB_OBS3_CHNL283_STATUS_ADDR A:0xe638d88
y.create.l HWIO_PMIC_ARB_OBS3_CHNL284_STATUS_ADDR A:0xe638e08
y.create.l HWIO_PMIC_ARB_OBS3_CHNL285_STATUS_ADDR A:0xe638e88
y.create.l HWIO_PMIC_ARB_OBS3_CHNL286_STATUS_ADDR A:0xe638f08
y.create.l HWIO_PMIC_ARB_OBS3_CHNL287_STATUS_ADDR A:0xe638f88
y.create.l HWIO_PMIC_ARB_OBS3_CHNL288_STATUS_ADDR A:0xe639008
y.create.l HWIO_PMIC_ARB_OBS3_CHNL289_STATUS_ADDR A:0xe639088
y.create.l HWIO_PMIC_ARB_OBS3_CHNL290_STATUS_ADDR A:0xe639108
y.create.l HWIO_PMIC_ARB_OBS3_CHNL291_STATUS_ADDR A:0xe639188
y.create.l HWIO_PMIC_ARB_OBS3_CHNL292_STATUS_ADDR A:0xe639208
y.create.l HWIO_PMIC_ARB_OBS3_CHNL293_STATUS_ADDR A:0xe639288
y.create.l HWIO_PMIC_ARB_OBS3_CHNL294_STATUS_ADDR A:0xe639308
y.create.l HWIO_PMIC_ARB_OBS3_CHNL295_STATUS_ADDR A:0xe639388
y.create.l HWIO_PMIC_ARB_OBS3_CHNL296_STATUS_ADDR A:0xe639408
y.create.l HWIO_PMIC_ARB_OBS3_CHNL297_STATUS_ADDR A:0xe639488
y.create.l HWIO_PMIC_ARB_OBS3_CHNL298_STATUS_ADDR A:0xe639508
y.create.l HWIO_PMIC_ARB_OBS3_CHNL299_STATUS_ADDR A:0xe639588
y.create.l HWIO_PMIC_ARB_OBS3_CHNL300_STATUS_ADDR A:0xe639608
y.create.l HWIO_PMIC_ARB_OBS3_CHNL301_STATUS_ADDR A:0xe639688
y.create.l HWIO_PMIC_ARB_OBS3_CHNL302_STATUS_ADDR A:0xe639708
y.create.l HWIO_PMIC_ARB_OBS3_CHNL303_STATUS_ADDR A:0xe639788
y.create.l HWIO_PMIC_ARB_OBS3_CHNL304_STATUS_ADDR A:0xe639808
y.create.l HWIO_PMIC_ARB_OBS3_CHNL305_STATUS_ADDR A:0xe639888
y.create.l HWIO_PMIC_ARB_OBS3_CHNL306_STATUS_ADDR A:0xe639908
y.create.l HWIO_PMIC_ARB_OBS3_CHNL307_STATUS_ADDR A:0xe639988
y.create.l HWIO_PMIC_ARB_OBS3_CHNL308_STATUS_ADDR A:0xe639a08
y.create.l HWIO_PMIC_ARB_OBS3_CHNL309_STATUS_ADDR A:0xe639a88
y.create.l HWIO_PMIC_ARB_OBS3_CHNL310_STATUS_ADDR A:0xe639b08
y.create.l HWIO_PMIC_ARB_OBS3_CHNL311_STATUS_ADDR A:0xe639b88
y.create.l HWIO_PMIC_ARB_OBS3_CHNL312_STATUS_ADDR A:0xe639c08
y.create.l HWIO_PMIC_ARB_OBS3_CHNL313_STATUS_ADDR A:0xe639c88
y.create.l HWIO_PMIC_ARB_OBS3_CHNL314_STATUS_ADDR A:0xe639d08
y.create.l HWIO_PMIC_ARB_OBS3_CHNL315_STATUS_ADDR A:0xe639d88
y.create.l HWIO_PMIC_ARB_OBS3_CHNL316_STATUS_ADDR A:0xe639e08
y.create.l HWIO_PMIC_ARB_OBS3_CHNL317_STATUS_ADDR A:0xe639e88
y.create.l HWIO_PMIC_ARB_OBS3_CHNL318_STATUS_ADDR A:0xe639f08
y.create.l HWIO_PMIC_ARB_OBS3_CHNL319_STATUS_ADDR A:0xe639f88
y.create.l HWIO_PMIC_ARB_OBS3_CHNL320_STATUS_ADDR A:0xe63a008
y.create.l HWIO_PMIC_ARB_OBS3_CHNL321_STATUS_ADDR A:0xe63a088
y.create.l HWIO_PMIC_ARB_OBS3_CHNL322_STATUS_ADDR A:0xe63a108
y.create.l HWIO_PMIC_ARB_OBS3_CHNL323_STATUS_ADDR A:0xe63a188
y.create.l HWIO_PMIC_ARB_OBS3_CHNL324_STATUS_ADDR A:0xe63a208
y.create.l HWIO_PMIC_ARB_OBS3_CHNL325_STATUS_ADDR A:0xe63a288
y.create.l HWIO_PMIC_ARB_OBS3_CHNL326_STATUS_ADDR A:0xe63a308
y.create.l HWIO_PMIC_ARB_OBS3_CHNL327_STATUS_ADDR A:0xe63a388
y.create.l HWIO_PMIC_ARB_OBS3_CHNL328_STATUS_ADDR A:0xe63a408
y.create.l HWIO_PMIC_ARB_OBS3_CHNL329_STATUS_ADDR A:0xe63a488
y.create.l HWIO_PMIC_ARB_OBS3_CHNL330_STATUS_ADDR A:0xe63a508
y.create.l HWIO_PMIC_ARB_OBS3_CHNL331_STATUS_ADDR A:0xe63a588
y.create.l HWIO_PMIC_ARB_OBS3_CHNL332_STATUS_ADDR A:0xe63a608
y.create.l HWIO_PMIC_ARB_OBS3_CHNL333_STATUS_ADDR A:0xe63a688
y.create.l HWIO_PMIC_ARB_OBS3_CHNL334_STATUS_ADDR A:0xe63a708
y.create.l HWIO_PMIC_ARB_OBS3_CHNL335_STATUS_ADDR A:0xe63a788
y.create.l HWIO_PMIC_ARB_OBS3_CHNL336_STATUS_ADDR A:0xe63a808
y.create.l HWIO_PMIC_ARB_OBS3_CHNL337_STATUS_ADDR A:0xe63a888
y.create.l HWIO_PMIC_ARB_OBS3_CHNL338_STATUS_ADDR A:0xe63a908
y.create.l HWIO_PMIC_ARB_OBS3_CHNL339_STATUS_ADDR A:0xe63a988
y.create.l HWIO_PMIC_ARB_OBS3_CHNL340_STATUS_ADDR A:0xe63aa08
y.create.l HWIO_PMIC_ARB_OBS3_CHNL341_STATUS_ADDR A:0xe63aa88
y.create.l HWIO_PMIC_ARB_OBS3_CHNL342_STATUS_ADDR A:0xe63ab08
y.create.l HWIO_PMIC_ARB_OBS3_CHNL343_STATUS_ADDR A:0xe63ab88
y.create.l HWIO_PMIC_ARB_OBS3_CHNL344_STATUS_ADDR A:0xe63ac08
y.create.l HWIO_PMIC_ARB_OBS3_CHNL345_STATUS_ADDR A:0xe63ac88
y.create.l HWIO_PMIC_ARB_OBS3_CHNL346_STATUS_ADDR A:0xe63ad08
y.create.l HWIO_PMIC_ARB_OBS3_CHNL347_STATUS_ADDR A:0xe63ad88
y.create.l HWIO_PMIC_ARB_OBS3_CHNL348_STATUS_ADDR A:0xe63ae08
y.create.l HWIO_PMIC_ARB_OBS3_CHNL349_STATUS_ADDR A:0xe63ae88
y.create.l HWIO_PMIC_ARB_OBS3_CHNL350_STATUS_ADDR A:0xe63af08
y.create.l HWIO_PMIC_ARB_OBS3_CHNL351_STATUS_ADDR A:0xe63af88
y.create.l HWIO_PMIC_ARB_OBS3_CHNL352_STATUS_ADDR A:0xe63b008
y.create.l HWIO_PMIC_ARB_OBS3_CHNL353_STATUS_ADDR A:0xe63b088
y.create.l HWIO_PMIC_ARB_OBS3_CHNL354_STATUS_ADDR A:0xe63b108
y.create.l HWIO_PMIC_ARB_OBS3_CHNL355_STATUS_ADDR A:0xe63b188
y.create.l HWIO_PMIC_ARB_OBS3_CHNL356_STATUS_ADDR A:0xe63b208
y.create.l HWIO_PMIC_ARB_OBS3_CHNL357_STATUS_ADDR A:0xe63b288
y.create.l HWIO_PMIC_ARB_OBS3_CHNL358_STATUS_ADDR A:0xe63b308
y.create.l HWIO_PMIC_ARB_OBS3_CHNL359_STATUS_ADDR A:0xe63b388
y.create.l HWIO_PMIC_ARB_OBS3_CHNL360_STATUS_ADDR A:0xe63b408
y.create.l HWIO_PMIC_ARB_OBS3_CHNL361_STATUS_ADDR A:0xe63b488
y.create.l HWIO_PMIC_ARB_OBS3_CHNL362_STATUS_ADDR A:0xe63b508
y.create.l HWIO_PMIC_ARB_OBS3_CHNL363_STATUS_ADDR A:0xe63b588
y.create.l HWIO_PMIC_ARB_OBS3_CHNL364_STATUS_ADDR A:0xe63b608
y.create.l HWIO_PMIC_ARB_OBS3_CHNL365_STATUS_ADDR A:0xe63b688
y.create.l HWIO_PMIC_ARB_OBS3_CHNL366_STATUS_ADDR A:0xe63b708
y.create.l HWIO_PMIC_ARB_OBS3_CHNL367_STATUS_ADDR A:0xe63b788
y.create.l HWIO_PMIC_ARB_OBS3_CHNL368_STATUS_ADDR A:0xe63b808
y.create.l HWIO_PMIC_ARB_OBS3_CHNL369_STATUS_ADDR A:0xe63b888
y.create.l HWIO_PMIC_ARB_OBS3_CHNL370_STATUS_ADDR A:0xe63b908
y.create.l HWIO_PMIC_ARB_OBS3_CHNL371_STATUS_ADDR A:0xe63b988
y.create.l HWIO_PMIC_ARB_OBS3_CHNL372_STATUS_ADDR A:0xe63ba08
y.create.l HWIO_PMIC_ARB_OBS3_CHNL373_STATUS_ADDR A:0xe63ba88
y.create.l HWIO_PMIC_ARB_OBS3_CHNL374_STATUS_ADDR A:0xe63bb08
y.create.l HWIO_PMIC_ARB_OBS3_CHNL375_STATUS_ADDR A:0xe63bb88
y.create.l HWIO_PMIC_ARB_OBS3_CHNL376_STATUS_ADDR A:0xe63bc08
y.create.l HWIO_PMIC_ARB_OBS3_CHNL377_STATUS_ADDR A:0xe63bc88
y.create.l HWIO_PMIC_ARB_OBS3_CHNL378_STATUS_ADDR A:0xe63bd08
y.create.l HWIO_PMIC_ARB_OBS3_CHNL379_STATUS_ADDR A:0xe63bd88
y.create.l HWIO_PMIC_ARB_OBS3_CHNL380_STATUS_ADDR A:0xe63be08
y.create.l HWIO_PMIC_ARB_OBS3_CHNL381_STATUS_ADDR A:0xe63be88
y.create.l HWIO_PMIC_ARB_OBS3_CHNL382_STATUS_ADDR A:0xe63bf08
y.create.l HWIO_PMIC_ARB_OBS3_CHNL383_STATUS_ADDR A:0xe63bf88
y.create.l HWIO_PMIC_ARB_OBS3_CHNL384_STATUS_ADDR A:0xe63c008
y.create.l HWIO_PMIC_ARB_OBS3_CHNL385_STATUS_ADDR A:0xe63c088
y.create.l HWIO_PMIC_ARB_OBS3_CHNL386_STATUS_ADDR A:0xe63c108
y.create.l HWIO_PMIC_ARB_OBS3_CHNL387_STATUS_ADDR A:0xe63c188
y.create.l HWIO_PMIC_ARB_OBS3_CHNL388_STATUS_ADDR A:0xe63c208
y.create.l HWIO_PMIC_ARB_OBS3_CHNL389_STATUS_ADDR A:0xe63c288
y.create.l HWIO_PMIC_ARB_OBS3_CHNL390_STATUS_ADDR A:0xe63c308
y.create.l HWIO_PMIC_ARB_OBS3_CHNL391_STATUS_ADDR A:0xe63c388
y.create.l HWIO_PMIC_ARB_OBS3_CHNL392_STATUS_ADDR A:0xe63c408
y.create.l HWIO_PMIC_ARB_OBS3_CHNL393_STATUS_ADDR A:0xe63c488
y.create.l HWIO_PMIC_ARB_OBS3_CHNL394_STATUS_ADDR A:0xe63c508
y.create.l HWIO_PMIC_ARB_OBS3_CHNL395_STATUS_ADDR A:0xe63c588
y.create.l HWIO_PMIC_ARB_OBS3_CHNL396_STATUS_ADDR A:0xe63c608
y.create.l HWIO_PMIC_ARB_OBS3_CHNL397_STATUS_ADDR A:0xe63c688
y.create.l HWIO_PMIC_ARB_OBS3_CHNL398_STATUS_ADDR A:0xe63c708
y.create.l HWIO_PMIC_ARB_OBS3_CHNL399_STATUS_ADDR A:0xe63c788
y.create.l HWIO_PMIC_ARB_OBS3_CHNL400_STATUS_ADDR A:0xe63c808
y.create.l HWIO_PMIC_ARB_OBS3_CHNL401_STATUS_ADDR A:0xe63c888
y.create.l HWIO_PMIC_ARB_OBS3_CHNL402_STATUS_ADDR A:0xe63c908
y.create.l HWIO_PMIC_ARB_OBS3_CHNL403_STATUS_ADDR A:0xe63c988
y.create.l HWIO_PMIC_ARB_OBS3_CHNL404_STATUS_ADDR A:0xe63ca08
y.create.l HWIO_PMIC_ARB_OBS3_CHNL405_STATUS_ADDR A:0xe63ca88
y.create.l HWIO_PMIC_ARB_OBS3_CHNL406_STATUS_ADDR A:0xe63cb08
y.create.l HWIO_PMIC_ARB_OBS3_CHNL407_STATUS_ADDR A:0xe63cb88
y.create.l HWIO_PMIC_ARB_OBS3_CHNL408_STATUS_ADDR A:0xe63cc08
y.create.l HWIO_PMIC_ARB_OBS3_CHNL409_STATUS_ADDR A:0xe63cc88
y.create.l HWIO_PMIC_ARB_OBS3_CHNL410_STATUS_ADDR A:0xe63cd08
y.create.l HWIO_PMIC_ARB_OBS3_CHNL411_STATUS_ADDR A:0xe63cd88
y.create.l HWIO_PMIC_ARB_OBS3_CHNL412_STATUS_ADDR A:0xe63ce08
y.create.l HWIO_PMIC_ARB_OBS3_CHNL413_STATUS_ADDR A:0xe63ce88
y.create.l HWIO_PMIC_ARB_OBS3_CHNL414_STATUS_ADDR A:0xe63cf08
y.create.l HWIO_PMIC_ARB_OBS3_CHNL415_STATUS_ADDR A:0xe63cf88
y.create.l HWIO_PMIC_ARB_OBS3_CHNL416_STATUS_ADDR A:0xe63d008
y.create.l HWIO_PMIC_ARB_OBS3_CHNL417_STATUS_ADDR A:0xe63d088
y.create.l HWIO_PMIC_ARB_OBS3_CHNL418_STATUS_ADDR A:0xe63d108
y.create.l HWIO_PMIC_ARB_OBS3_CHNL419_STATUS_ADDR A:0xe63d188
y.create.l HWIO_PMIC_ARB_OBS3_CHNL420_STATUS_ADDR A:0xe63d208
y.create.l HWIO_PMIC_ARB_OBS3_CHNL421_STATUS_ADDR A:0xe63d288
y.create.l HWIO_PMIC_ARB_OBS3_CHNL422_STATUS_ADDR A:0xe63d308
y.create.l HWIO_PMIC_ARB_OBS3_CHNL423_STATUS_ADDR A:0xe63d388
y.create.l HWIO_PMIC_ARB_OBS3_CHNL424_STATUS_ADDR A:0xe63d408
y.create.l HWIO_PMIC_ARB_OBS3_CHNL425_STATUS_ADDR A:0xe63d488
y.create.l HWIO_PMIC_ARB_OBS3_CHNL426_STATUS_ADDR A:0xe63d508
y.create.l HWIO_PMIC_ARB_OBS3_CHNL427_STATUS_ADDR A:0xe63d588
y.create.l HWIO_PMIC_ARB_OBS3_CHNL428_STATUS_ADDR A:0xe63d608
y.create.l HWIO_PMIC_ARB_OBS3_CHNL429_STATUS_ADDR A:0xe63d688
y.create.l HWIO_PMIC_ARB_OBS3_CHNL430_STATUS_ADDR A:0xe63d708
y.create.l HWIO_PMIC_ARB_OBS3_CHNL431_STATUS_ADDR A:0xe63d788
y.create.l HWIO_PMIC_ARB_OBS3_CHNL432_STATUS_ADDR A:0xe63d808
y.create.l HWIO_PMIC_ARB_OBS3_CHNL433_STATUS_ADDR A:0xe63d888
y.create.l HWIO_PMIC_ARB_OBS3_CHNL434_STATUS_ADDR A:0xe63d908
y.create.l HWIO_PMIC_ARB_OBS3_CHNL435_STATUS_ADDR A:0xe63d988
y.create.l HWIO_PMIC_ARB_OBS3_CHNL436_STATUS_ADDR A:0xe63da08
y.create.l HWIO_PMIC_ARB_OBS3_CHNL437_STATUS_ADDR A:0xe63da88
y.create.l HWIO_PMIC_ARB_OBS3_CHNL438_STATUS_ADDR A:0xe63db08
y.create.l HWIO_PMIC_ARB_OBS3_CHNL439_STATUS_ADDR A:0xe63db88
y.create.l HWIO_PMIC_ARB_OBS3_CHNL440_STATUS_ADDR A:0xe63dc08
y.create.l HWIO_PMIC_ARB_OBS3_CHNL441_STATUS_ADDR A:0xe63dc88
y.create.l HWIO_PMIC_ARB_OBS3_CHNL442_STATUS_ADDR A:0xe63dd08
y.create.l HWIO_PMIC_ARB_OBS3_CHNL443_STATUS_ADDR A:0xe63dd88
y.create.l HWIO_PMIC_ARB_OBS3_CHNL444_STATUS_ADDR A:0xe63de08
y.create.l HWIO_PMIC_ARB_OBS3_CHNL445_STATUS_ADDR A:0xe63de88
y.create.l HWIO_PMIC_ARB_OBS3_CHNL446_STATUS_ADDR A:0xe63df08
y.create.l HWIO_PMIC_ARB_OBS3_CHNL447_STATUS_ADDR A:0xe63df88
y.create.l HWIO_PMIC_ARB_OBS3_CHNL448_STATUS_ADDR A:0xe63e008
y.create.l HWIO_PMIC_ARB_OBS3_CHNL449_STATUS_ADDR A:0xe63e088
y.create.l HWIO_PMIC_ARB_OBS3_CHNL450_STATUS_ADDR A:0xe63e108
y.create.l HWIO_PMIC_ARB_OBS3_CHNL451_STATUS_ADDR A:0xe63e188
y.create.l HWIO_PMIC_ARB_OBS3_CHNL452_STATUS_ADDR A:0xe63e208
y.create.l HWIO_PMIC_ARB_OBS3_CHNL453_STATUS_ADDR A:0xe63e288
y.create.l HWIO_PMIC_ARB_OBS3_CHNL454_STATUS_ADDR A:0xe63e308
y.create.l HWIO_PMIC_ARB_OBS3_CHNL455_STATUS_ADDR A:0xe63e388
y.create.l HWIO_PMIC_ARB_OBS3_CHNL456_STATUS_ADDR A:0xe63e408
y.create.l HWIO_PMIC_ARB_OBS3_CHNL457_STATUS_ADDR A:0xe63e488
y.create.l HWIO_PMIC_ARB_OBS3_CHNL458_STATUS_ADDR A:0xe63e508
y.create.l HWIO_PMIC_ARB_OBS3_CHNL459_STATUS_ADDR A:0xe63e588
y.create.l HWIO_PMIC_ARB_OBS3_CHNL460_STATUS_ADDR A:0xe63e608
y.create.l HWIO_PMIC_ARB_OBS3_CHNL461_STATUS_ADDR A:0xe63e688
y.create.l HWIO_PMIC_ARB_OBS3_CHNL462_STATUS_ADDR A:0xe63e708
y.create.l HWIO_PMIC_ARB_OBS3_CHNL463_STATUS_ADDR A:0xe63e788
y.create.l HWIO_PMIC_ARB_OBS3_CHNL464_STATUS_ADDR A:0xe63e808
y.create.l HWIO_PMIC_ARB_OBS3_CHNL465_STATUS_ADDR A:0xe63e888
y.create.l HWIO_PMIC_ARB_OBS3_CHNL466_STATUS_ADDR A:0xe63e908
y.create.l HWIO_PMIC_ARB_OBS3_CHNL467_STATUS_ADDR A:0xe63e988
y.create.l HWIO_PMIC_ARB_OBS3_CHNL468_STATUS_ADDR A:0xe63ea08
y.create.l HWIO_PMIC_ARB_OBS3_CHNL469_STATUS_ADDR A:0xe63ea88
y.create.l HWIO_PMIC_ARB_OBS3_CHNL470_STATUS_ADDR A:0xe63eb08
y.create.l HWIO_PMIC_ARB_OBS3_CHNL471_STATUS_ADDR A:0xe63eb88
y.create.l HWIO_PMIC_ARB_OBS3_CHNL472_STATUS_ADDR A:0xe63ec08
y.create.l HWIO_PMIC_ARB_OBS3_CHNL473_STATUS_ADDR A:0xe63ec88
y.create.l HWIO_PMIC_ARB_OBS3_CHNL474_STATUS_ADDR A:0xe63ed08
y.create.l HWIO_PMIC_ARB_OBS3_CHNL475_STATUS_ADDR A:0xe63ed88
y.create.l HWIO_PMIC_ARB_OBS3_CHNL476_STATUS_ADDR A:0xe63ee08
y.create.l HWIO_PMIC_ARB_OBS3_CHNL477_STATUS_ADDR A:0xe63ee88
y.create.l HWIO_PMIC_ARB_OBS3_CHNL478_STATUS_ADDR A:0xe63ef08
y.create.l HWIO_PMIC_ARB_OBS3_CHNL479_STATUS_ADDR A:0xe63ef88
y.create.l HWIO_PMIC_ARB_OBS3_CHNL480_STATUS_ADDR A:0xe63f008
y.create.l HWIO_PMIC_ARB_OBS3_CHNL481_STATUS_ADDR A:0xe63f088
y.create.l HWIO_PMIC_ARB_OBS3_CHNL482_STATUS_ADDR A:0xe63f108
y.create.l HWIO_PMIC_ARB_OBS3_CHNL483_STATUS_ADDR A:0xe63f188
y.create.l HWIO_PMIC_ARB_OBS3_CHNL484_STATUS_ADDR A:0xe63f208
y.create.l HWIO_PMIC_ARB_OBS3_CHNL485_STATUS_ADDR A:0xe63f288
y.create.l HWIO_PMIC_ARB_OBS3_CHNL486_STATUS_ADDR A:0xe63f308
y.create.l HWIO_PMIC_ARB_OBS3_CHNL487_STATUS_ADDR A:0xe63f388
y.create.l HWIO_PMIC_ARB_OBS3_CHNL488_STATUS_ADDR A:0xe63f408
y.create.l HWIO_PMIC_ARB_OBS3_CHNL489_STATUS_ADDR A:0xe63f488
y.create.l HWIO_PMIC_ARB_OBS3_CHNL490_STATUS_ADDR A:0xe63f508
y.create.l HWIO_PMIC_ARB_OBS3_CHNL491_STATUS_ADDR A:0xe63f588
y.create.l HWIO_PMIC_ARB_OBS3_CHNL492_STATUS_ADDR A:0xe63f608
y.create.l HWIO_PMIC_ARB_OBS3_CHNL493_STATUS_ADDR A:0xe63f688
y.create.l HWIO_PMIC_ARB_OBS3_CHNL494_STATUS_ADDR A:0xe63f708
y.create.l HWIO_PMIC_ARB_OBS3_CHNL495_STATUS_ADDR A:0xe63f788
y.create.l HWIO_PMIC_ARB_OBS3_CHNL496_STATUS_ADDR A:0xe63f808
y.create.l HWIO_PMIC_ARB_OBS3_CHNL497_STATUS_ADDR A:0xe63f888
y.create.l HWIO_PMIC_ARB_OBS3_CHNL498_STATUS_ADDR A:0xe63f908
y.create.l HWIO_PMIC_ARB_OBS3_CHNL499_STATUS_ADDR A:0xe63f988
y.create.l HWIO_PMIC_ARB_OBS3_CHNL500_STATUS_ADDR A:0xe63fa08
y.create.l HWIO_PMIC_ARB_OBS3_CHNL501_STATUS_ADDR A:0xe63fa88
y.create.l HWIO_PMIC_ARB_OBS3_CHNL502_STATUS_ADDR A:0xe63fb08
y.create.l HWIO_PMIC_ARB_OBS3_CHNL503_STATUS_ADDR A:0xe63fb88
y.create.l HWIO_PMIC_ARB_OBS3_CHNL504_STATUS_ADDR A:0xe63fc08
y.create.l HWIO_PMIC_ARB_OBS3_CHNL505_STATUS_ADDR A:0xe63fc88
y.create.l HWIO_PMIC_ARB_OBS3_CHNL506_STATUS_ADDR A:0xe63fd08
y.create.l HWIO_PMIC_ARB_OBS3_CHNL507_STATUS_ADDR A:0xe63fd88
y.create.l HWIO_PMIC_ARB_OBS3_CHNL508_STATUS_ADDR A:0xe63fe08
y.create.l HWIO_PMIC_ARB_OBS3_CHNL509_STATUS_ADDR A:0xe63fe88
y.create.l HWIO_PMIC_ARB_OBS3_CHNL510_STATUS_ADDR A:0xe63ff08
y.create.l HWIO_PMIC_ARB_OBS3_CHNL511_STATUS_ADDR A:0xe63ff88
y.create.l HWIO_PMIC_ARB_OBS4_CHNL0_STATUS_ADDR A:0xe640008
y.create.l HWIO_PMIC_ARB_OBS4_CHNL1_STATUS_ADDR A:0xe640088
y.create.l HWIO_PMIC_ARB_OBS4_CHNL2_STATUS_ADDR A:0xe640108
y.create.l HWIO_PMIC_ARB_OBS4_CHNL3_STATUS_ADDR A:0xe640188
y.create.l HWIO_PMIC_ARB_OBS4_CHNL4_STATUS_ADDR A:0xe640208
y.create.l HWIO_PMIC_ARB_OBS4_CHNL5_STATUS_ADDR A:0xe640288
y.create.l HWIO_PMIC_ARB_OBS4_CHNL6_STATUS_ADDR A:0xe640308
y.create.l HWIO_PMIC_ARB_OBS4_CHNL7_STATUS_ADDR A:0xe640388
y.create.l HWIO_PMIC_ARB_OBS4_CHNL8_STATUS_ADDR A:0xe640408
y.create.l HWIO_PMIC_ARB_OBS4_CHNL9_STATUS_ADDR A:0xe640488
y.create.l HWIO_PMIC_ARB_OBS4_CHNL10_STATUS_ADDR A:0xe640508
y.create.l HWIO_PMIC_ARB_OBS4_CHNL11_STATUS_ADDR A:0xe640588
y.create.l HWIO_PMIC_ARB_OBS4_CHNL12_STATUS_ADDR A:0xe640608
y.create.l HWIO_PMIC_ARB_OBS4_CHNL13_STATUS_ADDR A:0xe640688
y.create.l HWIO_PMIC_ARB_OBS4_CHNL14_STATUS_ADDR A:0xe640708
y.create.l HWIO_PMIC_ARB_OBS4_CHNL15_STATUS_ADDR A:0xe640788
y.create.l HWIO_PMIC_ARB_OBS4_CHNL16_STATUS_ADDR A:0xe640808
y.create.l HWIO_PMIC_ARB_OBS4_CHNL17_STATUS_ADDR A:0xe640888
y.create.l HWIO_PMIC_ARB_OBS4_CHNL18_STATUS_ADDR A:0xe640908
y.create.l HWIO_PMIC_ARB_OBS4_CHNL19_STATUS_ADDR A:0xe640988
y.create.l HWIO_PMIC_ARB_OBS4_CHNL20_STATUS_ADDR A:0xe640a08
y.create.l HWIO_PMIC_ARB_OBS4_CHNL21_STATUS_ADDR A:0xe640a88
y.create.l HWIO_PMIC_ARB_OBS4_CHNL22_STATUS_ADDR A:0xe640b08
y.create.l HWIO_PMIC_ARB_OBS4_CHNL23_STATUS_ADDR A:0xe640b88
y.create.l HWIO_PMIC_ARB_OBS4_CHNL24_STATUS_ADDR A:0xe640c08
y.create.l HWIO_PMIC_ARB_OBS4_CHNL25_STATUS_ADDR A:0xe640c88
y.create.l HWIO_PMIC_ARB_OBS4_CHNL26_STATUS_ADDR A:0xe640d08
y.create.l HWIO_PMIC_ARB_OBS4_CHNL27_STATUS_ADDR A:0xe640d88
y.create.l HWIO_PMIC_ARB_OBS4_CHNL28_STATUS_ADDR A:0xe640e08
y.create.l HWIO_PMIC_ARB_OBS4_CHNL29_STATUS_ADDR A:0xe640e88
y.create.l HWIO_PMIC_ARB_OBS4_CHNL30_STATUS_ADDR A:0xe640f08
y.create.l HWIO_PMIC_ARB_OBS4_CHNL31_STATUS_ADDR A:0xe640f88
y.create.l HWIO_PMIC_ARB_OBS4_CHNL32_STATUS_ADDR A:0xe641008
y.create.l HWIO_PMIC_ARB_OBS4_CHNL33_STATUS_ADDR A:0xe641088
y.create.l HWIO_PMIC_ARB_OBS4_CHNL34_STATUS_ADDR A:0xe641108
y.create.l HWIO_PMIC_ARB_OBS4_CHNL35_STATUS_ADDR A:0xe641188
y.create.l HWIO_PMIC_ARB_OBS4_CHNL36_STATUS_ADDR A:0xe641208
y.create.l HWIO_PMIC_ARB_OBS4_CHNL37_STATUS_ADDR A:0xe641288
y.create.l HWIO_PMIC_ARB_OBS4_CHNL38_STATUS_ADDR A:0xe641308
y.create.l HWIO_PMIC_ARB_OBS4_CHNL39_STATUS_ADDR A:0xe641388
y.create.l HWIO_PMIC_ARB_OBS4_CHNL40_STATUS_ADDR A:0xe641408
y.create.l HWIO_PMIC_ARB_OBS4_CHNL41_STATUS_ADDR A:0xe641488
y.create.l HWIO_PMIC_ARB_OBS4_CHNL42_STATUS_ADDR A:0xe641508
y.create.l HWIO_PMIC_ARB_OBS4_CHNL43_STATUS_ADDR A:0xe641588
y.create.l HWIO_PMIC_ARB_OBS4_CHNL44_STATUS_ADDR A:0xe641608
y.create.l HWIO_PMIC_ARB_OBS4_CHNL45_STATUS_ADDR A:0xe641688
y.create.l HWIO_PMIC_ARB_OBS4_CHNL46_STATUS_ADDR A:0xe641708
y.create.l HWIO_PMIC_ARB_OBS4_CHNL47_STATUS_ADDR A:0xe641788
y.create.l HWIO_PMIC_ARB_OBS4_CHNL48_STATUS_ADDR A:0xe641808
y.create.l HWIO_PMIC_ARB_OBS4_CHNL49_STATUS_ADDR A:0xe641888
y.create.l HWIO_PMIC_ARB_OBS4_CHNL50_STATUS_ADDR A:0xe641908
y.create.l HWIO_PMIC_ARB_OBS4_CHNL51_STATUS_ADDR A:0xe641988
y.create.l HWIO_PMIC_ARB_OBS4_CHNL52_STATUS_ADDR A:0xe641a08
y.create.l HWIO_PMIC_ARB_OBS4_CHNL53_STATUS_ADDR A:0xe641a88
y.create.l HWIO_PMIC_ARB_OBS4_CHNL54_STATUS_ADDR A:0xe641b08
y.create.l HWIO_PMIC_ARB_OBS4_CHNL55_STATUS_ADDR A:0xe641b88
y.create.l HWIO_PMIC_ARB_OBS4_CHNL56_STATUS_ADDR A:0xe641c08
y.create.l HWIO_PMIC_ARB_OBS4_CHNL57_STATUS_ADDR A:0xe641c88
y.create.l HWIO_PMIC_ARB_OBS4_CHNL58_STATUS_ADDR A:0xe641d08
y.create.l HWIO_PMIC_ARB_OBS4_CHNL59_STATUS_ADDR A:0xe641d88
y.create.l HWIO_PMIC_ARB_OBS4_CHNL60_STATUS_ADDR A:0xe641e08
y.create.l HWIO_PMIC_ARB_OBS4_CHNL61_STATUS_ADDR A:0xe641e88
y.create.l HWIO_PMIC_ARB_OBS4_CHNL62_STATUS_ADDR A:0xe641f08
y.create.l HWIO_PMIC_ARB_OBS4_CHNL63_STATUS_ADDR A:0xe641f88
y.create.l HWIO_PMIC_ARB_OBS4_CHNL64_STATUS_ADDR A:0xe642008
y.create.l HWIO_PMIC_ARB_OBS4_CHNL65_STATUS_ADDR A:0xe642088
y.create.l HWIO_PMIC_ARB_OBS4_CHNL66_STATUS_ADDR A:0xe642108
y.create.l HWIO_PMIC_ARB_OBS4_CHNL67_STATUS_ADDR A:0xe642188
y.create.l HWIO_PMIC_ARB_OBS4_CHNL68_STATUS_ADDR A:0xe642208
y.create.l HWIO_PMIC_ARB_OBS4_CHNL69_STATUS_ADDR A:0xe642288
y.create.l HWIO_PMIC_ARB_OBS4_CHNL70_STATUS_ADDR A:0xe642308
y.create.l HWIO_PMIC_ARB_OBS4_CHNL71_STATUS_ADDR A:0xe642388
y.create.l HWIO_PMIC_ARB_OBS4_CHNL72_STATUS_ADDR A:0xe642408
y.create.l HWIO_PMIC_ARB_OBS4_CHNL73_STATUS_ADDR A:0xe642488
y.create.l HWIO_PMIC_ARB_OBS4_CHNL74_STATUS_ADDR A:0xe642508
y.create.l HWIO_PMIC_ARB_OBS4_CHNL75_STATUS_ADDR A:0xe642588
y.create.l HWIO_PMIC_ARB_OBS4_CHNL76_STATUS_ADDR A:0xe642608
y.create.l HWIO_PMIC_ARB_OBS4_CHNL77_STATUS_ADDR A:0xe642688
y.create.l HWIO_PMIC_ARB_OBS4_CHNL78_STATUS_ADDR A:0xe642708
y.create.l HWIO_PMIC_ARB_OBS4_CHNL79_STATUS_ADDR A:0xe642788
y.create.l HWIO_PMIC_ARB_OBS4_CHNL80_STATUS_ADDR A:0xe642808
y.create.l HWIO_PMIC_ARB_OBS4_CHNL81_STATUS_ADDR A:0xe642888
y.create.l HWIO_PMIC_ARB_OBS4_CHNL82_STATUS_ADDR A:0xe642908
y.create.l HWIO_PMIC_ARB_OBS4_CHNL83_STATUS_ADDR A:0xe642988
y.create.l HWIO_PMIC_ARB_OBS4_CHNL84_STATUS_ADDR A:0xe642a08
y.create.l HWIO_PMIC_ARB_OBS4_CHNL85_STATUS_ADDR A:0xe642a88
y.create.l HWIO_PMIC_ARB_OBS4_CHNL86_STATUS_ADDR A:0xe642b08
y.create.l HWIO_PMIC_ARB_OBS4_CHNL87_STATUS_ADDR A:0xe642b88
y.create.l HWIO_PMIC_ARB_OBS4_CHNL88_STATUS_ADDR A:0xe642c08
y.create.l HWIO_PMIC_ARB_OBS4_CHNL89_STATUS_ADDR A:0xe642c88
y.create.l HWIO_PMIC_ARB_OBS4_CHNL90_STATUS_ADDR A:0xe642d08
y.create.l HWIO_PMIC_ARB_OBS4_CHNL91_STATUS_ADDR A:0xe642d88
y.create.l HWIO_PMIC_ARB_OBS4_CHNL92_STATUS_ADDR A:0xe642e08
y.create.l HWIO_PMIC_ARB_OBS4_CHNL93_STATUS_ADDR A:0xe642e88
y.create.l HWIO_PMIC_ARB_OBS4_CHNL94_STATUS_ADDR A:0xe642f08
y.create.l HWIO_PMIC_ARB_OBS4_CHNL95_STATUS_ADDR A:0xe642f88
y.create.l HWIO_PMIC_ARB_OBS4_CHNL96_STATUS_ADDR A:0xe643008
y.create.l HWIO_PMIC_ARB_OBS4_CHNL97_STATUS_ADDR A:0xe643088
y.create.l HWIO_PMIC_ARB_OBS4_CHNL98_STATUS_ADDR A:0xe643108
y.create.l HWIO_PMIC_ARB_OBS4_CHNL99_STATUS_ADDR A:0xe643188
y.create.l HWIO_PMIC_ARB_OBS4_CHNL100_STATUS_ADDR A:0xe643208
y.create.l HWIO_PMIC_ARB_OBS4_CHNL101_STATUS_ADDR A:0xe643288
y.create.l HWIO_PMIC_ARB_OBS4_CHNL102_STATUS_ADDR A:0xe643308
y.create.l HWIO_PMIC_ARB_OBS4_CHNL103_STATUS_ADDR A:0xe643388
y.create.l HWIO_PMIC_ARB_OBS4_CHNL104_STATUS_ADDR A:0xe643408
y.create.l HWIO_PMIC_ARB_OBS4_CHNL105_STATUS_ADDR A:0xe643488
y.create.l HWIO_PMIC_ARB_OBS4_CHNL106_STATUS_ADDR A:0xe643508
y.create.l HWIO_PMIC_ARB_OBS4_CHNL107_STATUS_ADDR A:0xe643588
y.create.l HWIO_PMIC_ARB_OBS4_CHNL108_STATUS_ADDR A:0xe643608
y.create.l HWIO_PMIC_ARB_OBS4_CHNL109_STATUS_ADDR A:0xe643688
y.create.l HWIO_PMIC_ARB_OBS4_CHNL110_STATUS_ADDR A:0xe643708
y.create.l HWIO_PMIC_ARB_OBS4_CHNL111_STATUS_ADDR A:0xe643788
y.create.l HWIO_PMIC_ARB_OBS4_CHNL112_STATUS_ADDR A:0xe643808
y.create.l HWIO_PMIC_ARB_OBS4_CHNL113_STATUS_ADDR A:0xe643888
y.create.l HWIO_PMIC_ARB_OBS4_CHNL114_STATUS_ADDR A:0xe643908
y.create.l HWIO_PMIC_ARB_OBS4_CHNL115_STATUS_ADDR A:0xe643988
y.create.l HWIO_PMIC_ARB_OBS4_CHNL116_STATUS_ADDR A:0xe643a08
y.create.l HWIO_PMIC_ARB_OBS4_CHNL117_STATUS_ADDR A:0xe643a88
y.create.l HWIO_PMIC_ARB_OBS4_CHNL118_STATUS_ADDR A:0xe643b08
y.create.l HWIO_PMIC_ARB_OBS4_CHNL119_STATUS_ADDR A:0xe643b88
y.create.l HWIO_PMIC_ARB_OBS4_CHNL120_STATUS_ADDR A:0xe643c08
y.create.l HWIO_PMIC_ARB_OBS4_CHNL121_STATUS_ADDR A:0xe643c88
y.create.l HWIO_PMIC_ARB_OBS4_CHNL122_STATUS_ADDR A:0xe643d08
y.create.l HWIO_PMIC_ARB_OBS4_CHNL123_STATUS_ADDR A:0xe643d88
y.create.l HWIO_PMIC_ARB_OBS4_CHNL124_STATUS_ADDR A:0xe643e08
y.create.l HWIO_PMIC_ARB_OBS4_CHNL125_STATUS_ADDR A:0xe643e88
y.create.l HWIO_PMIC_ARB_OBS4_CHNL126_STATUS_ADDR A:0xe643f08
y.create.l HWIO_PMIC_ARB_OBS4_CHNL127_STATUS_ADDR A:0xe643f88
y.create.l HWIO_PMIC_ARB_OBS4_CHNL128_STATUS_ADDR A:0xe644008
y.create.l HWIO_PMIC_ARB_OBS4_CHNL129_STATUS_ADDR A:0xe644088
y.create.l HWIO_PMIC_ARB_OBS4_CHNL130_STATUS_ADDR A:0xe644108
y.create.l HWIO_PMIC_ARB_OBS4_CHNL131_STATUS_ADDR A:0xe644188
y.create.l HWIO_PMIC_ARB_OBS4_CHNL132_STATUS_ADDR A:0xe644208
y.create.l HWIO_PMIC_ARB_OBS4_CHNL133_STATUS_ADDR A:0xe644288
y.create.l HWIO_PMIC_ARB_OBS4_CHNL134_STATUS_ADDR A:0xe644308
y.create.l HWIO_PMIC_ARB_OBS4_CHNL135_STATUS_ADDR A:0xe644388
y.create.l HWIO_PMIC_ARB_OBS4_CHNL136_STATUS_ADDR A:0xe644408
y.create.l HWIO_PMIC_ARB_OBS4_CHNL137_STATUS_ADDR A:0xe644488
y.create.l HWIO_PMIC_ARB_OBS4_CHNL138_STATUS_ADDR A:0xe644508
y.create.l HWIO_PMIC_ARB_OBS4_CHNL139_STATUS_ADDR A:0xe644588
y.create.l HWIO_PMIC_ARB_OBS4_CHNL140_STATUS_ADDR A:0xe644608
y.create.l HWIO_PMIC_ARB_OBS4_CHNL141_STATUS_ADDR A:0xe644688
y.create.l HWIO_PMIC_ARB_OBS4_CHNL142_STATUS_ADDR A:0xe644708
y.create.l HWIO_PMIC_ARB_OBS4_CHNL143_STATUS_ADDR A:0xe644788
y.create.l HWIO_PMIC_ARB_OBS4_CHNL144_STATUS_ADDR A:0xe644808
y.create.l HWIO_PMIC_ARB_OBS4_CHNL145_STATUS_ADDR A:0xe644888
y.create.l HWIO_PMIC_ARB_OBS4_CHNL146_STATUS_ADDR A:0xe644908
y.create.l HWIO_PMIC_ARB_OBS4_CHNL147_STATUS_ADDR A:0xe644988
y.create.l HWIO_PMIC_ARB_OBS4_CHNL148_STATUS_ADDR A:0xe644a08
y.create.l HWIO_PMIC_ARB_OBS4_CHNL149_STATUS_ADDR A:0xe644a88
y.create.l HWIO_PMIC_ARB_OBS4_CHNL150_STATUS_ADDR A:0xe644b08
y.create.l HWIO_PMIC_ARB_OBS4_CHNL151_STATUS_ADDR A:0xe644b88
y.create.l HWIO_PMIC_ARB_OBS4_CHNL152_STATUS_ADDR A:0xe644c08
y.create.l HWIO_PMIC_ARB_OBS4_CHNL153_STATUS_ADDR A:0xe644c88
y.create.l HWIO_PMIC_ARB_OBS4_CHNL154_STATUS_ADDR A:0xe644d08
y.create.l HWIO_PMIC_ARB_OBS4_CHNL155_STATUS_ADDR A:0xe644d88
y.create.l HWIO_PMIC_ARB_OBS4_CHNL156_STATUS_ADDR A:0xe644e08
y.create.l HWIO_PMIC_ARB_OBS4_CHNL157_STATUS_ADDR A:0xe644e88
y.create.l HWIO_PMIC_ARB_OBS4_CHNL158_STATUS_ADDR A:0xe644f08
y.create.l HWIO_PMIC_ARB_OBS4_CHNL159_STATUS_ADDR A:0xe644f88
y.create.l HWIO_PMIC_ARB_OBS4_CHNL160_STATUS_ADDR A:0xe645008
y.create.l HWIO_PMIC_ARB_OBS4_CHNL161_STATUS_ADDR A:0xe645088
y.create.l HWIO_PMIC_ARB_OBS4_CHNL162_STATUS_ADDR A:0xe645108
y.create.l HWIO_PMIC_ARB_OBS4_CHNL163_STATUS_ADDR A:0xe645188
y.create.l HWIO_PMIC_ARB_OBS4_CHNL164_STATUS_ADDR A:0xe645208
y.create.l HWIO_PMIC_ARB_OBS4_CHNL165_STATUS_ADDR A:0xe645288
y.create.l HWIO_PMIC_ARB_OBS4_CHNL166_STATUS_ADDR A:0xe645308
y.create.l HWIO_PMIC_ARB_OBS4_CHNL167_STATUS_ADDR A:0xe645388
y.create.l HWIO_PMIC_ARB_OBS4_CHNL168_STATUS_ADDR A:0xe645408
y.create.l HWIO_PMIC_ARB_OBS4_CHNL169_STATUS_ADDR A:0xe645488
y.create.l HWIO_PMIC_ARB_OBS4_CHNL170_STATUS_ADDR A:0xe645508
y.create.l HWIO_PMIC_ARB_OBS4_CHNL171_STATUS_ADDR A:0xe645588
y.create.l HWIO_PMIC_ARB_OBS4_CHNL172_STATUS_ADDR A:0xe645608
y.create.l HWIO_PMIC_ARB_OBS4_CHNL173_STATUS_ADDR A:0xe645688
y.create.l HWIO_PMIC_ARB_OBS4_CHNL174_STATUS_ADDR A:0xe645708
y.create.l HWIO_PMIC_ARB_OBS4_CHNL175_STATUS_ADDR A:0xe645788
y.create.l HWIO_PMIC_ARB_OBS4_CHNL176_STATUS_ADDR A:0xe645808
y.create.l HWIO_PMIC_ARB_OBS4_CHNL177_STATUS_ADDR A:0xe645888
y.create.l HWIO_PMIC_ARB_OBS4_CHNL178_STATUS_ADDR A:0xe645908
y.create.l HWIO_PMIC_ARB_OBS4_CHNL179_STATUS_ADDR A:0xe645988
y.create.l HWIO_PMIC_ARB_OBS4_CHNL180_STATUS_ADDR A:0xe645a08
y.create.l HWIO_PMIC_ARB_OBS4_CHNL181_STATUS_ADDR A:0xe645a88
y.create.l HWIO_PMIC_ARB_OBS4_CHNL182_STATUS_ADDR A:0xe645b08
y.create.l HWIO_PMIC_ARB_OBS4_CHNL183_STATUS_ADDR A:0xe645b88
y.create.l HWIO_PMIC_ARB_OBS4_CHNL184_STATUS_ADDR A:0xe645c08
y.create.l HWIO_PMIC_ARB_OBS4_CHNL185_STATUS_ADDR A:0xe645c88
y.create.l HWIO_PMIC_ARB_OBS4_CHNL186_STATUS_ADDR A:0xe645d08
y.create.l HWIO_PMIC_ARB_OBS4_CHNL187_STATUS_ADDR A:0xe645d88
y.create.l HWIO_PMIC_ARB_OBS4_CHNL188_STATUS_ADDR A:0xe645e08
y.create.l HWIO_PMIC_ARB_OBS4_CHNL189_STATUS_ADDR A:0xe645e88
y.create.l HWIO_PMIC_ARB_OBS4_CHNL190_STATUS_ADDR A:0xe645f08
y.create.l HWIO_PMIC_ARB_OBS4_CHNL191_STATUS_ADDR A:0xe645f88
y.create.l HWIO_PMIC_ARB_OBS4_CHNL192_STATUS_ADDR A:0xe646008
y.create.l HWIO_PMIC_ARB_OBS4_CHNL193_STATUS_ADDR A:0xe646088
y.create.l HWIO_PMIC_ARB_OBS4_CHNL194_STATUS_ADDR A:0xe646108
y.create.l HWIO_PMIC_ARB_OBS4_CHNL195_STATUS_ADDR A:0xe646188
y.create.l HWIO_PMIC_ARB_OBS4_CHNL196_STATUS_ADDR A:0xe646208
y.create.l HWIO_PMIC_ARB_OBS4_CHNL197_STATUS_ADDR A:0xe646288
y.create.l HWIO_PMIC_ARB_OBS4_CHNL198_STATUS_ADDR A:0xe646308
y.create.l HWIO_PMIC_ARB_OBS4_CHNL199_STATUS_ADDR A:0xe646388
y.create.l HWIO_PMIC_ARB_OBS4_CHNL200_STATUS_ADDR A:0xe646408
y.create.l HWIO_PMIC_ARB_OBS4_CHNL201_STATUS_ADDR A:0xe646488
y.create.l HWIO_PMIC_ARB_OBS4_CHNL202_STATUS_ADDR A:0xe646508
y.create.l HWIO_PMIC_ARB_OBS4_CHNL203_STATUS_ADDR A:0xe646588
y.create.l HWIO_PMIC_ARB_OBS4_CHNL204_STATUS_ADDR A:0xe646608
y.create.l HWIO_PMIC_ARB_OBS4_CHNL205_STATUS_ADDR A:0xe646688
y.create.l HWIO_PMIC_ARB_OBS4_CHNL206_STATUS_ADDR A:0xe646708
y.create.l HWIO_PMIC_ARB_OBS4_CHNL207_STATUS_ADDR A:0xe646788
y.create.l HWIO_PMIC_ARB_OBS4_CHNL208_STATUS_ADDR A:0xe646808
y.create.l HWIO_PMIC_ARB_OBS4_CHNL209_STATUS_ADDR A:0xe646888
y.create.l HWIO_PMIC_ARB_OBS4_CHNL210_STATUS_ADDR A:0xe646908
y.create.l HWIO_PMIC_ARB_OBS4_CHNL211_STATUS_ADDR A:0xe646988
y.create.l HWIO_PMIC_ARB_OBS4_CHNL212_STATUS_ADDR A:0xe646a08
y.create.l HWIO_PMIC_ARB_OBS4_CHNL213_STATUS_ADDR A:0xe646a88
y.create.l HWIO_PMIC_ARB_OBS4_CHNL214_STATUS_ADDR A:0xe646b08
y.create.l HWIO_PMIC_ARB_OBS4_CHNL215_STATUS_ADDR A:0xe646b88
y.create.l HWIO_PMIC_ARB_OBS4_CHNL216_STATUS_ADDR A:0xe646c08
y.create.l HWIO_PMIC_ARB_OBS4_CHNL217_STATUS_ADDR A:0xe646c88
y.create.l HWIO_PMIC_ARB_OBS4_CHNL218_STATUS_ADDR A:0xe646d08
y.create.l HWIO_PMIC_ARB_OBS4_CHNL219_STATUS_ADDR A:0xe646d88
y.create.l HWIO_PMIC_ARB_OBS4_CHNL220_STATUS_ADDR A:0xe646e08
y.create.l HWIO_PMIC_ARB_OBS4_CHNL221_STATUS_ADDR A:0xe646e88
y.create.l HWIO_PMIC_ARB_OBS4_CHNL222_STATUS_ADDR A:0xe646f08
y.create.l HWIO_PMIC_ARB_OBS4_CHNL223_STATUS_ADDR A:0xe646f88
y.create.l HWIO_PMIC_ARB_OBS4_CHNL224_STATUS_ADDR A:0xe647008
y.create.l HWIO_PMIC_ARB_OBS4_CHNL225_STATUS_ADDR A:0xe647088
y.create.l HWIO_PMIC_ARB_OBS4_CHNL226_STATUS_ADDR A:0xe647108
y.create.l HWIO_PMIC_ARB_OBS4_CHNL227_STATUS_ADDR A:0xe647188
y.create.l HWIO_PMIC_ARB_OBS4_CHNL228_STATUS_ADDR A:0xe647208
y.create.l HWIO_PMIC_ARB_OBS4_CHNL229_STATUS_ADDR A:0xe647288
y.create.l HWIO_PMIC_ARB_OBS4_CHNL230_STATUS_ADDR A:0xe647308
y.create.l HWIO_PMIC_ARB_OBS4_CHNL231_STATUS_ADDR A:0xe647388
y.create.l HWIO_PMIC_ARB_OBS4_CHNL232_STATUS_ADDR A:0xe647408
y.create.l HWIO_PMIC_ARB_OBS4_CHNL233_STATUS_ADDR A:0xe647488
y.create.l HWIO_PMIC_ARB_OBS4_CHNL234_STATUS_ADDR A:0xe647508
y.create.l HWIO_PMIC_ARB_OBS4_CHNL235_STATUS_ADDR A:0xe647588
y.create.l HWIO_PMIC_ARB_OBS4_CHNL236_STATUS_ADDR A:0xe647608
y.create.l HWIO_PMIC_ARB_OBS4_CHNL237_STATUS_ADDR A:0xe647688
y.create.l HWIO_PMIC_ARB_OBS4_CHNL238_STATUS_ADDR A:0xe647708
y.create.l HWIO_PMIC_ARB_OBS4_CHNL239_STATUS_ADDR A:0xe647788
y.create.l HWIO_PMIC_ARB_OBS4_CHNL240_STATUS_ADDR A:0xe647808
y.create.l HWIO_PMIC_ARB_OBS4_CHNL241_STATUS_ADDR A:0xe647888
y.create.l HWIO_PMIC_ARB_OBS4_CHNL242_STATUS_ADDR A:0xe647908
y.create.l HWIO_PMIC_ARB_OBS4_CHNL243_STATUS_ADDR A:0xe647988
y.create.l HWIO_PMIC_ARB_OBS4_CHNL244_STATUS_ADDR A:0xe647a08
y.create.l HWIO_PMIC_ARB_OBS4_CHNL245_STATUS_ADDR A:0xe647a88
y.create.l HWIO_PMIC_ARB_OBS4_CHNL246_STATUS_ADDR A:0xe647b08
y.create.l HWIO_PMIC_ARB_OBS4_CHNL247_STATUS_ADDR A:0xe647b88
y.create.l HWIO_PMIC_ARB_OBS4_CHNL248_STATUS_ADDR A:0xe647c08
y.create.l HWIO_PMIC_ARB_OBS4_CHNL249_STATUS_ADDR A:0xe647c88
y.create.l HWIO_PMIC_ARB_OBS4_CHNL250_STATUS_ADDR A:0xe647d08
y.create.l HWIO_PMIC_ARB_OBS4_CHNL251_STATUS_ADDR A:0xe647d88
y.create.l HWIO_PMIC_ARB_OBS4_CHNL252_STATUS_ADDR A:0xe647e08
y.create.l HWIO_PMIC_ARB_OBS4_CHNL253_STATUS_ADDR A:0xe647e88
y.create.l HWIO_PMIC_ARB_OBS4_CHNL254_STATUS_ADDR A:0xe647f08
y.create.l HWIO_PMIC_ARB_OBS4_CHNL255_STATUS_ADDR A:0xe647f88
y.create.l HWIO_PMIC_ARB_OBS4_CHNL256_STATUS_ADDR A:0xe648008
y.create.l HWIO_PMIC_ARB_OBS4_CHNL257_STATUS_ADDR A:0xe648088
y.create.l HWIO_PMIC_ARB_OBS4_CHNL258_STATUS_ADDR A:0xe648108
y.create.l HWIO_PMIC_ARB_OBS4_CHNL259_STATUS_ADDR A:0xe648188
y.create.l HWIO_PMIC_ARB_OBS4_CHNL260_STATUS_ADDR A:0xe648208
y.create.l HWIO_PMIC_ARB_OBS4_CHNL261_STATUS_ADDR A:0xe648288
y.create.l HWIO_PMIC_ARB_OBS4_CHNL262_STATUS_ADDR A:0xe648308
y.create.l HWIO_PMIC_ARB_OBS4_CHNL263_STATUS_ADDR A:0xe648388
y.create.l HWIO_PMIC_ARB_OBS4_CHNL264_STATUS_ADDR A:0xe648408
y.create.l HWIO_PMIC_ARB_OBS4_CHNL265_STATUS_ADDR A:0xe648488
y.create.l HWIO_PMIC_ARB_OBS4_CHNL266_STATUS_ADDR A:0xe648508
y.create.l HWIO_PMIC_ARB_OBS4_CHNL267_STATUS_ADDR A:0xe648588
y.create.l HWIO_PMIC_ARB_OBS4_CHNL268_STATUS_ADDR A:0xe648608
y.create.l HWIO_PMIC_ARB_OBS4_CHNL269_STATUS_ADDR A:0xe648688
y.create.l HWIO_PMIC_ARB_OBS4_CHNL270_STATUS_ADDR A:0xe648708
y.create.l HWIO_PMIC_ARB_OBS4_CHNL271_STATUS_ADDR A:0xe648788
y.create.l HWIO_PMIC_ARB_OBS4_CHNL272_STATUS_ADDR A:0xe648808
y.create.l HWIO_PMIC_ARB_OBS4_CHNL273_STATUS_ADDR A:0xe648888
y.create.l HWIO_PMIC_ARB_OBS4_CHNL274_STATUS_ADDR A:0xe648908
y.create.l HWIO_PMIC_ARB_OBS4_CHNL275_STATUS_ADDR A:0xe648988
y.create.l HWIO_PMIC_ARB_OBS4_CHNL276_STATUS_ADDR A:0xe648a08
y.create.l HWIO_PMIC_ARB_OBS4_CHNL277_STATUS_ADDR A:0xe648a88
y.create.l HWIO_PMIC_ARB_OBS4_CHNL278_STATUS_ADDR A:0xe648b08
y.create.l HWIO_PMIC_ARB_OBS4_CHNL279_STATUS_ADDR A:0xe648b88
y.create.l HWIO_PMIC_ARB_OBS4_CHNL280_STATUS_ADDR A:0xe648c08
y.create.l HWIO_PMIC_ARB_OBS4_CHNL281_STATUS_ADDR A:0xe648c88
y.create.l HWIO_PMIC_ARB_OBS4_CHNL282_STATUS_ADDR A:0xe648d08
y.create.l HWIO_PMIC_ARB_OBS4_CHNL283_STATUS_ADDR A:0xe648d88
y.create.l HWIO_PMIC_ARB_OBS4_CHNL284_STATUS_ADDR A:0xe648e08
y.create.l HWIO_PMIC_ARB_OBS4_CHNL285_STATUS_ADDR A:0xe648e88
y.create.l HWIO_PMIC_ARB_OBS4_CHNL286_STATUS_ADDR A:0xe648f08
y.create.l HWIO_PMIC_ARB_OBS4_CHNL287_STATUS_ADDR A:0xe648f88
y.create.l HWIO_PMIC_ARB_OBS4_CHNL288_STATUS_ADDR A:0xe649008
y.create.l HWIO_PMIC_ARB_OBS4_CHNL289_STATUS_ADDR A:0xe649088
y.create.l HWIO_PMIC_ARB_OBS4_CHNL290_STATUS_ADDR A:0xe649108
y.create.l HWIO_PMIC_ARB_OBS4_CHNL291_STATUS_ADDR A:0xe649188
y.create.l HWIO_PMIC_ARB_OBS4_CHNL292_STATUS_ADDR A:0xe649208
y.create.l HWIO_PMIC_ARB_OBS4_CHNL293_STATUS_ADDR A:0xe649288
y.create.l HWIO_PMIC_ARB_OBS4_CHNL294_STATUS_ADDR A:0xe649308
y.create.l HWIO_PMIC_ARB_OBS4_CHNL295_STATUS_ADDR A:0xe649388
y.create.l HWIO_PMIC_ARB_OBS4_CHNL296_STATUS_ADDR A:0xe649408
y.create.l HWIO_PMIC_ARB_OBS4_CHNL297_STATUS_ADDR A:0xe649488
y.create.l HWIO_PMIC_ARB_OBS4_CHNL298_STATUS_ADDR A:0xe649508
y.create.l HWIO_PMIC_ARB_OBS4_CHNL299_STATUS_ADDR A:0xe649588
y.create.l HWIO_PMIC_ARB_OBS4_CHNL300_STATUS_ADDR A:0xe649608
y.create.l HWIO_PMIC_ARB_OBS4_CHNL301_STATUS_ADDR A:0xe649688
y.create.l HWIO_PMIC_ARB_OBS4_CHNL302_STATUS_ADDR A:0xe649708
y.create.l HWIO_PMIC_ARB_OBS4_CHNL303_STATUS_ADDR A:0xe649788
y.create.l HWIO_PMIC_ARB_OBS4_CHNL304_STATUS_ADDR A:0xe649808
y.create.l HWIO_PMIC_ARB_OBS4_CHNL305_STATUS_ADDR A:0xe649888
y.create.l HWIO_PMIC_ARB_OBS4_CHNL306_STATUS_ADDR A:0xe649908
y.create.l HWIO_PMIC_ARB_OBS4_CHNL307_STATUS_ADDR A:0xe649988
y.create.l HWIO_PMIC_ARB_OBS4_CHNL308_STATUS_ADDR A:0xe649a08
y.create.l HWIO_PMIC_ARB_OBS4_CHNL309_STATUS_ADDR A:0xe649a88
y.create.l HWIO_PMIC_ARB_OBS4_CHNL310_STATUS_ADDR A:0xe649b08
y.create.l HWIO_PMIC_ARB_OBS4_CHNL311_STATUS_ADDR A:0xe649b88
y.create.l HWIO_PMIC_ARB_OBS4_CHNL312_STATUS_ADDR A:0xe649c08
y.create.l HWIO_PMIC_ARB_OBS4_CHNL313_STATUS_ADDR A:0xe649c88
y.create.l HWIO_PMIC_ARB_OBS4_CHNL314_STATUS_ADDR A:0xe649d08
y.create.l HWIO_PMIC_ARB_OBS4_CHNL315_STATUS_ADDR A:0xe649d88
y.create.l HWIO_PMIC_ARB_OBS4_CHNL316_STATUS_ADDR A:0xe649e08
y.create.l HWIO_PMIC_ARB_OBS4_CHNL317_STATUS_ADDR A:0xe649e88
y.create.l HWIO_PMIC_ARB_OBS4_CHNL318_STATUS_ADDR A:0xe649f08
y.create.l HWIO_PMIC_ARB_OBS4_CHNL319_STATUS_ADDR A:0xe649f88
y.create.l HWIO_PMIC_ARB_OBS4_CHNL320_STATUS_ADDR A:0xe64a008
y.create.l HWIO_PMIC_ARB_OBS4_CHNL321_STATUS_ADDR A:0xe64a088
y.create.l HWIO_PMIC_ARB_OBS4_CHNL322_STATUS_ADDR A:0xe64a108
y.create.l HWIO_PMIC_ARB_OBS4_CHNL323_STATUS_ADDR A:0xe64a188
y.create.l HWIO_PMIC_ARB_OBS4_CHNL324_STATUS_ADDR A:0xe64a208
y.create.l HWIO_PMIC_ARB_OBS4_CHNL325_STATUS_ADDR A:0xe64a288
y.create.l HWIO_PMIC_ARB_OBS4_CHNL326_STATUS_ADDR A:0xe64a308
y.create.l HWIO_PMIC_ARB_OBS4_CHNL327_STATUS_ADDR A:0xe64a388
y.create.l HWIO_PMIC_ARB_OBS4_CHNL328_STATUS_ADDR A:0xe64a408
y.create.l HWIO_PMIC_ARB_OBS4_CHNL329_STATUS_ADDR A:0xe64a488
y.create.l HWIO_PMIC_ARB_OBS4_CHNL330_STATUS_ADDR A:0xe64a508
y.create.l HWIO_PMIC_ARB_OBS4_CHNL331_STATUS_ADDR A:0xe64a588
y.create.l HWIO_PMIC_ARB_OBS4_CHNL332_STATUS_ADDR A:0xe64a608
y.create.l HWIO_PMIC_ARB_OBS4_CHNL333_STATUS_ADDR A:0xe64a688
y.create.l HWIO_PMIC_ARB_OBS4_CHNL334_STATUS_ADDR A:0xe64a708
y.create.l HWIO_PMIC_ARB_OBS4_CHNL335_STATUS_ADDR A:0xe64a788
y.create.l HWIO_PMIC_ARB_OBS4_CHNL336_STATUS_ADDR A:0xe64a808
y.create.l HWIO_PMIC_ARB_OBS4_CHNL337_STATUS_ADDR A:0xe64a888
y.create.l HWIO_PMIC_ARB_OBS4_CHNL338_STATUS_ADDR A:0xe64a908
y.create.l HWIO_PMIC_ARB_OBS4_CHNL339_STATUS_ADDR A:0xe64a988
y.create.l HWIO_PMIC_ARB_OBS4_CHNL340_STATUS_ADDR A:0xe64aa08
y.create.l HWIO_PMIC_ARB_OBS4_CHNL341_STATUS_ADDR A:0xe64aa88
y.create.l HWIO_PMIC_ARB_OBS4_CHNL342_STATUS_ADDR A:0xe64ab08
y.create.l HWIO_PMIC_ARB_OBS4_CHNL343_STATUS_ADDR A:0xe64ab88
y.create.l HWIO_PMIC_ARB_OBS4_CHNL344_STATUS_ADDR A:0xe64ac08
y.create.l HWIO_PMIC_ARB_OBS4_CHNL345_STATUS_ADDR A:0xe64ac88
y.create.l HWIO_PMIC_ARB_OBS4_CHNL346_STATUS_ADDR A:0xe64ad08
y.create.l HWIO_PMIC_ARB_OBS4_CHNL347_STATUS_ADDR A:0xe64ad88
y.create.l HWIO_PMIC_ARB_OBS4_CHNL348_STATUS_ADDR A:0xe64ae08
y.create.l HWIO_PMIC_ARB_OBS4_CHNL349_STATUS_ADDR A:0xe64ae88
y.create.l HWIO_PMIC_ARB_OBS4_CHNL350_STATUS_ADDR A:0xe64af08
y.create.l HWIO_PMIC_ARB_OBS4_CHNL351_STATUS_ADDR A:0xe64af88
y.create.l HWIO_PMIC_ARB_OBS4_CHNL352_STATUS_ADDR A:0xe64b008
y.create.l HWIO_PMIC_ARB_OBS4_CHNL353_STATUS_ADDR A:0xe64b088
y.create.l HWIO_PMIC_ARB_OBS4_CHNL354_STATUS_ADDR A:0xe64b108
y.create.l HWIO_PMIC_ARB_OBS4_CHNL355_STATUS_ADDR A:0xe64b188
y.create.l HWIO_PMIC_ARB_OBS4_CHNL356_STATUS_ADDR A:0xe64b208
y.create.l HWIO_PMIC_ARB_OBS4_CHNL357_STATUS_ADDR A:0xe64b288
y.create.l HWIO_PMIC_ARB_OBS4_CHNL358_STATUS_ADDR A:0xe64b308
y.create.l HWIO_PMIC_ARB_OBS4_CHNL359_STATUS_ADDR A:0xe64b388
y.create.l HWIO_PMIC_ARB_OBS4_CHNL360_STATUS_ADDR A:0xe64b408
y.create.l HWIO_PMIC_ARB_OBS4_CHNL361_STATUS_ADDR A:0xe64b488
y.create.l HWIO_PMIC_ARB_OBS4_CHNL362_STATUS_ADDR A:0xe64b508
y.create.l HWIO_PMIC_ARB_OBS4_CHNL363_STATUS_ADDR A:0xe64b588
y.create.l HWIO_PMIC_ARB_OBS4_CHNL364_STATUS_ADDR A:0xe64b608
y.create.l HWIO_PMIC_ARB_OBS4_CHNL365_STATUS_ADDR A:0xe64b688
y.create.l HWIO_PMIC_ARB_OBS4_CHNL366_STATUS_ADDR A:0xe64b708
y.create.l HWIO_PMIC_ARB_OBS4_CHNL367_STATUS_ADDR A:0xe64b788
y.create.l HWIO_PMIC_ARB_OBS4_CHNL368_STATUS_ADDR A:0xe64b808
y.create.l HWIO_PMIC_ARB_OBS4_CHNL369_STATUS_ADDR A:0xe64b888
y.create.l HWIO_PMIC_ARB_OBS4_CHNL370_STATUS_ADDR A:0xe64b908
y.create.l HWIO_PMIC_ARB_OBS4_CHNL371_STATUS_ADDR A:0xe64b988
y.create.l HWIO_PMIC_ARB_OBS4_CHNL372_STATUS_ADDR A:0xe64ba08
y.create.l HWIO_PMIC_ARB_OBS4_CHNL373_STATUS_ADDR A:0xe64ba88
y.create.l HWIO_PMIC_ARB_OBS4_CHNL374_STATUS_ADDR A:0xe64bb08
y.create.l HWIO_PMIC_ARB_OBS4_CHNL375_STATUS_ADDR A:0xe64bb88
y.create.l HWIO_PMIC_ARB_OBS4_CHNL376_STATUS_ADDR A:0xe64bc08
y.create.l HWIO_PMIC_ARB_OBS4_CHNL377_STATUS_ADDR A:0xe64bc88
y.create.l HWIO_PMIC_ARB_OBS4_CHNL378_STATUS_ADDR A:0xe64bd08
y.create.l HWIO_PMIC_ARB_OBS4_CHNL379_STATUS_ADDR A:0xe64bd88
y.create.l HWIO_PMIC_ARB_OBS4_CHNL380_STATUS_ADDR A:0xe64be08
y.create.l HWIO_PMIC_ARB_OBS4_CHNL381_STATUS_ADDR A:0xe64be88
y.create.l HWIO_PMIC_ARB_OBS4_CHNL382_STATUS_ADDR A:0xe64bf08
y.create.l HWIO_PMIC_ARB_OBS4_CHNL383_STATUS_ADDR A:0xe64bf88
y.create.l HWIO_PMIC_ARB_OBS4_CHNL384_STATUS_ADDR A:0xe64c008
y.create.l HWIO_PMIC_ARB_OBS4_CHNL385_STATUS_ADDR A:0xe64c088
y.create.l HWIO_PMIC_ARB_OBS4_CHNL386_STATUS_ADDR A:0xe64c108
y.create.l HWIO_PMIC_ARB_OBS4_CHNL387_STATUS_ADDR A:0xe64c188
y.create.l HWIO_PMIC_ARB_OBS4_CHNL388_STATUS_ADDR A:0xe64c208
y.create.l HWIO_PMIC_ARB_OBS4_CHNL389_STATUS_ADDR A:0xe64c288
y.create.l HWIO_PMIC_ARB_OBS4_CHNL390_STATUS_ADDR A:0xe64c308
y.create.l HWIO_PMIC_ARB_OBS4_CHNL391_STATUS_ADDR A:0xe64c388
y.create.l HWIO_PMIC_ARB_OBS4_CHNL392_STATUS_ADDR A:0xe64c408
y.create.l HWIO_PMIC_ARB_OBS4_CHNL393_STATUS_ADDR A:0xe64c488
y.create.l HWIO_PMIC_ARB_OBS4_CHNL394_STATUS_ADDR A:0xe64c508
y.create.l HWIO_PMIC_ARB_OBS4_CHNL395_STATUS_ADDR A:0xe64c588
y.create.l HWIO_PMIC_ARB_OBS4_CHNL396_STATUS_ADDR A:0xe64c608
y.create.l HWIO_PMIC_ARB_OBS4_CHNL397_STATUS_ADDR A:0xe64c688
y.create.l HWIO_PMIC_ARB_OBS4_CHNL398_STATUS_ADDR A:0xe64c708
y.create.l HWIO_PMIC_ARB_OBS4_CHNL399_STATUS_ADDR A:0xe64c788
y.create.l HWIO_PMIC_ARB_OBS4_CHNL400_STATUS_ADDR A:0xe64c808
y.create.l HWIO_PMIC_ARB_OBS4_CHNL401_STATUS_ADDR A:0xe64c888
y.create.l HWIO_PMIC_ARB_OBS4_CHNL402_STATUS_ADDR A:0xe64c908
y.create.l HWIO_PMIC_ARB_OBS4_CHNL403_STATUS_ADDR A:0xe64c988
y.create.l HWIO_PMIC_ARB_OBS4_CHNL404_STATUS_ADDR A:0xe64ca08
y.create.l HWIO_PMIC_ARB_OBS4_CHNL405_STATUS_ADDR A:0xe64ca88
y.create.l HWIO_PMIC_ARB_OBS4_CHNL406_STATUS_ADDR A:0xe64cb08
y.create.l HWIO_PMIC_ARB_OBS4_CHNL407_STATUS_ADDR A:0xe64cb88
y.create.l HWIO_PMIC_ARB_OBS4_CHNL408_STATUS_ADDR A:0xe64cc08
y.create.l HWIO_PMIC_ARB_OBS4_CHNL409_STATUS_ADDR A:0xe64cc88
y.create.l HWIO_PMIC_ARB_OBS4_CHNL410_STATUS_ADDR A:0xe64cd08
y.create.l HWIO_PMIC_ARB_OBS4_CHNL411_STATUS_ADDR A:0xe64cd88
y.create.l HWIO_PMIC_ARB_OBS4_CHNL412_STATUS_ADDR A:0xe64ce08
y.create.l HWIO_PMIC_ARB_OBS4_CHNL413_STATUS_ADDR A:0xe64ce88
y.create.l HWIO_PMIC_ARB_OBS4_CHNL414_STATUS_ADDR A:0xe64cf08
y.create.l HWIO_PMIC_ARB_OBS4_CHNL415_STATUS_ADDR A:0xe64cf88
y.create.l HWIO_PMIC_ARB_OBS4_CHNL416_STATUS_ADDR A:0xe64d008
y.create.l HWIO_PMIC_ARB_OBS4_CHNL417_STATUS_ADDR A:0xe64d088
y.create.l HWIO_PMIC_ARB_OBS4_CHNL418_STATUS_ADDR A:0xe64d108
y.create.l HWIO_PMIC_ARB_OBS4_CHNL419_STATUS_ADDR A:0xe64d188
y.create.l HWIO_PMIC_ARB_OBS4_CHNL420_STATUS_ADDR A:0xe64d208
y.create.l HWIO_PMIC_ARB_OBS4_CHNL421_STATUS_ADDR A:0xe64d288
y.create.l HWIO_PMIC_ARB_OBS4_CHNL422_STATUS_ADDR A:0xe64d308
y.create.l HWIO_PMIC_ARB_OBS4_CHNL423_STATUS_ADDR A:0xe64d388
y.create.l HWIO_PMIC_ARB_OBS4_CHNL424_STATUS_ADDR A:0xe64d408
y.create.l HWIO_PMIC_ARB_OBS4_CHNL425_STATUS_ADDR A:0xe64d488
y.create.l HWIO_PMIC_ARB_OBS4_CHNL426_STATUS_ADDR A:0xe64d508
y.create.l HWIO_PMIC_ARB_OBS4_CHNL427_STATUS_ADDR A:0xe64d588
y.create.l HWIO_PMIC_ARB_OBS4_CHNL428_STATUS_ADDR A:0xe64d608
y.create.l HWIO_PMIC_ARB_OBS4_CHNL429_STATUS_ADDR A:0xe64d688
y.create.l HWIO_PMIC_ARB_OBS4_CHNL430_STATUS_ADDR A:0xe64d708
y.create.l HWIO_PMIC_ARB_OBS4_CHNL431_STATUS_ADDR A:0xe64d788
y.create.l HWIO_PMIC_ARB_OBS4_CHNL432_STATUS_ADDR A:0xe64d808
y.create.l HWIO_PMIC_ARB_OBS4_CHNL433_STATUS_ADDR A:0xe64d888
y.create.l HWIO_PMIC_ARB_OBS4_CHNL434_STATUS_ADDR A:0xe64d908
y.create.l HWIO_PMIC_ARB_OBS4_CHNL435_STATUS_ADDR A:0xe64d988
y.create.l HWIO_PMIC_ARB_OBS4_CHNL436_STATUS_ADDR A:0xe64da08
y.create.l HWIO_PMIC_ARB_OBS4_CHNL437_STATUS_ADDR A:0xe64da88
y.create.l HWIO_PMIC_ARB_OBS4_CHNL438_STATUS_ADDR A:0xe64db08
y.create.l HWIO_PMIC_ARB_OBS4_CHNL439_STATUS_ADDR A:0xe64db88
y.create.l HWIO_PMIC_ARB_OBS4_CHNL440_STATUS_ADDR A:0xe64dc08
y.create.l HWIO_PMIC_ARB_OBS4_CHNL441_STATUS_ADDR A:0xe64dc88
y.create.l HWIO_PMIC_ARB_OBS4_CHNL442_STATUS_ADDR A:0xe64dd08
y.create.l HWIO_PMIC_ARB_OBS4_CHNL443_STATUS_ADDR A:0xe64dd88
y.create.l HWIO_PMIC_ARB_OBS4_CHNL444_STATUS_ADDR A:0xe64de08
y.create.l HWIO_PMIC_ARB_OBS4_CHNL445_STATUS_ADDR A:0xe64de88
y.create.l HWIO_PMIC_ARB_OBS4_CHNL446_STATUS_ADDR A:0xe64df08
y.create.l HWIO_PMIC_ARB_OBS4_CHNL447_STATUS_ADDR A:0xe64df88
y.create.l HWIO_PMIC_ARB_OBS4_CHNL448_STATUS_ADDR A:0xe64e008
y.create.l HWIO_PMIC_ARB_OBS4_CHNL449_STATUS_ADDR A:0xe64e088
y.create.l HWIO_PMIC_ARB_OBS4_CHNL450_STATUS_ADDR A:0xe64e108
y.create.l HWIO_PMIC_ARB_OBS4_CHNL451_STATUS_ADDR A:0xe64e188
y.create.l HWIO_PMIC_ARB_OBS4_CHNL452_STATUS_ADDR A:0xe64e208
y.create.l HWIO_PMIC_ARB_OBS4_CHNL453_STATUS_ADDR A:0xe64e288
y.create.l HWIO_PMIC_ARB_OBS4_CHNL454_STATUS_ADDR A:0xe64e308
y.create.l HWIO_PMIC_ARB_OBS4_CHNL455_STATUS_ADDR A:0xe64e388
y.create.l HWIO_PMIC_ARB_OBS4_CHNL456_STATUS_ADDR A:0xe64e408
y.create.l HWIO_PMIC_ARB_OBS4_CHNL457_STATUS_ADDR A:0xe64e488
y.create.l HWIO_PMIC_ARB_OBS4_CHNL458_STATUS_ADDR A:0xe64e508
y.create.l HWIO_PMIC_ARB_OBS4_CHNL459_STATUS_ADDR A:0xe64e588
y.create.l HWIO_PMIC_ARB_OBS4_CHNL460_STATUS_ADDR A:0xe64e608
y.create.l HWIO_PMIC_ARB_OBS4_CHNL461_STATUS_ADDR A:0xe64e688
y.create.l HWIO_PMIC_ARB_OBS4_CHNL462_STATUS_ADDR A:0xe64e708
y.create.l HWIO_PMIC_ARB_OBS4_CHNL463_STATUS_ADDR A:0xe64e788
y.create.l HWIO_PMIC_ARB_OBS4_CHNL464_STATUS_ADDR A:0xe64e808
y.create.l HWIO_PMIC_ARB_OBS4_CHNL465_STATUS_ADDR A:0xe64e888
y.create.l HWIO_PMIC_ARB_OBS4_CHNL466_STATUS_ADDR A:0xe64e908
y.create.l HWIO_PMIC_ARB_OBS4_CHNL467_STATUS_ADDR A:0xe64e988
y.create.l HWIO_PMIC_ARB_OBS4_CHNL468_STATUS_ADDR A:0xe64ea08
y.create.l HWIO_PMIC_ARB_OBS4_CHNL469_STATUS_ADDR A:0xe64ea88
y.create.l HWIO_PMIC_ARB_OBS4_CHNL470_STATUS_ADDR A:0xe64eb08
y.create.l HWIO_PMIC_ARB_OBS4_CHNL471_STATUS_ADDR A:0xe64eb88
y.create.l HWIO_PMIC_ARB_OBS4_CHNL472_STATUS_ADDR A:0xe64ec08
y.create.l HWIO_PMIC_ARB_OBS4_CHNL473_STATUS_ADDR A:0xe64ec88
y.create.l HWIO_PMIC_ARB_OBS4_CHNL474_STATUS_ADDR A:0xe64ed08
y.create.l HWIO_PMIC_ARB_OBS4_CHNL475_STATUS_ADDR A:0xe64ed88
y.create.l HWIO_PMIC_ARB_OBS4_CHNL476_STATUS_ADDR A:0xe64ee08
y.create.l HWIO_PMIC_ARB_OBS4_CHNL477_STATUS_ADDR A:0xe64ee88
y.create.l HWIO_PMIC_ARB_OBS4_CHNL478_STATUS_ADDR A:0xe64ef08
y.create.l HWIO_PMIC_ARB_OBS4_CHNL479_STATUS_ADDR A:0xe64ef88
y.create.l HWIO_PMIC_ARB_OBS4_CHNL480_STATUS_ADDR A:0xe64f008
y.create.l HWIO_PMIC_ARB_OBS4_CHNL481_STATUS_ADDR A:0xe64f088
y.create.l HWIO_PMIC_ARB_OBS4_CHNL482_STATUS_ADDR A:0xe64f108
y.create.l HWIO_PMIC_ARB_OBS4_CHNL483_STATUS_ADDR A:0xe64f188
y.create.l HWIO_PMIC_ARB_OBS4_CHNL484_STATUS_ADDR A:0xe64f208
y.create.l HWIO_PMIC_ARB_OBS4_CHNL485_STATUS_ADDR A:0xe64f288
y.create.l HWIO_PMIC_ARB_OBS4_CHNL486_STATUS_ADDR A:0xe64f308
y.create.l HWIO_PMIC_ARB_OBS4_CHNL487_STATUS_ADDR A:0xe64f388
y.create.l HWIO_PMIC_ARB_OBS4_CHNL488_STATUS_ADDR A:0xe64f408
y.create.l HWIO_PMIC_ARB_OBS4_CHNL489_STATUS_ADDR A:0xe64f488
y.create.l HWIO_PMIC_ARB_OBS4_CHNL490_STATUS_ADDR A:0xe64f508
y.create.l HWIO_PMIC_ARB_OBS4_CHNL491_STATUS_ADDR A:0xe64f588
y.create.l HWIO_PMIC_ARB_OBS4_CHNL492_STATUS_ADDR A:0xe64f608
y.create.l HWIO_PMIC_ARB_OBS4_CHNL493_STATUS_ADDR A:0xe64f688
y.create.l HWIO_PMIC_ARB_OBS4_CHNL494_STATUS_ADDR A:0xe64f708
y.create.l HWIO_PMIC_ARB_OBS4_CHNL495_STATUS_ADDR A:0xe64f788
y.create.l HWIO_PMIC_ARB_OBS4_CHNL496_STATUS_ADDR A:0xe64f808
y.create.l HWIO_PMIC_ARB_OBS4_CHNL497_STATUS_ADDR A:0xe64f888
y.create.l HWIO_PMIC_ARB_OBS4_CHNL498_STATUS_ADDR A:0xe64f908
y.create.l HWIO_PMIC_ARB_OBS4_CHNL499_STATUS_ADDR A:0xe64f988
y.create.l HWIO_PMIC_ARB_OBS4_CHNL500_STATUS_ADDR A:0xe64fa08
y.create.l HWIO_PMIC_ARB_OBS4_CHNL501_STATUS_ADDR A:0xe64fa88
y.create.l HWIO_PMIC_ARB_OBS4_CHNL502_STATUS_ADDR A:0xe64fb08
y.create.l HWIO_PMIC_ARB_OBS4_CHNL503_STATUS_ADDR A:0xe64fb88
y.create.l HWIO_PMIC_ARB_OBS4_CHNL504_STATUS_ADDR A:0xe64fc08
y.create.l HWIO_PMIC_ARB_OBS4_CHNL505_STATUS_ADDR A:0xe64fc88
y.create.l HWIO_PMIC_ARB_OBS4_CHNL506_STATUS_ADDR A:0xe64fd08
y.create.l HWIO_PMIC_ARB_OBS4_CHNL507_STATUS_ADDR A:0xe64fd88
y.create.l HWIO_PMIC_ARB_OBS4_CHNL508_STATUS_ADDR A:0xe64fe08
y.create.l HWIO_PMIC_ARB_OBS4_CHNL509_STATUS_ADDR A:0xe64fe88
y.create.l HWIO_PMIC_ARB_OBS4_CHNL510_STATUS_ADDR A:0xe64ff08
y.create.l HWIO_PMIC_ARB_OBS4_CHNL511_STATUS_ADDR A:0xe64ff88
y.create.l HWIO_PMIC_ARB_OBS5_CHNL0_STATUS_ADDR A:0xe650008
y.create.l HWIO_PMIC_ARB_OBS5_CHNL1_STATUS_ADDR A:0xe650088
y.create.l HWIO_PMIC_ARB_OBS5_CHNL2_STATUS_ADDR A:0xe650108
y.create.l HWIO_PMIC_ARB_OBS5_CHNL3_STATUS_ADDR A:0xe650188
y.create.l HWIO_PMIC_ARB_OBS5_CHNL4_STATUS_ADDR A:0xe650208
y.create.l HWIO_PMIC_ARB_OBS5_CHNL5_STATUS_ADDR A:0xe650288
y.create.l HWIO_PMIC_ARB_OBS5_CHNL6_STATUS_ADDR A:0xe650308
y.create.l HWIO_PMIC_ARB_OBS5_CHNL7_STATUS_ADDR A:0xe650388
y.create.l HWIO_PMIC_ARB_OBS5_CHNL8_STATUS_ADDR A:0xe650408
y.create.l HWIO_PMIC_ARB_OBS5_CHNL9_STATUS_ADDR A:0xe650488
y.create.l HWIO_PMIC_ARB_OBS5_CHNL10_STATUS_ADDR A:0xe650508
y.create.l HWIO_PMIC_ARB_OBS5_CHNL11_STATUS_ADDR A:0xe650588
y.create.l HWIO_PMIC_ARB_OBS5_CHNL12_STATUS_ADDR A:0xe650608
y.create.l HWIO_PMIC_ARB_OBS5_CHNL13_STATUS_ADDR A:0xe650688
y.create.l HWIO_PMIC_ARB_OBS5_CHNL14_STATUS_ADDR A:0xe650708
y.create.l HWIO_PMIC_ARB_OBS5_CHNL15_STATUS_ADDR A:0xe650788
y.create.l HWIO_PMIC_ARB_OBS5_CHNL16_STATUS_ADDR A:0xe650808
y.create.l HWIO_PMIC_ARB_OBS5_CHNL17_STATUS_ADDR A:0xe650888
y.create.l HWIO_PMIC_ARB_OBS5_CHNL18_STATUS_ADDR A:0xe650908
y.create.l HWIO_PMIC_ARB_OBS5_CHNL19_STATUS_ADDR A:0xe650988
y.create.l HWIO_PMIC_ARB_OBS5_CHNL20_STATUS_ADDR A:0xe650a08
y.create.l HWIO_PMIC_ARB_OBS5_CHNL21_STATUS_ADDR A:0xe650a88
y.create.l HWIO_PMIC_ARB_OBS5_CHNL22_STATUS_ADDR A:0xe650b08
y.create.l HWIO_PMIC_ARB_OBS5_CHNL23_STATUS_ADDR A:0xe650b88
y.create.l HWIO_PMIC_ARB_OBS5_CHNL24_STATUS_ADDR A:0xe650c08
y.create.l HWIO_PMIC_ARB_OBS5_CHNL25_STATUS_ADDR A:0xe650c88
y.create.l HWIO_PMIC_ARB_OBS5_CHNL26_STATUS_ADDR A:0xe650d08
y.create.l HWIO_PMIC_ARB_OBS5_CHNL27_STATUS_ADDR A:0xe650d88
y.create.l HWIO_PMIC_ARB_OBS5_CHNL28_STATUS_ADDR A:0xe650e08
y.create.l HWIO_PMIC_ARB_OBS5_CHNL29_STATUS_ADDR A:0xe650e88
y.create.l HWIO_PMIC_ARB_OBS5_CHNL30_STATUS_ADDR A:0xe650f08
y.create.l HWIO_PMIC_ARB_OBS5_CHNL31_STATUS_ADDR A:0xe650f88
y.create.l HWIO_PMIC_ARB_OBS5_CHNL32_STATUS_ADDR A:0xe651008
y.create.l HWIO_PMIC_ARB_OBS5_CHNL33_STATUS_ADDR A:0xe651088
y.create.l HWIO_PMIC_ARB_OBS5_CHNL34_STATUS_ADDR A:0xe651108
y.create.l HWIO_PMIC_ARB_OBS5_CHNL35_STATUS_ADDR A:0xe651188
y.create.l HWIO_PMIC_ARB_OBS5_CHNL36_STATUS_ADDR A:0xe651208
y.create.l HWIO_PMIC_ARB_OBS5_CHNL37_STATUS_ADDR A:0xe651288
y.create.l HWIO_PMIC_ARB_OBS5_CHNL38_STATUS_ADDR A:0xe651308
y.create.l HWIO_PMIC_ARB_OBS5_CHNL39_STATUS_ADDR A:0xe651388
y.create.l HWIO_PMIC_ARB_OBS5_CHNL40_STATUS_ADDR A:0xe651408
y.create.l HWIO_PMIC_ARB_OBS5_CHNL41_STATUS_ADDR A:0xe651488
y.create.l HWIO_PMIC_ARB_OBS5_CHNL42_STATUS_ADDR A:0xe651508
y.create.l HWIO_PMIC_ARB_OBS5_CHNL43_STATUS_ADDR A:0xe651588
y.create.l HWIO_PMIC_ARB_OBS5_CHNL44_STATUS_ADDR A:0xe651608
y.create.l HWIO_PMIC_ARB_OBS5_CHNL45_STATUS_ADDR A:0xe651688
y.create.l HWIO_PMIC_ARB_OBS5_CHNL46_STATUS_ADDR A:0xe651708
y.create.l HWIO_PMIC_ARB_OBS5_CHNL47_STATUS_ADDR A:0xe651788
y.create.l HWIO_PMIC_ARB_OBS5_CHNL48_STATUS_ADDR A:0xe651808
y.create.l HWIO_PMIC_ARB_OBS5_CHNL49_STATUS_ADDR A:0xe651888
y.create.l HWIO_PMIC_ARB_OBS5_CHNL50_STATUS_ADDR A:0xe651908
y.create.l HWIO_PMIC_ARB_OBS5_CHNL51_STATUS_ADDR A:0xe651988
y.create.l HWIO_PMIC_ARB_OBS5_CHNL52_STATUS_ADDR A:0xe651a08
y.create.l HWIO_PMIC_ARB_OBS5_CHNL53_STATUS_ADDR A:0xe651a88
y.create.l HWIO_PMIC_ARB_OBS5_CHNL54_STATUS_ADDR A:0xe651b08
y.create.l HWIO_PMIC_ARB_OBS5_CHNL55_STATUS_ADDR A:0xe651b88
y.create.l HWIO_PMIC_ARB_OBS5_CHNL56_STATUS_ADDR A:0xe651c08
y.create.l HWIO_PMIC_ARB_OBS5_CHNL57_STATUS_ADDR A:0xe651c88
y.create.l HWIO_PMIC_ARB_OBS5_CHNL58_STATUS_ADDR A:0xe651d08
y.create.l HWIO_PMIC_ARB_OBS5_CHNL59_STATUS_ADDR A:0xe651d88
y.create.l HWIO_PMIC_ARB_OBS5_CHNL60_STATUS_ADDR A:0xe651e08
y.create.l HWIO_PMIC_ARB_OBS5_CHNL61_STATUS_ADDR A:0xe651e88
y.create.l HWIO_PMIC_ARB_OBS5_CHNL62_STATUS_ADDR A:0xe651f08
y.create.l HWIO_PMIC_ARB_OBS5_CHNL63_STATUS_ADDR A:0xe651f88
y.create.l HWIO_PMIC_ARB_OBS5_CHNL64_STATUS_ADDR A:0xe652008
y.create.l HWIO_PMIC_ARB_OBS5_CHNL65_STATUS_ADDR A:0xe652088
y.create.l HWIO_PMIC_ARB_OBS5_CHNL66_STATUS_ADDR A:0xe652108
y.create.l HWIO_PMIC_ARB_OBS5_CHNL67_STATUS_ADDR A:0xe652188
y.create.l HWIO_PMIC_ARB_OBS5_CHNL68_STATUS_ADDR A:0xe652208
y.create.l HWIO_PMIC_ARB_OBS5_CHNL69_STATUS_ADDR A:0xe652288
y.create.l HWIO_PMIC_ARB_OBS5_CHNL70_STATUS_ADDR A:0xe652308
y.create.l HWIO_PMIC_ARB_OBS5_CHNL71_STATUS_ADDR A:0xe652388
y.create.l HWIO_PMIC_ARB_OBS5_CHNL72_STATUS_ADDR A:0xe652408
y.create.l HWIO_PMIC_ARB_OBS5_CHNL73_STATUS_ADDR A:0xe652488
y.create.l HWIO_PMIC_ARB_OBS5_CHNL74_STATUS_ADDR A:0xe652508
y.create.l HWIO_PMIC_ARB_OBS5_CHNL75_STATUS_ADDR A:0xe652588
y.create.l HWIO_PMIC_ARB_OBS5_CHNL76_STATUS_ADDR A:0xe652608
y.create.l HWIO_PMIC_ARB_OBS5_CHNL77_STATUS_ADDR A:0xe652688
y.create.l HWIO_PMIC_ARB_OBS5_CHNL78_STATUS_ADDR A:0xe652708
y.create.l HWIO_PMIC_ARB_OBS5_CHNL79_STATUS_ADDR A:0xe652788
y.create.l HWIO_PMIC_ARB_OBS5_CHNL80_STATUS_ADDR A:0xe652808
y.create.l HWIO_PMIC_ARB_OBS5_CHNL81_STATUS_ADDR A:0xe652888
y.create.l HWIO_PMIC_ARB_OBS5_CHNL82_STATUS_ADDR A:0xe652908
y.create.l HWIO_PMIC_ARB_OBS5_CHNL83_STATUS_ADDR A:0xe652988
y.create.l HWIO_PMIC_ARB_OBS5_CHNL84_STATUS_ADDR A:0xe652a08
y.create.l HWIO_PMIC_ARB_OBS5_CHNL85_STATUS_ADDR A:0xe652a88
y.create.l HWIO_PMIC_ARB_OBS5_CHNL86_STATUS_ADDR A:0xe652b08
y.create.l HWIO_PMIC_ARB_OBS5_CHNL87_STATUS_ADDR A:0xe652b88
y.create.l HWIO_PMIC_ARB_OBS5_CHNL88_STATUS_ADDR A:0xe652c08
y.create.l HWIO_PMIC_ARB_OBS5_CHNL89_STATUS_ADDR A:0xe652c88
y.create.l HWIO_PMIC_ARB_OBS5_CHNL90_STATUS_ADDR A:0xe652d08
y.create.l HWIO_PMIC_ARB_OBS5_CHNL91_STATUS_ADDR A:0xe652d88
y.create.l HWIO_PMIC_ARB_OBS5_CHNL92_STATUS_ADDR A:0xe652e08
y.create.l HWIO_PMIC_ARB_OBS5_CHNL93_STATUS_ADDR A:0xe652e88
y.create.l HWIO_PMIC_ARB_OBS5_CHNL94_STATUS_ADDR A:0xe652f08
y.create.l HWIO_PMIC_ARB_OBS5_CHNL95_STATUS_ADDR A:0xe652f88
y.create.l HWIO_PMIC_ARB_OBS5_CHNL96_STATUS_ADDR A:0xe653008
y.create.l HWIO_PMIC_ARB_OBS5_CHNL97_STATUS_ADDR A:0xe653088
y.create.l HWIO_PMIC_ARB_OBS5_CHNL98_STATUS_ADDR A:0xe653108
y.create.l HWIO_PMIC_ARB_OBS5_CHNL99_STATUS_ADDR A:0xe653188
y.create.l HWIO_PMIC_ARB_OBS5_CHNL100_STATUS_ADDR A:0xe653208
y.create.l HWIO_PMIC_ARB_OBS5_CHNL101_STATUS_ADDR A:0xe653288
y.create.l HWIO_PMIC_ARB_OBS5_CHNL102_STATUS_ADDR A:0xe653308
y.create.l HWIO_PMIC_ARB_OBS5_CHNL103_STATUS_ADDR A:0xe653388
y.create.l HWIO_PMIC_ARB_OBS5_CHNL104_STATUS_ADDR A:0xe653408
y.create.l HWIO_PMIC_ARB_OBS5_CHNL105_STATUS_ADDR A:0xe653488
y.create.l HWIO_PMIC_ARB_OBS5_CHNL106_STATUS_ADDR A:0xe653508
y.create.l HWIO_PMIC_ARB_OBS5_CHNL107_STATUS_ADDR A:0xe653588
y.create.l HWIO_PMIC_ARB_OBS5_CHNL108_STATUS_ADDR A:0xe653608
y.create.l HWIO_PMIC_ARB_OBS5_CHNL109_STATUS_ADDR A:0xe653688
y.create.l HWIO_PMIC_ARB_OBS5_CHNL110_STATUS_ADDR A:0xe653708
y.create.l HWIO_PMIC_ARB_OBS5_CHNL111_STATUS_ADDR A:0xe653788
y.create.l HWIO_PMIC_ARB_OBS5_CHNL112_STATUS_ADDR A:0xe653808
y.create.l HWIO_PMIC_ARB_OBS5_CHNL113_STATUS_ADDR A:0xe653888
y.create.l HWIO_PMIC_ARB_OBS5_CHNL114_STATUS_ADDR A:0xe653908
y.create.l HWIO_PMIC_ARB_OBS5_CHNL115_STATUS_ADDR A:0xe653988
y.create.l HWIO_PMIC_ARB_OBS5_CHNL116_STATUS_ADDR A:0xe653a08
y.create.l HWIO_PMIC_ARB_OBS5_CHNL117_STATUS_ADDR A:0xe653a88
y.create.l HWIO_PMIC_ARB_OBS5_CHNL118_STATUS_ADDR A:0xe653b08
y.create.l HWIO_PMIC_ARB_OBS5_CHNL119_STATUS_ADDR A:0xe653b88
y.create.l HWIO_PMIC_ARB_OBS5_CHNL120_STATUS_ADDR A:0xe653c08
y.create.l HWIO_PMIC_ARB_OBS5_CHNL121_STATUS_ADDR A:0xe653c88
y.create.l HWIO_PMIC_ARB_OBS5_CHNL122_STATUS_ADDR A:0xe653d08
y.create.l HWIO_PMIC_ARB_OBS5_CHNL123_STATUS_ADDR A:0xe653d88
y.create.l HWIO_PMIC_ARB_OBS5_CHNL124_STATUS_ADDR A:0xe653e08
y.create.l HWIO_PMIC_ARB_OBS5_CHNL125_STATUS_ADDR A:0xe653e88
y.create.l HWIO_PMIC_ARB_OBS5_CHNL126_STATUS_ADDR A:0xe653f08
y.create.l HWIO_PMIC_ARB_OBS5_CHNL127_STATUS_ADDR A:0xe653f88
y.create.l HWIO_PMIC_ARB_OBS5_CHNL128_STATUS_ADDR A:0xe654008
y.create.l HWIO_PMIC_ARB_OBS5_CHNL129_STATUS_ADDR A:0xe654088
y.create.l HWIO_PMIC_ARB_OBS5_CHNL130_STATUS_ADDR A:0xe654108
y.create.l HWIO_PMIC_ARB_OBS5_CHNL131_STATUS_ADDR A:0xe654188
y.create.l HWIO_PMIC_ARB_OBS5_CHNL132_STATUS_ADDR A:0xe654208
y.create.l HWIO_PMIC_ARB_OBS5_CHNL133_STATUS_ADDR A:0xe654288
y.create.l HWIO_PMIC_ARB_OBS5_CHNL134_STATUS_ADDR A:0xe654308
y.create.l HWIO_PMIC_ARB_OBS5_CHNL135_STATUS_ADDR A:0xe654388
y.create.l HWIO_PMIC_ARB_OBS5_CHNL136_STATUS_ADDR A:0xe654408
y.create.l HWIO_PMIC_ARB_OBS5_CHNL137_STATUS_ADDR A:0xe654488
y.create.l HWIO_PMIC_ARB_OBS5_CHNL138_STATUS_ADDR A:0xe654508
y.create.l HWIO_PMIC_ARB_OBS5_CHNL139_STATUS_ADDR A:0xe654588
y.create.l HWIO_PMIC_ARB_OBS5_CHNL140_STATUS_ADDR A:0xe654608
y.create.l HWIO_PMIC_ARB_OBS5_CHNL141_STATUS_ADDR A:0xe654688
y.create.l HWIO_PMIC_ARB_OBS5_CHNL142_STATUS_ADDR A:0xe654708
y.create.l HWIO_PMIC_ARB_OBS5_CHNL143_STATUS_ADDR A:0xe654788
y.create.l HWIO_PMIC_ARB_OBS5_CHNL144_STATUS_ADDR A:0xe654808
y.create.l HWIO_PMIC_ARB_OBS5_CHNL145_STATUS_ADDR A:0xe654888
y.create.l HWIO_PMIC_ARB_OBS5_CHNL146_STATUS_ADDR A:0xe654908
y.create.l HWIO_PMIC_ARB_OBS5_CHNL147_STATUS_ADDR A:0xe654988
y.create.l HWIO_PMIC_ARB_OBS5_CHNL148_STATUS_ADDR A:0xe654a08
y.create.l HWIO_PMIC_ARB_OBS5_CHNL149_STATUS_ADDR A:0xe654a88
y.create.l HWIO_PMIC_ARB_OBS5_CHNL150_STATUS_ADDR A:0xe654b08
y.create.l HWIO_PMIC_ARB_OBS5_CHNL151_STATUS_ADDR A:0xe654b88
y.create.l HWIO_PMIC_ARB_OBS5_CHNL152_STATUS_ADDR A:0xe654c08
y.create.l HWIO_PMIC_ARB_OBS5_CHNL153_STATUS_ADDR A:0xe654c88
y.create.l HWIO_PMIC_ARB_OBS5_CHNL154_STATUS_ADDR A:0xe654d08
y.create.l HWIO_PMIC_ARB_OBS5_CHNL155_STATUS_ADDR A:0xe654d88
y.create.l HWIO_PMIC_ARB_OBS5_CHNL156_STATUS_ADDR A:0xe654e08
y.create.l HWIO_PMIC_ARB_OBS5_CHNL157_STATUS_ADDR A:0xe654e88
y.create.l HWIO_PMIC_ARB_OBS5_CHNL158_STATUS_ADDR A:0xe654f08
y.create.l HWIO_PMIC_ARB_OBS5_CHNL159_STATUS_ADDR A:0xe654f88
y.create.l HWIO_PMIC_ARB_OBS5_CHNL160_STATUS_ADDR A:0xe655008
y.create.l HWIO_PMIC_ARB_OBS5_CHNL161_STATUS_ADDR A:0xe655088
y.create.l HWIO_PMIC_ARB_OBS5_CHNL162_STATUS_ADDR A:0xe655108
y.create.l HWIO_PMIC_ARB_OBS5_CHNL163_STATUS_ADDR A:0xe655188
y.create.l HWIO_PMIC_ARB_OBS5_CHNL164_STATUS_ADDR A:0xe655208
y.create.l HWIO_PMIC_ARB_OBS5_CHNL165_STATUS_ADDR A:0xe655288
y.create.l HWIO_PMIC_ARB_OBS5_CHNL166_STATUS_ADDR A:0xe655308
y.create.l HWIO_PMIC_ARB_OBS5_CHNL167_STATUS_ADDR A:0xe655388
y.create.l HWIO_PMIC_ARB_OBS5_CHNL168_STATUS_ADDR A:0xe655408
y.create.l HWIO_PMIC_ARB_OBS5_CHNL169_STATUS_ADDR A:0xe655488
y.create.l HWIO_PMIC_ARB_OBS5_CHNL170_STATUS_ADDR A:0xe655508
y.create.l HWIO_PMIC_ARB_OBS5_CHNL171_STATUS_ADDR A:0xe655588
y.create.l HWIO_PMIC_ARB_OBS5_CHNL172_STATUS_ADDR A:0xe655608
y.create.l HWIO_PMIC_ARB_OBS5_CHNL173_STATUS_ADDR A:0xe655688
y.create.l HWIO_PMIC_ARB_OBS5_CHNL174_STATUS_ADDR A:0xe655708
y.create.l HWIO_PMIC_ARB_OBS5_CHNL175_STATUS_ADDR A:0xe655788
y.create.l HWIO_PMIC_ARB_OBS5_CHNL176_STATUS_ADDR A:0xe655808
y.create.l HWIO_PMIC_ARB_OBS5_CHNL177_STATUS_ADDR A:0xe655888
y.create.l HWIO_PMIC_ARB_OBS5_CHNL178_STATUS_ADDR A:0xe655908
y.create.l HWIO_PMIC_ARB_OBS5_CHNL179_STATUS_ADDR A:0xe655988
y.create.l HWIO_PMIC_ARB_OBS5_CHNL180_STATUS_ADDR A:0xe655a08
y.create.l HWIO_PMIC_ARB_OBS5_CHNL181_STATUS_ADDR A:0xe655a88
y.create.l HWIO_PMIC_ARB_OBS5_CHNL182_STATUS_ADDR A:0xe655b08
y.create.l HWIO_PMIC_ARB_OBS5_CHNL183_STATUS_ADDR A:0xe655b88
y.create.l HWIO_PMIC_ARB_OBS5_CHNL184_STATUS_ADDR A:0xe655c08
y.create.l HWIO_PMIC_ARB_OBS5_CHNL185_STATUS_ADDR A:0xe655c88
y.create.l HWIO_PMIC_ARB_OBS5_CHNL186_STATUS_ADDR A:0xe655d08
y.create.l HWIO_PMIC_ARB_OBS5_CHNL187_STATUS_ADDR A:0xe655d88
y.create.l HWIO_PMIC_ARB_OBS5_CHNL188_STATUS_ADDR A:0xe655e08
y.create.l HWIO_PMIC_ARB_OBS5_CHNL189_STATUS_ADDR A:0xe655e88
y.create.l HWIO_PMIC_ARB_OBS5_CHNL190_STATUS_ADDR A:0xe655f08
y.create.l HWIO_PMIC_ARB_OBS5_CHNL191_STATUS_ADDR A:0xe655f88
y.create.l HWIO_PMIC_ARB_OBS5_CHNL192_STATUS_ADDR A:0xe656008
y.create.l HWIO_PMIC_ARB_OBS5_CHNL193_STATUS_ADDR A:0xe656088
y.create.l HWIO_PMIC_ARB_OBS5_CHNL194_STATUS_ADDR A:0xe656108
y.create.l HWIO_PMIC_ARB_OBS5_CHNL195_STATUS_ADDR A:0xe656188
y.create.l HWIO_PMIC_ARB_OBS5_CHNL196_STATUS_ADDR A:0xe656208
y.create.l HWIO_PMIC_ARB_OBS5_CHNL197_STATUS_ADDR A:0xe656288
y.create.l HWIO_PMIC_ARB_OBS5_CHNL198_STATUS_ADDR A:0xe656308
y.create.l HWIO_PMIC_ARB_OBS5_CHNL199_STATUS_ADDR A:0xe656388
y.create.l HWIO_PMIC_ARB_OBS5_CHNL200_STATUS_ADDR A:0xe656408
y.create.l HWIO_PMIC_ARB_OBS5_CHNL201_STATUS_ADDR A:0xe656488
y.create.l HWIO_PMIC_ARB_OBS5_CHNL202_STATUS_ADDR A:0xe656508
y.create.l HWIO_PMIC_ARB_OBS5_CHNL203_STATUS_ADDR A:0xe656588
y.create.l HWIO_PMIC_ARB_OBS5_CHNL204_STATUS_ADDR A:0xe656608
y.create.l HWIO_PMIC_ARB_OBS5_CHNL205_STATUS_ADDR A:0xe656688
y.create.l HWIO_PMIC_ARB_OBS5_CHNL206_STATUS_ADDR A:0xe656708
y.create.l HWIO_PMIC_ARB_OBS5_CHNL207_STATUS_ADDR A:0xe656788
y.create.l HWIO_PMIC_ARB_OBS5_CHNL208_STATUS_ADDR A:0xe656808
y.create.l HWIO_PMIC_ARB_OBS5_CHNL209_STATUS_ADDR A:0xe656888
y.create.l HWIO_PMIC_ARB_OBS5_CHNL210_STATUS_ADDR A:0xe656908
y.create.l HWIO_PMIC_ARB_OBS5_CHNL211_STATUS_ADDR A:0xe656988
y.create.l HWIO_PMIC_ARB_OBS5_CHNL212_STATUS_ADDR A:0xe656a08
y.create.l HWIO_PMIC_ARB_OBS5_CHNL213_STATUS_ADDR A:0xe656a88
y.create.l HWIO_PMIC_ARB_OBS5_CHNL214_STATUS_ADDR A:0xe656b08
y.create.l HWIO_PMIC_ARB_OBS5_CHNL215_STATUS_ADDR A:0xe656b88
y.create.l HWIO_PMIC_ARB_OBS5_CHNL216_STATUS_ADDR A:0xe656c08
y.create.l HWIO_PMIC_ARB_OBS5_CHNL217_STATUS_ADDR A:0xe656c88
y.create.l HWIO_PMIC_ARB_OBS5_CHNL218_STATUS_ADDR A:0xe656d08
y.create.l HWIO_PMIC_ARB_OBS5_CHNL219_STATUS_ADDR A:0xe656d88
y.create.l HWIO_PMIC_ARB_OBS5_CHNL220_STATUS_ADDR A:0xe656e08
y.create.l HWIO_PMIC_ARB_OBS5_CHNL221_STATUS_ADDR A:0xe656e88
y.create.l HWIO_PMIC_ARB_OBS5_CHNL222_STATUS_ADDR A:0xe656f08
y.create.l HWIO_PMIC_ARB_OBS5_CHNL223_STATUS_ADDR A:0xe656f88
y.create.l HWIO_PMIC_ARB_OBS5_CHNL224_STATUS_ADDR A:0xe657008
y.create.l HWIO_PMIC_ARB_OBS5_CHNL225_STATUS_ADDR A:0xe657088
y.create.l HWIO_PMIC_ARB_OBS5_CHNL226_STATUS_ADDR A:0xe657108
y.create.l HWIO_PMIC_ARB_OBS5_CHNL227_STATUS_ADDR A:0xe657188
y.create.l HWIO_PMIC_ARB_OBS5_CHNL228_STATUS_ADDR A:0xe657208
y.create.l HWIO_PMIC_ARB_OBS5_CHNL229_STATUS_ADDR A:0xe657288
y.create.l HWIO_PMIC_ARB_OBS5_CHNL230_STATUS_ADDR A:0xe657308
y.create.l HWIO_PMIC_ARB_OBS5_CHNL231_STATUS_ADDR A:0xe657388
y.create.l HWIO_PMIC_ARB_OBS5_CHNL232_STATUS_ADDR A:0xe657408
y.create.l HWIO_PMIC_ARB_OBS5_CHNL233_STATUS_ADDR A:0xe657488
y.create.l HWIO_PMIC_ARB_OBS5_CHNL234_STATUS_ADDR A:0xe657508
y.create.l HWIO_PMIC_ARB_OBS5_CHNL235_STATUS_ADDR A:0xe657588
y.create.l HWIO_PMIC_ARB_OBS5_CHNL236_STATUS_ADDR A:0xe657608
y.create.l HWIO_PMIC_ARB_OBS5_CHNL237_STATUS_ADDR A:0xe657688
y.create.l HWIO_PMIC_ARB_OBS5_CHNL238_STATUS_ADDR A:0xe657708
y.create.l HWIO_PMIC_ARB_OBS5_CHNL239_STATUS_ADDR A:0xe657788
y.create.l HWIO_PMIC_ARB_OBS5_CHNL240_STATUS_ADDR A:0xe657808
y.create.l HWIO_PMIC_ARB_OBS5_CHNL241_STATUS_ADDR A:0xe657888
y.create.l HWIO_PMIC_ARB_OBS5_CHNL242_STATUS_ADDR A:0xe657908
y.create.l HWIO_PMIC_ARB_OBS5_CHNL243_STATUS_ADDR A:0xe657988
y.create.l HWIO_PMIC_ARB_OBS5_CHNL244_STATUS_ADDR A:0xe657a08
y.create.l HWIO_PMIC_ARB_OBS5_CHNL245_STATUS_ADDR A:0xe657a88
y.create.l HWIO_PMIC_ARB_OBS5_CHNL246_STATUS_ADDR A:0xe657b08
y.create.l HWIO_PMIC_ARB_OBS5_CHNL247_STATUS_ADDR A:0xe657b88
y.create.l HWIO_PMIC_ARB_OBS5_CHNL248_STATUS_ADDR A:0xe657c08
y.create.l HWIO_PMIC_ARB_OBS5_CHNL249_STATUS_ADDR A:0xe657c88
y.create.l HWIO_PMIC_ARB_OBS5_CHNL250_STATUS_ADDR A:0xe657d08
y.create.l HWIO_PMIC_ARB_OBS5_CHNL251_STATUS_ADDR A:0xe657d88
y.create.l HWIO_PMIC_ARB_OBS5_CHNL252_STATUS_ADDR A:0xe657e08
y.create.l HWIO_PMIC_ARB_OBS5_CHNL253_STATUS_ADDR A:0xe657e88
y.create.l HWIO_PMIC_ARB_OBS5_CHNL254_STATUS_ADDR A:0xe657f08
y.create.l HWIO_PMIC_ARB_OBS5_CHNL255_STATUS_ADDR A:0xe657f88
y.create.l HWIO_PMIC_ARB_OBS5_CHNL256_STATUS_ADDR A:0xe658008
y.create.l HWIO_PMIC_ARB_OBS5_CHNL257_STATUS_ADDR A:0xe658088
y.create.l HWIO_PMIC_ARB_OBS5_CHNL258_STATUS_ADDR A:0xe658108
y.create.l HWIO_PMIC_ARB_OBS5_CHNL259_STATUS_ADDR A:0xe658188
y.create.l HWIO_PMIC_ARB_OBS5_CHNL260_STATUS_ADDR A:0xe658208
y.create.l HWIO_PMIC_ARB_OBS5_CHNL261_STATUS_ADDR A:0xe658288
y.create.l HWIO_PMIC_ARB_OBS5_CHNL262_STATUS_ADDR A:0xe658308
y.create.l HWIO_PMIC_ARB_OBS5_CHNL263_STATUS_ADDR A:0xe658388
y.create.l HWIO_PMIC_ARB_OBS5_CHNL264_STATUS_ADDR A:0xe658408
y.create.l HWIO_PMIC_ARB_OBS5_CHNL265_STATUS_ADDR A:0xe658488
y.create.l HWIO_PMIC_ARB_OBS5_CHNL266_STATUS_ADDR A:0xe658508
y.create.l HWIO_PMIC_ARB_OBS5_CHNL267_STATUS_ADDR A:0xe658588
y.create.l HWIO_PMIC_ARB_OBS5_CHNL268_STATUS_ADDR A:0xe658608
y.create.l HWIO_PMIC_ARB_OBS5_CHNL269_STATUS_ADDR A:0xe658688
y.create.l HWIO_PMIC_ARB_OBS5_CHNL270_STATUS_ADDR A:0xe658708
y.create.l HWIO_PMIC_ARB_OBS5_CHNL271_STATUS_ADDR A:0xe658788
y.create.l HWIO_PMIC_ARB_OBS5_CHNL272_STATUS_ADDR A:0xe658808
y.create.l HWIO_PMIC_ARB_OBS5_CHNL273_STATUS_ADDR A:0xe658888
y.create.l HWIO_PMIC_ARB_OBS5_CHNL274_STATUS_ADDR A:0xe658908
y.create.l HWIO_PMIC_ARB_OBS5_CHNL275_STATUS_ADDR A:0xe658988
y.create.l HWIO_PMIC_ARB_OBS5_CHNL276_STATUS_ADDR A:0xe658a08
y.create.l HWIO_PMIC_ARB_OBS5_CHNL277_STATUS_ADDR A:0xe658a88
y.create.l HWIO_PMIC_ARB_OBS5_CHNL278_STATUS_ADDR A:0xe658b08
y.create.l HWIO_PMIC_ARB_OBS5_CHNL279_STATUS_ADDR A:0xe658b88
y.create.l HWIO_PMIC_ARB_OBS5_CHNL280_STATUS_ADDR A:0xe658c08
y.create.l HWIO_PMIC_ARB_OBS5_CHNL281_STATUS_ADDR A:0xe658c88
y.create.l HWIO_PMIC_ARB_OBS5_CHNL282_STATUS_ADDR A:0xe658d08
y.create.l HWIO_PMIC_ARB_OBS5_CHNL283_STATUS_ADDR A:0xe658d88
y.create.l HWIO_PMIC_ARB_OBS5_CHNL284_STATUS_ADDR A:0xe658e08
y.create.l HWIO_PMIC_ARB_OBS5_CHNL285_STATUS_ADDR A:0xe658e88
y.create.l HWIO_PMIC_ARB_OBS5_CHNL286_STATUS_ADDR A:0xe658f08
y.create.l HWIO_PMIC_ARB_OBS5_CHNL287_STATUS_ADDR A:0xe658f88
y.create.l HWIO_PMIC_ARB_OBS5_CHNL288_STATUS_ADDR A:0xe659008
y.create.l HWIO_PMIC_ARB_OBS5_CHNL289_STATUS_ADDR A:0xe659088
y.create.l HWIO_PMIC_ARB_OBS5_CHNL290_STATUS_ADDR A:0xe659108
y.create.l HWIO_PMIC_ARB_OBS5_CHNL291_STATUS_ADDR A:0xe659188
y.create.l HWIO_PMIC_ARB_OBS5_CHNL292_STATUS_ADDR A:0xe659208
y.create.l HWIO_PMIC_ARB_OBS5_CHNL293_STATUS_ADDR A:0xe659288
y.create.l HWIO_PMIC_ARB_OBS5_CHNL294_STATUS_ADDR A:0xe659308
y.create.l HWIO_PMIC_ARB_OBS5_CHNL295_STATUS_ADDR A:0xe659388
y.create.l HWIO_PMIC_ARB_OBS5_CHNL296_STATUS_ADDR A:0xe659408
y.create.l HWIO_PMIC_ARB_OBS5_CHNL297_STATUS_ADDR A:0xe659488
y.create.l HWIO_PMIC_ARB_OBS5_CHNL298_STATUS_ADDR A:0xe659508
y.create.l HWIO_PMIC_ARB_OBS5_CHNL299_STATUS_ADDR A:0xe659588
y.create.l HWIO_PMIC_ARB_OBS5_CHNL300_STATUS_ADDR A:0xe659608
y.create.l HWIO_PMIC_ARB_OBS5_CHNL301_STATUS_ADDR A:0xe659688
y.create.l HWIO_PMIC_ARB_OBS5_CHNL302_STATUS_ADDR A:0xe659708
y.create.l HWIO_PMIC_ARB_OBS5_CHNL303_STATUS_ADDR A:0xe659788
y.create.l HWIO_PMIC_ARB_OBS5_CHNL304_STATUS_ADDR A:0xe659808
y.create.l HWIO_PMIC_ARB_OBS5_CHNL305_STATUS_ADDR A:0xe659888
y.create.l HWIO_PMIC_ARB_OBS5_CHNL306_STATUS_ADDR A:0xe659908
y.create.l HWIO_PMIC_ARB_OBS5_CHNL307_STATUS_ADDR A:0xe659988
y.create.l HWIO_PMIC_ARB_OBS5_CHNL308_STATUS_ADDR A:0xe659a08
y.create.l HWIO_PMIC_ARB_OBS5_CHNL309_STATUS_ADDR A:0xe659a88
y.create.l HWIO_PMIC_ARB_OBS5_CHNL310_STATUS_ADDR A:0xe659b08
y.create.l HWIO_PMIC_ARB_OBS5_CHNL311_STATUS_ADDR A:0xe659b88
y.create.l HWIO_PMIC_ARB_OBS5_CHNL312_STATUS_ADDR A:0xe659c08
y.create.l HWIO_PMIC_ARB_OBS5_CHNL313_STATUS_ADDR A:0xe659c88
y.create.l HWIO_PMIC_ARB_OBS5_CHNL314_STATUS_ADDR A:0xe659d08
y.create.l HWIO_PMIC_ARB_OBS5_CHNL315_STATUS_ADDR A:0xe659d88
y.create.l HWIO_PMIC_ARB_OBS5_CHNL316_STATUS_ADDR A:0xe659e08
y.create.l HWIO_PMIC_ARB_OBS5_CHNL317_STATUS_ADDR A:0xe659e88
y.create.l HWIO_PMIC_ARB_OBS5_CHNL318_STATUS_ADDR A:0xe659f08
y.create.l HWIO_PMIC_ARB_OBS5_CHNL319_STATUS_ADDR A:0xe659f88
y.create.l HWIO_PMIC_ARB_OBS5_CHNL320_STATUS_ADDR A:0xe65a008
y.create.l HWIO_PMIC_ARB_OBS5_CHNL321_STATUS_ADDR A:0xe65a088
y.create.l HWIO_PMIC_ARB_OBS5_CHNL322_STATUS_ADDR A:0xe65a108
y.create.l HWIO_PMIC_ARB_OBS5_CHNL323_STATUS_ADDR A:0xe65a188
y.create.l HWIO_PMIC_ARB_OBS5_CHNL324_STATUS_ADDR A:0xe65a208
y.create.l HWIO_PMIC_ARB_OBS5_CHNL325_STATUS_ADDR A:0xe65a288
y.create.l HWIO_PMIC_ARB_OBS5_CHNL326_STATUS_ADDR A:0xe65a308
y.create.l HWIO_PMIC_ARB_OBS5_CHNL327_STATUS_ADDR A:0xe65a388
y.create.l HWIO_PMIC_ARB_OBS5_CHNL328_STATUS_ADDR A:0xe65a408
y.create.l HWIO_PMIC_ARB_OBS5_CHNL329_STATUS_ADDR A:0xe65a488
y.create.l HWIO_PMIC_ARB_OBS5_CHNL330_STATUS_ADDR A:0xe65a508
y.create.l HWIO_PMIC_ARB_OBS5_CHNL331_STATUS_ADDR A:0xe65a588
y.create.l HWIO_PMIC_ARB_OBS5_CHNL332_STATUS_ADDR A:0xe65a608
y.create.l HWIO_PMIC_ARB_OBS5_CHNL333_STATUS_ADDR A:0xe65a688
y.create.l HWIO_PMIC_ARB_OBS5_CHNL334_STATUS_ADDR A:0xe65a708
y.create.l HWIO_PMIC_ARB_OBS5_CHNL335_STATUS_ADDR A:0xe65a788
y.create.l HWIO_PMIC_ARB_OBS5_CHNL336_STATUS_ADDR A:0xe65a808
y.create.l HWIO_PMIC_ARB_OBS5_CHNL337_STATUS_ADDR A:0xe65a888
y.create.l HWIO_PMIC_ARB_OBS5_CHNL338_STATUS_ADDR A:0xe65a908
y.create.l HWIO_PMIC_ARB_OBS5_CHNL339_STATUS_ADDR A:0xe65a988
y.create.l HWIO_PMIC_ARB_OBS5_CHNL340_STATUS_ADDR A:0xe65aa08
y.create.l HWIO_PMIC_ARB_OBS5_CHNL341_STATUS_ADDR A:0xe65aa88
y.create.l HWIO_PMIC_ARB_OBS5_CHNL342_STATUS_ADDR A:0xe65ab08
y.create.l HWIO_PMIC_ARB_OBS5_CHNL343_STATUS_ADDR A:0xe65ab88
y.create.l HWIO_PMIC_ARB_OBS5_CHNL344_STATUS_ADDR A:0xe65ac08
y.create.l HWIO_PMIC_ARB_OBS5_CHNL345_STATUS_ADDR A:0xe65ac88
y.create.l HWIO_PMIC_ARB_OBS5_CHNL346_STATUS_ADDR A:0xe65ad08
y.create.l HWIO_PMIC_ARB_OBS5_CHNL347_STATUS_ADDR A:0xe65ad88
y.create.l HWIO_PMIC_ARB_OBS5_CHNL348_STATUS_ADDR A:0xe65ae08
y.create.l HWIO_PMIC_ARB_OBS5_CHNL349_STATUS_ADDR A:0xe65ae88
y.create.l HWIO_PMIC_ARB_OBS5_CHNL350_STATUS_ADDR A:0xe65af08
y.create.l HWIO_PMIC_ARB_OBS5_CHNL351_STATUS_ADDR A:0xe65af88
y.create.l HWIO_PMIC_ARB_OBS5_CHNL352_STATUS_ADDR A:0xe65b008
y.create.l HWIO_PMIC_ARB_OBS5_CHNL353_STATUS_ADDR A:0xe65b088
y.create.l HWIO_PMIC_ARB_OBS5_CHNL354_STATUS_ADDR A:0xe65b108
y.create.l HWIO_PMIC_ARB_OBS5_CHNL355_STATUS_ADDR A:0xe65b188
y.create.l HWIO_PMIC_ARB_OBS5_CHNL356_STATUS_ADDR A:0xe65b208
y.create.l HWIO_PMIC_ARB_OBS5_CHNL357_STATUS_ADDR A:0xe65b288
y.create.l HWIO_PMIC_ARB_OBS5_CHNL358_STATUS_ADDR A:0xe65b308
y.create.l HWIO_PMIC_ARB_OBS5_CHNL359_STATUS_ADDR A:0xe65b388
y.create.l HWIO_PMIC_ARB_OBS5_CHNL360_STATUS_ADDR A:0xe65b408
y.create.l HWIO_PMIC_ARB_OBS5_CHNL361_STATUS_ADDR A:0xe65b488
y.create.l HWIO_PMIC_ARB_OBS5_CHNL362_STATUS_ADDR A:0xe65b508
y.create.l HWIO_PMIC_ARB_OBS5_CHNL363_STATUS_ADDR A:0xe65b588
y.create.l HWIO_PMIC_ARB_OBS5_CHNL364_STATUS_ADDR A:0xe65b608
y.create.l HWIO_PMIC_ARB_OBS5_CHNL365_STATUS_ADDR A:0xe65b688
y.create.l HWIO_PMIC_ARB_OBS5_CHNL366_STATUS_ADDR A:0xe65b708
y.create.l HWIO_PMIC_ARB_OBS5_CHNL367_STATUS_ADDR A:0xe65b788
y.create.l HWIO_PMIC_ARB_OBS5_CHNL368_STATUS_ADDR A:0xe65b808
y.create.l HWIO_PMIC_ARB_OBS5_CHNL369_STATUS_ADDR A:0xe65b888
y.create.l HWIO_PMIC_ARB_OBS5_CHNL370_STATUS_ADDR A:0xe65b908
y.create.l HWIO_PMIC_ARB_OBS5_CHNL371_STATUS_ADDR A:0xe65b988
y.create.l HWIO_PMIC_ARB_OBS5_CHNL372_STATUS_ADDR A:0xe65ba08
y.create.l HWIO_PMIC_ARB_OBS5_CHNL373_STATUS_ADDR A:0xe65ba88
y.create.l HWIO_PMIC_ARB_OBS5_CHNL374_STATUS_ADDR A:0xe65bb08
y.create.l HWIO_PMIC_ARB_OBS5_CHNL375_STATUS_ADDR A:0xe65bb88
y.create.l HWIO_PMIC_ARB_OBS5_CHNL376_STATUS_ADDR A:0xe65bc08
y.create.l HWIO_PMIC_ARB_OBS5_CHNL377_STATUS_ADDR A:0xe65bc88
y.create.l HWIO_PMIC_ARB_OBS5_CHNL378_STATUS_ADDR A:0xe65bd08
y.create.l HWIO_PMIC_ARB_OBS5_CHNL379_STATUS_ADDR A:0xe65bd88
y.create.l HWIO_PMIC_ARB_OBS5_CHNL380_STATUS_ADDR A:0xe65be08
y.create.l HWIO_PMIC_ARB_OBS5_CHNL381_STATUS_ADDR A:0xe65be88
y.create.l HWIO_PMIC_ARB_OBS5_CHNL382_STATUS_ADDR A:0xe65bf08
y.create.l HWIO_PMIC_ARB_OBS5_CHNL383_STATUS_ADDR A:0xe65bf88
y.create.l HWIO_PMIC_ARB_OBS5_CHNL384_STATUS_ADDR A:0xe65c008
y.create.l HWIO_PMIC_ARB_OBS5_CHNL385_STATUS_ADDR A:0xe65c088
y.create.l HWIO_PMIC_ARB_OBS5_CHNL386_STATUS_ADDR A:0xe65c108
y.create.l HWIO_PMIC_ARB_OBS5_CHNL387_STATUS_ADDR A:0xe65c188
y.create.l HWIO_PMIC_ARB_OBS5_CHNL388_STATUS_ADDR A:0xe65c208
y.create.l HWIO_PMIC_ARB_OBS5_CHNL389_STATUS_ADDR A:0xe65c288
y.create.l HWIO_PMIC_ARB_OBS5_CHNL390_STATUS_ADDR A:0xe65c308
y.create.l HWIO_PMIC_ARB_OBS5_CHNL391_STATUS_ADDR A:0xe65c388
y.create.l HWIO_PMIC_ARB_OBS5_CHNL392_STATUS_ADDR A:0xe65c408
y.create.l HWIO_PMIC_ARB_OBS5_CHNL393_STATUS_ADDR A:0xe65c488
y.create.l HWIO_PMIC_ARB_OBS5_CHNL394_STATUS_ADDR A:0xe65c508
y.create.l HWIO_PMIC_ARB_OBS5_CHNL395_STATUS_ADDR A:0xe65c588
y.create.l HWIO_PMIC_ARB_OBS5_CHNL396_STATUS_ADDR A:0xe65c608
y.create.l HWIO_PMIC_ARB_OBS5_CHNL397_STATUS_ADDR A:0xe65c688
y.create.l HWIO_PMIC_ARB_OBS5_CHNL398_STATUS_ADDR A:0xe65c708
y.create.l HWIO_PMIC_ARB_OBS5_CHNL399_STATUS_ADDR A:0xe65c788
y.create.l HWIO_PMIC_ARB_OBS5_CHNL400_STATUS_ADDR A:0xe65c808
y.create.l HWIO_PMIC_ARB_OBS5_CHNL401_STATUS_ADDR A:0xe65c888
y.create.l HWIO_PMIC_ARB_OBS5_CHNL402_STATUS_ADDR A:0xe65c908
y.create.l HWIO_PMIC_ARB_OBS5_CHNL403_STATUS_ADDR A:0xe65c988
y.create.l HWIO_PMIC_ARB_OBS5_CHNL404_STATUS_ADDR A:0xe65ca08
y.create.l HWIO_PMIC_ARB_OBS5_CHNL405_STATUS_ADDR A:0xe65ca88
y.create.l HWIO_PMIC_ARB_OBS5_CHNL406_STATUS_ADDR A:0xe65cb08
y.create.l HWIO_PMIC_ARB_OBS5_CHNL407_STATUS_ADDR A:0xe65cb88
y.create.l HWIO_PMIC_ARB_OBS5_CHNL408_STATUS_ADDR A:0xe65cc08
y.create.l HWIO_PMIC_ARB_OBS5_CHNL409_STATUS_ADDR A:0xe65cc88
y.create.l HWIO_PMIC_ARB_OBS5_CHNL410_STATUS_ADDR A:0xe65cd08
y.create.l HWIO_PMIC_ARB_OBS5_CHNL411_STATUS_ADDR A:0xe65cd88
y.create.l HWIO_PMIC_ARB_OBS5_CHNL412_STATUS_ADDR A:0xe65ce08
y.create.l HWIO_PMIC_ARB_OBS5_CHNL413_STATUS_ADDR A:0xe65ce88
y.create.l HWIO_PMIC_ARB_OBS5_CHNL414_STATUS_ADDR A:0xe65cf08
y.create.l HWIO_PMIC_ARB_OBS5_CHNL415_STATUS_ADDR A:0xe65cf88
y.create.l HWIO_PMIC_ARB_OBS5_CHNL416_STATUS_ADDR A:0xe65d008
y.create.l HWIO_PMIC_ARB_OBS5_CHNL417_STATUS_ADDR A:0xe65d088
y.create.l HWIO_PMIC_ARB_OBS5_CHNL418_STATUS_ADDR A:0xe65d108
y.create.l HWIO_PMIC_ARB_OBS5_CHNL419_STATUS_ADDR A:0xe65d188
y.create.l HWIO_PMIC_ARB_OBS5_CHNL420_STATUS_ADDR A:0xe65d208
y.create.l HWIO_PMIC_ARB_OBS5_CHNL421_STATUS_ADDR A:0xe65d288
y.create.l HWIO_PMIC_ARB_OBS5_CHNL422_STATUS_ADDR A:0xe65d308
y.create.l HWIO_PMIC_ARB_OBS5_CHNL423_STATUS_ADDR A:0xe65d388
y.create.l HWIO_PMIC_ARB_OBS5_CHNL424_STATUS_ADDR A:0xe65d408
y.create.l HWIO_PMIC_ARB_OBS5_CHNL425_STATUS_ADDR A:0xe65d488
y.create.l HWIO_PMIC_ARB_OBS5_CHNL426_STATUS_ADDR A:0xe65d508
y.create.l HWIO_PMIC_ARB_OBS5_CHNL427_STATUS_ADDR A:0xe65d588
y.create.l HWIO_PMIC_ARB_OBS5_CHNL428_STATUS_ADDR A:0xe65d608
y.create.l HWIO_PMIC_ARB_OBS5_CHNL429_STATUS_ADDR A:0xe65d688
y.create.l HWIO_PMIC_ARB_OBS5_CHNL430_STATUS_ADDR A:0xe65d708
y.create.l HWIO_PMIC_ARB_OBS5_CHNL431_STATUS_ADDR A:0xe65d788
y.create.l HWIO_PMIC_ARB_OBS5_CHNL432_STATUS_ADDR A:0xe65d808
y.create.l HWIO_PMIC_ARB_OBS5_CHNL433_STATUS_ADDR A:0xe65d888
y.create.l HWIO_PMIC_ARB_OBS5_CHNL434_STATUS_ADDR A:0xe65d908
y.create.l HWIO_PMIC_ARB_OBS5_CHNL435_STATUS_ADDR A:0xe65d988
y.create.l HWIO_PMIC_ARB_OBS5_CHNL436_STATUS_ADDR A:0xe65da08
y.create.l HWIO_PMIC_ARB_OBS5_CHNL437_STATUS_ADDR A:0xe65da88
y.create.l HWIO_PMIC_ARB_OBS5_CHNL438_STATUS_ADDR A:0xe65db08
y.create.l HWIO_PMIC_ARB_OBS5_CHNL439_STATUS_ADDR A:0xe65db88
y.create.l HWIO_PMIC_ARB_OBS5_CHNL440_STATUS_ADDR A:0xe65dc08
y.create.l HWIO_PMIC_ARB_OBS5_CHNL441_STATUS_ADDR A:0xe65dc88
y.create.l HWIO_PMIC_ARB_OBS5_CHNL442_STATUS_ADDR A:0xe65dd08
y.create.l HWIO_PMIC_ARB_OBS5_CHNL443_STATUS_ADDR A:0xe65dd88
y.create.l HWIO_PMIC_ARB_OBS5_CHNL444_STATUS_ADDR A:0xe65de08
y.create.l HWIO_PMIC_ARB_OBS5_CHNL445_STATUS_ADDR A:0xe65de88
y.create.l HWIO_PMIC_ARB_OBS5_CHNL446_STATUS_ADDR A:0xe65df08
y.create.l HWIO_PMIC_ARB_OBS5_CHNL447_STATUS_ADDR A:0xe65df88
y.create.l HWIO_PMIC_ARB_OBS5_CHNL448_STATUS_ADDR A:0xe65e008
y.create.l HWIO_PMIC_ARB_OBS5_CHNL449_STATUS_ADDR A:0xe65e088
y.create.l HWIO_PMIC_ARB_OBS5_CHNL450_STATUS_ADDR A:0xe65e108
y.create.l HWIO_PMIC_ARB_OBS5_CHNL451_STATUS_ADDR A:0xe65e188
y.create.l HWIO_PMIC_ARB_OBS5_CHNL452_STATUS_ADDR A:0xe65e208
y.create.l HWIO_PMIC_ARB_OBS5_CHNL453_STATUS_ADDR A:0xe65e288
y.create.l HWIO_PMIC_ARB_OBS5_CHNL454_STATUS_ADDR A:0xe65e308
y.create.l HWIO_PMIC_ARB_OBS5_CHNL455_STATUS_ADDR A:0xe65e388
y.create.l HWIO_PMIC_ARB_OBS5_CHNL456_STATUS_ADDR A:0xe65e408
y.create.l HWIO_PMIC_ARB_OBS5_CHNL457_STATUS_ADDR A:0xe65e488
y.create.l HWIO_PMIC_ARB_OBS5_CHNL458_STATUS_ADDR A:0xe65e508
y.create.l HWIO_PMIC_ARB_OBS5_CHNL459_STATUS_ADDR A:0xe65e588
y.create.l HWIO_PMIC_ARB_OBS5_CHNL460_STATUS_ADDR A:0xe65e608
y.create.l HWIO_PMIC_ARB_OBS5_CHNL461_STATUS_ADDR A:0xe65e688
y.create.l HWIO_PMIC_ARB_OBS5_CHNL462_STATUS_ADDR A:0xe65e708
y.create.l HWIO_PMIC_ARB_OBS5_CHNL463_STATUS_ADDR A:0xe65e788
y.create.l HWIO_PMIC_ARB_OBS5_CHNL464_STATUS_ADDR A:0xe65e808
y.create.l HWIO_PMIC_ARB_OBS5_CHNL465_STATUS_ADDR A:0xe65e888
y.create.l HWIO_PMIC_ARB_OBS5_CHNL466_STATUS_ADDR A:0xe65e908
y.create.l HWIO_PMIC_ARB_OBS5_CHNL467_STATUS_ADDR A:0xe65e988
y.create.l HWIO_PMIC_ARB_OBS5_CHNL468_STATUS_ADDR A:0xe65ea08
y.create.l HWIO_PMIC_ARB_OBS5_CHNL469_STATUS_ADDR A:0xe65ea88
y.create.l HWIO_PMIC_ARB_OBS5_CHNL470_STATUS_ADDR A:0xe65eb08
y.create.l HWIO_PMIC_ARB_OBS5_CHNL471_STATUS_ADDR A:0xe65eb88
y.create.l HWIO_PMIC_ARB_OBS5_CHNL472_STATUS_ADDR A:0xe65ec08
y.create.l HWIO_PMIC_ARB_OBS5_CHNL473_STATUS_ADDR A:0xe65ec88
y.create.l HWIO_PMIC_ARB_OBS5_CHNL474_STATUS_ADDR A:0xe65ed08
y.create.l HWIO_PMIC_ARB_OBS5_CHNL475_STATUS_ADDR A:0xe65ed88
y.create.l HWIO_PMIC_ARB_OBS5_CHNL476_STATUS_ADDR A:0xe65ee08
y.create.l HWIO_PMIC_ARB_OBS5_CHNL477_STATUS_ADDR A:0xe65ee88
y.create.l HWIO_PMIC_ARB_OBS5_CHNL478_STATUS_ADDR A:0xe65ef08
y.create.l HWIO_PMIC_ARB_OBS5_CHNL479_STATUS_ADDR A:0xe65ef88
y.create.l HWIO_PMIC_ARB_OBS5_CHNL480_STATUS_ADDR A:0xe65f008
y.create.l HWIO_PMIC_ARB_OBS5_CHNL481_STATUS_ADDR A:0xe65f088
y.create.l HWIO_PMIC_ARB_OBS5_CHNL482_STATUS_ADDR A:0xe65f108
y.create.l HWIO_PMIC_ARB_OBS5_CHNL483_STATUS_ADDR A:0xe65f188
y.create.l HWIO_PMIC_ARB_OBS5_CHNL484_STATUS_ADDR A:0xe65f208
y.create.l HWIO_PMIC_ARB_OBS5_CHNL485_STATUS_ADDR A:0xe65f288
y.create.l HWIO_PMIC_ARB_OBS5_CHNL486_STATUS_ADDR A:0xe65f308
y.create.l HWIO_PMIC_ARB_OBS5_CHNL487_STATUS_ADDR A:0xe65f388
y.create.l HWIO_PMIC_ARB_OBS5_CHNL488_STATUS_ADDR A:0xe65f408
y.create.l HWIO_PMIC_ARB_OBS5_CHNL489_STATUS_ADDR A:0xe65f488
y.create.l HWIO_PMIC_ARB_OBS5_CHNL490_STATUS_ADDR A:0xe65f508
y.create.l HWIO_PMIC_ARB_OBS5_CHNL491_STATUS_ADDR A:0xe65f588
y.create.l HWIO_PMIC_ARB_OBS5_CHNL492_STATUS_ADDR A:0xe65f608
y.create.l HWIO_PMIC_ARB_OBS5_CHNL493_STATUS_ADDR A:0xe65f688
y.create.l HWIO_PMIC_ARB_OBS5_CHNL494_STATUS_ADDR A:0xe65f708
y.create.l HWIO_PMIC_ARB_OBS5_CHNL495_STATUS_ADDR A:0xe65f788
y.create.l HWIO_PMIC_ARB_OBS5_CHNL496_STATUS_ADDR A:0xe65f808
y.create.l HWIO_PMIC_ARB_OBS5_CHNL497_STATUS_ADDR A:0xe65f888
y.create.l HWIO_PMIC_ARB_OBS5_CHNL498_STATUS_ADDR A:0xe65f908
y.create.l HWIO_PMIC_ARB_OBS5_CHNL499_STATUS_ADDR A:0xe65f988
y.create.l HWIO_PMIC_ARB_OBS5_CHNL500_STATUS_ADDR A:0xe65fa08
y.create.l HWIO_PMIC_ARB_OBS5_CHNL501_STATUS_ADDR A:0xe65fa88
y.create.l HWIO_PMIC_ARB_OBS5_CHNL502_STATUS_ADDR A:0xe65fb08
y.create.l HWIO_PMIC_ARB_OBS5_CHNL503_STATUS_ADDR A:0xe65fb88
y.create.l HWIO_PMIC_ARB_OBS5_CHNL504_STATUS_ADDR A:0xe65fc08
y.create.l HWIO_PMIC_ARB_OBS5_CHNL505_STATUS_ADDR A:0xe65fc88
y.create.l HWIO_PMIC_ARB_OBS5_CHNL506_STATUS_ADDR A:0xe65fd08
y.create.l HWIO_PMIC_ARB_OBS5_CHNL507_STATUS_ADDR A:0xe65fd88
y.create.l HWIO_PMIC_ARB_OBS5_CHNL508_STATUS_ADDR A:0xe65fe08
y.create.l HWIO_PMIC_ARB_OBS5_CHNL509_STATUS_ADDR A:0xe65fe88
y.create.l HWIO_PMIC_ARB_OBS5_CHNL510_STATUS_ADDR A:0xe65ff08
y.create.l HWIO_PMIC_ARB_OBS5_CHNL511_STATUS_ADDR A:0xe65ff88
y.create.l HWIO_PMIC_ARB_OBS6_CHNL0_STATUS_ADDR A:0xe660008
y.create.l HWIO_PMIC_ARB_OBS6_CHNL1_STATUS_ADDR A:0xe660088
y.create.l HWIO_PMIC_ARB_OBS6_CHNL2_STATUS_ADDR A:0xe660108
y.create.l HWIO_PMIC_ARB_OBS6_CHNL3_STATUS_ADDR A:0xe660188
y.create.l HWIO_PMIC_ARB_OBS6_CHNL4_STATUS_ADDR A:0xe660208
y.create.l HWIO_PMIC_ARB_OBS6_CHNL5_STATUS_ADDR A:0xe660288
y.create.l HWIO_PMIC_ARB_OBS6_CHNL6_STATUS_ADDR A:0xe660308
y.create.l HWIO_PMIC_ARB_OBS6_CHNL7_STATUS_ADDR A:0xe660388
y.create.l HWIO_PMIC_ARB_OBS6_CHNL8_STATUS_ADDR A:0xe660408
y.create.l HWIO_PMIC_ARB_OBS6_CHNL9_STATUS_ADDR A:0xe660488
y.create.l HWIO_PMIC_ARB_OBS6_CHNL10_STATUS_ADDR A:0xe660508
y.create.l HWIO_PMIC_ARB_OBS6_CHNL11_STATUS_ADDR A:0xe660588
y.create.l HWIO_PMIC_ARB_OBS6_CHNL12_STATUS_ADDR A:0xe660608
y.create.l HWIO_PMIC_ARB_OBS6_CHNL13_STATUS_ADDR A:0xe660688
y.create.l HWIO_PMIC_ARB_OBS6_CHNL14_STATUS_ADDR A:0xe660708
y.create.l HWIO_PMIC_ARB_OBS6_CHNL15_STATUS_ADDR A:0xe660788
y.create.l HWIO_PMIC_ARB_OBS6_CHNL16_STATUS_ADDR A:0xe660808
y.create.l HWIO_PMIC_ARB_OBS6_CHNL17_STATUS_ADDR A:0xe660888
y.create.l HWIO_PMIC_ARB_OBS6_CHNL18_STATUS_ADDR A:0xe660908
y.create.l HWIO_PMIC_ARB_OBS6_CHNL19_STATUS_ADDR A:0xe660988
y.create.l HWIO_PMIC_ARB_OBS6_CHNL20_STATUS_ADDR A:0xe660a08
y.create.l HWIO_PMIC_ARB_OBS6_CHNL21_STATUS_ADDR A:0xe660a88
y.create.l HWIO_PMIC_ARB_OBS6_CHNL22_STATUS_ADDR A:0xe660b08
y.create.l HWIO_PMIC_ARB_OBS6_CHNL23_STATUS_ADDR A:0xe660b88
y.create.l HWIO_PMIC_ARB_OBS6_CHNL24_STATUS_ADDR A:0xe660c08
y.create.l HWIO_PMIC_ARB_OBS6_CHNL25_STATUS_ADDR A:0xe660c88
y.create.l HWIO_PMIC_ARB_OBS6_CHNL26_STATUS_ADDR A:0xe660d08
y.create.l HWIO_PMIC_ARB_OBS6_CHNL27_STATUS_ADDR A:0xe660d88
y.create.l HWIO_PMIC_ARB_OBS6_CHNL28_STATUS_ADDR A:0xe660e08
y.create.l HWIO_PMIC_ARB_OBS6_CHNL29_STATUS_ADDR A:0xe660e88
y.create.l HWIO_PMIC_ARB_OBS6_CHNL30_STATUS_ADDR A:0xe660f08
y.create.l HWIO_PMIC_ARB_OBS6_CHNL31_STATUS_ADDR A:0xe660f88
y.create.l HWIO_PMIC_ARB_OBS6_CHNL32_STATUS_ADDR A:0xe661008
y.create.l HWIO_PMIC_ARB_OBS6_CHNL33_STATUS_ADDR A:0xe661088
y.create.l HWIO_PMIC_ARB_OBS6_CHNL34_STATUS_ADDR A:0xe661108
y.create.l HWIO_PMIC_ARB_OBS6_CHNL35_STATUS_ADDR A:0xe661188
y.create.l HWIO_PMIC_ARB_OBS6_CHNL36_STATUS_ADDR A:0xe661208
y.create.l HWIO_PMIC_ARB_OBS6_CHNL37_STATUS_ADDR A:0xe661288
y.create.l HWIO_PMIC_ARB_OBS6_CHNL38_STATUS_ADDR A:0xe661308
y.create.l HWIO_PMIC_ARB_OBS6_CHNL39_STATUS_ADDR A:0xe661388
y.create.l HWIO_PMIC_ARB_OBS6_CHNL40_STATUS_ADDR A:0xe661408
y.create.l HWIO_PMIC_ARB_OBS6_CHNL41_STATUS_ADDR A:0xe661488
y.create.l HWIO_PMIC_ARB_OBS6_CHNL42_STATUS_ADDR A:0xe661508
y.create.l HWIO_PMIC_ARB_OBS6_CHNL43_STATUS_ADDR A:0xe661588
y.create.l HWIO_PMIC_ARB_OBS6_CHNL44_STATUS_ADDR A:0xe661608
y.create.l HWIO_PMIC_ARB_OBS6_CHNL45_STATUS_ADDR A:0xe661688
y.create.l HWIO_PMIC_ARB_OBS6_CHNL46_STATUS_ADDR A:0xe661708
y.create.l HWIO_PMIC_ARB_OBS6_CHNL47_STATUS_ADDR A:0xe661788
y.create.l HWIO_PMIC_ARB_OBS6_CHNL48_STATUS_ADDR A:0xe661808
y.create.l HWIO_PMIC_ARB_OBS6_CHNL49_STATUS_ADDR A:0xe661888
y.create.l HWIO_PMIC_ARB_OBS6_CHNL50_STATUS_ADDR A:0xe661908
y.create.l HWIO_PMIC_ARB_OBS6_CHNL51_STATUS_ADDR A:0xe661988
y.create.l HWIO_PMIC_ARB_OBS6_CHNL52_STATUS_ADDR A:0xe661a08
y.create.l HWIO_PMIC_ARB_OBS6_CHNL53_STATUS_ADDR A:0xe661a88
y.create.l HWIO_PMIC_ARB_OBS6_CHNL54_STATUS_ADDR A:0xe661b08
y.create.l HWIO_PMIC_ARB_OBS6_CHNL55_STATUS_ADDR A:0xe661b88
y.create.l HWIO_PMIC_ARB_OBS6_CHNL56_STATUS_ADDR A:0xe661c08
y.create.l HWIO_PMIC_ARB_OBS6_CHNL57_STATUS_ADDR A:0xe661c88
y.create.l HWIO_PMIC_ARB_OBS6_CHNL58_STATUS_ADDR A:0xe661d08
y.create.l HWIO_PMIC_ARB_OBS6_CHNL59_STATUS_ADDR A:0xe661d88
y.create.l HWIO_PMIC_ARB_OBS6_CHNL60_STATUS_ADDR A:0xe661e08
y.create.l HWIO_PMIC_ARB_OBS6_CHNL61_STATUS_ADDR A:0xe661e88
y.create.l HWIO_PMIC_ARB_OBS6_CHNL62_STATUS_ADDR A:0xe661f08
y.create.l HWIO_PMIC_ARB_OBS6_CHNL63_STATUS_ADDR A:0xe661f88
y.create.l HWIO_PMIC_ARB_OBS6_CHNL64_STATUS_ADDR A:0xe662008
y.create.l HWIO_PMIC_ARB_OBS6_CHNL65_STATUS_ADDR A:0xe662088
y.create.l HWIO_PMIC_ARB_OBS6_CHNL66_STATUS_ADDR A:0xe662108
y.create.l HWIO_PMIC_ARB_OBS6_CHNL67_STATUS_ADDR A:0xe662188
y.create.l HWIO_PMIC_ARB_OBS6_CHNL68_STATUS_ADDR A:0xe662208
y.create.l HWIO_PMIC_ARB_OBS6_CHNL69_STATUS_ADDR A:0xe662288
y.create.l HWIO_PMIC_ARB_OBS6_CHNL70_STATUS_ADDR A:0xe662308
y.create.l HWIO_PMIC_ARB_OBS6_CHNL71_STATUS_ADDR A:0xe662388
y.create.l HWIO_PMIC_ARB_OBS6_CHNL72_STATUS_ADDR A:0xe662408
y.create.l HWIO_PMIC_ARB_OBS6_CHNL73_STATUS_ADDR A:0xe662488
y.create.l HWIO_PMIC_ARB_OBS6_CHNL74_STATUS_ADDR A:0xe662508
y.create.l HWIO_PMIC_ARB_OBS6_CHNL75_STATUS_ADDR A:0xe662588
y.create.l HWIO_PMIC_ARB_OBS6_CHNL76_STATUS_ADDR A:0xe662608
y.create.l HWIO_PMIC_ARB_OBS6_CHNL77_STATUS_ADDR A:0xe662688
y.create.l HWIO_PMIC_ARB_OBS6_CHNL78_STATUS_ADDR A:0xe662708
y.create.l HWIO_PMIC_ARB_OBS6_CHNL79_STATUS_ADDR A:0xe662788
y.create.l HWIO_PMIC_ARB_OBS6_CHNL80_STATUS_ADDR A:0xe662808
y.create.l HWIO_PMIC_ARB_OBS6_CHNL81_STATUS_ADDR A:0xe662888
y.create.l HWIO_PMIC_ARB_OBS6_CHNL82_STATUS_ADDR A:0xe662908
y.create.l HWIO_PMIC_ARB_OBS6_CHNL83_STATUS_ADDR A:0xe662988
y.create.l HWIO_PMIC_ARB_OBS6_CHNL84_STATUS_ADDR A:0xe662a08
y.create.l HWIO_PMIC_ARB_OBS6_CHNL85_STATUS_ADDR A:0xe662a88
y.create.l HWIO_PMIC_ARB_OBS6_CHNL86_STATUS_ADDR A:0xe662b08
y.create.l HWIO_PMIC_ARB_OBS6_CHNL87_STATUS_ADDR A:0xe662b88
y.create.l HWIO_PMIC_ARB_OBS6_CHNL88_STATUS_ADDR A:0xe662c08
y.create.l HWIO_PMIC_ARB_OBS6_CHNL89_STATUS_ADDR A:0xe662c88
y.create.l HWIO_PMIC_ARB_OBS6_CHNL90_STATUS_ADDR A:0xe662d08
y.create.l HWIO_PMIC_ARB_OBS6_CHNL91_STATUS_ADDR A:0xe662d88
y.create.l HWIO_PMIC_ARB_OBS6_CHNL92_STATUS_ADDR A:0xe662e08
y.create.l HWIO_PMIC_ARB_OBS6_CHNL93_STATUS_ADDR A:0xe662e88
y.create.l HWIO_PMIC_ARB_OBS6_CHNL94_STATUS_ADDR A:0xe662f08
y.create.l HWIO_PMIC_ARB_OBS6_CHNL95_STATUS_ADDR A:0xe662f88
y.create.l HWIO_PMIC_ARB_OBS6_CHNL96_STATUS_ADDR A:0xe663008
y.create.l HWIO_PMIC_ARB_OBS6_CHNL97_STATUS_ADDR A:0xe663088
y.create.l HWIO_PMIC_ARB_OBS6_CHNL98_STATUS_ADDR A:0xe663108
y.create.l HWIO_PMIC_ARB_OBS6_CHNL99_STATUS_ADDR A:0xe663188
y.create.l HWIO_PMIC_ARB_OBS6_CHNL100_STATUS_ADDR A:0xe663208
y.create.l HWIO_PMIC_ARB_OBS6_CHNL101_STATUS_ADDR A:0xe663288
y.create.l HWIO_PMIC_ARB_OBS6_CHNL102_STATUS_ADDR A:0xe663308
y.create.l HWIO_PMIC_ARB_OBS6_CHNL103_STATUS_ADDR A:0xe663388
y.create.l HWIO_PMIC_ARB_OBS6_CHNL104_STATUS_ADDR A:0xe663408
y.create.l HWIO_PMIC_ARB_OBS6_CHNL105_STATUS_ADDR A:0xe663488
y.create.l HWIO_PMIC_ARB_OBS6_CHNL106_STATUS_ADDR A:0xe663508
y.create.l HWIO_PMIC_ARB_OBS6_CHNL107_STATUS_ADDR A:0xe663588
y.create.l HWIO_PMIC_ARB_OBS6_CHNL108_STATUS_ADDR A:0xe663608
y.create.l HWIO_PMIC_ARB_OBS6_CHNL109_STATUS_ADDR A:0xe663688
y.create.l HWIO_PMIC_ARB_OBS6_CHNL110_STATUS_ADDR A:0xe663708
y.create.l HWIO_PMIC_ARB_OBS6_CHNL111_STATUS_ADDR A:0xe663788
y.create.l HWIO_PMIC_ARB_OBS6_CHNL112_STATUS_ADDR A:0xe663808
y.create.l HWIO_PMIC_ARB_OBS6_CHNL113_STATUS_ADDR A:0xe663888
y.create.l HWIO_PMIC_ARB_OBS6_CHNL114_STATUS_ADDR A:0xe663908
y.create.l HWIO_PMIC_ARB_OBS6_CHNL115_STATUS_ADDR A:0xe663988
y.create.l HWIO_PMIC_ARB_OBS6_CHNL116_STATUS_ADDR A:0xe663a08
y.create.l HWIO_PMIC_ARB_OBS6_CHNL117_STATUS_ADDR A:0xe663a88
y.create.l HWIO_PMIC_ARB_OBS6_CHNL118_STATUS_ADDR A:0xe663b08
y.create.l HWIO_PMIC_ARB_OBS6_CHNL119_STATUS_ADDR A:0xe663b88
y.create.l HWIO_PMIC_ARB_OBS6_CHNL120_STATUS_ADDR A:0xe663c08
y.create.l HWIO_PMIC_ARB_OBS6_CHNL121_STATUS_ADDR A:0xe663c88
y.create.l HWIO_PMIC_ARB_OBS6_CHNL122_STATUS_ADDR A:0xe663d08
y.create.l HWIO_PMIC_ARB_OBS6_CHNL123_STATUS_ADDR A:0xe663d88
y.create.l HWIO_PMIC_ARB_OBS6_CHNL124_STATUS_ADDR A:0xe663e08
y.create.l HWIO_PMIC_ARB_OBS6_CHNL125_STATUS_ADDR A:0xe663e88
y.create.l HWIO_PMIC_ARB_OBS6_CHNL126_STATUS_ADDR A:0xe663f08
y.create.l HWIO_PMIC_ARB_OBS6_CHNL127_STATUS_ADDR A:0xe663f88
y.create.l HWIO_PMIC_ARB_OBS6_CHNL128_STATUS_ADDR A:0xe664008
y.create.l HWIO_PMIC_ARB_OBS6_CHNL129_STATUS_ADDR A:0xe664088
y.create.l HWIO_PMIC_ARB_OBS6_CHNL130_STATUS_ADDR A:0xe664108
y.create.l HWIO_PMIC_ARB_OBS6_CHNL131_STATUS_ADDR A:0xe664188
y.create.l HWIO_PMIC_ARB_OBS6_CHNL132_STATUS_ADDR A:0xe664208
y.create.l HWIO_PMIC_ARB_OBS6_CHNL133_STATUS_ADDR A:0xe664288
y.create.l HWIO_PMIC_ARB_OBS6_CHNL134_STATUS_ADDR A:0xe664308
y.create.l HWIO_PMIC_ARB_OBS6_CHNL135_STATUS_ADDR A:0xe664388
y.create.l HWIO_PMIC_ARB_OBS6_CHNL136_STATUS_ADDR A:0xe664408
y.create.l HWIO_PMIC_ARB_OBS6_CHNL137_STATUS_ADDR A:0xe664488
y.create.l HWIO_PMIC_ARB_OBS6_CHNL138_STATUS_ADDR A:0xe664508
y.create.l HWIO_PMIC_ARB_OBS6_CHNL139_STATUS_ADDR A:0xe664588
y.create.l HWIO_PMIC_ARB_OBS6_CHNL140_STATUS_ADDR A:0xe664608
y.create.l HWIO_PMIC_ARB_OBS6_CHNL141_STATUS_ADDR A:0xe664688
y.create.l HWIO_PMIC_ARB_OBS6_CHNL142_STATUS_ADDR A:0xe664708
y.create.l HWIO_PMIC_ARB_OBS6_CHNL143_STATUS_ADDR A:0xe664788
y.create.l HWIO_PMIC_ARB_OBS6_CHNL144_STATUS_ADDR A:0xe664808
y.create.l HWIO_PMIC_ARB_OBS6_CHNL145_STATUS_ADDR A:0xe664888
y.create.l HWIO_PMIC_ARB_OBS6_CHNL146_STATUS_ADDR A:0xe664908
y.create.l HWIO_PMIC_ARB_OBS6_CHNL147_STATUS_ADDR A:0xe664988
y.create.l HWIO_PMIC_ARB_OBS6_CHNL148_STATUS_ADDR A:0xe664a08
y.create.l HWIO_PMIC_ARB_OBS6_CHNL149_STATUS_ADDR A:0xe664a88
y.create.l HWIO_PMIC_ARB_OBS6_CHNL150_STATUS_ADDR A:0xe664b08
y.create.l HWIO_PMIC_ARB_OBS6_CHNL151_STATUS_ADDR A:0xe664b88
y.create.l HWIO_PMIC_ARB_OBS6_CHNL152_STATUS_ADDR A:0xe664c08
y.create.l HWIO_PMIC_ARB_OBS6_CHNL153_STATUS_ADDR A:0xe664c88
y.create.l HWIO_PMIC_ARB_OBS6_CHNL154_STATUS_ADDR A:0xe664d08
y.create.l HWIO_PMIC_ARB_OBS6_CHNL155_STATUS_ADDR A:0xe664d88
y.create.l HWIO_PMIC_ARB_OBS6_CHNL156_STATUS_ADDR A:0xe664e08
y.create.l HWIO_PMIC_ARB_OBS6_CHNL157_STATUS_ADDR A:0xe664e88
y.create.l HWIO_PMIC_ARB_OBS6_CHNL158_STATUS_ADDR A:0xe664f08
y.create.l HWIO_PMIC_ARB_OBS6_CHNL159_STATUS_ADDR A:0xe664f88
y.create.l HWIO_PMIC_ARB_OBS6_CHNL160_STATUS_ADDR A:0xe665008
y.create.l HWIO_PMIC_ARB_OBS6_CHNL161_STATUS_ADDR A:0xe665088
y.create.l HWIO_PMIC_ARB_OBS6_CHNL162_STATUS_ADDR A:0xe665108
y.create.l HWIO_PMIC_ARB_OBS6_CHNL163_STATUS_ADDR A:0xe665188
y.create.l HWIO_PMIC_ARB_OBS6_CHNL164_STATUS_ADDR A:0xe665208
y.create.l HWIO_PMIC_ARB_OBS6_CHNL165_STATUS_ADDR A:0xe665288
y.create.l HWIO_PMIC_ARB_OBS6_CHNL166_STATUS_ADDR A:0xe665308
y.create.l HWIO_PMIC_ARB_OBS6_CHNL167_STATUS_ADDR A:0xe665388
y.create.l HWIO_PMIC_ARB_OBS6_CHNL168_STATUS_ADDR A:0xe665408
y.create.l HWIO_PMIC_ARB_OBS6_CHNL169_STATUS_ADDR A:0xe665488
y.create.l HWIO_PMIC_ARB_OBS6_CHNL170_STATUS_ADDR A:0xe665508
y.create.l HWIO_PMIC_ARB_OBS6_CHNL171_STATUS_ADDR A:0xe665588
y.create.l HWIO_PMIC_ARB_OBS6_CHNL172_STATUS_ADDR A:0xe665608
y.create.l HWIO_PMIC_ARB_OBS6_CHNL173_STATUS_ADDR A:0xe665688
y.create.l HWIO_PMIC_ARB_OBS6_CHNL174_STATUS_ADDR A:0xe665708
y.create.l HWIO_PMIC_ARB_OBS6_CHNL175_STATUS_ADDR A:0xe665788
y.create.l HWIO_PMIC_ARB_OBS6_CHNL176_STATUS_ADDR A:0xe665808
y.create.l HWIO_PMIC_ARB_OBS6_CHNL177_STATUS_ADDR A:0xe665888
y.create.l HWIO_PMIC_ARB_OBS6_CHNL178_STATUS_ADDR A:0xe665908
y.create.l HWIO_PMIC_ARB_OBS6_CHNL179_STATUS_ADDR A:0xe665988
y.create.l HWIO_PMIC_ARB_OBS6_CHNL180_STATUS_ADDR A:0xe665a08
y.create.l HWIO_PMIC_ARB_OBS6_CHNL181_STATUS_ADDR A:0xe665a88
y.create.l HWIO_PMIC_ARB_OBS6_CHNL182_STATUS_ADDR A:0xe665b08
y.create.l HWIO_PMIC_ARB_OBS6_CHNL183_STATUS_ADDR A:0xe665b88
y.create.l HWIO_PMIC_ARB_OBS6_CHNL184_STATUS_ADDR A:0xe665c08
y.create.l HWIO_PMIC_ARB_OBS6_CHNL185_STATUS_ADDR A:0xe665c88
y.create.l HWIO_PMIC_ARB_OBS6_CHNL186_STATUS_ADDR A:0xe665d08
y.create.l HWIO_PMIC_ARB_OBS6_CHNL187_STATUS_ADDR A:0xe665d88
y.create.l HWIO_PMIC_ARB_OBS6_CHNL188_STATUS_ADDR A:0xe665e08
y.create.l HWIO_PMIC_ARB_OBS6_CHNL189_STATUS_ADDR A:0xe665e88
y.create.l HWIO_PMIC_ARB_OBS6_CHNL190_STATUS_ADDR A:0xe665f08
y.create.l HWIO_PMIC_ARB_OBS6_CHNL191_STATUS_ADDR A:0xe665f88
y.create.l HWIO_PMIC_ARB_OBS6_CHNL192_STATUS_ADDR A:0xe666008
y.create.l HWIO_PMIC_ARB_OBS6_CHNL193_STATUS_ADDR A:0xe666088
y.create.l HWIO_PMIC_ARB_OBS6_CHNL194_STATUS_ADDR A:0xe666108
y.create.l HWIO_PMIC_ARB_OBS6_CHNL195_STATUS_ADDR A:0xe666188
y.create.l HWIO_PMIC_ARB_OBS6_CHNL196_STATUS_ADDR A:0xe666208
y.create.l HWIO_PMIC_ARB_OBS6_CHNL197_STATUS_ADDR A:0xe666288
y.create.l HWIO_PMIC_ARB_OBS6_CHNL198_STATUS_ADDR A:0xe666308
y.create.l HWIO_PMIC_ARB_OBS6_CHNL199_STATUS_ADDR A:0xe666388
y.create.l HWIO_PMIC_ARB_OBS6_CHNL200_STATUS_ADDR A:0xe666408
y.create.l HWIO_PMIC_ARB_OBS6_CHNL201_STATUS_ADDR A:0xe666488
y.create.l HWIO_PMIC_ARB_OBS6_CHNL202_STATUS_ADDR A:0xe666508
y.create.l HWIO_PMIC_ARB_OBS6_CHNL203_STATUS_ADDR A:0xe666588
y.create.l HWIO_PMIC_ARB_OBS6_CHNL204_STATUS_ADDR A:0xe666608
y.create.l HWIO_PMIC_ARB_OBS6_CHNL205_STATUS_ADDR A:0xe666688
y.create.l HWIO_PMIC_ARB_OBS6_CHNL206_STATUS_ADDR A:0xe666708
y.create.l HWIO_PMIC_ARB_OBS6_CHNL207_STATUS_ADDR A:0xe666788
y.create.l HWIO_PMIC_ARB_OBS6_CHNL208_STATUS_ADDR A:0xe666808
y.create.l HWIO_PMIC_ARB_OBS6_CHNL209_STATUS_ADDR A:0xe666888
y.create.l HWIO_PMIC_ARB_OBS6_CHNL210_STATUS_ADDR A:0xe666908
y.create.l HWIO_PMIC_ARB_OBS6_CHNL211_STATUS_ADDR A:0xe666988
y.create.l HWIO_PMIC_ARB_OBS6_CHNL212_STATUS_ADDR A:0xe666a08
y.create.l HWIO_PMIC_ARB_OBS6_CHNL213_STATUS_ADDR A:0xe666a88
y.create.l HWIO_PMIC_ARB_OBS6_CHNL214_STATUS_ADDR A:0xe666b08
y.create.l HWIO_PMIC_ARB_OBS6_CHNL215_STATUS_ADDR A:0xe666b88
y.create.l HWIO_PMIC_ARB_OBS6_CHNL216_STATUS_ADDR A:0xe666c08
y.create.l HWIO_PMIC_ARB_OBS6_CHNL217_STATUS_ADDR A:0xe666c88
y.create.l HWIO_PMIC_ARB_OBS6_CHNL218_STATUS_ADDR A:0xe666d08
y.create.l HWIO_PMIC_ARB_OBS6_CHNL219_STATUS_ADDR A:0xe666d88
y.create.l HWIO_PMIC_ARB_OBS6_CHNL220_STATUS_ADDR A:0xe666e08
y.create.l HWIO_PMIC_ARB_OBS6_CHNL221_STATUS_ADDR A:0xe666e88
y.create.l HWIO_PMIC_ARB_OBS6_CHNL222_STATUS_ADDR A:0xe666f08
y.create.l HWIO_PMIC_ARB_OBS6_CHNL223_STATUS_ADDR A:0xe666f88
y.create.l HWIO_PMIC_ARB_OBS6_CHNL224_STATUS_ADDR A:0xe667008
y.create.l HWIO_PMIC_ARB_OBS6_CHNL225_STATUS_ADDR A:0xe667088
y.create.l HWIO_PMIC_ARB_OBS6_CHNL226_STATUS_ADDR A:0xe667108
y.create.l HWIO_PMIC_ARB_OBS6_CHNL227_STATUS_ADDR A:0xe667188
y.create.l HWIO_PMIC_ARB_OBS6_CHNL228_STATUS_ADDR A:0xe667208
y.create.l HWIO_PMIC_ARB_OBS6_CHNL229_STATUS_ADDR A:0xe667288
y.create.l HWIO_PMIC_ARB_OBS6_CHNL230_STATUS_ADDR A:0xe667308
y.create.l HWIO_PMIC_ARB_OBS6_CHNL231_STATUS_ADDR A:0xe667388
y.create.l HWIO_PMIC_ARB_OBS6_CHNL232_STATUS_ADDR A:0xe667408
y.create.l HWIO_PMIC_ARB_OBS6_CHNL233_STATUS_ADDR A:0xe667488
y.create.l HWIO_PMIC_ARB_OBS6_CHNL234_STATUS_ADDR A:0xe667508
y.create.l HWIO_PMIC_ARB_OBS6_CHNL235_STATUS_ADDR A:0xe667588
y.create.l HWIO_PMIC_ARB_OBS6_CHNL236_STATUS_ADDR A:0xe667608
y.create.l HWIO_PMIC_ARB_OBS6_CHNL237_STATUS_ADDR A:0xe667688
y.create.l HWIO_PMIC_ARB_OBS6_CHNL238_STATUS_ADDR A:0xe667708
y.create.l HWIO_PMIC_ARB_OBS6_CHNL239_STATUS_ADDR A:0xe667788
y.create.l HWIO_PMIC_ARB_OBS6_CHNL240_STATUS_ADDR A:0xe667808
y.create.l HWIO_PMIC_ARB_OBS6_CHNL241_STATUS_ADDR A:0xe667888
y.create.l HWIO_PMIC_ARB_OBS6_CHNL242_STATUS_ADDR A:0xe667908
y.create.l HWIO_PMIC_ARB_OBS6_CHNL243_STATUS_ADDR A:0xe667988
y.create.l HWIO_PMIC_ARB_OBS6_CHNL244_STATUS_ADDR A:0xe667a08
y.create.l HWIO_PMIC_ARB_OBS6_CHNL245_STATUS_ADDR A:0xe667a88
y.create.l HWIO_PMIC_ARB_OBS6_CHNL246_STATUS_ADDR A:0xe667b08
y.create.l HWIO_PMIC_ARB_OBS6_CHNL247_STATUS_ADDR A:0xe667b88
y.create.l HWIO_PMIC_ARB_OBS6_CHNL248_STATUS_ADDR A:0xe667c08
y.create.l HWIO_PMIC_ARB_OBS6_CHNL249_STATUS_ADDR A:0xe667c88
y.create.l HWIO_PMIC_ARB_OBS6_CHNL250_STATUS_ADDR A:0xe667d08
y.create.l HWIO_PMIC_ARB_OBS6_CHNL251_STATUS_ADDR A:0xe667d88
y.create.l HWIO_PMIC_ARB_OBS6_CHNL252_STATUS_ADDR A:0xe667e08
y.create.l HWIO_PMIC_ARB_OBS6_CHNL253_STATUS_ADDR A:0xe667e88
y.create.l HWIO_PMIC_ARB_OBS6_CHNL254_STATUS_ADDR A:0xe667f08
y.create.l HWIO_PMIC_ARB_OBS6_CHNL255_STATUS_ADDR A:0xe667f88
y.create.l HWIO_PMIC_ARB_OBS6_CHNL256_STATUS_ADDR A:0xe668008
y.create.l HWIO_PMIC_ARB_OBS6_CHNL257_STATUS_ADDR A:0xe668088
y.create.l HWIO_PMIC_ARB_OBS6_CHNL258_STATUS_ADDR A:0xe668108
y.create.l HWIO_PMIC_ARB_OBS6_CHNL259_STATUS_ADDR A:0xe668188
y.create.l HWIO_PMIC_ARB_OBS6_CHNL260_STATUS_ADDR A:0xe668208
y.create.l HWIO_PMIC_ARB_OBS6_CHNL261_STATUS_ADDR A:0xe668288
y.create.l HWIO_PMIC_ARB_OBS6_CHNL262_STATUS_ADDR A:0xe668308
y.create.l HWIO_PMIC_ARB_OBS6_CHNL263_STATUS_ADDR A:0xe668388
y.create.l HWIO_PMIC_ARB_OBS6_CHNL264_STATUS_ADDR A:0xe668408
y.create.l HWIO_PMIC_ARB_OBS6_CHNL265_STATUS_ADDR A:0xe668488
y.create.l HWIO_PMIC_ARB_OBS6_CHNL266_STATUS_ADDR A:0xe668508
y.create.l HWIO_PMIC_ARB_OBS6_CHNL267_STATUS_ADDR A:0xe668588
y.create.l HWIO_PMIC_ARB_OBS6_CHNL268_STATUS_ADDR A:0xe668608
y.create.l HWIO_PMIC_ARB_OBS6_CHNL269_STATUS_ADDR A:0xe668688
y.create.l HWIO_PMIC_ARB_OBS6_CHNL270_STATUS_ADDR A:0xe668708
y.create.l HWIO_PMIC_ARB_OBS6_CHNL271_STATUS_ADDR A:0xe668788
y.create.l HWIO_PMIC_ARB_OBS6_CHNL272_STATUS_ADDR A:0xe668808
y.create.l HWIO_PMIC_ARB_OBS6_CHNL273_STATUS_ADDR A:0xe668888
y.create.l HWIO_PMIC_ARB_OBS6_CHNL274_STATUS_ADDR A:0xe668908
y.create.l HWIO_PMIC_ARB_OBS6_CHNL275_STATUS_ADDR A:0xe668988
y.create.l HWIO_PMIC_ARB_OBS6_CHNL276_STATUS_ADDR A:0xe668a08
y.create.l HWIO_PMIC_ARB_OBS6_CHNL277_STATUS_ADDR A:0xe668a88
y.create.l HWIO_PMIC_ARB_OBS6_CHNL278_STATUS_ADDR A:0xe668b08
y.create.l HWIO_PMIC_ARB_OBS6_CHNL279_STATUS_ADDR A:0xe668b88
y.create.l HWIO_PMIC_ARB_OBS6_CHNL280_STATUS_ADDR A:0xe668c08
y.create.l HWIO_PMIC_ARB_OBS6_CHNL281_STATUS_ADDR A:0xe668c88
y.create.l HWIO_PMIC_ARB_OBS6_CHNL282_STATUS_ADDR A:0xe668d08
y.create.l HWIO_PMIC_ARB_OBS6_CHNL283_STATUS_ADDR A:0xe668d88
y.create.l HWIO_PMIC_ARB_OBS6_CHNL284_STATUS_ADDR A:0xe668e08
y.create.l HWIO_PMIC_ARB_OBS6_CHNL285_STATUS_ADDR A:0xe668e88
y.create.l HWIO_PMIC_ARB_OBS6_CHNL286_STATUS_ADDR A:0xe668f08
y.create.l HWIO_PMIC_ARB_OBS6_CHNL287_STATUS_ADDR A:0xe668f88
y.create.l HWIO_PMIC_ARB_OBS6_CHNL288_STATUS_ADDR A:0xe669008
y.create.l HWIO_PMIC_ARB_OBS6_CHNL289_STATUS_ADDR A:0xe669088
y.create.l HWIO_PMIC_ARB_OBS6_CHNL290_STATUS_ADDR A:0xe669108
y.create.l HWIO_PMIC_ARB_OBS6_CHNL291_STATUS_ADDR A:0xe669188
y.create.l HWIO_PMIC_ARB_OBS6_CHNL292_STATUS_ADDR A:0xe669208
y.create.l HWIO_PMIC_ARB_OBS6_CHNL293_STATUS_ADDR A:0xe669288
y.create.l HWIO_PMIC_ARB_OBS6_CHNL294_STATUS_ADDR A:0xe669308
y.create.l HWIO_PMIC_ARB_OBS6_CHNL295_STATUS_ADDR A:0xe669388
y.create.l HWIO_PMIC_ARB_OBS6_CHNL296_STATUS_ADDR A:0xe669408
y.create.l HWIO_PMIC_ARB_OBS6_CHNL297_STATUS_ADDR A:0xe669488
y.create.l HWIO_PMIC_ARB_OBS6_CHNL298_STATUS_ADDR A:0xe669508
y.create.l HWIO_PMIC_ARB_OBS6_CHNL299_STATUS_ADDR A:0xe669588
y.create.l HWIO_PMIC_ARB_OBS6_CHNL300_STATUS_ADDR A:0xe669608
y.create.l HWIO_PMIC_ARB_OBS6_CHNL301_STATUS_ADDR A:0xe669688
y.create.l HWIO_PMIC_ARB_OBS6_CHNL302_STATUS_ADDR A:0xe669708
y.create.l HWIO_PMIC_ARB_OBS6_CHNL303_STATUS_ADDR A:0xe669788
y.create.l HWIO_PMIC_ARB_OBS6_CHNL304_STATUS_ADDR A:0xe669808
y.create.l HWIO_PMIC_ARB_OBS6_CHNL305_STATUS_ADDR A:0xe669888
y.create.l HWIO_PMIC_ARB_OBS6_CHNL306_STATUS_ADDR A:0xe669908
y.create.l HWIO_PMIC_ARB_OBS6_CHNL307_STATUS_ADDR A:0xe669988
y.create.l HWIO_PMIC_ARB_OBS6_CHNL308_STATUS_ADDR A:0xe669a08
y.create.l HWIO_PMIC_ARB_OBS6_CHNL309_STATUS_ADDR A:0xe669a88
y.create.l HWIO_PMIC_ARB_OBS6_CHNL310_STATUS_ADDR A:0xe669b08
y.create.l HWIO_PMIC_ARB_OBS6_CHNL311_STATUS_ADDR A:0xe669b88
y.create.l HWIO_PMIC_ARB_OBS6_CHNL312_STATUS_ADDR A:0xe669c08
y.create.l HWIO_PMIC_ARB_OBS6_CHNL313_STATUS_ADDR A:0xe669c88
y.create.l HWIO_PMIC_ARB_OBS6_CHNL314_STATUS_ADDR A:0xe669d08
y.create.l HWIO_PMIC_ARB_OBS6_CHNL315_STATUS_ADDR A:0xe669d88
y.create.l HWIO_PMIC_ARB_OBS6_CHNL316_STATUS_ADDR A:0xe669e08
y.create.l HWIO_PMIC_ARB_OBS6_CHNL317_STATUS_ADDR A:0xe669e88
y.create.l HWIO_PMIC_ARB_OBS6_CHNL318_STATUS_ADDR A:0xe669f08
y.create.l HWIO_PMIC_ARB_OBS6_CHNL319_STATUS_ADDR A:0xe669f88
y.create.l HWIO_PMIC_ARB_OBS6_CHNL320_STATUS_ADDR A:0xe66a008
y.create.l HWIO_PMIC_ARB_OBS6_CHNL321_STATUS_ADDR A:0xe66a088
y.create.l HWIO_PMIC_ARB_OBS6_CHNL322_STATUS_ADDR A:0xe66a108
y.create.l HWIO_PMIC_ARB_OBS6_CHNL323_STATUS_ADDR A:0xe66a188
y.create.l HWIO_PMIC_ARB_OBS6_CHNL324_STATUS_ADDR A:0xe66a208
y.create.l HWIO_PMIC_ARB_OBS6_CHNL325_STATUS_ADDR A:0xe66a288
y.create.l HWIO_PMIC_ARB_OBS6_CHNL326_STATUS_ADDR A:0xe66a308
y.create.l HWIO_PMIC_ARB_OBS6_CHNL327_STATUS_ADDR A:0xe66a388
y.create.l HWIO_PMIC_ARB_OBS6_CHNL328_STATUS_ADDR A:0xe66a408
y.create.l HWIO_PMIC_ARB_OBS6_CHNL329_STATUS_ADDR A:0xe66a488
y.create.l HWIO_PMIC_ARB_OBS6_CHNL330_STATUS_ADDR A:0xe66a508
y.create.l HWIO_PMIC_ARB_OBS6_CHNL331_STATUS_ADDR A:0xe66a588
y.create.l HWIO_PMIC_ARB_OBS6_CHNL332_STATUS_ADDR A:0xe66a608
y.create.l HWIO_PMIC_ARB_OBS6_CHNL333_STATUS_ADDR A:0xe66a688
y.create.l HWIO_PMIC_ARB_OBS6_CHNL334_STATUS_ADDR A:0xe66a708
y.create.l HWIO_PMIC_ARB_OBS6_CHNL335_STATUS_ADDR A:0xe66a788
y.create.l HWIO_PMIC_ARB_OBS6_CHNL336_STATUS_ADDR A:0xe66a808
y.create.l HWIO_PMIC_ARB_OBS6_CHNL337_STATUS_ADDR A:0xe66a888
y.create.l HWIO_PMIC_ARB_OBS6_CHNL338_STATUS_ADDR A:0xe66a908
y.create.l HWIO_PMIC_ARB_OBS6_CHNL339_STATUS_ADDR A:0xe66a988
y.create.l HWIO_PMIC_ARB_OBS6_CHNL340_STATUS_ADDR A:0xe66aa08
y.create.l HWIO_PMIC_ARB_OBS6_CHNL341_STATUS_ADDR A:0xe66aa88
y.create.l HWIO_PMIC_ARB_OBS6_CHNL342_STATUS_ADDR A:0xe66ab08
y.create.l HWIO_PMIC_ARB_OBS6_CHNL343_STATUS_ADDR A:0xe66ab88
y.create.l HWIO_PMIC_ARB_OBS6_CHNL344_STATUS_ADDR A:0xe66ac08
y.create.l HWIO_PMIC_ARB_OBS6_CHNL345_STATUS_ADDR A:0xe66ac88
y.create.l HWIO_PMIC_ARB_OBS6_CHNL346_STATUS_ADDR A:0xe66ad08
y.create.l HWIO_PMIC_ARB_OBS6_CHNL347_STATUS_ADDR A:0xe66ad88
y.create.l HWIO_PMIC_ARB_OBS6_CHNL348_STATUS_ADDR A:0xe66ae08
y.create.l HWIO_PMIC_ARB_OBS6_CHNL349_STATUS_ADDR A:0xe66ae88
y.create.l HWIO_PMIC_ARB_OBS6_CHNL350_STATUS_ADDR A:0xe66af08
y.create.l HWIO_PMIC_ARB_OBS6_CHNL351_STATUS_ADDR A:0xe66af88
y.create.l HWIO_PMIC_ARB_OBS6_CHNL352_STATUS_ADDR A:0xe66b008
y.create.l HWIO_PMIC_ARB_OBS6_CHNL353_STATUS_ADDR A:0xe66b088
y.create.l HWIO_PMIC_ARB_OBS6_CHNL354_STATUS_ADDR A:0xe66b108
y.create.l HWIO_PMIC_ARB_OBS6_CHNL355_STATUS_ADDR A:0xe66b188
y.create.l HWIO_PMIC_ARB_OBS6_CHNL356_STATUS_ADDR A:0xe66b208
y.create.l HWIO_PMIC_ARB_OBS6_CHNL357_STATUS_ADDR A:0xe66b288
y.create.l HWIO_PMIC_ARB_OBS6_CHNL358_STATUS_ADDR A:0xe66b308
y.create.l HWIO_PMIC_ARB_OBS6_CHNL359_STATUS_ADDR A:0xe66b388
y.create.l HWIO_PMIC_ARB_OBS6_CHNL360_STATUS_ADDR A:0xe66b408
y.create.l HWIO_PMIC_ARB_OBS6_CHNL361_STATUS_ADDR A:0xe66b488
y.create.l HWIO_PMIC_ARB_OBS6_CHNL362_STATUS_ADDR A:0xe66b508
y.create.l HWIO_PMIC_ARB_OBS6_CHNL363_STATUS_ADDR A:0xe66b588
y.create.l HWIO_PMIC_ARB_OBS6_CHNL364_STATUS_ADDR A:0xe66b608
y.create.l HWIO_PMIC_ARB_OBS6_CHNL365_STATUS_ADDR A:0xe66b688
y.create.l HWIO_PMIC_ARB_OBS6_CHNL366_STATUS_ADDR A:0xe66b708
y.create.l HWIO_PMIC_ARB_OBS6_CHNL367_STATUS_ADDR A:0xe66b788
y.create.l HWIO_PMIC_ARB_OBS6_CHNL368_STATUS_ADDR A:0xe66b808
y.create.l HWIO_PMIC_ARB_OBS6_CHNL369_STATUS_ADDR A:0xe66b888
y.create.l HWIO_PMIC_ARB_OBS6_CHNL370_STATUS_ADDR A:0xe66b908
y.create.l HWIO_PMIC_ARB_OBS6_CHNL371_STATUS_ADDR A:0xe66b988
y.create.l HWIO_PMIC_ARB_OBS6_CHNL372_STATUS_ADDR A:0xe66ba08
y.create.l HWIO_PMIC_ARB_OBS6_CHNL373_STATUS_ADDR A:0xe66ba88
y.create.l HWIO_PMIC_ARB_OBS6_CHNL374_STATUS_ADDR A:0xe66bb08
y.create.l HWIO_PMIC_ARB_OBS6_CHNL375_STATUS_ADDR A:0xe66bb88
y.create.l HWIO_PMIC_ARB_OBS6_CHNL376_STATUS_ADDR A:0xe66bc08
y.create.l HWIO_PMIC_ARB_OBS6_CHNL377_STATUS_ADDR A:0xe66bc88
y.create.l HWIO_PMIC_ARB_OBS6_CHNL378_STATUS_ADDR A:0xe66bd08
y.create.l HWIO_PMIC_ARB_OBS6_CHNL379_STATUS_ADDR A:0xe66bd88
y.create.l HWIO_PMIC_ARB_OBS6_CHNL380_STATUS_ADDR A:0xe66be08
y.create.l HWIO_PMIC_ARB_OBS6_CHNL381_STATUS_ADDR A:0xe66be88
y.create.l HWIO_PMIC_ARB_OBS6_CHNL382_STATUS_ADDR A:0xe66bf08
y.create.l HWIO_PMIC_ARB_OBS6_CHNL383_STATUS_ADDR A:0xe66bf88
y.create.l HWIO_PMIC_ARB_OBS6_CHNL384_STATUS_ADDR A:0xe66c008
y.create.l HWIO_PMIC_ARB_OBS6_CHNL385_STATUS_ADDR A:0xe66c088
y.create.l HWIO_PMIC_ARB_OBS6_CHNL386_STATUS_ADDR A:0xe66c108
y.create.l HWIO_PMIC_ARB_OBS6_CHNL387_STATUS_ADDR A:0xe66c188
y.create.l HWIO_PMIC_ARB_OBS6_CHNL388_STATUS_ADDR A:0xe66c208
y.create.l HWIO_PMIC_ARB_OBS6_CHNL389_STATUS_ADDR A:0xe66c288
y.create.l HWIO_PMIC_ARB_OBS6_CHNL390_STATUS_ADDR A:0xe66c308
y.create.l HWIO_PMIC_ARB_OBS6_CHNL391_STATUS_ADDR A:0xe66c388
y.create.l HWIO_PMIC_ARB_OBS6_CHNL392_STATUS_ADDR A:0xe66c408
y.create.l HWIO_PMIC_ARB_OBS6_CHNL393_STATUS_ADDR A:0xe66c488
y.create.l HWIO_PMIC_ARB_OBS6_CHNL394_STATUS_ADDR A:0xe66c508
y.create.l HWIO_PMIC_ARB_OBS6_CHNL395_STATUS_ADDR A:0xe66c588
y.create.l HWIO_PMIC_ARB_OBS6_CHNL396_STATUS_ADDR A:0xe66c608
y.create.l HWIO_PMIC_ARB_OBS6_CHNL397_STATUS_ADDR A:0xe66c688
y.create.l HWIO_PMIC_ARB_OBS6_CHNL398_STATUS_ADDR A:0xe66c708
y.create.l HWIO_PMIC_ARB_OBS6_CHNL399_STATUS_ADDR A:0xe66c788
y.create.l HWIO_PMIC_ARB_OBS6_CHNL400_STATUS_ADDR A:0xe66c808
y.create.l HWIO_PMIC_ARB_OBS6_CHNL401_STATUS_ADDR A:0xe66c888
y.create.l HWIO_PMIC_ARB_OBS6_CHNL402_STATUS_ADDR A:0xe66c908
y.create.l HWIO_PMIC_ARB_OBS6_CHNL403_STATUS_ADDR A:0xe66c988
y.create.l HWIO_PMIC_ARB_OBS6_CHNL404_STATUS_ADDR A:0xe66ca08
y.create.l HWIO_PMIC_ARB_OBS6_CHNL405_STATUS_ADDR A:0xe66ca88
y.create.l HWIO_PMIC_ARB_OBS6_CHNL406_STATUS_ADDR A:0xe66cb08
y.create.l HWIO_PMIC_ARB_OBS6_CHNL407_STATUS_ADDR A:0xe66cb88
y.create.l HWIO_PMIC_ARB_OBS6_CHNL408_STATUS_ADDR A:0xe66cc08
y.create.l HWIO_PMIC_ARB_OBS6_CHNL409_STATUS_ADDR A:0xe66cc88
y.create.l HWIO_PMIC_ARB_OBS6_CHNL410_STATUS_ADDR A:0xe66cd08
y.create.l HWIO_PMIC_ARB_OBS6_CHNL411_STATUS_ADDR A:0xe66cd88
y.create.l HWIO_PMIC_ARB_OBS6_CHNL412_STATUS_ADDR A:0xe66ce08
y.create.l HWIO_PMIC_ARB_OBS6_CHNL413_STATUS_ADDR A:0xe66ce88
y.create.l HWIO_PMIC_ARB_OBS6_CHNL414_STATUS_ADDR A:0xe66cf08
y.create.l HWIO_PMIC_ARB_OBS6_CHNL415_STATUS_ADDR A:0xe66cf88
y.create.l HWIO_PMIC_ARB_OBS6_CHNL416_STATUS_ADDR A:0xe66d008
y.create.l HWIO_PMIC_ARB_OBS6_CHNL417_STATUS_ADDR A:0xe66d088
y.create.l HWIO_PMIC_ARB_OBS6_CHNL418_STATUS_ADDR A:0xe66d108
y.create.l HWIO_PMIC_ARB_OBS6_CHNL419_STATUS_ADDR A:0xe66d188
y.create.l HWIO_PMIC_ARB_OBS6_CHNL420_STATUS_ADDR A:0xe66d208
y.create.l HWIO_PMIC_ARB_OBS6_CHNL421_STATUS_ADDR A:0xe66d288
y.create.l HWIO_PMIC_ARB_OBS6_CHNL422_STATUS_ADDR A:0xe66d308
y.create.l HWIO_PMIC_ARB_OBS6_CHNL423_STATUS_ADDR A:0xe66d388
y.create.l HWIO_PMIC_ARB_OBS6_CHNL424_STATUS_ADDR A:0xe66d408
y.create.l HWIO_PMIC_ARB_OBS6_CHNL425_STATUS_ADDR A:0xe66d488
y.create.l HWIO_PMIC_ARB_OBS6_CHNL426_STATUS_ADDR A:0xe66d508
y.create.l HWIO_PMIC_ARB_OBS6_CHNL427_STATUS_ADDR A:0xe66d588
y.create.l HWIO_PMIC_ARB_OBS6_CHNL428_STATUS_ADDR A:0xe66d608
y.create.l HWIO_PMIC_ARB_OBS6_CHNL429_STATUS_ADDR A:0xe66d688
y.create.l HWIO_PMIC_ARB_OBS6_CHNL430_STATUS_ADDR A:0xe66d708
y.create.l HWIO_PMIC_ARB_OBS6_CHNL431_STATUS_ADDR A:0xe66d788
y.create.l HWIO_PMIC_ARB_OBS6_CHNL432_STATUS_ADDR A:0xe66d808
y.create.l HWIO_PMIC_ARB_OBS6_CHNL433_STATUS_ADDR A:0xe66d888
y.create.l HWIO_PMIC_ARB_OBS6_CHNL434_STATUS_ADDR A:0xe66d908
y.create.l HWIO_PMIC_ARB_OBS6_CHNL435_STATUS_ADDR A:0xe66d988
y.create.l HWIO_PMIC_ARB_OBS6_CHNL436_STATUS_ADDR A:0xe66da08
y.create.l HWIO_PMIC_ARB_OBS6_CHNL437_STATUS_ADDR A:0xe66da88
y.create.l HWIO_PMIC_ARB_OBS6_CHNL438_STATUS_ADDR A:0xe66db08
y.create.l HWIO_PMIC_ARB_OBS6_CHNL439_STATUS_ADDR A:0xe66db88
y.create.l HWIO_PMIC_ARB_OBS6_CHNL440_STATUS_ADDR A:0xe66dc08
y.create.l HWIO_PMIC_ARB_OBS6_CHNL441_STATUS_ADDR A:0xe66dc88
y.create.l HWIO_PMIC_ARB_OBS6_CHNL442_STATUS_ADDR A:0xe66dd08
y.create.l HWIO_PMIC_ARB_OBS6_CHNL443_STATUS_ADDR A:0xe66dd88
y.create.l HWIO_PMIC_ARB_OBS6_CHNL444_STATUS_ADDR A:0xe66de08
y.create.l HWIO_PMIC_ARB_OBS6_CHNL445_STATUS_ADDR A:0xe66de88
y.create.l HWIO_PMIC_ARB_OBS6_CHNL446_STATUS_ADDR A:0xe66df08
y.create.l HWIO_PMIC_ARB_OBS6_CHNL447_STATUS_ADDR A:0xe66df88
y.create.l HWIO_PMIC_ARB_OBS6_CHNL448_STATUS_ADDR A:0xe66e008
y.create.l HWIO_PMIC_ARB_OBS6_CHNL449_STATUS_ADDR A:0xe66e088
y.create.l HWIO_PMIC_ARB_OBS6_CHNL450_STATUS_ADDR A:0xe66e108
y.create.l HWIO_PMIC_ARB_OBS6_CHNL451_STATUS_ADDR A:0xe66e188
y.create.l HWIO_PMIC_ARB_OBS6_CHNL452_STATUS_ADDR A:0xe66e208
y.create.l HWIO_PMIC_ARB_OBS6_CHNL453_STATUS_ADDR A:0xe66e288
y.create.l HWIO_PMIC_ARB_OBS6_CHNL454_STATUS_ADDR A:0xe66e308
y.create.l HWIO_PMIC_ARB_OBS6_CHNL455_STATUS_ADDR A:0xe66e388
y.create.l HWIO_PMIC_ARB_OBS6_CHNL456_STATUS_ADDR A:0xe66e408
y.create.l HWIO_PMIC_ARB_OBS6_CHNL457_STATUS_ADDR A:0xe66e488
y.create.l HWIO_PMIC_ARB_OBS6_CHNL458_STATUS_ADDR A:0xe66e508
y.create.l HWIO_PMIC_ARB_OBS6_CHNL459_STATUS_ADDR A:0xe66e588
y.create.l HWIO_PMIC_ARB_OBS6_CHNL460_STATUS_ADDR A:0xe66e608
y.create.l HWIO_PMIC_ARB_OBS6_CHNL461_STATUS_ADDR A:0xe66e688
y.create.l HWIO_PMIC_ARB_OBS6_CHNL462_STATUS_ADDR A:0xe66e708
y.create.l HWIO_PMIC_ARB_OBS6_CHNL463_STATUS_ADDR A:0xe66e788
y.create.l HWIO_PMIC_ARB_OBS6_CHNL464_STATUS_ADDR A:0xe66e808
y.create.l HWIO_PMIC_ARB_OBS6_CHNL465_STATUS_ADDR A:0xe66e888
y.create.l HWIO_PMIC_ARB_OBS6_CHNL466_STATUS_ADDR A:0xe66e908
y.create.l HWIO_PMIC_ARB_OBS6_CHNL467_STATUS_ADDR A:0xe66e988
y.create.l HWIO_PMIC_ARB_OBS6_CHNL468_STATUS_ADDR A:0xe66ea08
y.create.l HWIO_PMIC_ARB_OBS6_CHNL469_STATUS_ADDR A:0xe66ea88
y.create.l HWIO_PMIC_ARB_OBS6_CHNL470_STATUS_ADDR A:0xe66eb08
y.create.l HWIO_PMIC_ARB_OBS6_CHNL471_STATUS_ADDR A:0xe66eb88
y.create.l HWIO_PMIC_ARB_OBS6_CHNL472_STATUS_ADDR A:0xe66ec08
y.create.l HWIO_PMIC_ARB_OBS6_CHNL473_STATUS_ADDR A:0xe66ec88
y.create.l HWIO_PMIC_ARB_OBS6_CHNL474_STATUS_ADDR A:0xe66ed08
y.create.l HWIO_PMIC_ARB_OBS6_CHNL475_STATUS_ADDR A:0xe66ed88
y.create.l HWIO_PMIC_ARB_OBS6_CHNL476_STATUS_ADDR A:0xe66ee08
y.create.l HWIO_PMIC_ARB_OBS6_CHNL477_STATUS_ADDR A:0xe66ee88
y.create.l HWIO_PMIC_ARB_OBS6_CHNL478_STATUS_ADDR A:0xe66ef08
y.create.l HWIO_PMIC_ARB_OBS6_CHNL479_STATUS_ADDR A:0xe66ef88
y.create.l HWIO_PMIC_ARB_OBS6_CHNL480_STATUS_ADDR A:0xe66f008
y.create.l HWIO_PMIC_ARB_OBS6_CHNL481_STATUS_ADDR A:0xe66f088
y.create.l HWIO_PMIC_ARB_OBS6_CHNL482_STATUS_ADDR A:0xe66f108
y.create.l HWIO_PMIC_ARB_OBS6_CHNL483_STATUS_ADDR A:0xe66f188
y.create.l HWIO_PMIC_ARB_OBS6_CHNL484_STATUS_ADDR A:0xe66f208
y.create.l HWIO_PMIC_ARB_OBS6_CHNL485_STATUS_ADDR A:0xe66f288
y.create.l HWIO_PMIC_ARB_OBS6_CHNL486_STATUS_ADDR A:0xe66f308
y.create.l HWIO_PMIC_ARB_OBS6_CHNL487_STATUS_ADDR A:0xe66f388
y.create.l HWIO_PMIC_ARB_OBS6_CHNL488_STATUS_ADDR A:0xe66f408
y.create.l HWIO_PMIC_ARB_OBS6_CHNL489_STATUS_ADDR A:0xe66f488
y.create.l HWIO_PMIC_ARB_OBS6_CHNL490_STATUS_ADDR A:0xe66f508
y.create.l HWIO_PMIC_ARB_OBS6_CHNL491_STATUS_ADDR A:0xe66f588
y.create.l HWIO_PMIC_ARB_OBS6_CHNL492_STATUS_ADDR A:0xe66f608
y.create.l HWIO_PMIC_ARB_OBS6_CHNL493_STATUS_ADDR A:0xe66f688
y.create.l HWIO_PMIC_ARB_OBS6_CHNL494_STATUS_ADDR A:0xe66f708
y.create.l HWIO_PMIC_ARB_OBS6_CHNL495_STATUS_ADDR A:0xe66f788
y.create.l HWIO_PMIC_ARB_OBS6_CHNL496_STATUS_ADDR A:0xe66f808
y.create.l HWIO_PMIC_ARB_OBS6_CHNL497_STATUS_ADDR A:0xe66f888
y.create.l HWIO_PMIC_ARB_OBS6_CHNL498_STATUS_ADDR A:0xe66f908
y.create.l HWIO_PMIC_ARB_OBS6_CHNL499_STATUS_ADDR A:0xe66f988
y.create.l HWIO_PMIC_ARB_OBS6_CHNL500_STATUS_ADDR A:0xe66fa08
y.create.l HWIO_PMIC_ARB_OBS6_CHNL501_STATUS_ADDR A:0xe66fa88
y.create.l HWIO_PMIC_ARB_OBS6_CHNL502_STATUS_ADDR A:0xe66fb08
y.create.l HWIO_PMIC_ARB_OBS6_CHNL503_STATUS_ADDR A:0xe66fb88
y.create.l HWIO_PMIC_ARB_OBS6_CHNL504_STATUS_ADDR A:0xe66fc08
y.create.l HWIO_PMIC_ARB_OBS6_CHNL505_STATUS_ADDR A:0xe66fc88
y.create.l HWIO_PMIC_ARB_OBS6_CHNL506_STATUS_ADDR A:0xe66fd08
y.create.l HWIO_PMIC_ARB_OBS6_CHNL507_STATUS_ADDR A:0xe66fd88
y.create.l HWIO_PMIC_ARB_OBS6_CHNL508_STATUS_ADDR A:0xe66fe08
y.create.l HWIO_PMIC_ARB_OBS6_CHNL509_STATUS_ADDR A:0xe66fe88
y.create.l HWIO_PMIC_ARB_OBS6_CHNL510_STATUS_ADDR A:0xe66ff08
y.create.l HWIO_PMIC_ARB_OBS6_CHNL511_STATUS_ADDR A:0xe66ff88
y.create.l HWIO_PMIC_ARB_OBS0_CHNL0_RDATA0_ADDR A:0xe600018
y.create.l HWIO_PMIC_ARB_OBS0_CHNL1_RDATA0_ADDR A:0xe600098
y.create.l HWIO_PMIC_ARB_OBS0_CHNL2_RDATA0_ADDR A:0xe600118
y.create.l HWIO_PMIC_ARB_OBS0_CHNL3_RDATA0_ADDR A:0xe600198
y.create.l HWIO_PMIC_ARB_OBS0_CHNL4_RDATA0_ADDR A:0xe600218
y.create.l HWIO_PMIC_ARB_OBS0_CHNL5_RDATA0_ADDR A:0xe600298
y.create.l HWIO_PMIC_ARB_OBS0_CHNL6_RDATA0_ADDR A:0xe600318
y.create.l HWIO_PMIC_ARB_OBS0_CHNL7_RDATA0_ADDR A:0xe600398
y.create.l HWIO_PMIC_ARB_OBS0_CHNL8_RDATA0_ADDR A:0xe600418
y.create.l HWIO_PMIC_ARB_OBS0_CHNL9_RDATA0_ADDR A:0xe600498
y.create.l HWIO_PMIC_ARB_OBS0_CHNL10_RDATA0_ADDR A:0xe600518
y.create.l HWIO_PMIC_ARB_OBS0_CHNL11_RDATA0_ADDR A:0xe600598
y.create.l HWIO_PMIC_ARB_OBS0_CHNL12_RDATA0_ADDR A:0xe600618
y.create.l HWIO_PMIC_ARB_OBS0_CHNL13_RDATA0_ADDR A:0xe600698
y.create.l HWIO_PMIC_ARB_OBS0_CHNL14_RDATA0_ADDR A:0xe600718
y.create.l HWIO_PMIC_ARB_OBS0_CHNL15_RDATA0_ADDR A:0xe600798
y.create.l HWIO_PMIC_ARB_OBS0_CHNL16_RDATA0_ADDR A:0xe600818
y.create.l HWIO_PMIC_ARB_OBS0_CHNL17_RDATA0_ADDR A:0xe600898
y.create.l HWIO_PMIC_ARB_OBS0_CHNL18_RDATA0_ADDR A:0xe600918
y.create.l HWIO_PMIC_ARB_OBS0_CHNL19_RDATA0_ADDR A:0xe600998
y.create.l HWIO_PMIC_ARB_OBS0_CHNL20_RDATA0_ADDR A:0xe600a18
y.create.l HWIO_PMIC_ARB_OBS0_CHNL21_RDATA0_ADDR A:0xe600a98
y.create.l HWIO_PMIC_ARB_OBS0_CHNL22_RDATA0_ADDR A:0xe600b18
y.create.l HWIO_PMIC_ARB_OBS0_CHNL23_RDATA0_ADDR A:0xe600b98
y.create.l HWIO_PMIC_ARB_OBS0_CHNL24_RDATA0_ADDR A:0xe600c18
y.create.l HWIO_PMIC_ARB_OBS0_CHNL25_RDATA0_ADDR A:0xe600c98
y.create.l HWIO_PMIC_ARB_OBS0_CHNL26_RDATA0_ADDR A:0xe600d18
y.create.l HWIO_PMIC_ARB_OBS0_CHNL27_RDATA0_ADDR A:0xe600d98
y.create.l HWIO_PMIC_ARB_OBS0_CHNL28_RDATA0_ADDR A:0xe600e18
y.create.l HWIO_PMIC_ARB_OBS0_CHNL29_RDATA0_ADDR A:0xe600e98
y.create.l HWIO_PMIC_ARB_OBS0_CHNL30_RDATA0_ADDR A:0xe600f18
y.create.l HWIO_PMIC_ARB_OBS0_CHNL31_RDATA0_ADDR A:0xe600f98
y.create.l HWIO_PMIC_ARB_OBS0_CHNL32_RDATA0_ADDR A:0xe601018
y.create.l HWIO_PMIC_ARB_OBS0_CHNL33_RDATA0_ADDR A:0xe601098
y.create.l HWIO_PMIC_ARB_OBS0_CHNL34_RDATA0_ADDR A:0xe601118
y.create.l HWIO_PMIC_ARB_OBS0_CHNL35_RDATA0_ADDR A:0xe601198
y.create.l HWIO_PMIC_ARB_OBS0_CHNL36_RDATA0_ADDR A:0xe601218
y.create.l HWIO_PMIC_ARB_OBS0_CHNL37_RDATA0_ADDR A:0xe601298
y.create.l HWIO_PMIC_ARB_OBS0_CHNL38_RDATA0_ADDR A:0xe601318
y.create.l HWIO_PMIC_ARB_OBS0_CHNL39_RDATA0_ADDR A:0xe601398
y.create.l HWIO_PMIC_ARB_OBS0_CHNL40_RDATA0_ADDR A:0xe601418
y.create.l HWIO_PMIC_ARB_OBS0_CHNL41_RDATA0_ADDR A:0xe601498
y.create.l HWIO_PMIC_ARB_OBS0_CHNL42_RDATA0_ADDR A:0xe601518
y.create.l HWIO_PMIC_ARB_OBS0_CHNL43_RDATA0_ADDR A:0xe601598
y.create.l HWIO_PMIC_ARB_OBS0_CHNL44_RDATA0_ADDR A:0xe601618
y.create.l HWIO_PMIC_ARB_OBS0_CHNL45_RDATA0_ADDR A:0xe601698
y.create.l HWIO_PMIC_ARB_OBS0_CHNL46_RDATA0_ADDR A:0xe601718
y.create.l HWIO_PMIC_ARB_OBS0_CHNL47_RDATA0_ADDR A:0xe601798
y.create.l HWIO_PMIC_ARB_OBS0_CHNL48_RDATA0_ADDR A:0xe601818
y.create.l HWIO_PMIC_ARB_OBS0_CHNL49_RDATA0_ADDR A:0xe601898
y.create.l HWIO_PMIC_ARB_OBS0_CHNL50_RDATA0_ADDR A:0xe601918
y.create.l HWIO_PMIC_ARB_OBS0_CHNL51_RDATA0_ADDR A:0xe601998
y.create.l HWIO_PMIC_ARB_OBS0_CHNL52_RDATA0_ADDR A:0xe601a18
y.create.l HWIO_PMIC_ARB_OBS0_CHNL53_RDATA0_ADDR A:0xe601a98
y.create.l HWIO_PMIC_ARB_OBS0_CHNL54_RDATA0_ADDR A:0xe601b18
y.create.l HWIO_PMIC_ARB_OBS0_CHNL55_RDATA0_ADDR A:0xe601b98
y.create.l HWIO_PMIC_ARB_OBS0_CHNL56_RDATA0_ADDR A:0xe601c18
y.create.l HWIO_PMIC_ARB_OBS0_CHNL57_RDATA0_ADDR A:0xe601c98
y.create.l HWIO_PMIC_ARB_OBS0_CHNL58_RDATA0_ADDR A:0xe601d18
y.create.l HWIO_PMIC_ARB_OBS0_CHNL59_RDATA0_ADDR A:0xe601d98
y.create.l HWIO_PMIC_ARB_OBS0_CHNL60_RDATA0_ADDR A:0xe601e18
y.create.l HWIO_PMIC_ARB_OBS0_CHNL61_RDATA0_ADDR A:0xe601e98
y.create.l HWIO_PMIC_ARB_OBS0_CHNL62_RDATA0_ADDR A:0xe601f18
y.create.l HWIO_PMIC_ARB_OBS0_CHNL63_RDATA0_ADDR A:0xe601f98
y.create.l HWIO_PMIC_ARB_OBS0_CHNL64_RDATA0_ADDR A:0xe602018
y.create.l HWIO_PMIC_ARB_OBS0_CHNL65_RDATA0_ADDR A:0xe602098
y.create.l HWIO_PMIC_ARB_OBS0_CHNL66_RDATA0_ADDR A:0xe602118
y.create.l HWIO_PMIC_ARB_OBS0_CHNL67_RDATA0_ADDR A:0xe602198
y.create.l HWIO_PMIC_ARB_OBS0_CHNL68_RDATA0_ADDR A:0xe602218
y.create.l HWIO_PMIC_ARB_OBS0_CHNL69_RDATA0_ADDR A:0xe602298
y.create.l HWIO_PMIC_ARB_OBS0_CHNL70_RDATA0_ADDR A:0xe602318
y.create.l HWIO_PMIC_ARB_OBS0_CHNL71_RDATA0_ADDR A:0xe602398
y.create.l HWIO_PMIC_ARB_OBS0_CHNL72_RDATA0_ADDR A:0xe602418
y.create.l HWIO_PMIC_ARB_OBS0_CHNL73_RDATA0_ADDR A:0xe602498
y.create.l HWIO_PMIC_ARB_OBS0_CHNL74_RDATA0_ADDR A:0xe602518
y.create.l HWIO_PMIC_ARB_OBS0_CHNL75_RDATA0_ADDR A:0xe602598
y.create.l HWIO_PMIC_ARB_OBS0_CHNL76_RDATA0_ADDR A:0xe602618
y.create.l HWIO_PMIC_ARB_OBS0_CHNL77_RDATA0_ADDR A:0xe602698
y.create.l HWIO_PMIC_ARB_OBS0_CHNL78_RDATA0_ADDR A:0xe602718
y.create.l HWIO_PMIC_ARB_OBS0_CHNL79_RDATA0_ADDR A:0xe602798
y.create.l HWIO_PMIC_ARB_OBS0_CHNL80_RDATA0_ADDR A:0xe602818
y.create.l HWIO_PMIC_ARB_OBS0_CHNL81_RDATA0_ADDR A:0xe602898
y.create.l HWIO_PMIC_ARB_OBS0_CHNL82_RDATA0_ADDR A:0xe602918
y.create.l HWIO_PMIC_ARB_OBS0_CHNL83_RDATA0_ADDR A:0xe602998
y.create.l HWIO_PMIC_ARB_OBS0_CHNL84_RDATA0_ADDR A:0xe602a18
y.create.l HWIO_PMIC_ARB_OBS0_CHNL85_RDATA0_ADDR A:0xe602a98
y.create.l HWIO_PMIC_ARB_OBS0_CHNL86_RDATA0_ADDR A:0xe602b18
y.create.l HWIO_PMIC_ARB_OBS0_CHNL87_RDATA0_ADDR A:0xe602b98
y.create.l HWIO_PMIC_ARB_OBS0_CHNL88_RDATA0_ADDR A:0xe602c18
y.create.l HWIO_PMIC_ARB_OBS0_CHNL89_RDATA0_ADDR A:0xe602c98
y.create.l HWIO_PMIC_ARB_OBS0_CHNL90_RDATA0_ADDR A:0xe602d18
y.create.l HWIO_PMIC_ARB_OBS0_CHNL91_RDATA0_ADDR A:0xe602d98
y.create.l HWIO_PMIC_ARB_OBS0_CHNL92_RDATA0_ADDR A:0xe602e18
y.create.l HWIO_PMIC_ARB_OBS0_CHNL93_RDATA0_ADDR A:0xe602e98
y.create.l HWIO_PMIC_ARB_OBS0_CHNL94_RDATA0_ADDR A:0xe602f18
y.create.l HWIO_PMIC_ARB_OBS0_CHNL95_RDATA0_ADDR A:0xe602f98
y.create.l HWIO_PMIC_ARB_OBS0_CHNL96_RDATA0_ADDR A:0xe603018
y.create.l HWIO_PMIC_ARB_OBS0_CHNL97_RDATA0_ADDR A:0xe603098
y.create.l HWIO_PMIC_ARB_OBS0_CHNL98_RDATA0_ADDR A:0xe603118
y.create.l HWIO_PMIC_ARB_OBS0_CHNL99_RDATA0_ADDR A:0xe603198
y.create.l HWIO_PMIC_ARB_OBS0_CHNL100_RDATA0_ADDR A:0xe603218
y.create.l HWIO_PMIC_ARB_OBS0_CHNL101_RDATA0_ADDR A:0xe603298
y.create.l HWIO_PMIC_ARB_OBS0_CHNL102_RDATA0_ADDR A:0xe603318
y.create.l HWIO_PMIC_ARB_OBS0_CHNL103_RDATA0_ADDR A:0xe603398
y.create.l HWIO_PMIC_ARB_OBS0_CHNL104_RDATA0_ADDR A:0xe603418
y.create.l HWIO_PMIC_ARB_OBS0_CHNL105_RDATA0_ADDR A:0xe603498
y.create.l HWIO_PMIC_ARB_OBS0_CHNL106_RDATA0_ADDR A:0xe603518
y.create.l HWIO_PMIC_ARB_OBS0_CHNL107_RDATA0_ADDR A:0xe603598
y.create.l HWIO_PMIC_ARB_OBS0_CHNL108_RDATA0_ADDR A:0xe603618
y.create.l HWIO_PMIC_ARB_OBS0_CHNL109_RDATA0_ADDR A:0xe603698
y.create.l HWIO_PMIC_ARB_OBS0_CHNL110_RDATA0_ADDR A:0xe603718
y.create.l HWIO_PMIC_ARB_OBS0_CHNL111_RDATA0_ADDR A:0xe603798
y.create.l HWIO_PMIC_ARB_OBS0_CHNL112_RDATA0_ADDR A:0xe603818
y.create.l HWIO_PMIC_ARB_OBS0_CHNL113_RDATA0_ADDR A:0xe603898
y.create.l HWIO_PMIC_ARB_OBS0_CHNL114_RDATA0_ADDR A:0xe603918
y.create.l HWIO_PMIC_ARB_OBS0_CHNL115_RDATA0_ADDR A:0xe603998
y.create.l HWIO_PMIC_ARB_OBS0_CHNL116_RDATA0_ADDR A:0xe603a18
y.create.l HWIO_PMIC_ARB_OBS0_CHNL117_RDATA0_ADDR A:0xe603a98
y.create.l HWIO_PMIC_ARB_OBS0_CHNL118_RDATA0_ADDR A:0xe603b18
y.create.l HWIO_PMIC_ARB_OBS0_CHNL119_RDATA0_ADDR A:0xe603b98
y.create.l HWIO_PMIC_ARB_OBS0_CHNL120_RDATA0_ADDR A:0xe603c18
y.create.l HWIO_PMIC_ARB_OBS0_CHNL121_RDATA0_ADDR A:0xe603c98
y.create.l HWIO_PMIC_ARB_OBS0_CHNL122_RDATA0_ADDR A:0xe603d18
y.create.l HWIO_PMIC_ARB_OBS0_CHNL123_RDATA0_ADDR A:0xe603d98
y.create.l HWIO_PMIC_ARB_OBS0_CHNL124_RDATA0_ADDR A:0xe603e18
y.create.l HWIO_PMIC_ARB_OBS0_CHNL125_RDATA0_ADDR A:0xe603e98
y.create.l HWIO_PMIC_ARB_OBS0_CHNL126_RDATA0_ADDR A:0xe603f18
y.create.l HWIO_PMIC_ARB_OBS0_CHNL127_RDATA0_ADDR A:0xe603f98
y.create.l HWIO_PMIC_ARB_OBS0_CHNL128_RDATA0_ADDR A:0xe604018
y.create.l HWIO_PMIC_ARB_OBS0_CHNL129_RDATA0_ADDR A:0xe604098
y.create.l HWIO_PMIC_ARB_OBS0_CHNL130_RDATA0_ADDR A:0xe604118
y.create.l HWIO_PMIC_ARB_OBS0_CHNL131_RDATA0_ADDR A:0xe604198
y.create.l HWIO_PMIC_ARB_OBS0_CHNL132_RDATA0_ADDR A:0xe604218
y.create.l HWIO_PMIC_ARB_OBS0_CHNL133_RDATA0_ADDR A:0xe604298
y.create.l HWIO_PMIC_ARB_OBS0_CHNL134_RDATA0_ADDR A:0xe604318
y.create.l HWIO_PMIC_ARB_OBS0_CHNL135_RDATA0_ADDR A:0xe604398
y.create.l HWIO_PMIC_ARB_OBS0_CHNL136_RDATA0_ADDR A:0xe604418
y.create.l HWIO_PMIC_ARB_OBS0_CHNL137_RDATA0_ADDR A:0xe604498
y.create.l HWIO_PMIC_ARB_OBS0_CHNL138_RDATA0_ADDR A:0xe604518
y.create.l HWIO_PMIC_ARB_OBS0_CHNL139_RDATA0_ADDR A:0xe604598
y.create.l HWIO_PMIC_ARB_OBS0_CHNL140_RDATA0_ADDR A:0xe604618
y.create.l HWIO_PMIC_ARB_OBS0_CHNL141_RDATA0_ADDR A:0xe604698
y.create.l HWIO_PMIC_ARB_OBS0_CHNL142_RDATA0_ADDR A:0xe604718
y.create.l HWIO_PMIC_ARB_OBS0_CHNL143_RDATA0_ADDR A:0xe604798
y.create.l HWIO_PMIC_ARB_OBS0_CHNL144_RDATA0_ADDR A:0xe604818
y.create.l HWIO_PMIC_ARB_OBS0_CHNL145_RDATA0_ADDR A:0xe604898
y.create.l HWIO_PMIC_ARB_OBS0_CHNL146_RDATA0_ADDR A:0xe604918
y.create.l HWIO_PMIC_ARB_OBS0_CHNL147_RDATA0_ADDR A:0xe604998
y.create.l HWIO_PMIC_ARB_OBS0_CHNL148_RDATA0_ADDR A:0xe604a18
y.create.l HWIO_PMIC_ARB_OBS0_CHNL149_RDATA0_ADDR A:0xe604a98
y.create.l HWIO_PMIC_ARB_OBS0_CHNL150_RDATA0_ADDR A:0xe604b18
y.create.l HWIO_PMIC_ARB_OBS0_CHNL151_RDATA0_ADDR A:0xe604b98
y.create.l HWIO_PMIC_ARB_OBS0_CHNL152_RDATA0_ADDR A:0xe604c18
y.create.l HWIO_PMIC_ARB_OBS0_CHNL153_RDATA0_ADDR A:0xe604c98
y.create.l HWIO_PMIC_ARB_OBS0_CHNL154_RDATA0_ADDR A:0xe604d18
y.create.l HWIO_PMIC_ARB_OBS0_CHNL155_RDATA0_ADDR A:0xe604d98
y.create.l HWIO_PMIC_ARB_OBS0_CHNL156_RDATA0_ADDR A:0xe604e18
y.create.l HWIO_PMIC_ARB_OBS0_CHNL157_RDATA0_ADDR A:0xe604e98
y.create.l HWIO_PMIC_ARB_OBS0_CHNL158_RDATA0_ADDR A:0xe604f18
y.create.l HWIO_PMIC_ARB_OBS0_CHNL159_RDATA0_ADDR A:0xe604f98
y.create.l HWIO_PMIC_ARB_OBS0_CHNL160_RDATA0_ADDR A:0xe605018
y.create.l HWIO_PMIC_ARB_OBS0_CHNL161_RDATA0_ADDR A:0xe605098
y.create.l HWIO_PMIC_ARB_OBS0_CHNL162_RDATA0_ADDR A:0xe605118
y.create.l HWIO_PMIC_ARB_OBS0_CHNL163_RDATA0_ADDR A:0xe605198
y.create.l HWIO_PMIC_ARB_OBS0_CHNL164_RDATA0_ADDR A:0xe605218
y.create.l HWIO_PMIC_ARB_OBS0_CHNL165_RDATA0_ADDR A:0xe605298
y.create.l HWIO_PMIC_ARB_OBS0_CHNL166_RDATA0_ADDR A:0xe605318
y.create.l HWIO_PMIC_ARB_OBS0_CHNL167_RDATA0_ADDR A:0xe605398
y.create.l HWIO_PMIC_ARB_OBS0_CHNL168_RDATA0_ADDR A:0xe605418
y.create.l HWIO_PMIC_ARB_OBS0_CHNL169_RDATA0_ADDR A:0xe605498
y.create.l HWIO_PMIC_ARB_OBS0_CHNL170_RDATA0_ADDR A:0xe605518
y.create.l HWIO_PMIC_ARB_OBS0_CHNL171_RDATA0_ADDR A:0xe605598
y.create.l HWIO_PMIC_ARB_OBS0_CHNL172_RDATA0_ADDR A:0xe605618
y.create.l HWIO_PMIC_ARB_OBS0_CHNL173_RDATA0_ADDR A:0xe605698
y.create.l HWIO_PMIC_ARB_OBS0_CHNL174_RDATA0_ADDR A:0xe605718
y.create.l HWIO_PMIC_ARB_OBS0_CHNL175_RDATA0_ADDR A:0xe605798
y.create.l HWIO_PMIC_ARB_OBS0_CHNL176_RDATA0_ADDR A:0xe605818
y.create.l HWIO_PMIC_ARB_OBS0_CHNL177_RDATA0_ADDR A:0xe605898
y.create.l HWIO_PMIC_ARB_OBS0_CHNL178_RDATA0_ADDR A:0xe605918
y.create.l HWIO_PMIC_ARB_OBS0_CHNL179_RDATA0_ADDR A:0xe605998
y.create.l HWIO_PMIC_ARB_OBS0_CHNL180_RDATA0_ADDR A:0xe605a18
y.create.l HWIO_PMIC_ARB_OBS0_CHNL181_RDATA0_ADDR A:0xe605a98
y.create.l HWIO_PMIC_ARB_OBS0_CHNL182_RDATA0_ADDR A:0xe605b18
y.create.l HWIO_PMIC_ARB_OBS0_CHNL183_RDATA0_ADDR A:0xe605b98
y.create.l HWIO_PMIC_ARB_OBS0_CHNL184_RDATA0_ADDR A:0xe605c18
y.create.l HWIO_PMIC_ARB_OBS0_CHNL185_RDATA0_ADDR A:0xe605c98
y.create.l HWIO_PMIC_ARB_OBS0_CHNL186_RDATA0_ADDR A:0xe605d18
y.create.l HWIO_PMIC_ARB_OBS0_CHNL187_RDATA0_ADDR A:0xe605d98
y.create.l HWIO_PMIC_ARB_OBS0_CHNL188_RDATA0_ADDR A:0xe605e18
y.create.l HWIO_PMIC_ARB_OBS0_CHNL189_RDATA0_ADDR A:0xe605e98
y.create.l HWIO_PMIC_ARB_OBS0_CHNL190_RDATA0_ADDR A:0xe605f18
y.create.l HWIO_PMIC_ARB_OBS0_CHNL191_RDATA0_ADDR A:0xe605f98
y.create.l HWIO_PMIC_ARB_OBS0_CHNL192_RDATA0_ADDR A:0xe606018
y.create.l HWIO_PMIC_ARB_OBS0_CHNL193_RDATA0_ADDR A:0xe606098
y.create.l HWIO_PMIC_ARB_OBS0_CHNL194_RDATA0_ADDR A:0xe606118
y.create.l HWIO_PMIC_ARB_OBS0_CHNL195_RDATA0_ADDR A:0xe606198
y.create.l HWIO_PMIC_ARB_OBS0_CHNL196_RDATA0_ADDR A:0xe606218
y.create.l HWIO_PMIC_ARB_OBS0_CHNL197_RDATA0_ADDR A:0xe606298
y.create.l HWIO_PMIC_ARB_OBS0_CHNL198_RDATA0_ADDR A:0xe606318
y.create.l HWIO_PMIC_ARB_OBS0_CHNL199_RDATA0_ADDR A:0xe606398
y.create.l HWIO_PMIC_ARB_OBS0_CHNL200_RDATA0_ADDR A:0xe606418
y.create.l HWIO_PMIC_ARB_OBS0_CHNL201_RDATA0_ADDR A:0xe606498
y.create.l HWIO_PMIC_ARB_OBS0_CHNL202_RDATA0_ADDR A:0xe606518
y.create.l HWIO_PMIC_ARB_OBS0_CHNL203_RDATA0_ADDR A:0xe606598
y.create.l HWIO_PMIC_ARB_OBS0_CHNL204_RDATA0_ADDR A:0xe606618
y.create.l HWIO_PMIC_ARB_OBS0_CHNL205_RDATA0_ADDR A:0xe606698
y.create.l HWIO_PMIC_ARB_OBS0_CHNL206_RDATA0_ADDR A:0xe606718
y.create.l HWIO_PMIC_ARB_OBS0_CHNL207_RDATA0_ADDR A:0xe606798
y.create.l HWIO_PMIC_ARB_OBS0_CHNL208_RDATA0_ADDR A:0xe606818
y.create.l HWIO_PMIC_ARB_OBS0_CHNL209_RDATA0_ADDR A:0xe606898
y.create.l HWIO_PMIC_ARB_OBS0_CHNL210_RDATA0_ADDR A:0xe606918
y.create.l HWIO_PMIC_ARB_OBS0_CHNL211_RDATA0_ADDR A:0xe606998
y.create.l HWIO_PMIC_ARB_OBS0_CHNL212_RDATA0_ADDR A:0xe606a18
y.create.l HWIO_PMIC_ARB_OBS0_CHNL213_RDATA0_ADDR A:0xe606a98
y.create.l HWIO_PMIC_ARB_OBS0_CHNL214_RDATA0_ADDR A:0xe606b18
y.create.l HWIO_PMIC_ARB_OBS0_CHNL215_RDATA0_ADDR A:0xe606b98
y.create.l HWIO_PMIC_ARB_OBS0_CHNL216_RDATA0_ADDR A:0xe606c18
y.create.l HWIO_PMIC_ARB_OBS0_CHNL217_RDATA0_ADDR A:0xe606c98
y.create.l HWIO_PMIC_ARB_OBS0_CHNL218_RDATA0_ADDR A:0xe606d18
y.create.l HWIO_PMIC_ARB_OBS0_CHNL219_RDATA0_ADDR A:0xe606d98
y.create.l HWIO_PMIC_ARB_OBS0_CHNL220_RDATA0_ADDR A:0xe606e18
y.create.l HWIO_PMIC_ARB_OBS0_CHNL221_RDATA0_ADDR A:0xe606e98
y.create.l HWIO_PMIC_ARB_OBS0_CHNL222_RDATA0_ADDR A:0xe606f18
y.create.l HWIO_PMIC_ARB_OBS0_CHNL223_RDATA0_ADDR A:0xe606f98
y.create.l HWIO_PMIC_ARB_OBS0_CHNL224_RDATA0_ADDR A:0xe607018
y.create.l HWIO_PMIC_ARB_OBS0_CHNL225_RDATA0_ADDR A:0xe607098
y.create.l HWIO_PMIC_ARB_OBS0_CHNL226_RDATA0_ADDR A:0xe607118
y.create.l HWIO_PMIC_ARB_OBS0_CHNL227_RDATA0_ADDR A:0xe607198
y.create.l HWIO_PMIC_ARB_OBS0_CHNL228_RDATA0_ADDR A:0xe607218
y.create.l HWIO_PMIC_ARB_OBS0_CHNL229_RDATA0_ADDR A:0xe607298
y.create.l HWIO_PMIC_ARB_OBS0_CHNL230_RDATA0_ADDR A:0xe607318
y.create.l HWIO_PMIC_ARB_OBS0_CHNL231_RDATA0_ADDR A:0xe607398
y.create.l HWIO_PMIC_ARB_OBS0_CHNL232_RDATA0_ADDR A:0xe607418
y.create.l HWIO_PMIC_ARB_OBS0_CHNL233_RDATA0_ADDR A:0xe607498
y.create.l HWIO_PMIC_ARB_OBS0_CHNL234_RDATA0_ADDR A:0xe607518
y.create.l HWIO_PMIC_ARB_OBS0_CHNL235_RDATA0_ADDR A:0xe607598
y.create.l HWIO_PMIC_ARB_OBS0_CHNL236_RDATA0_ADDR A:0xe607618
y.create.l HWIO_PMIC_ARB_OBS0_CHNL237_RDATA0_ADDR A:0xe607698
y.create.l HWIO_PMIC_ARB_OBS0_CHNL238_RDATA0_ADDR A:0xe607718
y.create.l HWIO_PMIC_ARB_OBS0_CHNL239_RDATA0_ADDR A:0xe607798
y.create.l HWIO_PMIC_ARB_OBS0_CHNL240_RDATA0_ADDR A:0xe607818
y.create.l HWIO_PMIC_ARB_OBS0_CHNL241_RDATA0_ADDR A:0xe607898
y.create.l HWIO_PMIC_ARB_OBS0_CHNL242_RDATA0_ADDR A:0xe607918
y.create.l HWIO_PMIC_ARB_OBS0_CHNL243_RDATA0_ADDR A:0xe607998
y.create.l HWIO_PMIC_ARB_OBS0_CHNL244_RDATA0_ADDR A:0xe607a18
y.create.l HWIO_PMIC_ARB_OBS0_CHNL245_RDATA0_ADDR A:0xe607a98
y.create.l HWIO_PMIC_ARB_OBS0_CHNL246_RDATA0_ADDR A:0xe607b18
y.create.l HWIO_PMIC_ARB_OBS0_CHNL247_RDATA0_ADDR A:0xe607b98
y.create.l HWIO_PMIC_ARB_OBS0_CHNL248_RDATA0_ADDR A:0xe607c18
y.create.l HWIO_PMIC_ARB_OBS0_CHNL249_RDATA0_ADDR A:0xe607c98
y.create.l HWIO_PMIC_ARB_OBS0_CHNL250_RDATA0_ADDR A:0xe607d18
y.create.l HWIO_PMIC_ARB_OBS0_CHNL251_RDATA0_ADDR A:0xe607d98
y.create.l HWIO_PMIC_ARB_OBS0_CHNL252_RDATA0_ADDR A:0xe607e18
y.create.l HWIO_PMIC_ARB_OBS0_CHNL253_RDATA0_ADDR A:0xe607e98
y.create.l HWIO_PMIC_ARB_OBS0_CHNL254_RDATA0_ADDR A:0xe607f18
y.create.l HWIO_PMIC_ARB_OBS0_CHNL255_RDATA0_ADDR A:0xe607f98
y.create.l HWIO_PMIC_ARB_OBS0_CHNL256_RDATA0_ADDR A:0xe608018
y.create.l HWIO_PMIC_ARB_OBS0_CHNL257_RDATA0_ADDR A:0xe608098
y.create.l HWIO_PMIC_ARB_OBS0_CHNL258_RDATA0_ADDR A:0xe608118
y.create.l HWIO_PMIC_ARB_OBS0_CHNL259_RDATA0_ADDR A:0xe608198
y.create.l HWIO_PMIC_ARB_OBS0_CHNL260_RDATA0_ADDR A:0xe608218
y.create.l HWIO_PMIC_ARB_OBS0_CHNL261_RDATA0_ADDR A:0xe608298
y.create.l HWIO_PMIC_ARB_OBS0_CHNL262_RDATA0_ADDR A:0xe608318
y.create.l HWIO_PMIC_ARB_OBS0_CHNL263_RDATA0_ADDR A:0xe608398
y.create.l HWIO_PMIC_ARB_OBS0_CHNL264_RDATA0_ADDR A:0xe608418
y.create.l HWIO_PMIC_ARB_OBS0_CHNL265_RDATA0_ADDR A:0xe608498
y.create.l HWIO_PMIC_ARB_OBS0_CHNL266_RDATA0_ADDR A:0xe608518
y.create.l HWIO_PMIC_ARB_OBS0_CHNL267_RDATA0_ADDR A:0xe608598
y.create.l HWIO_PMIC_ARB_OBS0_CHNL268_RDATA0_ADDR A:0xe608618
y.create.l HWIO_PMIC_ARB_OBS0_CHNL269_RDATA0_ADDR A:0xe608698
y.create.l HWIO_PMIC_ARB_OBS0_CHNL270_RDATA0_ADDR A:0xe608718
y.create.l HWIO_PMIC_ARB_OBS0_CHNL271_RDATA0_ADDR A:0xe608798
y.create.l HWIO_PMIC_ARB_OBS0_CHNL272_RDATA0_ADDR A:0xe608818
y.create.l HWIO_PMIC_ARB_OBS0_CHNL273_RDATA0_ADDR A:0xe608898
y.create.l HWIO_PMIC_ARB_OBS0_CHNL274_RDATA0_ADDR A:0xe608918
y.create.l HWIO_PMIC_ARB_OBS0_CHNL275_RDATA0_ADDR A:0xe608998
y.create.l HWIO_PMIC_ARB_OBS0_CHNL276_RDATA0_ADDR A:0xe608a18
y.create.l HWIO_PMIC_ARB_OBS0_CHNL277_RDATA0_ADDR A:0xe608a98
y.create.l HWIO_PMIC_ARB_OBS0_CHNL278_RDATA0_ADDR A:0xe608b18
y.create.l HWIO_PMIC_ARB_OBS0_CHNL279_RDATA0_ADDR A:0xe608b98
y.create.l HWIO_PMIC_ARB_OBS0_CHNL280_RDATA0_ADDR A:0xe608c18
y.create.l HWIO_PMIC_ARB_OBS0_CHNL281_RDATA0_ADDR A:0xe608c98
y.create.l HWIO_PMIC_ARB_OBS0_CHNL282_RDATA0_ADDR A:0xe608d18
y.create.l HWIO_PMIC_ARB_OBS0_CHNL283_RDATA0_ADDR A:0xe608d98
y.create.l HWIO_PMIC_ARB_OBS0_CHNL284_RDATA0_ADDR A:0xe608e18
y.create.l HWIO_PMIC_ARB_OBS0_CHNL285_RDATA0_ADDR A:0xe608e98
y.create.l HWIO_PMIC_ARB_OBS0_CHNL286_RDATA0_ADDR A:0xe608f18
y.create.l HWIO_PMIC_ARB_OBS0_CHNL287_RDATA0_ADDR A:0xe608f98
y.create.l HWIO_PMIC_ARB_OBS0_CHNL288_RDATA0_ADDR A:0xe609018
y.create.l HWIO_PMIC_ARB_OBS0_CHNL289_RDATA0_ADDR A:0xe609098
y.create.l HWIO_PMIC_ARB_OBS0_CHNL290_RDATA0_ADDR A:0xe609118
y.create.l HWIO_PMIC_ARB_OBS0_CHNL291_RDATA0_ADDR A:0xe609198
y.create.l HWIO_PMIC_ARB_OBS0_CHNL292_RDATA0_ADDR A:0xe609218
y.create.l HWIO_PMIC_ARB_OBS0_CHNL293_RDATA0_ADDR A:0xe609298
y.create.l HWIO_PMIC_ARB_OBS0_CHNL294_RDATA0_ADDR A:0xe609318
y.create.l HWIO_PMIC_ARB_OBS0_CHNL295_RDATA0_ADDR A:0xe609398
y.create.l HWIO_PMIC_ARB_OBS0_CHNL296_RDATA0_ADDR A:0xe609418
y.create.l HWIO_PMIC_ARB_OBS0_CHNL297_RDATA0_ADDR A:0xe609498
y.create.l HWIO_PMIC_ARB_OBS0_CHNL298_RDATA0_ADDR A:0xe609518
y.create.l HWIO_PMIC_ARB_OBS0_CHNL299_RDATA0_ADDR A:0xe609598
y.create.l HWIO_PMIC_ARB_OBS0_CHNL300_RDATA0_ADDR A:0xe609618
y.create.l HWIO_PMIC_ARB_OBS0_CHNL301_RDATA0_ADDR A:0xe609698
y.create.l HWIO_PMIC_ARB_OBS0_CHNL302_RDATA0_ADDR A:0xe609718
y.create.l HWIO_PMIC_ARB_OBS0_CHNL303_RDATA0_ADDR A:0xe609798
y.create.l HWIO_PMIC_ARB_OBS0_CHNL304_RDATA0_ADDR A:0xe609818
y.create.l HWIO_PMIC_ARB_OBS0_CHNL305_RDATA0_ADDR A:0xe609898
y.create.l HWIO_PMIC_ARB_OBS0_CHNL306_RDATA0_ADDR A:0xe609918
y.create.l HWIO_PMIC_ARB_OBS0_CHNL307_RDATA0_ADDR A:0xe609998
y.create.l HWIO_PMIC_ARB_OBS0_CHNL308_RDATA0_ADDR A:0xe609a18
y.create.l HWIO_PMIC_ARB_OBS0_CHNL309_RDATA0_ADDR A:0xe609a98
y.create.l HWIO_PMIC_ARB_OBS0_CHNL310_RDATA0_ADDR A:0xe609b18
y.create.l HWIO_PMIC_ARB_OBS0_CHNL311_RDATA0_ADDR A:0xe609b98
y.create.l HWIO_PMIC_ARB_OBS0_CHNL312_RDATA0_ADDR A:0xe609c18
y.create.l HWIO_PMIC_ARB_OBS0_CHNL313_RDATA0_ADDR A:0xe609c98
y.create.l HWIO_PMIC_ARB_OBS0_CHNL314_RDATA0_ADDR A:0xe609d18
y.create.l HWIO_PMIC_ARB_OBS0_CHNL315_RDATA0_ADDR A:0xe609d98
y.create.l HWIO_PMIC_ARB_OBS0_CHNL316_RDATA0_ADDR A:0xe609e18
y.create.l HWIO_PMIC_ARB_OBS0_CHNL317_RDATA0_ADDR A:0xe609e98
y.create.l HWIO_PMIC_ARB_OBS0_CHNL318_RDATA0_ADDR A:0xe609f18
y.create.l HWIO_PMIC_ARB_OBS0_CHNL319_RDATA0_ADDR A:0xe609f98
y.create.l HWIO_PMIC_ARB_OBS0_CHNL320_RDATA0_ADDR A:0xe60a018
y.create.l HWIO_PMIC_ARB_OBS0_CHNL321_RDATA0_ADDR A:0xe60a098
y.create.l HWIO_PMIC_ARB_OBS0_CHNL322_RDATA0_ADDR A:0xe60a118
y.create.l HWIO_PMIC_ARB_OBS0_CHNL323_RDATA0_ADDR A:0xe60a198
y.create.l HWIO_PMIC_ARB_OBS0_CHNL324_RDATA0_ADDR A:0xe60a218
y.create.l HWIO_PMIC_ARB_OBS0_CHNL325_RDATA0_ADDR A:0xe60a298
y.create.l HWIO_PMIC_ARB_OBS0_CHNL326_RDATA0_ADDR A:0xe60a318
y.create.l HWIO_PMIC_ARB_OBS0_CHNL327_RDATA0_ADDR A:0xe60a398
y.create.l HWIO_PMIC_ARB_OBS0_CHNL328_RDATA0_ADDR A:0xe60a418
y.create.l HWIO_PMIC_ARB_OBS0_CHNL329_RDATA0_ADDR A:0xe60a498
y.create.l HWIO_PMIC_ARB_OBS0_CHNL330_RDATA0_ADDR A:0xe60a518
y.create.l HWIO_PMIC_ARB_OBS0_CHNL331_RDATA0_ADDR A:0xe60a598
y.create.l HWIO_PMIC_ARB_OBS0_CHNL332_RDATA0_ADDR A:0xe60a618
y.create.l HWIO_PMIC_ARB_OBS0_CHNL333_RDATA0_ADDR A:0xe60a698
y.create.l HWIO_PMIC_ARB_OBS0_CHNL334_RDATA0_ADDR A:0xe60a718
y.create.l HWIO_PMIC_ARB_OBS0_CHNL335_RDATA0_ADDR A:0xe60a798
y.create.l HWIO_PMIC_ARB_OBS0_CHNL336_RDATA0_ADDR A:0xe60a818
y.create.l HWIO_PMIC_ARB_OBS0_CHNL337_RDATA0_ADDR A:0xe60a898
y.create.l HWIO_PMIC_ARB_OBS0_CHNL338_RDATA0_ADDR A:0xe60a918
y.create.l HWIO_PMIC_ARB_OBS0_CHNL339_RDATA0_ADDR A:0xe60a998
y.create.l HWIO_PMIC_ARB_OBS0_CHNL340_RDATA0_ADDR A:0xe60aa18
y.create.l HWIO_PMIC_ARB_OBS0_CHNL341_RDATA0_ADDR A:0xe60aa98
y.create.l HWIO_PMIC_ARB_OBS0_CHNL342_RDATA0_ADDR A:0xe60ab18
y.create.l HWIO_PMIC_ARB_OBS0_CHNL343_RDATA0_ADDR A:0xe60ab98
y.create.l HWIO_PMIC_ARB_OBS0_CHNL344_RDATA0_ADDR A:0xe60ac18
y.create.l HWIO_PMIC_ARB_OBS0_CHNL345_RDATA0_ADDR A:0xe60ac98
y.create.l HWIO_PMIC_ARB_OBS0_CHNL346_RDATA0_ADDR A:0xe60ad18
y.create.l HWIO_PMIC_ARB_OBS0_CHNL347_RDATA0_ADDR A:0xe60ad98
y.create.l HWIO_PMIC_ARB_OBS0_CHNL348_RDATA0_ADDR A:0xe60ae18
y.create.l HWIO_PMIC_ARB_OBS0_CHNL349_RDATA0_ADDR A:0xe60ae98
y.create.l HWIO_PMIC_ARB_OBS0_CHNL350_RDATA0_ADDR A:0xe60af18
y.create.l HWIO_PMIC_ARB_OBS0_CHNL351_RDATA0_ADDR A:0xe60af98
y.create.l HWIO_PMIC_ARB_OBS0_CHNL352_RDATA0_ADDR A:0xe60b018
y.create.l HWIO_PMIC_ARB_OBS0_CHNL353_RDATA0_ADDR A:0xe60b098
y.create.l HWIO_PMIC_ARB_OBS0_CHNL354_RDATA0_ADDR A:0xe60b118
y.create.l HWIO_PMIC_ARB_OBS0_CHNL355_RDATA0_ADDR A:0xe60b198
y.create.l HWIO_PMIC_ARB_OBS0_CHNL356_RDATA0_ADDR A:0xe60b218
y.create.l HWIO_PMIC_ARB_OBS0_CHNL357_RDATA0_ADDR A:0xe60b298
y.create.l HWIO_PMIC_ARB_OBS0_CHNL358_RDATA0_ADDR A:0xe60b318
y.create.l HWIO_PMIC_ARB_OBS0_CHNL359_RDATA0_ADDR A:0xe60b398
y.create.l HWIO_PMIC_ARB_OBS0_CHNL360_RDATA0_ADDR A:0xe60b418
y.create.l HWIO_PMIC_ARB_OBS0_CHNL361_RDATA0_ADDR A:0xe60b498
y.create.l HWIO_PMIC_ARB_OBS0_CHNL362_RDATA0_ADDR A:0xe60b518
y.create.l HWIO_PMIC_ARB_OBS0_CHNL363_RDATA0_ADDR A:0xe60b598
y.create.l HWIO_PMIC_ARB_OBS0_CHNL364_RDATA0_ADDR A:0xe60b618
y.create.l HWIO_PMIC_ARB_OBS0_CHNL365_RDATA0_ADDR A:0xe60b698
y.create.l HWIO_PMIC_ARB_OBS0_CHNL366_RDATA0_ADDR A:0xe60b718
y.create.l HWIO_PMIC_ARB_OBS0_CHNL367_RDATA0_ADDR A:0xe60b798
y.create.l HWIO_PMIC_ARB_OBS0_CHNL368_RDATA0_ADDR A:0xe60b818
y.create.l HWIO_PMIC_ARB_OBS0_CHNL369_RDATA0_ADDR A:0xe60b898
y.create.l HWIO_PMIC_ARB_OBS0_CHNL370_RDATA0_ADDR A:0xe60b918
y.create.l HWIO_PMIC_ARB_OBS0_CHNL371_RDATA0_ADDR A:0xe60b998
y.create.l HWIO_PMIC_ARB_OBS0_CHNL372_RDATA0_ADDR A:0xe60ba18
y.create.l HWIO_PMIC_ARB_OBS0_CHNL373_RDATA0_ADDR A:0xe60ba98
y.create.l HWIO_PMIC_ARB_OBS0_CHNL374_RDATA0_ADDR A:0xe60bb18
y.create.l HWIO_PMIC_ARB_OBS0_CHNL375_RDATA0_ADDR A:0xe60bb98
y.create.l HWIO_PMIC_ARB_OBS0_CHNL376_RDATA0_ADDR A:0xe60bc18
y.create.l HWIO_PMIC_ARB_OBS0_CHNL377_RDATA0_ADDR A:0xe60bc98
y.create.l HWIO_PMIC_ARB_OBS0_CHNL378_RDATA0_ADDR A:0xe60bd18
y.create.l HWIO_PMIC_ARB_OBS0_CHNL379_RDATA0_ADDR A:0xe60bd98
y.create.l HWIO_PMIC_ARB_OBS0_CHNL380_RDATA0_ADDR A:0xe60be18
y.create.l HWIO_PMIC_ARB_OBS0_CHNL381_RDATA0_ADDR A:0xe60be98
y.create.l HWIO_PMIC_ARB_OBS0_CHNL382_RDATA0_ADDR A:0xe60bf18
y.create.l HWIO_PMIC_ARB_OBS0_CHNL383_RDATA0_ADDR A:0xe60bf98
y.create.l HWIO_PMIC_ARB_OBS0_CHNL384_RDATA0_ADDR A:0xe60c018
y.create.l HWIO_PMIC_ARB_OBS0_CHNL385_RDATA0_ADDR A:0xe60c098
y.create.l HWIO_PMIC_ARB_OBS0_CHNL386_RDATA0_ADDR A:0xe60c118
y.create.l HWIO_PMIC_ARB_OBS0_CHNL387_RDATA0_ADDR A:0xe60c198
y.create.l HWIO_PMIC_ARB_OBS0_CHNL388_RDATA0_ADDR A:0xe60c218
y.create.l HWIO_PMIC_ARB_OBS0_CHNL389_RDATA0_ADDR A:0xe60c298
y.create.l HWIO_PMIC_ARB_OBS0_CHNL390_RDATA0_ADDR A:0xe60c318
y.create.l HWIO_PMIC_ARB_OBS0_CHNL391_RDATA0_ADDR A:0xe60c398
y.create.l HWIO_PMIC_ARB_OBS0_CHNL392_RDATA0_ADDR A:0xe60c418
y.create.l HWIO_PMIC_ARB_OBS0_CHNL393_RDATA0_ADDR A:0xe60c498
y.create.l HWIO_PMIC_ARB_OBS0_CHNL394_RDATA0_ADDR A:0xe60c518
y.create.l HWIO_PMIC_ARB_OBS0_CHNL395_RDATA0_ADDR A:0xe60c598
y.create.l HWIO_PMIC_ARB_OBS0_CHNL396_RDATA0_ADDR A:0xe60c618
y.create.l HWIO_PMIC_ARB_OBS0_CHNL397_RDATA0_ADDR A:0xe60c698
y.create.l HWIO_PMIC_ARB_OBS0_CHNL398_RDATA0_ADDR A:0xe60c718
y.create.l HWIO_PMIC_ARB_OBS0_CHNL399_RDATA0_ADDR A:0xe60c798
y.create.l HWIO_PMIC_ARB_OBS0_CHNL400_RDATA0_ADDR A:0xe60c818
y.create.l HWIO_PMIC_ARB_OBS0_CHNL401_RDATA0_ADDR A:0xe60c898
y.create.l HWIO_PMIC_ARB_OBS0_CHNL402_RDATA0_ADDR A:0xe60c918
y.create.l HWIO_PMIC_ARB_OBS0_CHNL403_RDATA0_ADDR A:0xe60c998
y.create.l HWIO_PMIC_ARB_OBS0_CHNL404_RDATA0_ADDR A:0xe60ca18
y.create.l HWIO_PMIC_ARB_OBS0_CHNL405_RDATA0_ADDR A:0xe60ca98
y.create.l HWIO_PMIC_ARB_OBS0_CHNL406_RDATA0_ADDR A:0xe60cb18
y.create.l HWIO_PMIC_ARB_OBS0_CHNL407_RDATA0_ADDR A:0xe60cb98
y.create.l HWIO_PMIC_ARB_OBS0_CHNL408_RDATA0_ADDR A:0xe60cc18
y.create.l HWIO_PMIC_ARB_OBS0_CHNL409_RDATA0_ADDR A:0xe60cc98
y.create.l HWIO_PMIC_ARB_OBS0_CHNL410_RDATA0_ADDR A:0xe60cd18
y.create.l HWIO_PMIC_ARB_OBS0_CHNL411_RDATA0_ADDR A:0xe60cd98
y.create.l HWIO_PMIC_ARB_OBS0_CHNL412_RDATA0_ADDR A:0xe60ce18
y.create.l HWIO_PMIC_ARB_OBS0_CHNL413_RDATA0_ADDR A:0xe60ce98
y.create.l HWIO_PMIC_ARB_OBS0_CHNL414_RDATA0_ADDR A:0xe60cf18
y.create.l HWIO_PMIC_ARB_OBS0_CHNL415_RDATA0_ADDR A:0xe60cf98
y.create.l HWIO_PMIC_ARB_OBS0_CHNL416_RDATA0_ADDR A:0xe60d018
y.create.l HWIO_PMIC_ARB_OBS0_CHNL417_RDATA0_ADDR A:0xe60d098
y.create.l HWIO_PMIC_ARB_OBS0_CHNL418_RDATA0_ADDR A:0xe60d118
y.create.l HWIO_PMIC_ARB_OBS0_CHNL419_RDATA0_ADDR A:0xe60d198
y.create.l HWIO_PMIC_ARB_OBS0_CHNL420_RDATA0_ADDR A:0xe60d218
y.create.l HWIO_PMIC_ARB_OBS0_CHNL421_RDATA0_ADDR A:0xe60d298
y.create.l HWIO_PMIC_ARB_OBS0_CHNL422_RDATA0_ADDR A:0xe60d318
y.create.l HWIO_PMIC_ARB_OBS0_CHNL423_RDATA0_ADDR A:0xe60d398
y.create.l HWIO_PMIC_ARB_OBS0_CHNL424_RDATA0_ADDR A:0xe60d418
y.create.l HWIO_PMIC_ARB_OBS0_CHNL425_RDATA0_ADDR A:0xe60d498
y.create.l HWIO_PMIC_ARB_OBS0_CHNL426_RDATA0_ADDR A:0xe60d518
y.create.l HWIO_PMIC_ARB_OBS0_CHNL427_RDATA0_ADDR A:0xe60d598
y.create.l HWIO_PMIC_ARB_OBS0_CHNL428_RDATA0_ADDR A:0xe60d618
y.create.l HWIO_PMIC_ARB_OBS0_CHNL429_RDATA0_ADDR A:0xe60d698
y.create.l HWIO_PMIC_ARB_OBS0_CHNL430_RDATA0_ADDR A:0xe60d718
y.create.l HWIO_PMIC_ARB_OBS0_CHNL431_RDATA0_ADDR A:0xe60d798
y.create.l HWIO_PMIC_ARB_OBS0_CHNL432_RDATA0_ADDR A:0xe60d818
y.create.l HWIO_PMIC_ARB_OBS0_CHNL433_RDATA0_ADDR A:0xe60d898
y.create.l HWIO_PMIC_ARB_OBS0_CHNL434_RDATA0_ADDR A:0xe60d918
y.create.l HWIO_PMIC_ARB_OBS0_CHNL435_RDATA0_ADDR A:0xe60d998
y.create.l HWIO_PMIC_ARB_OBS0_CHNL436_RDATA0_ADDR A:0xe60da18
y.create.l HWIO_PMIC_ARB_OBS0_CHNL437_RDATA0_ADDR A:0xe60da98
y.create.l HWIO_PMIC_ARB_OBS0_CHNL438_RDATA0_ADDR A:0xe60db18
y.create.l HWIO_PMIC_ARB_OBS0_CHNL439_RDATA0_ADDR A:0xe60db98
y.create.l HWIO_PMIC_ARB_OBS0_CHNL440_RDATA0_ADDR A:0xe60dc18
y.create.l HWIO_PMIC_ARB_OBS0_CHNL441_RDATA0_ADDR A:0xe60dc98
y.create.l HWIO_PMIC_ARB_OBS0_CHNL442_RDATA0_ADDR A:0xe60dd18
y.create.l HWIO_PMIC_ARB_OBS0_CHNL443_RDATA0_ADDR A:0xe60dd98
y.create.l HWIO_PMIC_ARB_OBS0_CHNL444_RDATA0_ADDR A:0xe60de18
y.create.l HWIO_PMIC_ARB_OBS0_CHNL445_RDATA0_ADDR A:0xe60de98
y.create.l HWIO_PMIC_ARB_OBS0_CHNL446_RDATA0_ADDR A:0xe60df18
y.create.l HWIO_PMIC_ARB_OBS0_CHNL447_RDATA0_ADDR A:0xe60df98
y.create.l HWIO_PMIC_ARB_OBS0_CHNL448_RDATA0_ADDR A:0xe60e018
y.create.l HWIO_PMIC_ARB_OBS0_CHNL449_RDATA0_ADDR A:0xe60e098
y.create.l HWIO_PMIC_ARB_OBS0_CHNL450_RDATA0_ADDR A:0xe60e118
y.create.l HWIO_PMIC_ARB_OBS0_CHNL451_RDATA0_ADDR A:0xe60e198
y.create.l HWIO_PMIC_ARB_OBS0_CHNL452_RDATA0_ADDR A:0xe60e218
y.create.l HWIO_PMIC_ARB_OBS0_CHNL453_RDATA0_ADDR A:0xe60e298
y.create.l HWIO_PMIC_ARB_OBS0_CHNL454_RDATA0_ADDR A:0xe60e318
y.create.l HWIO_PMIC_ARB_OBS0_CHNL455_RDATA0_ADDR A:0xe60e398
y.create.l HWIO_PMIC_ARB_OBS0_CHNL456_RDATA0_ADDR A:0xe60e418
y.create.l HWIO_PMIC_ARB_OBS0_CHNL457_RDATA0_ADDR A:0xe60e498
y.create.l HWIO_PMIC_ARB_OBS0_CHNL458_RDATA0_ADDR A:0xe60e518
y.create.l HWIO_PMIC_ARB_OBS0_CHNL459_RDATA0_ADDR A:0xe60e598
y.create.l HWIO_PMIC_ARB_OBS0_CHNL460_RDATA0_ADDR A:0xe60e618
y.create.l HWIO_PMIC_ARB_OBS0_CHNL461_RDATA0_ADDR A:0xe60e698
y.create.l HWIO_PMIC_ARB_OBS0_CHNL462_RDATA0_ADDR A:0xe60e718
y.create.l HWIO_PMIC_ARB_OBS0_CHNL463_RDATA0_ADDR A:0xe60e798
y.create.l HWIO_PMIC_ARB_OBS0_CHNL464_RDATA0_ADDR A:0xe60e818
y.create.l HWIO_PMIC_ARB_OBS0_CHNL465_RDATA0_ADDR A:0xe60e898
y.create.l HWIO_PMIC_ARB_OBS0_CHNL466_RDATA0_ADDR A:0xe60e918
y.create.l HWIO_PMIC_ARB_OBS0_CHNL467_RDATA0_ADDR A:0xe60e998
y.create.l HWIO_PMIC_ARB_OBS0_CHNL468_RDATA0_ADDR A:0xe60ea18
y.create.l HWIO_PMIC_ARB_OBS0_CHNL469_RDATA0_ADDR A:0xe60ea98
y.create.l HWIO_PMIC_ARB_OBS0_CHNL470_RDATA0_ADDR A:0xe60eb18
y.create.l HWIO_PMIC_ARB_OBS0_CHNL471_RDATA0_ADDR A:0xe60eb98
y.create.l HWIO_PMIC_ARB_OBS0_CHNL472_RDATA0_ADDR A:0xe60ec18
y.create.l HWIO_PMIC_ARB_OBS0_CHNL473_RDATA0_ADDR A:0xe60ec98
y.create.l HWIO_PMIC_ARB_OBS0_CHNL474_RDATA0_ADDR A:0xe60ed18
y.create.l HWIO_PMIC_ARB_OBS0_CHNL475_RDATA0_ADDR A:0xe60ed98
y.create.l HWIO_PMIC_ARB_OBS0_CHNL476_RDATA0_ADDR A:0xe60ee18
y.create.l HWIO_PMIC_ARB_OBS0_CHNL477_RDATA0_ADDR A:0xe60ee98
y.create.l HWIO_PMIC_ARB_OBS0_CHNL478_RDATA0_ADDR A:0xe60ef18
y.create.l HWIO_PMIC_ARB_OBS0_CHNL479_RDATA0_ADDR A:0xe60ef98
y.create.l HWIO_PMIC_ARB_OBS0_CHNL480_RDATA0_ADDR A:0xe60f018
y.create.l HWIO_PMIC_ARB_OBS0_CHNL481_RDATA0_ADDR A:0xe60f098
y.create.l HWIO_PMIC_ARB_OBS0_CHNL482_RDATA0_ADDR A:0xe60f118
y.create.l HWIO_PMIC_ARB_OBS0_CHNL483_RDATA0_ADDR A:0xe60f198
y.create.l HWIO_PMIC_ARB_OBS0_CHNL484_RDATA0_ADDR A:0xe60f218
y.create.l HWIO_PMIC_ARB_OBS0_CHNL485_RDATA0_ADDR A:0xe60f298
y.create.l HWIO_PMIC_ARB_OBS0_CHNL486_RDATA0_ADDR A:0xe60f318
y.create.l HWIO_PMIC_ARB_OBS0_CHNL487_RDATA0_ADDR A:0xe60f398
y.create.l HWIO_PMIC_ARB_OBS0_CHNL488_RDATA0_ADDR A:0xe60f418
y.create.l HWIO_PMIC_ARB_OBS0_CHNL489_RDATA0_ADDR A:0xe60f498
y.create.l HWIO_PMIC_ARB_OBS0_CHNL490_RDATA0_ADDR A:0xe60f518
y.create.l HWIO_PMIC_ARB_OBS0_CHNL491_RDATA0_ADDR A:0xe60f598
y.create.l HWIO_PMIC_ARB_OBS0_CHNL492_RDATA0_ADDR A:0xe60f618
y.create.l HWIO_PMIC_ARB_OBS0_CHNL493_RDATA0_ADDR A:0xe60f698
y.create.l HWIO_PMIC_ARB_OBS0_CHNL494_RDATA0_ADDR A:0xe60f718
y.create.l HWIO_PMIC_ARB_OBS0_CHNL495_RDATA0_ADDR A:0xe60f798
y.create.l HWIO_PMIC_ARB_OBS0_CHNL496_RDATA0_ADDR A:0xe60f818
y.create.l HWIO_PMIC_ARB_OBS0_CHNL497_RDATA0_ADDR A:0xe60f898
y.create.l HWIO_PMIC_ARB_OBS0_CHNL498_RDATA0_ADDR A:0xe60f918
y.create.l HWIO_PMIC_ARB_OBS0_CHNL499_RDATA0_ADDR A:0xe60f998
y.create.l HWIO_PMIC_ARB_OBS0_CHNL500_RDATA0_ADDR A:0xe60fa18
y.create.l HWIO_PMIC_ARB_OBS0_CHNL501_RDATA0_ADDR A:0xe60fa98
y.create.l HWIO_PMIC_ARB_OBS0_CHNL502_RDATA0_ADDR A:0xe60fb18
y.create.l HWIO_PMIC_ARB_OBS0_CHNL503_RDATA0_ADDR A:0xe60fb98
y.create.l HWIO_PMIC_ARB_OBS0_CHNL504_RDATA0_ADDR A:0xe60fc18
y.create.l HWIO_PMIC_ARB_OBS0_CHNL505_RDATA0_ADDR A:0xe60fc98
y.create.l HWIO_PMIC_ARB_OBS0_CHNL506_RDATA0_ADDR A:0xe60fd18
y.create.l HWIO_PMIC_ARB_OBS0_CHNL507_RDATA0_ADDR A:0xe60fd98
y.create.l HWIO_PMIC_ARB_OBS0_CHNL508_RDATA0_ADDR A:0xe60fe18
y.create.l HWIO_PMIC_ARB_OBS0_CHNL509_RDATA0_ADDR A:0xe60fe98
y.create.l HWIO_PMIC_ARB_OBS0_CHNL510_RDATA0_ADDR A:0xe60ff18
y.create.l HWIO_PMIC_ARB_OBS0_CHNL511_RDATA0_ADDR A:0xe60ff98
y.create.l HWIO_PMIC_ARB_OBS1_CHNL0_RDATA0_ADDR A:0xe610018
y.create.l HWIO_PMIC_ARB_OBS1_CHNL1_RDATA0_ADDR A:0xe610098
y.create.l HWIO_PMIC_ARB_OBS1_CHNL2_RDATA0_ADDR A:0xe610118
y.create.l HWIO_PMIC_ARB_OBS1_CHNL3_RDATA0_ADDR A:0xe610198
y.create.l HWIO_PMIC_ARB_OBS1_CHNL4_RDATA0_ADDR A:0xe610218
y.create.l HWIO_PMIC_ARB_OBS1_CHNL5_RDATA0_ADDR A:0xe610298
y.create.l HWIO_PMIC_ARB_OBS1_CHNL6_RDATA0_ADDR A:0xe610318
y.create.l HWIO_PMIC_ARB_OBS1_CHNL7_RDATA0_ADDR A:0xe610398
y.create.l HWIO_PMIC_ARB_OBS1_CHNL8_RDATA0_ADDR A:0xe610418
y.create.l HWIO_PMIC_ARB_OBS1_CHNL9_RDATA0_ADDR A:0xe610498
y.create.l HWIO_PMIC_ARB_OBS1_CHNL10_RDATA0_ADDR A:0xe610518
y.create.l HWIO_PMIC_ARB_OBS1_CHNL11_RDATA0_ADDR A:0xe610598
y.create.l HWIO_PMIC_ARB_OBS1_CHNL12_RDATA0_ADDR A:0xe610618
y.create.l HWIO_PMIC_ARB_OBS1_CHNL13_RDATA0_ADDR A:0xe610698
y.create.l HWIO_PMIC_ARB_OBS1_CHNL14_RDATA0_ADDR A:0xe610718
y.create.l HWIO_PMIC_ARB_OBS1_CHNL15_RDATA0_ADDR A:0xe610798
y.create.l HWIO_PMIC_ARB_OBS1_CHNL16_RDATA0_ADDR A:0xe610818
y.create.l HWIO_PMIC_ARB_OBS1_CHNL17_RDATA0_ADDR A:0xe610898
y.create.l HWIO_PMIC_ARB_OBS1_CHNL18_RDATA0_ADDR A:0xe610918
y.create.l HWIO_PMIC_ARB_OBS1_CHNL19_RDATA0_ADDR A:0xe610998
y.create.l HWIO_PMIC_ARB_OBS1_CHNL20_RDATA0_ADDR A:0xe610a18
y.create.l HWIO_PMIC_ARB_OBS1_CHNL21_RDATA0_ADDR A:0xe610a98
y.create.l HWIO_PMIC_ARB_OBS1_CHNL22_RDATA0_ADDR A:0xe610b18
y.create.l HWIO_PMIC_ARB_OBS1_CHNL23_RDATA0_ADDR A:0xe610b98
y.create.l HWIO_PMIC_ARB_OBS1_CHNL24_RDATA0_ADDR A:0xe610c18
y.create.l HWIO_PMIC_ARB_OBS1_CHNL25_RDATA0_ADDR A:0xe610c98
y.create.l HWIO_PMIC_ARB_OBS1_CHNL26_RDATA0_ADDR A:0xe610d18
y.create.l HWIO_PMIC_ARB_OBS1_CHNL27_RDATA0_ADDR A:0xe610d98
y.create.l HWIO_PMIC_ARB_OBS1_CHNL28_RDATA0_ADDR A:0xe610e18
y.create.l HWIO_PMIC_ARB_OBS1_CHNL29_RDATA0_ADDR A:0xe610e98
y.create.l HWIO_PMIC_ARB_OBS1_CHNL30_RDATA0_ADDR A:0xe610f18
y.create.l HWIO_PMIC_ARB_OBS1_CHNL31_RDATA0_ADDR A:0xe610f98
y.create.l HWIO_PMIC_ARB_OBS1_CHNL32_RDATA0_ADDR A:0xe611018
y.create.l HWIO_PMIC_ARB_OBS1_CHNL33_RDATA0_ADDR A:0xe611098
y.create.l HWIO_PMIC_ARB_OBS1_CHNL34_RDATA0_ADDR A:0xe611118
y.create.l HWIO_PMIC_ARB_OBS1_CHNL35_RDATA0_ADDR A:0xe611198
y.create.l HWIO_PMIC_ARB_OBS1_CHNL36_RDATA0_ADDR A:0xe611218
y.create.l HWIO_PMIC_ARB_OBS1_CHNL37_RDATA0_ADDR A:0xe611298
y.create.l HWIO_PMIC_ARB_OBS1_CHNL38_RDATA0_ADDR A:0xe611318
y.create.l HWIO_PMIC_ARB_OBS1_CHNL39_RDATA0_ADDR A:0xe611398
y.create.l HWIO_PMIC_ARB_OBS1_CHNL40_RDATA0_ADDR A:0xe611418
y.create.l HWIO_PMIC_ARB_OBS1_CHNL41_RDATA0_ADDR A:0xe611498
y.create.l HWIO_PMIC_ARB_OBS1_CHNL42_RDATA0_ADDR A:0xe611518
y.create.l HWIO_PMIC_ARB_OBS1_CHNL43_RDATA0_ADDR A:0xe611598
y.create.l HWIO_PMIC_ARB_OBS1_CHNL44_RDATA0_ADDR A:0xe611618
y.create.l HWIO_PMIC_ARB_OBS1_CHNL45_RDATA0_ADDR A:0xe611698
y.create.l HWIO_PMIC_ARB_OBS1_CHNL46_RDATA0_ADDR A:0xe611718
y.create.l HWIO_PMIC_ARB_OBS1_CHNL47_RDATA0_ADDR A:0xe611798
y.create.l HWIO_PMIC_ARB_OBS1_CHNL48_RDATA0_ADDR A:0xe611818
y.create.l HWIO_PMIC_ARB_OBS1_CHNL49_RDATA0_ADDR A:0xe611898
y.create.l HWIO_PMIC_ARB_OBS1_CHNL50_RDATA0_ADDR A:0xe611918
y.create.l HWIO_PMIC_ARB_OBS1_CHNL51_RDATA0_ADDR A:0xe611998
y.create.l HWIO_PMIC_ARB_OBS1_CHNL52_RDATA0_ADDR A:0xe611a18
y.create.l HWIO_PMIC_ARB_OBS1_CHNL53_RDATA0_ADDR A:0xe611a98
y.create.l HWIO_PMIC_ARB_OBS1_CHNL54_RDATA0_ADDR A:0xe611b18
y.create.l HWIO_PMIC_ARB_OBS1_CHNL55_RDATA0_ADDR A:0xe611b98
y.create.l HWIO_PMIC_ARB_OBS1_CHNL56_RDATA0_ADDR A:0xe611c18
y.create.l HWIO_PMIC_ARB_OBS1_CHNL57_RDATA0_ADDR A:0xe611c98
y.create.l HWIO_PMIC_ARB_OBS1_CHNL58_RDATA0_ADDR A:0xe611d18
y.create.l HWIO_PMIC_ARB_OBS1_CHNL59_RDATA0_ADDR A:0xe611d98
y.create.l HWIO_PMIC_ARB_OBS1_CHNL60_RDATA0_ADDR A:0xe611e18
y.create.l HWIO_PMIC_ARB_OBS1_CHNL61_RDATA0_ADDR A:0xe611e98
y.create.l HWIO_PMIC_ARB_OBS1_CHNL62_RDATA0_ADDR A:0xe611f18
y.create.l HWIO_PMIC_ARB_OBS1_CHNL63_RDATA0_ADDR A:0xe611f98
y.create.l HWIO_PMIC_ARB_OBS1_CHNL64_RDATA0_ADDR A:0xe612018
y.create.l HWIO_PMIC_ARB_OBS1_CHNL65_RDATA0_ADDR A:0xe612098
y.create.l HWIO_PMIC_ARB_OBS1_CHNL66_RDATA0_ADDR A:0xe612118
y.create.l HWIO_PMIC_ARB_OBS1_CHNL67_RDATA0_ADDR A:0xe612198
y.create.l HWIO_PMIC_ARB_OBS1_CHNL68_RDATA0_ADDR A:0xe612218
y.create.l HWIO_PMIC_ARB_OBS1_CHNL69_RDATA0_ADDR A:0xe612298
y.create.l HWIO_PMIC_ARB_OBS1_CHNL70_RDATA0_ADDR A:0xe612318
y.create.l HWIO_PMIC_ARB_OBS1_CHNL71_RDATA0_ADDR A:0xe612398
y.create.l HWIO_PMIC_ARB_OBS1_CHNL72_RDATA0_ADDR A:0xe612418
y.create.l HWIO_PMIC_ARB_OBS1_CHNL73_RDATA0_ADDR A:0xe612498
y.create.l HWIO_PMIC_ARB_OBS1_CHNL74_RDATA0_ADDR A:0xe612518
y.create.l HWIO_PMIC_ARB_OBS1_CHNL75_RDATA0_ADDR A:0xe612598
y.create.l HWIO_PMIC_ARB_OBS1_CHNL76_RDATA0_ADDR A:0xe612618
y.create.l HWIO_PMIC_ARB_OBS1_CHNL77_RDATA0_ADDR A:0xe612698
y.create.l HWIO_PMIC_ARB_OBS1_CHNL78_RDATA0_ADDR A:0xe612718
y.create.l HWIO_PMIC_ARB_OBS1_CHNL79_RDATA0_ADDR A:0xe612798
y.create.l HWIO_PMIC_ARB_OBS1_CHNL80_RDATA0_ADDR A:0xe612818
y.create.l HWIO_PMIC_ARB_OBS1_CHNL81_RDATA0_ADDR A:0xe612898
y.create.l HWIO_PMIC_ARB_OBS1_CHNL82_RDATA0_ADDR A:0xe612918
y.create.l HWIO_PMIC_ARB_OBS1_CHNL83_RDATA0_ADDR A:0xe612998
y.create.l HWIO_PMIC_ARB_OBS1_CHNL84_RDATA0_ADDR A:0xe612a18
y.create.l HWIO_PMIC_ARB_OBS1_CHNL85_RDATA0_ADDR A:0xe612a98
y.create.l HWIO_PMIC_ARB_OBS1_CHNL86_RDATA0_ADDR A:0xe612b18
y.create.l HWIO_PMIC_ARB_OBS1_CHNL87_RDATA0_ADDR A:0xe612b98
y.create.l HWIO_PMIC_ARB_OBS1_CHNL88_RDATA0_ADDR A:0xe612c18
y.create.l HWIO_PMIC_ARB_OBS1_CHNL89_RDATA0_ADDR A:0xe612c98
y.create.l HWIO_PMIC_ARB_OBS1_CHNL90_RDATA0_ADDR A:0xe612d18
y.create.l HWIO_PMIC_ARB_OBS1_CHNL91_RDATA0_ADDR A:0xe612d98
y.create.l HWIO_PMIC_ARB_OBS1_CHNL92_RDATA0_ADDR A:0xe612e18
y.create.l HWIO_PMIC_ARB_OBS1_CHNL93_RDATA0_ADDR A:0xe612e98
y.create.l HWIO_PMIC_ARB_OBS1_CHNL94_RDATA0_ADDR A:0xe612f18
y.create.l HWIO_PMIC_ARB_OBS1_CHNL95_RDATA0_ADDR A:0xe612f98
y.create.l HWIO_PMIC_ARB_OBS1_CHNL96_RDATA0_ADDR A:0xe613018
y.create.l HWIO_PMIC_ARB_OBS1_CHNL97_RDATA0_ADDR A:0xe613098
y.create.l HWIO_PMIC_ARB_OBS1_CHNL98_RDATA0_ADDR A:0xe613118
y.create.l HWIO_PMIC_ARB_OBS1_CHNL99_RDATA0_ADDR A:0xe613198
y.create.l HWIO_PMIC_ARB_OBS1_CHNL100_RDATA0_ADDR A:0xe613218
y.create.l HWIO_PMIC_ARB_OBS1_CHNL101_RDATA0_ADDR A:0xe613298
y.create.l HWIO_PMIC_ARB_OBS1_CHNL102_RDATA0_ADDR A:0xe613318
y.create.l HWIO_PMIC_ARB_OBS1_CHNL103_RDATA0_ADDR A:0xe613398
y.create.l HWIO_PMIC_ARB_OBS1_CHNL104_RDATA0_ADDR A:0xe613418
y.create.l HWIO_PMIC_ARB_OBS1_CHNL105_RDATA0_ADDR A:0xe613498
y.create.l HWIO_PMIC_ARB_OBS1_CHNL106_RDATA0_ADDR A:0xe613518
y.create.l HWIO_PMIC_ARB_OBS1_CHNL107_RDATA0_ADDR A:0xe613598
y.create.l HWIO_PMIC_ARB_OBS1_CHNL108_RDATA0_ADDR A:0xe613618
y.create.l HWIO_PMIC_ARB_OBS1_CHNL109_RDATA0_ADDR A:0xe613698
y.create.l HWIO_PMIC_ARB_OBS1_CHNL110_RDATA0_ADDR A:0xe613718
y.create.l HWIO_PMIC_ARB_OBS1_CHNL111_RDATA0_ADDR A:0xe613798
y.create.l HWIO_PMIC_ARB_OBS1_CHNL112_RDATA0_ADDR A:0xe613818
y.create.l HWIO_PMIC_ARB_OBS1_CHNL113_RDATA0_ADDR A:0xe613898
y.create.l HWIO_PMIC_ARB_OBS1_CHNL114_RDATA0_ADDR A:0xe613918
y.create.l HWIO_PMIC_ARB_OBS1_CHNL115_RDATA0_ADDR A:0xe613998
y.create.l HWIO_PMIC_ARB_OBS1_CHNL116_RDATA0_ADDR A:0xe613a18
y.create.l HWIO_PMIC_ARB_OBS1_CHNL117_RDATA0_ADDR A:0xe613a98
y.create.l HWIO_PMIC_ARB_OBS1_CHNL118_RDATA0_ADDR A:0xe613b18
y.create.l HWIO_PMIC_ARB_OBS1_CHNL119_RDATA0_ADDR A:0xe613b98
y.create.l HWIO_PMIC_ARB_OBS1_CHNL120_RDATA0_ADDR A:0xe613c18
y.create.l HWIO_PMIC_ARB_OBS1_CHNL121_RDATA0_ADDR A:0xe613c98
y.create.l HWIO_PMIC_ARB_OBS1_CHNL122_RDATA0_ADDR A:0xe613d18
y.create.l HWIO_PMIC_ARB_OBS1_CHNL123_RDATA0_ADDR A:0xe613d98
y.create.l HWIO_PMIC_ARB_OBS1_CHNL124_RDATA0_ADDR A:0xe613e18
y.create.l HWIO_PMIC_ARB_OBS1_CHNL125_RDATA0_ADDR A:0xe613e98
y.create.l HWIO_PMIC_ARB_OBS1_CHNL126_RDATA0_ADDR A:0xe613f18
y.create.l HWIO_PMIC_ARB_OBS1_CHNL127_RDATA0_ADDR A:0xe613f98
y.create.l HWIO_PMIC_ARB_OBS1_CHNL128_RDATA0_ADDR A:0xe614018
y.create.l HWIO_PMIC_ARB_OBS1_CHNL129_RDATA0_ADDR A:0xe614098
y.create.l HWIO_PMIC_ARB_OBS1_CHNL130_RDATA0_ADDR A:0xe614118
y.create.l HWIO_PMIC_ARB_OBS1_CHNL131_RDATA0_ADDR A:0xe614198
y.create.l HWIO_PMIC_ARB_OBS1_CHNL132_RDATA0_ADDR A:0xe614218
y.create.l HWIO_PMIC_ARB_OBS1_CHNL133_RDATA0_ADDR A:0xe614298
y.create.l HWIO_PMIC_ARB_OBS1_CHNL134_RDATA0_ADDR A:0xe614318
y.create.l HWIO_PMIC_ARB_OBS1_CHNL135_RDATA0_ADDR A:0xe614398
y.create.l HWIO_PMIC_ARB_OBS1_CHNL136_RDATA0_ADDR A:0xe614418
y.create.l HWIO_PMIC_ARB_OBS1_CHNL137_RDATA0_ADDR A:0xe614498
y.create.l HWIO_PMIC_ARB_OBS1_CHNL138_RDATA0_ADDR A:0xe614518
y.create.l HWIO_PMIC_ARB_OBS1_CHNL139_RDATA0_ADDR A:0xe614598
y.create.l HWIO_PMIC_ARB_OBS1_CHNL140_RDATA0_ADDR A:0xe614618
y.create.l HWIO_PMIC_ARB_OBS1_CHNL141_RDATA0_ADDR A:0xe614698
y.create.l HWIO_PMIC_ARB_OBS1_CHNL142_RDATA0_ADDR A:0xe614718
y.create.l HWIO_PMIC_ARB_OBS1_CHNL143_RDATA0_ADDR A:0xe614798
y.create.l HWIO_PMIC_ARB_OBS1_CHNL144_RDATA0_ADDR A:0xe614818
y.create.l HWIO_PMIC_ARB_OBS1_CHNL145_RDATA0_ADDR A:0xe614898
y.create.l HWIO_PMIC_ARB_OBS1_CHNL146_RDATA0_ADDR A:0xe614918
y.create.l HWIO_PMIC_ARB_OBS1_CHNL147_RDATA0_ADDR A:0xe614998
y.create.l HWIO_PMIC_ARB_OBS1_CHNL148_RDATA0_ADDR A:0xe614a18
y.create.l HWIO_PMIC_ARB_OBS1_CHNL149_RDATA0_ADDR A:0xe614a98
y.create.l HWIO_PMIC_ARB_OBS1_CHNL150_RDATA0_ADDR A:0xe614b18
y.create.l HWIO_PMIC_ARB_OBS1_CHNL151_RDATA0_ADDR A:0xe614b98
y.create.l HWIO_PMIC_ARB_OBS1_CHNL152_RDATA0_ADDR A:0xe614c18
y.create.l HWIO_PMIC_ARB_OBS1_CHNL153_RDATA0_ADDR A:0xe614c98
y.create.l HWIO_PMIC_ARB_OBS1_CHNL154_RDATA0_ADDR A:0xe614d18
y.create.l HWIO_PMIC_ARB_OBS1_CHNL155_RDATA0_ADDR A:0xe614d98
y.create.l HWIO_PMIC_ARB_OBS1_CHNL156_RDATA0_ADDR A:0xe614e18
y.create.l HWIO_PMIC_ARB_OBS1_CHNL157_RDATA0_ADDR A:0xe614e98
y.create.l HWIO_PMIC_ARB_OBS1_CHNL158_RDATA0_ADDR A:0xe614f18
y.create.l HWIO_PMIC_ARB_OBS1_CHNL159_RDATA0_ADDR A:0xe614f98
y.create.l HWIO_PMIC_ARB_OBS1_CHNL160_RDATA0_ADDR A:0xe615018
y.create.l HWIO_PMIC_ARB_OBS1_CHNL161_RDATA0_ADDR A:0xe615098
y.create.l HWIO_PMIC_ARB_OBS1_CHNL162_RDATA0_ADDR A:0xe615118
y.create.l HWIO_PMIC_ARB_OBS1_CHNL163_RDATA0_ADDR A:0xe615198
y.create.l HWIO_PMIC_ARB_OBS1_CHNL164_RDATA0_ADDR A:0xe615218
y.create.l HWIO_PMIC_ARB_OBS1_CHNL165_RDATA0_ADDR A:0xe615298
y.create.l HWIO_PMIC_ARB_OBS1_CHNL166_RDATA0_ADDR A:0xe615318
y.create.l HWIO_PMIC_ARB_OBS1_CHNL167_RDATA0_ADDR A:0xe615398
y.create.l HWIO_PMIC_ARB_OBS1_CHNL168_RDATA0_ADDR A:0xe615418
y.create.l HWIO_PMIC_ARB_OBS1_CHNL169_RDATA0_ADDR A:0xe615498
y.create.l HWIO_PMIC_ARB_OBS1_CHNL170_RDATA0_ADDR A:0xe615518
y.create.l HWIO_PMIC_ARB_OBS1_CHNL171_RDATA0_ADDR A:0xe615598
y.create.l HWIO_PMIC_ARB_OBS1_CHNL172_RDATA0_ADDR A:0xe615618
y.create.l HWIO_PMIC_ARB_OBS1_CHNL173_RDATA0_ADDR A:0xe615698
y.create.l HWIO_PMIC_ARB_OBS1_CHNL174_RDATA0_ADDR A:0xe615718
y.create.l HWIO_PMIC_ARB_OBS1_CHNL175_RDATA0_ADDR A:0xe615798
y.create.l HWIO_PMIC_ARB_OBS1_CHNL176_RDATA0_ADDR A:0xe615818
y.create.l HWIO_PMIC_ARB_OBS1_CHNL177_RDATA0_ADDR A:0xe615898
y.create.l HWIO_PMIC_ARB_OBS1_CHNL178_RDATA0_ADDR A:0xe615918
y.create.l HWIO_PMIC_ARB_OBS1_CHNL179_RDATA0_ADDR A:0xe615998
y.create.l HWIO_PMIC_ARB_OBS1_CHNL180_RDATA0_ADDR A:0xe615a18
y.create.l HWIO_PMIC_ARB_OBS1_CHNL181_RDATA0_ADDR A:0xe615a98
y.create.l HWIO_PMIC_ARB_OBS1_CHNL182_RDATA0_ADDR A:0xe615b18
y.create.l HWIO_PMIC_ARB_OBS1_CHNL183_RDATA0_ADDR A:0xe615b98
y.create.l HWIO_PMIC_ARB_OBS1_CHNL184_RDATA0_ADDR A:0xe615c18
y.create.l HWIO_PMIC_ARB_OBS1_CHNL185_RDATA0_ADDR A:0xe615c98
y.create.l HWIO_PMIC_ARB_OBS1_CHNL186_RDATA0_ADDR A:0xe615d18
y.create.l HWIO_PMIC_ARB_OBS1_CHNL187_RDATA0_ADDR A:0xe615d98
y.create.l HWIO_PMIC_ARB_OBS1_CHNL188_RDATA0_ADDR A:0xe615e18
y.create.l HWIO_PMIC_ARB_OBS1_CHNL189_RDATA0_ADDR A:0xe615e98
y.create.l HWIO_PMIC_ARB_OBS1_CHNL190_RDATA0_ADDR A:0xe615f18
y.create.l HWIO_PMIC_ARB_OBS1_CHNL191_RDATA0_ADDR A:0xe615f98
y.create.l HWIO_PMIC_ARB_OBS1_CHNL192_RDATA0_ADDR A:0xe616018
y.create.l HWIO_PMIC_ARB_OBS1_CHNL193_RDATA0_ADDR A:0xe616098
y.create.l HWIO_PMIC_ARB_OBS1_CHNL194_RDATA0_ADDR A:0xe616118
y.create.l HWIO_PMIC_ARB_OBS1_CHNL195_RDATA0_ADDR A:0xe616198
y.create.l HWIO_PMIC_ARB_OBS1_CHNL196_RDATA0_ADDR A:0xe616218
y.create.l HWIO_PMIC_ARB_OBS1_CHNL197_RDATA0_ADDR A:0xe616298
y.create.l HWIO_PMIC_ARB_OBS1_CHNL198_RDATA0_ADDR A:0xe616318
y.create.l HWIO_PMIC_ARB_OBS1_CHNL199_RDATA0_ADDR A:0xe616398
y.create.l HWIO_PMIC_ARB_OBS1_CHNL200_RDATA0_ADDR A:0xe616418
y.create.l HWIO_PMIC_ARB_OBS1_CHNL201_RDATA0_ADDR A:0xe616498
y.create.l HWIO_PMIC_ARB_OBS1_CHNL202_RDATA0_ADDR A:0xe616518
y.create.l HWIO_PMIC_ARB_OBS1_CHNL203_RDATA0_ADDR A:0xe616598
y.create.l HWIO_PMIC_ARB_OBS1_CHNL204_RDATA0_ADDR A:0xe616618
y.create.l HWIO_PMIC_ARB_OBS1_CHNL205_RDATA0_ADDR A:0xe616698
y.create.l HWIO_PMIC_ARB_OBS1_CHNL206_RDATA0_ADDR A:0xe616718
y.create.l HWIO_PMIC_ARB_OBS1_CHNL207_RDATA0_ADDR A:0xe616798
y.create.l HWIO_PMIC_ARB_OBS1_CHNL208_RDATA0_ADDR A:0xe616818
y.create.l HWIO_PMIC_ARB_OBS1_CHNL209_RDATA0_ADDR A:0xe616898
y.create.l HWIO_PMIC_ARB_OBS1_CHNL210_RDATA0_ADDR A:0xe616918
y.create.l HWIO_PMIC_ARB_OBS1_CHNL211_RDATA0_ADDR A:0xe616998
y.create.l HWIO_PMIC_ARB_OBS1_CHNL212_RDATA0_ADDR A:0xe616a18
y.create.l HWIO_PMIC_ARB_OBS1_CHNL213_RDATA0_ADDR A:0xe616a98
y.create.l HWIO_PMIC_ARB_OBS1_CHNL214_RDATA0_ADDR A:0xe616b18
y.create.l HWIO_PMIC_ARB_OBS1_CHNL215_RDATA0_ADDR A:0xe616b98
y.create.l HWIO_PMIC_ARB_OBS1_CHNL216_RDATA0_ADDR A:0xe616c18
y.create.l HWIO_PMIC_ARB_OBS1_CHNL217_RDATA0_ADDR A:0xe616c98
y.create.l HWIO_PMIC_ARB_OBS1_CHNL218_RDATA0_ADDR A:0xe616d18
y.create.l HWIO_PMIC_ARB_OBS1_CHNL219_RDATA0_ADDR A:0xe616d98
y.create.l HWIO_PMIC_ARB_OBS1_CHNL220_RDATA0_ADDR A:0xe616e18
y.create.l HWIO_PMIC_ARB_OBS1_CHNL221_RDATA0_ADDR A:0xe616e98
y.create.l HWIO_PMIC_ARB_OBS1_CHNL222_RDATA0_ADDR A:0xe616f18
y.create.l HWIO_PMIC_ARB_OBS1_CHNL223_RDATA0_ADDR A:0xe616f98
y.create.l HWIO_PMIC_ARB_OBS1_CHNL224_RDATA0_ADDR A:0xe617018
y.create.l HWIO_PMIC_ARB_OBS1_CHNL225_RDATA0_ADDR A:0xe617098
y.create.l HWIO_PMIC_ARB_OBS1_CHNL226_RDATA0_ADDR A:0xe617118
y.create.l HWIO_PMIC_ARB_OBS1_CHNL227_RDATA0_ADDR A:0xe617198
y.create.l HWIO_PMIC_ARB_OBS1_CHNL228_RDATA0_ADDR A:0xe617218
y.create.l HWIO_PMIC_ARB_OBS1_CHNL229_RDATA0_ADDR A:0xe617298
y.create.l HWIO_PMIC_ARB_OBS1_CHNL230_RDATA0_ADDR A:0xe617318
y.create.l HWIO_PMIC_ARB_OBS1_CHNL231_RDATA0_ADDR A:0xe617398
y.create.l HWIO_PMIC_ARB_OBS1_CHNL232_RDATA0_ADDR A:0xe617418
y.create.l HWIO_PMIC_ARB_OBS1_CHNL233_RDATA0_ADDR A:0xe617498
y.create.l HWIO_PMIC_ARB_OBS1_CHNL234_RDATA0_ADDR A:0xe617518
y.create.l HWIO_PMIC_ARB_OBS1_CHNL235_RDATA0_ADDR A:0xe617598
y.create.l HWIO_PMIC_ARB_OBS1_CHNL236_RDATA0_ADDR A:0xe617618
y.create.l HWIO_PMIC_ARB_OBS1_CHNL237_RDATA0_ADDR A:0xe617698
y.create.l HWIO_PMIC_ARB_OBS1_CHNL238_RDATA0_ADDR A:0xe617718
y.create.l HWIO_PMIC_ARB_OBS1_CHNL239_RDATA0_ADDR A:0xe617798
y.create.l HWIO_PMIC_ARB_OBS1_CHNL240_RDATA0_ADDR A:0xe617818
y.create.l HWIO_PMIC_ARB_OBS1_CHNL241_RDATA0_ADDR A:0xe617898
y.create.l HWIO_PMIC_ARB_OBS1_CHNL242_RDATA0_ADDR A:0xe617918
y.create.l HWIO_PMIC_ARB_OBS1_CHNL243_RDATA0_ADDR A:0xe617998
y.create.l HWIO_PMIC_ARB_OBS1_CHNL244_RDATA0_ADDR A:0xe617a18
y.create.l HWIO_PMIC_ARB_OBS1_CHNL245_RDATA0_ADDR A:0xe617a98
y.create.l HWIO_PMIC_ARB_OBS1_CHNL246_RDATA0_ADDR A:0xe617b18
y.create.l HWIO_PMIC_ARB_OBS1_CHNL247_RDATA0_ADDR A:0xe617b98
y.create.l HWIO_PMIC_ARB_OBS1_CHNL248_RDATA0_ADDR A:0xe617c18
y.create.l HWIO_PMIC_ARB_OBS1_CHNL249_RDATA0_ADDR A:0xe617c98
y.create.l HWIO_PMIC_ARB_OBS1_CHNL250_RDATA0_ADDR A:0xe617d18
y.create.l HWIO_PMIC_ARB_OBS1_CHNL251_RDATA0_ADDR A:0xe617d98
y.create.l HWIO_PMIC_ARB_OBS1_CHNL252_RDATA0_ADDR A:0xe617e18
y.create.l HWIO_PMIC_ARB_OBS1_CHNL253_RDATA0_ADDR A:0xe617e98
y.create.l HWIO_PMIC_ARB_OBS1_CHNL254_RDATA0_ADDR A:0xe617f18
y.create.l HWIO_PMIC_ARB_OBS1_CHNL255_RDATA0_ADDR A:0xe617f98
y.create.l HWIO_PMIC_ARB_OBS1_CHNL256_RDATA0_ADDR A:0xe618018
y.create.l HWIO_PMIC_ARB_OBS1_CHNL257_RDATA0_ADDR A:0xe618098
y.create.l HWIO_PMIC_ARB_OBS1_CHNL258_RDATA0_ADDR A:0xe618118
y.create.l HWIO_PMIC_ARB_OBS1_CHNL259_RDATA0_ADDR A:0xe618198
y.create.l HWIO_PMIC_ARB_OBS1_CHNL260_RDATA0_ADDR A:0xe618218
y.create.l HWIO_PMIC_ARB_OBS1_CHNL261_RDATA0_ADDR A:0xe618298
y.create.l HWIO_PMIC_ARB_OBS1_CHNL262_RDATA0_ADDR A:0xe618318
y.create.l HWIO_PMIC_ARB_OBS1_CHNL263_RDATA0_ADDR A:0xe618398
y.create.l HWIO_PMIC_ARB_OBS1_CHNL264_RDATA0_ADDR A:0xe618418
y.create.l HWIO_PMIC_ARB_OBS1_CHNL265_RDATA0_ADDR A:0xe618498
y.create.l HWIO_PMIC_ARB_OBS1_CHNL266_RDATA0_ADDR A:0xe618518
y.create.l HWIO_PMIC_ARB_OBS1_CHNL267_RDATA0_ADDR A:0xe618598
y.create.l HWIO_PMIC_ARB_OBS1_CHNL268_RDATA0_ADDR A:0xe618618
y.create.l HWIO_PMIC_ARB_OBS1_CHNL269_RDATA0_ADDR A:0xe618698
y.create.l HWIO_PMIC_ARB_OBS1_CHNL270_RDATA0_ADDR A:0xe618718
y.create.l HWIO_PMIC_ARB_OBS1_CHNL271_RDATA0_ADDR A:0xe618798
y.create.l HWIO_PMIC_ARB_OBS1_CHNL272_RDATA0_ADDR A:0xe618818
y.create.l HWIO_PMIC_ARB_OBS1_CHNL273_RDATA0_ADDR A:0xe618898
y.create.l HWIO_PMIC_ARB_OBS1_CHNL274_RDATA0_ADDR A:0xe618918
y.create.l HWIO_PMIC_ARB_OBS1_CHNL275_RDATA0_ADDR A:0xe618998
y.create.l HWIO_PMIC_ARB_OBS1_CHNL276_RDATA0_ADDR A:0xe618a18
y.create.l HWIO_PMIC_ARB_OBS1_CHNL277_RDATA0_ADDR A:0xe618a98
y.create.l HWIO_PMIC_ARB_OBS1_CHNL278_RDATA0_ADDR A:0xe618b18
y.create.l HWIO_PMIC_ARB_OBS1_CHNL279_RDATA0_ADDR A:0xe618b98
y.create.l HWIO_PMIC_ARB_OBS1_CHNL280_RDATA0_ADDR A:0xe618c18
y.create.l HWIO_PMIC_ARB_OBS1_CHNL281_RDATA0_ADDR A:0xe618c98
y.create.l HWIO_PMIC_ARB_OBS1_CHNL282_RDATA0_ADDR A:0xe618d18
y.create.l HWIO_PMIC_ARB_OBS1_CHNL283_RDATA0_ADDR A:0xe618d98
y.create.l HWIO_PMIC_ARB_OBS1_CHNL284_RDATA0_ADDR A:0xe618e18
y.create.l HWIO_PMIC_ARB_OBS1_CHNL285_RDATA0_ADDR A:0xe618e98
y.create.l HWIO_PMIC_ARB_OBS1_CHNL286_RDATA0_ADDR A:0xe618f18
y.create.l HWIO_PMIC_ARB_OBS1_CHNL287_RDATA0_ADDR A:0xe618f98
y.create.l HWIO_PMIC_ARB_OBS1_CHNL288_RDATA0_ADDR A:0xe619018
y.create.l HWIO_PMIC_ARB_OBS1_CHNL289_RDATA0_ADDR A:0xe619098
y.create.l HWIO_PMIC_ARB_OBS1_CHNL290_RDATA0_ADDR A:0xe619118
y.create.l HWIO_PMIC_ARB_OBS1_CHNL291_RDATA0_ADDR A:0xe619198
y.create.l HWIO_PMIC_ARB_OBS1_CHNL292_RDATA0_ADDR A:0xe619218
y.create.l HWIO_PMIC_ARB_OBS1_CHNL293_RDATA0_ADDR A:0xe619298
y.create.l HWIO_PMIC_ARB_OBS1_CHNL294_RDATA0_ADDR A:0xe619318
y.create.l HWIO_PMIC_ARB_OBS1_CHNL295_RDATA0_ADDR A:0xe619398
y.create.l HWIO_PMIC_ARB_OBS1_CHNL296_RDATA0_ADDR A:0xe619418
y.create.l HWIO_PMIC_ARB_OBS1_CHNL297_RDATA0_ADDR A:0xe619498
y.create.l HWIO_PMIC_ARB_OBS1_CHNL298_RDATA0_ADDR A:0xe619518
y.create.l HWIO_PMIC_ARB_OBS1_CHNL299_RDATA0_ADDR A:0xe619598
y.create.l HWIO_PMIC_ARB_OBS1_CHNL300_RDATA0_ADDR A:0xe619618
y.create.l HWIO_PMIC_ARB_OBS1_CHNL301_RDATA0_ADDR A:0xe619698
y.create.l HWIO_PMIC_ARB_OBS1_CHNL302_RDATA0_ADDR A:0xe619718
y.create.l HWIO_PMIC_ARB_OBS1_CHNL303_RDATA0_ADDR A:0xe619798
y.create.l HWIO_PMIC_ARB_OBS1_CHNL304_RDATA0_ADDR A:0xe619818
y.create.l HWIO_PMIC_ARB_OBS1_CHNL305_RDATA0_ADDR A:0xe619898
y.create.l HWIO_PMIC_ARB_OBS1_CHNL306_RDATA0_ADDR A:0xe619918
y.create.l HWIO_PMIC_ARB_OBS1_CHNL307_RDATA0_ADDR A:0xe619998
y.create.l HWIO_PMIC_ARB_OBS1_CHNL308_RDATA0_ADDR A:0xe619a18
y.create.l HWIO_PMIC_ARB_OBS1_CHNL309_RDATA0_ADDR A:0xe619a98
y.create.l HWIO_PMIC_ARB_OBS1_CHNL310_RDATA0_ADDR A:0xe619b18
y.create.l HWIO_PMIC_ARB_OBS1_CHNL311_RDATA0_ADDR A:0xe619b98
y.create.l HWIO_PMIC_ARB_OBS1_CHNL312_RDATA0_ADDR A:0xe619c18
y.create.l HWIO_PMIC_ARB_OBS1_CHNL313_RDATA0_ADDR A:0xe619c98
y.create.l HWIO_PMIC_ARB_OBS1_CHNL314_RDATA0_ADDR A:0xe619d18
y.create.l HWIO_PMIC_ARB_OBS1_CHNL315_RDATA0_ADDR A:0xe619d98
y.create.l HWIO_PMIC_ARB_OBS1_CHNL316_RDATA0_ADDR A:0xe619e18
y.create.l HWIO_PMIC_ARB_OBS1_CHNL317_RDATA0_ADDR A:0xe619e98
y.create.l HWIO_PMIC_ARB_OBS1_CHNL318_RDATA0_ADDR A:0xe619f18
y.create.l HWIO_PMIC_ARB_OBS1_CHNL319_RDATA0_ADDR A:0xe619f98
y.create.l HWIO_PMIC_ARB_OBS1_CHNL320_RDATA0_ADDR A:0xe61a018
y.create.l HWIO_PMIC_ARB_OBS1_CHNL321_RDATA0_ADDR A:0xe61a098
y.create.l HWIO_PMIC_ARB_OBS1_CHNL322_RDATA0_ADDR A:0xe61a118
y.create.l HWIO_PMIC_ARB_OBS1_CHNL323_RDATA0_ADDR A:0xe61a198
y.create.l HWIO_PMIC_ARB_OBS1_CHNL324_RDATA0_ADDR A:0xe61a218
y.create.l HWIO_PMIC_ARB_OBS1_CHNL325_RDATA0_ADDR A:0xe61a298
y.create.l HWIO_PMIC_ARB_OBS1_CHNL326_RDATA0_ADDR A:0xe61a318
y.create.l HWIO_PMIC_ARB_OBS1_CHNL327_RDATA0_ADDR A:0xe61a398
y.create.l HWIO_PMIC_ARB_OBS1_CHNL328_RDATA0_ADDR A:0xe61a418
y.create.l HWIO_PMIC_ARB_OBS1_CHNL329_RDATA0_ADDR A:0xe61a498
y.create.l HWIO_PMIC_ARB_OBS1_CHNL330_RDATA0_ADDR A:0xe61a518
y.create.l HWIO_PMIC_ARB_OBS1_CHNL331_RDATA0_ADDR A:0xe61a598
y.create.l HWIO_PMIC_ARB_OBS1_CHNL332_RDATA0_ADDR A:0xe61a618
y.create.l HWIO_PMIC_ARB_OBS1_CHNL333_RDATA0_ADDR A:0xe61a698
y.create.l HWIO_PMIC_ARB_OBS1_CHNL334_RDATA0_ADDR A:0xe61a718
y.create.l HWIO_PMIC_ARB_OBS1_CHNL335_RDATA0_ADDR A:0xe61a798
y.create.l HWIO_PMIC_ARB_OBS1_CHNL336_RDATA0_ADDR A:0xe61a818
y.create.l HWIO_PMIC_ARB_OBS1_CHNL337_RDATA0_ADDR A:0xe61a898
y.create.l HWIO_PMIC_ARB_OBS1_CHNL338_RDATA0_ADDR A:0xe61a918
y.create.l HWIO_PMIC_ARB_OBS1_CHNL339_RDATA0_ADDR A:0xe61a998
y.create.l HWIO_PMIC_ARB_OBS1_CHNL340_RDATA0_ADDR A:0xe61aa18
y.create.l HWIO_PMIC_ARB_OBS1_CHNL341_RDATA0_ADDR A:0xe61aa98
y.create.l HWIO_PMIC_ARB_OBS1_CHNL342_RDATA0_ADDR A:0xe61ab18
y.create.l HWIO_PMIC_ARB_OBS1_CHNL343_RDATA0_ADDR A:0xe61ab98
y.create.l HWIO_PMIC_ARB_OBS1_CHNL344_RDATA0_ADDR A:0xe61ac18
y.create.l HWIO_PMIC_ARB_OBS1_CHNL345_RDATA0_ADDR A:0xe61ac98
y.create.l HWIO_PMIC_ARB_OBS1_CHNL346_RDATA0_ADDR A:0xe61ad18
y.create.l HWIO_PMIC_ARB_OBS1_CHNL347_RDATA0_ADDR A:0xe61ad98
y.create.l HWIO_PMIC_ARB_OBS1_CHNL348_RDATA0_ADDR A:0xe61ae18
y.create.l HWIO_PMIC_ARB_OBS1_CHNL349_RDATA0_ADDR A:0xe61ae98
y.create.l HWIO_PMIC_ARB_OBS1_CHNL350_RDATA0_ADDR A:0xe61af18
y.create.l HWIO_PMIC_ARB_OBS1_CHNL351_RDATA0_ADDR A:0xe61af98
y.create.l HWIO_PMIC_ARB_OBS1_CHNL352_RDATA0_ADDR A:0xe61b018
y.create.l HWIO_PMIC_ARB_OBS1_CHNL353_RDATA0_ADDR A:0xe61b098
y.create.l HWIO_PMIC_ARB_OBS1_CHNL354_RDATA0_ADDR A:0xe61b118
y.create.l HWIO_PMIC_ARB_OBS1_CHNL355_RDATA0_ADDR A:0xe61b198
y.create.l HWIO_PMIC_ARB_OBS1_CHNL356_RDATA0_ADDR A:0xe61b218
y.create.l HWIO_PMIC_ARB_OBS1_CHNL357_RDATA0_ADDR A:0xe61b298
y.create.l HWIO_PMIC_ARB_OBS1_CHNL358_RDATA0_ADDR A:0xe61b318
y.create.l HWIO_PMIC_ARB_OBS1_CHNL359_RDATA0_ADDR A:0xe61b398
y.create.l HWIO_PMIC_ARB_OBS1_CHNL360_RDATA0_ADDR A:0xe61b418
y.create.l HWIO_PMIC_ARB_OBS1_CHNL361_RDATA0_ADDR A:0xe61b498
y.create.l HWIO_PMIC_ARB_OBS1_CHNL362_RDATA0_ADDR A:0xe61b518
y.create.l HWIO_PMIC_ARB_OBS1_CHNL363_RDATA0_ADDR A:0xe61b598
y.create.l HWIO_PMIC_ARB_OBS1_CHNL364_RDATA0_ADDR A:0xe61b618
y.create.l HWIO_PMIC_ARB_OBS1_CHNL365_RDATA0_ADDR A:0xe61b698
y.create.l HWIO_PMIC_ARB_OBS1_CHNL366_RDATA0_ADDR A:0xe61b718
y.create.l HWIO_PMIC_ARB_OBS1_CHNL367_RDATA0_ADDR A:0xe61b798
y.create.l HWIO_PMIC_ARB_OBS1_CHNL368_RDATA0_ADDR A:0xe61b818
y.create.l HWIO_PMIC_ARB_OBS1_CHNL369_RDATA0_ADDR A:0xe61b898
y.create.l HWIO_PMIC_ARB_OBS1_CHNL370_RDATA0_ADDR A:0xe61b918
y.create.l HWIO_PMIC_ARB_OBS1_CHNL371_RDATA0_ADDR A:0xe61b998
y.create.l HWIO_PMIC_ARB_OBS1_CHNL372_RDATA0_ADDR A:0xe61ba18
y.create.l HWIO_PMIC_ARB_OBS1_CHNL373_RDATA0_ADDR A:0xe61ba98
y.create.l HWIO_PMIC_ARB_OBS1_CHNL374_RDATA0_ADDR A:0xe61bb18
y.create.l HWIO_PMIC_ARB_OBS1_CHNL375_RDATA0_ADDR A:0xe61bb98
y.create.l HWIO_PMIC_ARB_OBS1_CHNL376_RDATA0_ADDR A:0xe61bc18
y.create.l HWIO_PMIC_ARB_OBS1_CHNL377_RDATA0_ADDR A:0xe61bc98
y.create.l HWIO_PMIC_ARB_OBS1_CHNL378_RDATA0_ADDR A:0xe61bd18
y.create.l HWIO_PMIC_ARB_OBS1_CHNL379_RDATA0_ADDR A:0xe61bd98
y.create.l HWIO_PMIC_ARB_OBS1_CHNL380_RDATA0_ADDR A:0xe61be18
y.create.l HWIO_PMIC_ARB_OBS1_CHNL381_RDATA0_ADDR A:0xe61be98
y.create.l HWIO_PMIC_ARB_OBS1_CHNL382_RDATA0_ADDR A:0xe61bf18
y.create.l HWIO_PMIC_ARB_OBS1_CHNL383_RDATA0_ADDR A:0xe61bf98
y.create.l HWIO_PMIC_ARB_OBS1_CHNL384_RDATA0_ADDR A:0xe61c018
y.create.l HWIO_PMIC_ARB_OBS1_CHNL385_RDATA0_ADDR A:0xe61c098
y.create.l HWIO_PMIC_ARB_OBS1_CHNL386_RDATA0_ADDR A:0xe61c118
y.create.l HWIO_PMIC_ARB_OBS1_CHNL387_RDATA0_ADDR A:0xe61c198
y.create.l HWIO_PMIC_ARB_OBS1_CHNL388_RDATA0_ADDR A:0xe61c218
y.create.l HWIO_PMIC_ARB_OBS1_CHNL389_RDATA0_ADDR A:0xe61c298
y.create.l HWIO_PMIC_ARB_OBS1_CHNL390_RDATA0_ADDR A:0xe61c318
y.create.l HWIO_PMIC_ARB_OBS1_CHNL391_RDATA0_ADDR A:0xe61c398
y.create.l HWIO_PMIC_ARB_OBS1_CHNL392_RDATA0_ADDR A:0xe61c418
y.create.l HWIO_PMIC_ARB_OBS1_CHNL393_RDATA0_ADDR A:0xe61c498
y.create.l HWIO_PMIC_ARB_OBS1_CHNL394_RDATA0_ADDR A:0xe61c518
y.create.l HWIO_PMIC_ARB_OBS1_CHNL395_RDATA0_ADDR A:0xe61c598
y.create.l HWIO_PMIC_ARB_OBS1_CHNL396_RDATA0_ADDR A:0xe61c618
y.create.l HWIO_PMIC_ARB_OBS1_CHNL397_RDATA0_ADDR A:0xe61c698
y.create.l HWIO_PMIC_ARB_OBS1_CHNL398_RDATA0_ADDR A:0xe61c718
y.create.l HWIO_PMIC_ARB_OBS1_CHNL399_RDATA0_ADDR A:0xe61c798
y.create.l HWIO_PMIC_ARB_OBS1_CHNL400_RDATA0_ADDR A:0xe61c818
y.create.l HWIO_PMIC_ARB_OBS1_CHNL401_RDATA0_ADDR A:0xe61c898
y.create.l HWIO_PMIC_ARB_OBS1_CHNL402_RDATA0_ADDR A:0xe61c918
y.create.l HWIO_PMIC_ARB_OBS1_CHNL403_RDATA0_ADDR A:0xe61c998
y.create.l HWIO_PMIC_ARB_OBS1_CHNL404_RDATA0_ADDR A:0xe61ca18
y.create.l HWIO_PMIC_ARB_OBS1_CHNL405_RDATA0_ADDR A:0xe61ca98
y.create.l HWIO_PMIC_ARB_OBS1_CHNL406_RDATA0_ADDR A:0xe61cb18
y.create.l HWIO_PMIC_ARB_OBS1_CHNL407_RDATA0_ADDR A:0xe61cb98
y.create.l HWIO_PMIC_ARB_OBS1_CHNL408_RDATA0_ADDR A:0xe61cc18
y.create.l HWIO_PMIC_ARB_OBS1_CHNL409_RDATA0_ADDR A:0xe61cc98
y.create.l HWIO_PMIC_ARB_OBS1_CHNL410_RDATA0_ADDR A:0xe61cd18
y.create.l HWIO_PMIC_ARB_OBS1_CHNL411_RDATA0_ADDR A:0xe61cd98
y.create.l HWIO_PMIC_ARB_OBS1_CHNL412_RDATA0_ADDR A:0xe61ce18
y.create.l HWIO_PMIC_ARB_OBS1_CHNL413_RDATA0_ADDR A:0xe61ce98
y.create.l HWIO_PMIC_ARB_OBS1_CHNL414_RDATA0_ADDR A:0xe61cf18
y.create.l HWIO_PMIC_ARB_OBS1_CHNL415_RDATA0_ADDR A:0xe61cf98
y.create.l HWIO_PMIC_ARB_OBS1_CHNL416_RDATA0_ADDR A:0xe61d018
y.create.l HWIO_PMIC_ARB_OBS1_CHNL417_RDATA0_ADDR A:0xe61d098
y.create.l HWIO_PMIC_ARB_OBS1_CHNL418_RDATA0_ADDR A:0xe61d118
y.create.l HWIO_PMIC_ARB_OBS1_CHNL419_RDATA0_ADDR A:0xe61d198
y.create.l HWIO_PMIC_ARB_OBS1_CHNL420_RDATA0_ADDR A:0xe61d218
y.create.l HWIO_PMIC_ARB_OBS1_CHNL421_RDATA0_ADDR A:0xe61d298
y.create.l HWIO_PMIC_ARB_OBS1_CHNL422_RDATA0_ADDR A:0xe61d318
y.create.l HWIO_PMIC_ARB_OBS1_CHNL423_RDATA0_ADDR A:0xe61d398
y.create.l HWIO_PMIC_ARB_OBS1_CHNL424_RDATA0_ADDR A:0xe61d418
y.create.l HWIO_PMIC_ARB_OBS1_CHNL425_RDATA0_ADDR A:0xe61d498
y.create.l HWIO_PMIC_ARB_OBS1_CHNL426_RDATA0_ADDR A:0xe61d518
y.create.l HWIO_PMIC_ARB_OBS1_CHNL427_RDATA0_ADDR A:0xe61d598
y.create.l HWIO_PMIC_ARB_OBS1_CHNL428_RDATA0_ADDR A:0xe61d618
y.create.l HWIO_PMIC_ARB_OBS1_CHNL429_RDATA0_ADDR A:0xe61d698
y.create.l HWIO_PMIC_ARB_OBS1_CHNL430_RDATA0_ADDR A:0xe61d718
y.create.l HWIO_PMIC_ARB_OBS1_CHNL431_RDATA0_ADDR A:0xe61d798
y.create.l HWIO_PMIC_ARB_OBS1_CHNL432_RDATA0_ADDR A:0xe61d818
y.create.l HWIO_PMIC_ARB_OBS1_CHNL433_RDATA0_ADDR A:0xe61d898
y.create.l HWIO_PMIC_ARB_OBS1_CHNL434_RDATA0_ADDR A:0xe61d918
y.create.l HWIO_PMIC_ARB_OBS1_CHNL435_RDATA0_ADDR A:0xe61d998
y.create.l HWIO_PMIC_ARB_OBS1_CHNL436_RDATA0_ADDR A:0xe61da18
y.create.l HWIO_PMIC_ARB_OBS1_CHNL437_RDATA0_ADDR A:0xe61da98
y.create.l HWIO_PMIC_ARB_OBS1_CHNL438_RDATA0_ADDR A:0xe61db18
y.create.l HWIO_PMIC_ARB_OBS1_CHNL439_RDATA0_ADDR A:0xe61db98
y.create.l HWIO_PMIC_ARB_OBS1_CHNL440_RDATA0_ADDR A:0xe61dc18
y.create.l HWIO_PMIC_ARB_OBS1_CHNL441_RDATA0_ADDR A:0xe61dc98
y.create.l HWIO_PMIC_ARB_OBS1_CHNL442_RDATA0_ADDR A:0xe61dd18
y.create.l HWIO_PMIC_ARB_OBS1_CHNL443_RDATA0_ADDR A:0xe61dd98
y.create.l HWIO_PMIC_ARB_OBS1_CHNL444_RDATA0_ADDR A:0xe61de18
y.create.l HWIO_PMIC_ARB_OBS1_CHNL445_RDATA0_ADDR A:0xe61de98
y.create.l HWIO_PMIC_ARB_OBS1_CHNL446_RDATA0_ADDR A:0xe61df18
y.create.l HWIO_PMIC_ARB_OBS1_CHNL447_RDATA0_ADDR A:0xe61df98
y.create.l HWIO_PMIC_ARB_OBS1_CHNL448_RDATA0_ADDR A:0xe61e018
y.create.l HWIO_PMIC_ARB_OBS1_CHNL449_RDATA0_ADDR A:0xe61e098
y.create.l HWIO_PMIC_ARB_OBS1_CHNL450_RDATA0_ADDR A:0xe61e118
y.create.l HWIO_PMIC_ARB_OBS1_CHNL451_RDATA0_ADDR A:0xe61e198
y.create.l HWIO_PMIC_ARB_OBS1_CHNL452_RDATA0_ADDR A:0xe61e218
y.create.l HWIO_PMIC_ARB_OBS1_CHNL453_RDATA0_ADDR A:0xe61e298
y.create.l HWIO_PMIC_ARB_OBS1_CHNL454_RDATA0_ADDR A:0xe61e318
y.create.l HWIO_PMIC_ARB_OBS1_CHNL455_RDATA0_ADDR A:0xe61e398
y.create.l HWIO_PMIC_ARB_OBS1_CHNL456_RDATA0_ADDR A:0xe61e418
y.create.l HWIO_PMIC_ARB_OBS1_CHNL457_RDATA0_ADDR A:0xe61e498
y.create.l HWIO_PMIC_ARB_OBS1_CHNL458_RDATA0_ADDR A:0xe61e518
y.create.l HWIO_PMIC_ARB_OBS1_CHNL459_RDATA0_ADDR A:0xe61e598
y.create.l HWIO_PMIC_ARB_OBS1_CHNL460_RDATA0_ADDR A:0xe61e618
y.create.l HWIO_PMIC_ARB_OBS1_CHNL461_RDATA0_ADDR A:0xe61e698
y.create.l HWIO_PMIC_ARB_OBS1_CHNL462_RDATA0_ADDR A:0xe61e718
y.create.l HWIO_PMIC_ARB_OBS1_CHNL463_RDATA0_ADDR A:0xe61e798
y.create.l HWIO_PMIC_ARB_OBS1_CHNL464_RDATA0_ADDR A:0xe61e818
y.create.l HWIO_PMIC_ARB_OBS1_CHNL465_RDATA0_ADDR A:0xe61e898
y.create.l HWIO_PMIC_ARB_OBS1_CHNL466_RDATA0_ADDR A:0xe61e918
y.create.l HWIO_PMIC_ARB_OBS1_CHNL467_RDATA0_ADDR A:0xe61e998
y.create.l HWIO_PMIC_ARB_OBS1_CHNL468_RDATA0_ADDR A:0xe61ea18
y.create.l HWIO_PMIC_ARB_OBS1_CHNL469_RDATA0_ADDR A:0xe61ea98
y.create.l HWIO_PMIC_ARB_OBS1_CHNL470_RDATA0_ADDR A:0xe61eb18
y.create.l HWIO_PMIC_ARB_OBS1_CHNL471_RDATA0_ADDR A:0xe61eb98
y.create.l HWIO_PMIC_ARB_OBS1_CHNL472_RDATA0_ADDR A:0xe61ec18
y.create.l HWIO_PMIC_ARB_OBS1_CHNL473_RDATA0_ADDR A:0xe61ec98
y.create.l HWIO_PMIC_ARB_OBS1_CHNL474_RDATA0_ADDR A:0xe61ed18
y.create.l HWIO_PMIC_ARB_OBS1_CHNL475_RDATA0_ADDR A:0xe61ed98
y.create.l HWIO_PMIC_ARB_OBS1_CHNL476_RDATA0_ADDR A:0xe61ee18
y.create.l HWIO_PMIC_ARB_OBS1_CHNL477_RDATA0_ADDR A:0xe61ee98
y.create.l HWIO_PMIC_ARB_OBS1_CHNL478_RDATA0_ADDR A:0xe61ef18
y.create.l HWIO_PMIC_ARB_OBS1_CHNL479_RDATA0_ADDR A:0xe61ef98
y.create.l HWIO_PMIC_ARB_OBS1_CHNL480_RDATA0_ADDR A:0xe61f018
y.create.l HWIO_PMIC_ARB_OBS1_CHNL481_RDATA0_ADDR A:0xe61f098
y.create.l HWIO_PMIC_ARB_OBS1_CHNL482_RDATA0_ADDR A:0xe61f118
y.create.l HWIO_PMIC_ARB_OBS1_CHNL483_RDATA0_ADDR A:0xe61f198
y.create.l HWIO_PMIC_ARB_OBS1_CHNL484_RDATA0_ADDR A:0xe61f218
y.create.l HWIO_PMIC_ARB_OBS1_CHNL485_RDATA0_ADDR A:0xe61f298
y.create.l HWIO_PMIC_ARB_OBS1_CHNL486_RDATA0_ADDR A:0xe61f318
y.create.l HWIO_PMIC_ARB_OBS1_CHNL487_RDATA0_ADDR A:0xe61f398
y.create.l HWIO_PMIC_ARB_OBS1_CHNL488_RDATA0_ADDR A:0xe61f418
y.create.l HWIO_PMIC_ARB_OBS1_CHNL489_RDATA0_ADDR A:0xe61f498
y.create.l HWIO_PMIC_ARB_OBS1_CHNL490_RDATA0_ADDR A:0xe61f518
y.create.l HWIO_PMIC_ARB_OBS1_CHNL491_RDATA0_ADDR A:0xe61f598
y.create.l HWIO_PMIC_ARB_OBS1_CHNL492_RDATA0_ADDR A:0xe61f618
y.create.l HWIO_PMIC_ARB_OBS1_CHNL493_RDATA0_ADDR A:0xe61f698
y.create.l HWIO_PMIC_ARB_OBS1_CHNL494_RDATA0_ADDR A:0xe61f718
y.create.l HWIO_PMIC_ARB_OBS1_CHNL495_RDATA0_ADDR A:0xe61f798
y.create.l HWIO_PMIC_ARB_OBS1_CHNL496_RDATA0_ADDR A:0xe61f818
y.create.l HWIO_PMIC_ARB_OBS1_CHNL497_RDATA0_ADDR A:0xe61f898
y.create.l HWIO_PMIC_ARB_OBS1_CHNL498_RDATA0_ADDR A:0xe61f918
y.create.l HWIO_PMIC_ARB_OBS1_CHNL499_RDATA0_ADDR A:0xe61f998
y.create.l HWIO_PMIC_ARB_OBS1_CHNL500_RDATA0_ADDR A:0xe61fa18
y.create.l HWIO_PMIC_ARB_OBS1_CHNL501_RDATA0_ADDR A:0xe61fa98
y.create.l HWIO_PMIC_ARB_OBS1_CHNL502_RDATA0_ADDR A:0xe61fb18
y.create.l HWIO_PMIC_ARB_OBS1_CHNL503_RDATA0_ADDR A:0xe61fb98
y.create.l HWIO_PMIC_ARB_OBS1_CHNL504_RDATA0_ADDR A:0xe61fc18
y.create.l HWIO_PMIC_ARB_OBS1_CHNL505_RDATA0_ADDR A:0xe61fc98
y.create.l HWIO_PMIC_ARB_OBS1_CHNL506_RDATA0_ADDR A:0xe61fd18
y.create.l HWIO_PMIC_ARB_OBS1_CHNL507_RDATA0_ADDR A:0xe61fd98
y.create.l HWIO_PMIC_ARB_OBS1_CHNL508_RDATA0_ADDR A:0xe61fe18
y.create.l HWIO_PMIC_ARB_OBS1_CHNL509_RDATA0_ADDR A:0xe61fe98
y.create.l HWIO_PMIC_ARB_OBS1_CHNL510_RDATA0_ADDR A:0xe61ff18
y.create.l HWIO_PMIC_ARB_OBS1_CHNL511_RDATA0_ADDR A:0xe61ff98
y.create.l HWIO_PMIC_ARB_OBS2_CHNL0_RDATA0_ADDR A:0xe620018
y.create.l HWIO_PMIC_ARB_OBS2_CHNL1_RDATA0_ADDR A:0xe620098
y.create.l HWIO_PMIC_ARB_OBS2_CHNL2_RDATA0_ADDR A:0xe620118
y.create.l HWIO_PMIC_ARB_OBS2_CHNL3_RDATA0_ADDR A:0xe620198
y.create.l HWIO_PMIC_ARB_OBS2_CHNL4_RDATA0_ADDR A:0xe620218
y.create.l HWIO_PMIC_ARB_OBS2_CHNL5_RDATA0_ADDR A:0xe620298
y.create.l HWIO_PMIC_ARB_OBS2_CHNL6_RDATA0_ADDR A:0xe620318
y.create.l HWIO_PMIC_ARB_OBS2_CHNL7_RDATA0_ADDR A:0xe620398
y.create.l HWIO_PMIC_ARB_OBS2_CHNL8_RDATA0_ADDR A:0xe620418
y.create.l HWIO_PMIC_ARB_OBS2_CHNL9_RDATA0_ADDR A:0xe620498
y.create.l HWIO_PMIC_ARB_OBS2_CHNL10_RDATA0_ADDR A:0xe620518
y.create.l HWIO_PMIC_ARB_OBS2_CHNL11_RDATA0_ADDR A:0xe620598
y.create.l HWIO_PMIC_ARB_OBS2_CHNL12_RDATA0_ADDR A:0xe620618
y.create.l HWIO_PMIC_ARB_OBS2_CHNL13_RDATA0_ADDR A:0xe620698
y.create.l HWIO_PMIC_ARB_OBS2_CHNL14_RDATA0_ADDR A:0xe620718
y.create.l HWIO_PMIC_ARB_OBS2_CHNL15_RDATA0_ADDR A:0xe620798
y.create.l HWIO_PMIC_ARB_OBS2_CHNL16_RDATA0_ADDR A:0xe620818
y.create.l HWIO_PMIC_ARB_OBS2_CHNL17_RDATA0_ADDR A:0xe620898
y.create.l HWIO_PMIC_ARB_OBS2_CHNL18_RDATA0_ADDR A:0xe620918
y.create.l HWIO_PMIC_ARB_OBS2_CHNL19_RDATA0_ADDR A:0xe620998
y.create.l HWIO_PMIC_ARB_OBS2_CHNL20_RDATA0_ADDR A:0xe620a18
y.create.l HWIO_PMIC_ARB_OBS2_CHNL21_RDATA0_ADDR A:0xe620a98
y.create.l HWIO_PMIC_ARB_OBS2_CHNL22_RDATA0_ADDR A:0xe620b18
y.create.l HWIO_PMIC_ARB_OBS2_CHNL23_RDATA0_ADDR A:0xe620b98
y.create.l HWIO_PMIC_ARB_OBS2_CHNL24_RDATA0_ADDR A:0xe620c18
y.create.l HWIO_PMIC_ARB_OBS2_CHNL25_RDATA0_ADDR A:0xe620c98
y.create.l HWIO_PMIC_ARB_OBS2_CHNL26_RDATA0_ADDR A:0xe620d18
y.create.l HWIO_PMIC_ARB_OBS2_CHNL27_RDATA0_ADDR A:0xe620d98
y.create.l HWIO_PMIC_ARB_OBS2_CHNL28_RDATA0_ADDR A:0xe620e18
y.create.l HWIO_PMIC_ARB_OBS2_CHNL29_RDATA0_ADDR A:0xe620e98
y.create.l HWIO_PMIC_ARB_OBS2_CHNL30_RDATA0_ADDR A:0xe620f18
y.create.l HWIO_PMIC_ARB_OBS2_CHNL31_RDATA0_ADDR A:0xe620f98
y.create.l HWIO_PMIC_ARB_OBS2_CHNL32_RDATA0_ADDR A:0xe621018
y.create.l HWIO_PMIC_ARB_OBS2_CHNL33_RDATA0_ADDR A:0xe621098
y.create.l HWIO_PMIC_ARB_OBS2_CHNL34_RDATA0_ADDR A:0xe621118
y.create.l HWIO_PMIC_ARB_OBS2_CHNL35_RDATA0_ADDR A:0xe621198
y.create.l HWIO_PMIC_ARB_OBS2_CHNL36_RDATA0_ADDR A:0xe621218
y.create.l HWIO_PMIC_ARB_OBS2_CHNL37_RDATA0_ADDR A:0xe621298
y.create.l HWIO_PMIC_ARB_OBS2_CHNL38_RDATA0_ADDR A:0xe621318
y.create.l HWIO_PMIC_ARB_OBS2_CHNL39_RDATA0_ADDR A:0xe621398
y.create.l HWIO_PMIC_ARB_OBS2_CHNL40_RDATA0_ADDR A:0xe621418
y.create.l HWIO_PMIC_ARB_OBS2_CHNL41_RDATA0_ADDR A:0xe621498
y.create.l HWIO_PMIC_ARB_OBS2_CHNL42_RDATA0_ADDR A:0xe621518
y.create.l HWIO_PMIC_ARB_OBS2_CHNL43_RDATA0_ADDR A:0xe621598
y.create.l HWIO_PMIC_ARB_OBS2_CHNL44_RDATA0_ADDR A:0xe621618
y.create.l HWIO_PMIC_ARB_OBS2_CHNL45_RDATA0_ADDR A:0xe621698
y.create.l HWIO_PMIC_ARB_OBS2_CHNL46_RDATA0_ADDR A:0xe621718
y.create.l HWIO_PMIC_ARB_OBS2_CHNL47_RDATA0_ADDR A:0xe621798
y.create.l HWIO_PMIC_ARB_OBS2_CHNL48_RDATA0_ADDR A:0xe621818
y.create.l HWIO_PMIC_ARB_OBS2_CHNL49_RDATA0_ADDR A:0xe621898
y.create.l HWIO_PMIC_ARB_OBS2_CHNL50_RDATA0_ADDR A:0xe621918
y.create.l HWIO_PMIC_ARB_OBS2_CHNL51_RDATA0_ADDR A:0xe621998
y.create.l HWIO_PMIC_ARB_OBS2_CHNL52_RDATA0_ADDR A:0xe621a18
y.create.l HWIO_PMIC_ARB_OBS2_CHNL53_RDATA0_ADDR A:0xe621a98
y.create.l HWIO_PMIC_ARB_OBS2_CHNL54_RDATA0_ADDR A:0xe621b18
y.create.l HWIO_PMIC_ARB_OBS2_CHNL55_RDATA0_ADDR A:0xe621b98
y.create.l HWIO_PMIC_ARB_OBS2_CHNL56_RDATA0_ADDR A:0xe621c18
y.create.l HWIO_PMIC_ARB_OBS2_CHNL57_RDATA0_ADDR A:0xe621c98
y.create.l HWIO_PMIC_ARB_OBS2_CHNL58_RDATA0_ADDR A:0xe621d18
y.create.l HWIO_PMIC_ARB_OBS2_CHNL59_RDATA0_ADDR A:0xe621d98
y.create.l HWIO_PMIC_ARB_OBS2_CHNL60_RDATA0_ADDR A:0xe621e18
y.create.l HWIO_PMIC_ARB_OBS2_CHNL61_RDATA0_ADDR A:0xe621e98
y.create.l HWIO_PMIC_ARB_OBS2_CHNL62_RDATA0_ADDR A:0xe621f18
y.create.l HWIO_PMIC_ARB_OBS2_CHNL63_RDATA0_ADDR A:0xe621f98
y.create.l HWIO_PMIC_ARB_OBS2_CHNL64_RDATA0_ADDR A:0xe622018
y.create.l HWIO_PMIC_ARB_OBS2_CHNL65_RDATA0_ADDR A:0xe622098
y.create.l HWIO_PMIC_ARB_OBS2_CHNL66_RDATA0_ADDR A:0xe622118
y.create.l HWIO_PMIC_ARB_OBS2_CHNL67_RDATA0_ADDR A:0xe622198
y.create.l HWIO_PMIC_ARB_OBS2_CHNL68_RDATA0_ADDR A:0xe622218
y.create.l HWIO_PMIC_ARB_OBS2_CHNL69_RDATA0_ADDR A:0xe622298
y.create.l HWIO_PMIC_ARB_OBS2_CHNL70_RDATA0_ADDR A:0xe622318
y.create.l HWIO_PMIC_ARB_OBS2_CHNL71_RDATA0_ADDR A:0xe622398
y.create.l HWIO_PMIC_ARB_OBS2_CHNL72_RDATA0_ADDR A:0xe622418
y.create.l HWIO_PMIC_ARB_OBS2_CHNL73_RDATA0_ADDR A:0xe622498
y.create.l HWIO_PMIC_ARB_OBS2_CHNL74_RDATA0_ADDR A:0xe622518
y.create.l HWIO_PMIC_ARB_OBS2_CHNL75_RDATA0_ADDR A:0xe622598
y.create.l HWIO_PMIC_ARB_OBS2_CHNL76_RDATA0_ADDR A:0xe622618
y.create.l HWIO_PMIC_ARB_OBS2_CHNL77_RDATA0_ADDR A:0xe622698
y.create.l HWIO_PMIC_ARB_OBS2_CHNL78_RDATA0_ADDR A:0xe622718
y.create.l HWIO_PMIC_ARB_OBS2_CHNL79_RDATA0_ADDR A:0xe622798
y.create.l HWIO_PMIC_ARB_OBS2_CHNL80_RDATA0_ADDR A:0xe622818
y.create.l HWIO_PMIC_ARB_OBS2_CHNL81_RDATA0_ADDR A:0xe622898
y.create.l HWIO_PMIC_ARB_OBS2_CHNL82_RDATA0_ADDR A:0xe622918
y.create.l HWIO_PMIC_ARB_OBS2_CHNL83_RDATA0_ADDR A:0xe622998
y.create.l HWIO_PMIC_ARB_OBS2_CHNL84_RDATA0_ADDR A:0xe622a18
y.create.l HWIO_PMIC_ARB_OBS2_CHNL85_RDATA0_ADDR A:0xe622a98
y.create.l HWIO_PMIC_ARB_OBS2_CHNL86_RDATA0_ADDR A:0xe622b18
y.create.l HWIO_PMIC_ARB_OBS2_CHNL87_RDATA0_ADDR A:0xe622b98
y.create.l HWIO_PMIC_ARB_OBS2_CHNL88_RDATA0_ADDR A:0xe622c18
y.create.l HWIO_PMIC_ARB_OBS2_CHNL89_RDATA0_ADDR A:0xe622c98
y.create.l HWIO_PMIC_ARB_OBS2_CHNL90_RDATA0_ADDR A:0xe622d18
y.create.l HWIO_PMIC_ARB_OBS2_CHNL91_RDATA0_ADDR A:0xe622d98
y.create.l HWIO_PMIC_ARB_OBS2_CHNL92_RDATA0_ADDR A:0xe622e18
y.create.l HWIO_PMIC_ARB_OBS2_CHNL93_RDATA0_ADDR A:0xe622e98
y.create.l HWIO_PMIC_ARB_OBS2_CHNL94_RDATA0_ADDR A:0xe622f18
y.create.l HWIO_PMIC_ARB_OBS2_CHNL95_RDATA0_ADDR A:0xe622f98
y.create.l HWIO_PMIC_ARB_OBS2_CHNL96_RDATA0_ADDR A:0xe623018
y.create.l HWIO_PMIC_ARB_OBS2_CHNL97_RDATA0_ADDR A:0xe623098
y.create.l HWIO_PMIC_ARB_OBS2_CHNL98_RDATA0_ADDR A:0xe623118
y.create.l HWIO_PMIC_ARB_OBS2_CHNL99_RDATA0_ADDR A:0xe623198
y.create.l HWIO_PMIC_ARB_OBS2_CHNL100_RDATA0_ADDR A:0xe623218
y.create.l HWIO_PMIC_ARB_OBS2_CHNL101_RDATA0_ADDR A:0xe623298
y.create.l HWIO_PMIC_ARB_OBS2_CHNL102_RDATA0_ADDR A:0xe623318
y.create.l HWIO_PMIC_ARB_OBS2_CHNL103_RDATA0_ADDR A:0xe623398
y.create.l HWIO_PMIC_ARB_OBS2_CHNL104_RDATA0_ADDR A:0xe623418
y.create.l HWIO_PMIC_ARB_OBS2_CHNL105_RDATA0_ADDR A:0xe623498
y.create.l HWIO_PMIC_ARB_OBS2_CHNL106_RDATA0_ADDR A:0xe623518
y.create.l HWIO_PMIC_ARB_OBS2_CHNL107_RDATA0_ADDR A:0xe623598
y.create.l HWIO_PMIC_ARB_OBS2_CHNL108_RDATA0_ADDR A:0xe623618
y.create.l HWIO_PMIC_ARB_OBS2_CHNL109_RDATA0_ADDR A:0xe623698
y.create.l HWIO_PMIC_ARB_OBS2_CHNL110_RDATA0_ADDR A:0xe623718
y.create.l HWIO_PMIC_ARB_OBS2_CHNL111_RDATA0_ADDR A:0xe623798
y.create.l HWIO_PMIC_ARB_OBS2_CHNL112_RDATA0_ADDR A:0xe623818
y.create.l HWIO_PMIC_ARB_OBS2_CHNL113_RDATA0_ADDR A:0xe623898
y.create.l HWIO_PMIC_ARB_OBS2_CHNL114_RDATA0_ADDR A:0xe623918
y.create.l HWIO_PMIC_ARB_OBS2_CHNL115_RDATA0_ADDR A:0xe623998
y.create.l HWIO_PMIC_ARB_OBS2_CHNL116_RDATA0_ADDR A:0xe623a18
y.create.l HWIO_PMIC_ARB_OBS2_CHNL117_RDATA0_ADDR A:0xe623a98
y.create.l HWIO_PMIC_ARB_OBS2_CHNL118_RDATA0_ADDR A:0xe623b18
y.create.l HWIO_PMIC_ARB_OBS2_CHNL119_RDATA0_ADDR A:0xe623b98
y.create.l HWIO_PMIC_ARB_OBS2_CHNL120_RDATA0_ADDR A:0xe623c18
y.create.l HWIO_PMIC_ARB_OBS2_CHNL121_RDATA0_ADDR A:0xe623c98
y.create.l HWIO_PMIC_ARB_OBS2_CHNL122_RDATA0_ADDR A:0xe623d18
y.create.l HWIO_PMIC_ARB_OBS2_CHNL123_RDATA0_ADDR A:0xe623d98
y.create.l HWIO_PMIC_ARB_OBS2_CHNL124_RDATA0_ADDR A:0xe623e18
y.create.l HWIO_PMIC_ARB_OBS2_CHNL125_RDATA0_ADDR A:0xe623e98
y.create.l HWIO_PMIC_ARB_OBS2_CHNL126_RDATA0_ADDR A:0xe623f18
y.create.l HWIO_PMIC_ARB_OBS2_CHNL127_RDATA0_ADDR A:0xe623f98
y.create.l HWIO_PMIC_ARB_OBS2_CHNL128_RDATA0_ADDR A:0xe624018
y.create.l HWIO_PMIC_ARB_OBS2_CHNL129_RDATA0_ADDR A:0xe624098
y.create.l HWIO_PMIC_ARB_OBS2_CHNL130_RDATA0_ADDR A:0xe624118
y.create.l HWIO_PMIC_ARB_OBS2_CHNL131_RDATA0_ADDR A:0xe624198
y.create.l HWIO_PMIC_ARB_OBS2_CHNL132_RDATA0_ADDR A:0xe624218
y.create.l HWIO_PMIC_ARB_OBS2_CHNL133_RDATA0_ADDR A:0xe624298
y.create.l HWIO_PMIC_ARB_OBS2_CHNL134_RDATA0_ADDR A:0xe624318
y.create.l HWIO_PMIC_ARB_OBS2_CHNL135_RDATA0_ADDR A:0xe624398
y.create.l HWIO_PMIC_ARB_OBS2_CHNL136_RDATA0_ADDR A:0xe624418
y.create.l HWIO_PMIC_ARB_OBS2_CHNL137_RDATA0_ADDR A:0xe624498
y.create.l HWIO_PMIC_ARB_OBS2_CHNL138_RDATA0_ADDR A:0xe624518
y.create.l HWIO_PMIC_ARB_OBS2_CHNL139_RDATA0_ADDR A:0xe624598
y.create.l HWIO_PMIC_ARB_OBS2_CHNL140_RDATA0_ADDR A:0xe624618
y.create.l HWIO_PMIC_ARB_OBS2_CHNL141_RDATA0_ADDR A:0xe624698
y.create.l HWIO_PMIC_ARB_OBS2_CHNL142_RDATA0_ADDR A:0xe624718
y.create.l HWIO_PMIC_ARB_OBS2_CHNL143_RDATA0_ADDR A:0xe624798
y.create.l HWIO_PMIC_ARB_OBS2_CHNL144_RDATA0_ADDR A:0xe624818
y.create.l HWIO_PMIC_ARB_OBS2_CHNL145_RDATA0_ADDR A:0xe624898
y.create.l HWIO_PMIC_ARB_OBS2_CHNL146_RDATA0_ADDR A:0xe624918
y.create.l HWIO_PMIC_ARB_OBS2_CHNL147_RDATA0_ADDR A:0xe624998
y.create.l HWIO_PMIC_ARB_OBS2_CHNL148_RDATA0_ADDR A:0xe624a18
y.create.l HWIO_PMIC_ARB_OBS2_CHNL149_RDATA0_ADDR A:0xe624a98
y.create.l HWIO_PMIC_ARB_OBS2_CHNL150_RDATA0_ADDR A:0xe624b18
y.create.l HWIO_PMIC_ARB_OBS2_CHNL151_RDATA0_ADDR A:0xe624b98
y.create.l HWIO_PMIC_ARB_OBS2_CHNL152_RDATA0_ADDR A:0xe624c18
y.create.l HWIO_PMIC_ARB_OBS2_CHNL153_RDATA0_ADDR A:0xe624c98
y.create.l HWIO_PMIC_ARB_OBS2_CHNL154_RDATA0_ADDR A:0xe624d18
y.create.l HWIO_PMIC_ARB_OBS2_CHNL155_RDATA0_ADDR A:0xe624d98
y.create.l HWIO_PMIC_ARB_OBS2_CHNL156_RDATA0_ADDR A:0xe624e18
y.create.l HWIO_PMIC_ARB_OBS2_CHNL157_RDATA0_ADDR A:0xe624e98
y.create.l HWIO_PMIC_ARB_OBS2_CHNL158_RDATA0_ADDR A:0xe624f18
y.create.l HWIO_PMIC_ARB_OBS2_CHNL159_RDATA0_ADDR A:0xe624f98
y.create.l HWIO_PMIC_ARB_OBS2_CHNL160_RDATA0_ADDR A:0xe625018
y.create.l HWIO_PMIC_ARB_OBS2_CHNL161_RDATA0_ADDR A:0xe625098
y.create.l HWIO_PMIC_ARB_OBS2_CHNL162_RDATA0_ADDR A:0xe625118
y.create.l HWIO_PMIC_ARB_OBS2_CHNL163_RDATA0_ADDR A:0xe625198
y.create.l HWIO_PMIC_ARB_OBS2_CHNL164_RDATA0_ADDR A:0xe625218
y.create.l HWIO_PMIC_ARB_OBS2_CHNL165_RDATA0_ADDR A:0xe625298
y.create.l HWIO_PMIC_ARB_OBS2_CHNL166_RDATA0_ADDR A:0xe625318
y.create.l HWIO_PMIC_ARB_OBS2_CHNL167_RDATA0_ADDR A:0xe625398
y.create.l HWIO_PMIC_ARB_OBS2_CHNL168_RDATA0_ADDR A:0xe625418
y.create.l HWIO_PMIC_ARB_OBS2_CHNL169_RDATA0_ADDR A:0xe625498
y.create.l HWIO_PMIC_ARB_OBS2_CHNL170_RDATA0_ADDR A:0xe625518
y.create.l HWIO_PMIC_ARB_OBS2_CHNL171_RDATA0_ADDR A:0xe625598
y.create.l HWIO_PMIC_ARB_OBS2_CHNL172_RDATA0_ADDR A:0xe625618
y.create.l HWIO_PMIC_ARB_OBS2_CHNL173_RDATA0_ADDR A:0xe625698
y.create.l HWIO_PMIC_ARB_OBS2_CHNL174_RDATA0_ADDR A:0xe625718
y.create.l HWIO_PMIC_ARB_OBS2_CHNL175_RDATA0_ADDR A:0xe625798
y.create.l HWIO_PMIC_ARB_OBS2_CHNL176_RDATA0_ADDR A:0xe625818
y.create.l HWIO_PMIC_ARB_OBS2_CHNL177_RDATA0_ADDR A:0xe625898
y.create.l HWIO_PMIC_ARB_OBS2_CHNL178_RDATA0_ADDR A:0xe625918
y.create.l HWIO_PMIC_ARB_OBS2_CHNL179_RDATA0_ADDR A:0xe625998
y.create.l HWIO_PMIC_ARB_OBS2_CHNL180_RDATA0_ADDR A:0xe625a18
y.create.l HWIO_PMIC_ARB_OBS2_CHNL181_RDATA0_ADDR A:0xe625a98
y.create.l HWIO_PMIC_ARB_OBS2_CHNL182_RDATA0_ADDR A:0xe625b18
y.create.l HWIO_PMIC_ARB_OBS2_CHNL183_RDATA0_ADDR A:0xe625b98
y.create.l HWIO_PMIC_ARB_OBS2_CHNL184_RDATA0_ADDR A:0xe625c18
y.create.l HWIO_PMIC_ARB_OBS2_CHNL185_RDATA0_ADDR A:0xe625c98
y.create.l HWIO_PMIC_ARB_OBS2_CHNL186_RDATA0_ADDR A:0xe625d18
y.create.l HWIO_PMIC_ARB_OBS2_CHNL187_RDATA0_ADDR A:0xe625d98
y.create.l HWIO_PMIC_ARB_OBS2_CHNL188_RDATA0_ADDR A:0xe625e18
y.create.l HWIO_PMIC_ARB_OBS2_CHNL189_RDATA0_ADDR A:0xe625e98
y.create.l HWIO_PMIC_ARB_OBS2_CHNL190_RDATA0_ADDR A:0xe625f18
y.create.l HWIO_PMIC_ARB_OBS2_CHNL191_RDATA0_ADDR A:0xe625f98
y.create.l HWIO_PMIC_ARB_OBS2_CHNL192_RDATA0_ADDR A:0xe626018
y.create.l HWIO_PMIC_ARB_OBS2_CHNL193_RDATA0_ADDR A:0xe626098
y.create.l HWIO_PMIC_ARB_OBS2_CHNL194_RDATA0_ADDR A:0xe626118
y.create.l HWIO_PMIC_ARB_OBS2_CHNL195_RDATA0_ADDR A:0xe626198
y.create.l HWIO_PMIC_ARB_OBS2_CHNL196_RDATA0_ADDR A:0xe626218
y.create.l HWIO_PMIC_ARB_OBS2_CHNL197_RDATA0_ADDR A:0xe626298
y.create.l HWIO_PMIC_ARB_OBS2_CHNL198_RDATA0_ADDR A:0xe626318
y.create.l HWIO_PMIC_ARB_OBS2_CHNL199_RDATA0_ADDR A:0xe626398
y.create.l HWIO_PMIC_ARB_OBS2_CHNL200_RDATA0_ADDR A:0xe626418
y.create.l HWIO_PMIC_ARB_OBS2_CHNL201_RDATA0_ADDR A:0xe626498
y.create.l HWIO_PMIC_ARB_OBS2_CHNL202_RDATA0_ADDR A:0xe626518
y.create.l HWIO_PMIC_ARB_OBS2_CHNL203_RDATA0_ADDR A:0xe626598
y.create.l HWIO_PMIC_ARB_OBS2_CHNL204_RDATA0_ADDR A:0xe626618
y.create.l HWIO_PMIC_ARB_OBS2_CHNL205_RDATA0_ADDR A:0xe626698
y.create.l HWIO_PMIC_ARB_OBS2_CHNL206_RDATA0_ADDR A:0xe626718
y.create.l HWIO_PMIC_ARB_OBS2_CHNL207_RDATA0_ADDR A:0xe626798
y.create.l HWIO_PMIC_ARB_OBS2_CHNL208_RDATA0_ADDR A:0xe626818
y.create.l HWIO_PMIC_ARB_OBS2_CHNL209_RDATA0_ADDR A:0xe626898
y.create.l HWIO_PMIC_ARB_OBS2_CHNL210_RDATA0_ADDR A:0xe626918
y.create.l HWIO_PMIC_ARB_OBS2_CHNL211_RDATA0_ADDR A:0xe626998
y.create.l HWIO_PMIC_ARB_OBS2_CHNL212_RDATA0_ADDR A:0xe626a18
y.create.l HWIO_PMIC_ARB_OBS2_CHNL213_RDATA0_ADDR A:0xe626a98
y.create.l HWIO_PMIC_ARB_OBS2_CHNL214_RDATA0_ADDR A:0xe626b18
y.create.l HWIO_PMIC_ARB_OBS2_CHNL215_RDATA0_ADDR A:0xe626b98
y.create.l HWIO_PMIC_ARB_OBS2_CHNL216_RDATA0_ADDR A:0xe626c18
y.create.l HWIO_PMIC_ARB_OBS2_CHNL217_RDATA0_ADDR A:0xe626c98
y.create.l HWIO_PMIC_ARB_OBS2_CHNL218_RDATA0_ADDR A:0xe626d18
y.create.l HWIO_PMIC_ARB_OBS2_CHNL219_RDATA0_ADDR A:0xe626d98
y.create.l HWIO_PMIC_ARB_OBS2_CHNL220_RDATA0_ADDR A:0xe626e18
y.create.l HWIO_PMIC_ARB_OBS2_CHNL221_RDATA0_ADDR A:0xe626e98
y.create.l HWIO_PMIC_ARB_OBS2_CHNL222_RDATA0_ADDR A:0xe626f18
y.create.l HWIO_PMIC_ARB_OBS2_CHNL223_RDATA0_ADDR A:0xe626f98
y.create.l HWIO_PMIC_ARB_OBS2_CHNL224_RDATA0_ADDR A:0xe627018
y.create.l HWIO_PMIC_ARB_OBS2_CHNL225_RDATA0_ADDR A:0xe627098
y.create.l HWIO_PMIC_ARB_OBS2_CHNL226_RDATA0_ADDR A:0xe627118
y.create.l HWIO_PMIC_ARB_OBS2_CHNL227_RDATA0_ADDR A:0xe627198
y.create.l HWIO_PMIC_ARB_OBS2_CHNL228_RDATA0_ADDR A:0xe627218
y.create.l HWIO_PMIC_ARB_OBS2_CHNL229_RDATA0_ADDR A:0xe627298
y.create.l HWIO_PMIC_ARB_OBS2_CHNL230_RDATA0_ADDR A:0xe627318
y.create.l HWIO_PMIC_ARB_OBS2_CHNL231_RDATA0_ADDR A:0xe627398
y.create.l HWIO_PMIC_ARB_OBS2_CHNL232_RDATA0_ADDR A:0xe627418
y.create.l HWIO_PMIC_ARB_OBS2_CHNL233_RDATA0_ADDR A:0xe627498
y.create.l HWIO_PMIC_ARB_OBS2_CHNL234_RDATA0_ADDR A:0xe627518
y.create.l HWIO_PMIC_ARB_OBS2_CHNL235_RDATA0_ADDR A:0xe627598
y.create.l HWIO_PMIC_ARB_OBS2_CHNL236_RDATA0_ADDR A:0xe627618
y.create.l HWIO_PMIC_ARB_OBS2_CHNL237_RDATA0_ADDR A:0xe627698
y.create.l HWIO_PMIC_ARB_OBS2_CHNL238_RDATA0_ADDR A:0xe627718
y.create.l HWIO_PMIC_ARB_OBS2_CHNL239_RDATA0_ADDR A:0xe627798
y.create.l HWIO_PMIC_ARB_OBS2_CHNL240_RDATA0_ADDR A:0xe627818
y.create.l HWIO_PMIC_ARB_OBS2_CHNL241_RDATA0_ADDR A:0xe627898
y.create.l HWIO_PMIC_ARB_OBS2_CHNL242_RDATA0_ADDR A:0xe627918
y.create.l HWIO_PMIC_ARB_OBS2_CHNL243_RDATA0_ADDR A:0xe627998
y.create.l HWIO_PMIC_ARB_OBS2_CHNL244_RDATA0_ADDR A:0xe627a18
y.create.l HWIO_PMIC_ARB_OBS2_CHNL245_RDATA0_ADDR A:0xe627a98
y.create.l HWIO_PMIC_ARB_OBS2_CHNL246_RDATA0_ADDR A:0xe627b18
y.create.l HWIO_PMIC_ARB_OBS2_CHNL247_RDATA0_ADDR A:0xe627b98
y.create.l HWIO_PMIC_ARB_OBS2_CHNL248_RDATA0_ADDR A:0xe627c18
y.create.l HWIO_PMIC_ARB_OBS2_CHNL249_RDATA0_ADDR A:0xe627c98
y.create.l HWIO_PMIC_ARB_OBS2_CHNL250_RDATA0_ADDR A:0xe627d18
y.create.l HWIO_PMIC_ARB_OBS2_CHNL251_RDATA0_ADDR A:0xe627d98
y.create.l HWIO_PMIC_ARB_OBS2_CHNL252_RDATA0_ADDR A:0xe627e18
y.create.l HWIO_PMIC_ARB_OBS2_CHNL253_RDATA0_ADDR A:0xe627e98
y.create.l HWIO_PMIC_ARB_OBS2_CHNL254_RDATA0_ADDR A:0xe627f18
y.create.l HWIO_PMIC_ARB_OBS2_CHNL255_RDATA0_ADDR A:0xe627f98
y.create.l HWIO_PMIC_ARB_OBS2_CHNL256_RDATA0_ADDR A:0xe628018
y.create.l HWIO_PMIC_ARB_OBS2_CHNL257_RDATA0_ADDR A:0xe628098
y.create.l HWIO_PMIC_ARB_OBS2_CHNL258_RDATA0_ADDR A:0xe628118
y.create.l HWIO_PMIC_ARB_OBS2_CHNL259_RDATA0_ADDR A:0xe628198
y.create.l HWIO_PMIC_ARB_OBS2_CHNL260_RDATA0_ADDR A:0xe628218
y.create.l HWIO_PMIC_ARB_OBS2_CHNL261_RDATA0_ADDR A:0xe628298
y.create.l HWIO_PMIC_ARB_OBS2_CHNL262_RDATA0_ADDR A:0xe628318
y.create.l HWIO_PMIC_ARB_OBS2_CHNL263_RDATA0_ADDR A:0xe628398
y.create.l HWIO_PMIC_ARB_OBS2_CHNL264_RDATA0_ADDR A:0xe628418
y.create.l HWIO_PMIC_ARB_OBS2_CHNL265_RDATA0_ADDR A:0xe628498
y.create.l HWIO_PMIC_ARB_OBS2_CHNL266_RDATA0_ADDR A:0xe628518
y.create.l HWIO_PMIC_ARB_OBS2_CHNL267_RDATA0_ADDR A:0xe628598
y.create.l HWIO_PMIC_ARB_OBS2_CHNL268_RDATA0_ADDR A:0xe628618
y.create.l HWIO_PMIC_ARB_OBS2_CHNL269_RDATA0_ADDR A:0xe628698
y.create.l HWIO_PMIC_ARB_OBS2_CHNL270_RDATA0_ADDR A:0xe628718
y.create.l HWIO_PMIC_ARB_OBS2_CHNL271_RDATA0_ADDR A:0xe628798
y.create.l HWIO_PMIC_ARB_OBS2_CHNL272_RDATA0_ADDR A:0xe628818
y.create.l HWIO_PMIC_ARB_OBS2_CHNL273_RDATA0_ADDR A:0xe628898
y.create.l HWIO_PMIC_ARB_OBS2_CHNL274_RDATA0_ADDR A:0xe628918
y.create.l HWIO_PMIC_ARB_OBS2_CHNL275_RDATA0_ADDR A:0xe628998
y.create.l HWIO_PMIC_ARB_OBS2_CHNL276_RDATA0_ADDR A:0xe628a18
y.create.l HWIO_PMIC_ARB_OBS2_CHNL277_RDATA0_ADDR A:0xe628a98
y.create.l HWIO_PMIC_ARB_OBS2_CHNL278_RDATA0_ADDR A:0xe628b18
y.create.l HWIO_PMIC_ARB_OBS2_CHNL279_RDATA0_ADDR A:0xe628b98
y.create.l HWIO_PMIC_ARB_OBS2_CHNL280_RDATA0_ADDR A:0xe628c18
y.create.l HWIO_PMIC_ARB_OBS2_CHNL281_RDATA0_ADDR A:0xe628c98
y.create.l HWIO_PMIC_ARB_OBS2_CHNL282_RDATA0_ADDR A:0xe628d18
y.create.l HWIO_PMIC_ARB_OBS2_CHNL283_RDATA0_ADDR A:0xe628d98
y.create.l HWIO_PMIC_ARB_OBS2_CHNL284_RDATA0_ADDR A:0xe628e18
y.create.l HWIO_PMIC_ARB_OBS2_CHNL285_RDATA0_ADDR A:0xe628e98
y.create.l HWIO_PMIC_ARB_OBS2_CHNL286_RDATA0_ADDR A:0xe628f18
y.create.l HWIO_PMIC_ARB_OBS2_CHNL287_RDATA0_ADDR A:0xe628f98
y.create.l HWIO_PMIC_ARB_OBS2_CHNL288_RDATA0_ADDR A:0xe629018
y.create.l HWIO_PMIC_ARB_OBS2_CHNL289_RDATA0_ADDR A:0xe629098
y.create.l HWIO_PMIC_ARB_OBS2_CHNL290_RDATA0_ADDR A:0xe629118
y.create.l HWIO_PMIC_ARB_OBS2_CHNL291_RDATA0_ADDR A:0xe629198
y.create.l HWIO_PMIC_ARB_OBS2_CHNL292_RDATA0_ADDR A:0xe629218
y.create.l HWIO_PMIC_ARB_OBS2_CHNL293_RDATA0_ADDR A:0xe629298
y.create.l HWIO_PMIC_ARB_OBS2_CHNL294_RDATA0_ADDR A:0xe629318
y.create.l HWIO_PMIC_ARB_OBS2_CHNL295_RDATA0_ADDR A:0xe629398
y.create.l HWIO_PMIC_ARB_OBS2_CHNL296_RDATA0_ADDR A:0xe629418
y.create.l HWIO_PMIC_ARB_OBS2_CHNL297_RDATA0_ADDR A:0xe629498
y.create.l HWIO_PMIC_ARB_OBS2_CHNL298_RDATA0_ADDR A:0xe629518
y.create.l HWIO_PMIC_ARB_OBS2_CHNL299_RDATA0_ADDR A:0xe629598
y.create.l HWIO_PMIC_ARB_OBS2_CHNL300_RDATA0_ADDR A:0xe629618
y.create.l HWIO_PMIC_ARB_OBS2_CHNL301_RDATA0_ADDR A:0xe629698
y.create.l HWIO_PMIC_ARB_OBS2_CHNL302_RDATA0_ADDR A:0xe629718
y.create.l HWIO_PMIC_ARB_OBS2_CHNL303_RDATA0_ADDR A:0xe629798
y.create.l HWIO_PMIC_ARB_OBS2_CHNL304_RDATA0_ADDR A:0xe629818
y.create.l HWIO_PMIC_ARB_OBS2_CHNL305_RDATA0_ADDR A:0xe629898
y.create.l HWIO_PMIC_ARB_OBS2_CHNL306_RDATA0_ADDR A:0xe629918
y.create.l HWIO_PMIC_ARB_OBS2_CHNL307_RDATA0_ADDR A:0xe629998
y.create.l HWIO_PMIC_ARB_OBS2_CHNL308_RDATA0_ADDR A:0xe629a18
y.create.l HWIO_PMIC_ARB_OBS2_CHNL309_RDATA0_ADDR A:0xe629a98
y.create.l HWIO_PMIC_ARB_OBS2_CHNL310_RDATA0_ADDR A:0xe629b18
y.create.l HWIO_PMIC_ARB_OBS2_CHNL311_RDATA0_ADDR A:0xe629b98
y.create.l HWIO_PMIC_ARB_OBS2_CHNL312_RDATA0_ADDR A:0xe629c18
y.create.l HWIO_PMIC_ARB_OBS2_CHNL313_RDATA0_ADDR A:0xe629c98
y.create.l HWIO_PMIC_ARB_OBS2_CHNL314_RDATA0_ADDR A:0xe629d18
y.create.l HWIO_PMIC_ARB_OBS2_CHNL315_RDATA0_ADDR A:0xe629d98
y.create.l HWIO_PMIC_ARB_OBS2_CHNL316_RDATA0_ADDR A:0xe629e18
y.create.l HWIO_PMIC_ARB_OBS2_CHNL317_RDATA0_ADDR A:0xe629e98
y.create.l HWIO_PMIC_ARB_OBS2_CHNL318_RDATA0_ADDR A:0xe629f18
y.create.l HWIO_PMIC_ARB_OBS2_CHNL319_RDATA0_ADDR A:0xe629f98
y.create.l HWIO_PMIC_ARB_OBS2_CHNL320_RDATA0_ADDR A:0xe62a018
y.create.l HWIO_PMIC_ARB_OBS2_CHNL321_RDATA0_ADDR A:0xe62a098
y.create.l HWIO_PMIC_ARB_OBS2_CHNL322_RDATA0_ADDR A:0xe62a118
y.create.l HWIO_PMIC_ARB_OBS2_CHNL323_RDATA0_ADDR A:0xe62a198
y.create.l HWIO_PMIC_ARB_OBS2_CHNL324_RDATA0_ADDR A:0xe62a218
y.create.l HWIO_PMIC_ARB_OBS2_CHNL325_RDATA0_ADDR A:0xe62a298
y.create.l HWIO_PMIC_ARB_OBS2_CHNL326_RDATA0_ADDR A:0xe62a318
y.create.l HWIO_PMIC_ARB_OBS2_CHNL327_RDATA0_ADDR A:0xe62a398
y.create.l HWIO_PMIC_ARB_OBS2_CHNL328_RDATA0_ADDR A:0xe62a418
y.create.l HWIO_PMIC_ARB_OBS2_CHNL329_RDATA0_ADDR A:0xe62a498
y.create.l HWIO_PMIC_ARB_OBS2_CHNL330_RDATA0_ADDR A:0xe62a518
y.create.l HWIO_PMIC_ARB_OBS2_CHNL331_RDATA0_ADDR A:0xe62a598
y.create.l HWIO_PMIC_ARB_OBS2_CHNL332_RDATA0_ADDR A:0xe62a618
y.create.l HWIO_PMIC_ARB_OBS2_CHNL333_RDATA0_ADDR A:0xe62a698
y.create.l HWIO_PMIC_ARB_OBS2_CHNL334_RDATA0_ADDR A:0xe62a718
y.create.l HWIO_PMIC_ARB_OBS2_CHNL335_RDATA0_ADDR A:0xe62a798
y.create.l HWIO_PMIC_ARB_OBS2_CHNL336_RDATA0_ADDR A:0xe62a818
y.create.l HWIO_PMIC_ARB_OBS2_CHNL337_RDATA0_ADDR A:0xe62a898
y.create.l HWIO_PMIC_ARB_OBS2_CHNL338_RDATA0_ADDR A:0xe62a918
y.create.l HWIO_PMIC_ARB_OBS2_CHNL339_RDATA0_ADDR A:0xe62a998
y.create.l HWIO_PMIC_ARB_OBS2_CHNL340_RDATA0_ADDR A:0xe62aa18
y.create.l HWIO_PMIC_ARB_OBS2_CHNL341_RDATA0_ADDR A:0xe62aa98
y.create.l HWIO_PMIC_ARB_OBS2_CHNL342_RDATA0_ADDR A:0xe62ab18
y.create.l HWIO_PMIC_ARB_OBS2_CHNL343_RDATA0_ADDR A:0xe62ab98
y.create.l HWIO_PMIC_ARB_OBS2_CHNL344_RDATA0_ADDR A:0xe62ac18
y.create.l HWIO_PMIC_ARB_OBS2_CHNL345_RDATA0_ADDR A:0xe62ac98
y.create.l HWIO_PMIC_ARB_OBS2_CHNL346_RDATA0_ADDR A:0xe62ad18
y.create.l HWIO_PMIC_ARB_OBS2_CHNL347_RDATA0_ADDR A:0xe62ad98
y.create.l HWIO_PMIC_ARB_OBS2_CHNL348_RDATA0_ADDR A:0xe62ae18
y.create.l HWIO_PMIC_ARB_OBS2_CHNL349_RDATA0_ADDR A:0xe62ae98
y.create.l HWIO_PMIC_ARB_OBS2_CHNL350_RDATA0_ADDR A:0xe62af18
y.create.l HWIO_PMIC_ARB_OBS2_CHNL351_RDATA0_ADDR A:0xe62af98
y.create.l HWIO_PMIC_ARB_OBS2_CHNL352_RDATA0_ADDR A:0xe62b018
y.create.l HWIO_PMIC_ARB_OBS2_CHNL353_RDATA0_ADDR A:0xe62b098
y.create.l HWIO_PMIC_ARB_OBS2_CHNL354_RDATA0_ADDR A:0xe62b118
y.create.l HWIO_PMIC_ARB_OBS2_CHNL355_RDATA0_ADDR A:0xe62b198
y.create.l HWIO_PMIC_ARB_OBS2_CHNL356_RDATA0_ADDR A:0xe62b218
y.create.l HWIO_PMIC_ARB_OBS2_CHNL357_RDATA0_ADDR A:0xe62b298
y.create.l HWIO_PMIC_ARB_OBS2_CHNL358_RDATA0_ADDR A:0xe62b318
y.create.l HWIO_PMIC_ARB_OBS2_CHNL359_RDATA0_ADDR A:0xe62b398
y.create.l HWIO_PMIC_ARB_OBS2_CHNL360_RDATA0_ADDR A:0xe62b418
y.create.l HWIO_PMIC_ARB_OBS2_CHNL361_RDATA0_ADDR A:0xe62b498
y.create.l HWIO_PMIC_ARB_OBS2_CHNL362_RDATA0_ADDR A:0xe62b518
y.create.l HWIO_PMIC_ARB_OBS2_CHNL363_RDATA0_ADDR A:0xe62b598
y.create.l HWIO_PMIC_ARB_OBS2_CHNL364_RDATA0_ADDR A:0xe62b618
y.create.l HWIO_PMIC_ARB_OBS2_CHNL365_RDATA0_ADDR A:0xe62b698
y.create.l HWIO_PMIC_ARB_OBS2_CHNL366_RDATA0_ADDR A:0xe62b718
y.create.l HWIO_PMIC_ARB_OBS2_CHNL367_RDATA0_ADDR A:0xe62b798
y.create.l HWIO_PMIC_ARB_OBS2_CHNL368_RDATA0_ADDR A:0xe62b818
y.create.l HWIO_PMIC_ARB_OBS2_CHNL369_RDATA0_ADDR A:0xe62b898
y.create.l HWIO_PMIC_ARB_OBS2_CHNL370_RDATA0_ADDR A:0xe62b918
y.create.l HWIO_PMIC_ARB_OBS2_CHNL371_RDATA0_ADDR A:0xe62b998
y.create.l HWIO_PMIC_ARB_OBS2_CHNL372_RDATA0_ADDR A:0xe62ba18
y.create.l HWIO_PMIC_ARB_OBS2_CHNL373_RDATA0_ADDR A:0xe62ba98
y.create.l HWIO_PMIC_ARB_OBS2_CHNL374_RDATA0_ADDR A:0xe62bb18
y.create.l HWIO_PMIC_ARB_OBS2_CHNL375_RDATA0_ADDR A:0xe62bb98
y.create.l HWIO_PMIC_ARB_OBS2_CHNL376_RDATA0_ADDR A:0xe62bc18
y.create.l HWIO_PMIC_ARB_OBS2_CHNL377_RDATA0_ADDR A:0xe62bc98
y.create.l HWIO_PMIC_ARB_OBS2_CHNL378_RDATA0_ADDR A:0xe62bd18
y.create.l HWIO_PMIC_ARB_OBS2_CHNL379_RDATA0_ADDR A:0xe62bd98
y.create.l HWIO_PMIC_ARB_OBS2_CHNL380_RDATA0_ADDR A:0xe62be18
y.create.l HWIO_PMIC_ARB_OBS2_CHNL381_RDATA0_ADDR A:0xe62be98
y.create.l HWIO_PMIC_ARB_OBS2_CHNL382_RDATA0_ADDR A:0xe62bf18
y.create.l HWIO_PMIC_ARB_OBS2_CHNL383_RDATA0_ADDR A:0xe62bf98
y.create.l HWIO_PMIC_ARB_OBS2_CHNL384_RDATA0_ADDR A:0xe62c018
y.create.l HWIO_PMIC_ARB_OBS2_CHNL385_RDATA0_ADDR A:0xe62c098
y.create.l HWIO_PMIC_ARB_OBS2_CHNL386_RDATA0_ADDR A:0xe62c118
y.create.l HWIO_PMIC_ARB_OBS2_CHNL387_RDATA0_ADDR A:0xe62c198
y.create.l HWIO_PMIC_ARB_OBS2_CHNL388_RDATA0_ADDR A:0xe62c218
y.create.l HWIO_PMIC_ARB_OBS2_CHNL389_RDATA0_ADDR A:0xe62c298
y.create.l HWIO_PMIC_ARB_OBS2_CHNL390_RDATA0_ADDR A:0xe62c318
y.create.l HWIO_PMIC_ARB_OBS2_CHNL391_RDATA0_ADDR A:0xe62c398
y.create.l HWIO_PMIC_ARB_OBS2_CHNL392_RDATA0_ADDR A:0xe62c418
y.create.l HWIO_PMIC_ARB_OBS2_CHNL393_RDATA0_ADDR A:0xe62c498
y.create.l HWIO_PMIC_ARB_OBS2_CHNL394_RDATA0_ADDR A:0xe62c518
y.create.l HWIO_PMIC_ARB_OBS2_CHNL395_RDATA0_ADDR A:0xe62c598
y.create.l HWIO_PMIC_ARB_OBS2_CHNL396_RDATA0_ADDR A:0xe62c618
y.create.l HWIO_PMIC_ARB_OBS2_CHNL397_RDATA0_ADDR A:0xe62c698
y.create.l HWIO_PMIC_ARB_OBS2_CHNL398_RDATA0_ADDR A:0xe62c718
y.create.l HWIO_PMIC_ARB_OBS2_CHNL399_RDATA0_ADDR A:0xe62c798
y.create.l HWIO_PMIC_ARB_OBS2_CHNL400_RDATA0_ADDR A:0xe62c818
y.create.l HWIO_PMIC_ARB_OBS2_CHNL401_RDATA0_ADDR A:0xe62c898
y.create.l HWIO_PMIC_ARB_OBS2_CHNL402_RDATA0_ADDR A:0xe62c918
y.create.l HWIO_PMIC_ARB_OBS2_CHNL403_RDATA0_ADDR A:0xe62c998
y.create.l HWIO_PMIC_ARB_OBS2_CHNL404_RDATA0_ADDR A:0xe62ca18
y.create.l HWIO_PMIC_ARB_OBS2_CHNL405_RDATA0_ADDR A:0xe62ca98
y.create.l HWIO_PMIC_ARB_OBS2_CHNL406_RDATA0_ADDR A:0xe62cb18
y.create.l HWIO_PMIC_ARB_OBS2_CHNL407_RDATA0_ADDR A:0xe62cb98
y.create.l HWIO_PMIC_ARB_OBS2_CHNL408_RDATA0_ADDR A:0xe62cc18
y.create.l HWIO_PMIC_ARB_OBS2_CHNL409_RDATA0_ADDR A:0xe62cc98
y.create.l HWIO_PMIC_ARB_OBS2_CHNL410_RDATA0_ADDR A:0xe62cd18
y.create.l HWIO_PMIC_ARB_OBS2_CHNL411_RDATA0_ADDR A:0xe62cd98
y.create.l HWIO_PMIC_ARB_OBS2_CHNL412_RDATA0_ADDR A:0xe62ce18
y.create.l HWIO_PMIC_ARB_OBS2_CHNL413_RDATA0_ADDR A:0xe62ce98
y.create.l HWIO_PMIC_ARB_OBS2_CHNL414_RDATA0_ADDR A:0xe62cf18
y.create.l HWIO_PMIC_ARB_OBS2_CHNL415_RDATA0_ADDR A:0xe62cf98
y.create.l HWIO_PMIC_ARB_OBS2_CHNL416_RDATA0_ADDR A:0xe62d018
y.create.l HWIO_PMIC_ARB_OBS2_CHNL417_RDATA0_ADDR A:0xe62d098
y.create.l HWIO_PMIC_ARB_OBS2_CHNL418_RDATA0_ADDR A:0xe62d118
y.create.l HWIO_PMIC_ARB_OBS2_CHNL419_RDATA0_ADDR A:0xe62d198
y.create.l HWIO_PMIC_ARB_OBS2_CHNL420_RDATA0_ADDR A:0xe62d218
y.create.l HWIO_PMIC_ARB_OBS2_CHNL421_RDATA0_ADDR A:0xe62d298
y.create.l HWIO_PMIC_ARB_OBS2_CHNL422_RDATA0_ADDR A:0xe62d318
y.create.l HWIO_PMIC_ARB_OBS2_CHNL423_RDATA0_ADDR A:0xe62d398
y.create.l HWIO_PMIC_ARB_OBS2_CHNL424_RDATA0_ADDR A:0xe62d418
y.create.l HWIO_PMIC_ARB_OBS2_CHNL425_RDATA0_ADDR A:0xe62d498
y.create.l HWIO_PMIC_ARB_OBS2_CHNL426_RDATA0_ADDR A:0xe62d518
y.create.l HWIO_PMIC_ARB_OBS2_CHNL427_RDATA0_ADDR A:0xe62d598
y.create.l HWIO_PMIC_ARB_OBS2_CHNL428_RDATA0_ADDR A:0xe62d618
y.create.l HWIO_PMIC_ARB_OBS2_CHNL429_RDATA0_ADDR A:0xe62d698
y.create.l HWIO_PMIC_ARB_OBS2_CHNL430_RDATA0_ADDR A:0xe62d718
y.create.l HWIO_PMIC_ARB_OBS2_CHNL431_RDATA0_ADDR A:0xe62d798
y.create.l HWIO_PMIC_ARB_OBS2_CHNL432_RDATA0_ADDR A:0xe62d818
y.create.l HWIO_PMIC_ARB_OBS2_CHNL433_RDATA0_ADDR A:0xe62d898
y.create.l HWIO_PMIC_ARB_OBS2_CHNL434_RDATA0_ADDR A:0xe62d918
y.create.l HWIO_PMIC_ARB_OBS2_CHNL435_RDATA0_ADDR A:0xe62d998
y.create.l HWIO_PMIC_ARB_OBS2_CHNL436_RDATA0_ADDR A:0xe62da18
y.create.l HWIO_PMIC_ARB_OBS2_CHNL437_RDATA0_ADDR A:0xe62da98
y.create.l HWIO_PMIC_ARB_OBS2_CHNL438_RDATA0_ADDR A:0xe62db18
y.create.l HWIO_PMIC_ARB_OBS2_CHNL439_RDATA0_ADDR A:0xe62db98
y.create.l HWIO_PMIC_ARB_OBS2_CHNL440_RDATA0_ADDR A:0xe62dc18
y.create.l HWIO_PMIC_ARB_OBS2_CHNL441_RDATA0_ADDR A:0xe62dc98
y.create.l HWIO_PMIC_ARB_OBS2_CHNL442_RDATA0_ADDR A:0xe62dd18
y.create.l HWIO_PMIC_ARB_OBS2_CHNL443_RDATA0_ADDR A:0xe62dd98
y.create.l HWIO_PMIC_ARB_OBS2_CHNL444_RDATA0_ADDR A:0xe62de18
y.create.l HWIO_PMIC_ARB_OBS2_CHNL445_RDATA0_ADDR A:0xe62de98
y.create.l HWIO_PMIC_ARB_OBS2_CHNL446_RDATA0_ADDR A:0xe62df18
y.create.l HWIO_PMIC_ARB_OBS2_CHNL447_RDATA0_ADDR A:0xe62df98
y.create.l HWIO_PMIC_ARB_OBS2_CHNL448_RDATA0_ADDR A:0xe62e018
y.create.l HWIO_PMIC_ARB_OBS2_CHNL449_RDATA0_ADDR A:0xe62e098
y.create.l HWIO_PMIC_ARB_OBS2_CHNL450_RDATA0_ADDR A:0xe62e118
y.create.l HWIO_PMIC_ARB_OBS2_CHNL451_RDATA0_ADDR A:0xe62e198
y.create.l HWIO_PMIC_ARB_OBS2_CHNL452_RDATA0_ADDR A:0xe62e218
y.create.l HWIO_PMIC_ARB_OBS2_CHNL453_RDATA0_ADDR A:0xe62e298
y.create.l HWIO_PMIC_ARB_OBS2_CHNL454_RDATA0_ADDR A:0xe62e318
y.create.l HWIO_PMIC_ARB_OBS2_CHNL455_RDATA0_ADDR A:0xe62e398
y.create.l HWIO_PMIC_ARB_OBS2_CHNL456_RDATA0_ADDR A:0xe62e418
y.create.l HWIO_PMIC_ARB_OBS2_CHNL457_RDATA0_ADDR A:0xe62e498
y.create.l HWIO_PMIC_ARB_OBS2_CHNL458_RDATA0_ADDR A:0xe62e518
y.create.l HWIO_PMIC_ARB_OBS2_CHNL459_RDATA0_ADDR A:0xe62e598
y.create.l HWIO_PMIC_ARB_OBS2_CHNL460_RDATA0_ADDR A:0xe62e618
y.create.l HWIO_PMIC_ARB_OBS2_CHNL461_RDATA0_ADDR A:0xe62e698
y.create.l HWIO_PMIC_ARB_OBS2_CHNL462_RDATA0_ADDR A:0xe62e718
y.create.l HWIO_PMIC_ARB_OBS2_CHNL463_RDATA0_ADDR A:0xe62e798
y.create.l HWIO_PMIC_ARB_OBS2_CHNL464_RDATA0_ADDR A:0xe62e818
y.create.l HWIO_PMIC_ARB_OBS2_CHNL465_RDATA0_ADDR A:0xe62e898
y.create.l HWIO_PMIC_ARB_OBS2_CHNL466_RDATA0_ADDR A:0xe62e918
y.create.l HWIO_PMIC_ARB_OBS2_CHNL467_RDATA0_ADDR A:0xe62e998
y.create.l HWIO_PMIC_ARB_OBS2_CHNL468_RDATA0_ADDR A:0xe62ea18
y.create.l HWIO_PMIC_ARB_OBS2_CHNL469_RDATA0_ADDR A:0xe62ea98
y.create.l HWIO_PMIC_ARB_OBS2_CHNL470_RDATA0_ADDR A:0xe62eb18
y.create.l HWIO_PMIC_ARB_OBS2_CHNL471_RDATA0_ADDR A:0xe62eb98
y.create.l HWIO_PMIC_ARB_OBS2_CHNL472_RDATA0_ADDR A:0xe62ec18
y.create.l HWIO_PMIC_ARB_OBS2_CHNL473_RDATA0_ADDR A:0xe62ec98
y.create.l HWIO_PMIC_ARB_OBS2_CHNL474_RDATA0_ADDR A:0xe62ed18
y.create.l HWIO_PMIC_ARB_OBS2_CHNL475_RDATA0_ADDR A:0xe62ed98
y.create.l HWIO_PMIC_ARB_OBS2_CHNL476_RDATA0_ADDR A:0xe62ee18
y.create.l HWIO_PMIC_ARB_OBS2_CHNL477_RDATA0_ADDR A:0xe62ee98
y.create.l HWIO_PMIC_ARB_OBS2_CHNL478_RDATA0_ADDR A:0xe62ef18
y.create.l HWIO_PMIC_ARB_OBS2_CHNL479_RDATA0_ADDR A:0xe62ef98
y.create.l HWIO_PMIC_ARB_OBS2_CHNL480_RDATA0_ADDR A:0xe62f018
y.create.l HWIO_PMIC_ARB_OBS2_CHNL481_RDATA0_ADDR A:0xe62f098
y.create.l HWIO_PMIC_ARB_OBS2_CHNL482_RDATA0_ADDR A:0xe62f118
y.create.l HWIO_PMIC_ARB_OBS2_CHNL483_RDATA0_ADDR A:0xe62f198
y.create.l HWIO_PMIC_ARB_OBS2_CHNL484_RDATA0_ADDR A:0xe62f218
y.create.l HWIO_PMIC_ARB_OBS2_CHNL485_RDATA0_ADDR A:0xe62f298
y.create.l HWIO_PMIC_ARB_OBS2_CHNL486_RDATA0_ADDR A:0xe62f318
y.create.l HWIO_PMIC_ARB_OBS2_CHNL487_RDATA0_ADDR A:0xe62f398
y.create.l HWIO_PMIC_ARB_OBS2_CHNL488_RDATA0_ADDR A:0xe62f418
y.create.l HWIO_PMIC_ARB_OBS2_CHNL489_RDATA0_ADDR A:0xe62f498
y.create.l HWIO_PMIC_ARB_OBS2_CHNL490_RDATA0_ADDR A:0xe62f518
y.create.l HWIO_PMIC_ARB_OBS2_CHNL491_RDATA0_ADDR A:0xe62f598
y.create.l HWIO_PMIC_ARB_OBS2_CHNL492_RDATA0_ADDR A:0xe62f618
y.create.l HWIO_PMIC_ARB_OBS2_CHNL493_RDATA0_ADDR A:0xe62f698
y.create.l HWIO_PMIC_ARB_OBS2_CHNL494_RDATA0_ADDR A:0xe62f718
y.create.l HWIO_PMIC_ARB_OBS2_CHNL495_RDATA0_ADDR A:0xe62f798
y.create.l HWIO_PMIC_ARB_OBS2_CHNL496_RDATA0_ADDR A:0xe62f818
y.create.l HWIO_PMIC_ARB_OBS2_CHNL497_RDATA0_ADDR A:0xe62f898
y.create.l HWIO_PMIC_ARB_OBS2_CHNL498_RDATA0_ADDR A:0xe62f918
y.create.l HWIO_PMIC_ARB_OBS2_CHNL499_RDATA0_ADDR A:0xe62f998
y.create.l HWIO_PMIC_ARB_OBS2_CHNL500_RDATA0_ADDR A:0xe62fa18
y.create.l HWIO_PMIC_ARB_OBS2_CHNL501_RDATA0_ADDR A:0xe62fa98
y.create.l HWIO_PMIC_ARB_OBS2_CHNL502_RDATA0_ADDR A:0xe62fb18
y.create.l HWIO_PMIC_ARB_OBS2_CHNL503_RDATA0_ADDR A:0xe62fb98
y.create.l HWIO_PMIC_ARB_OBS2_CHNL504_RDATA0_ADDR A:0xe62fc18
y.create.l HWIO_PMIC_ARB_OBS2_CHNL505_RDATA0_ADDR A:0xe62fc98
y.create.l HWIO_PMIC_ARB_OBS2_CHNL506_RDATA0_ADDR A:0xe62fd18
y.create.l HWIO_PMIC_ARB_OBS2_CHNL507_RDATA0_ADDR A:0xe62fd98
y.create.l HWIO_PMIC_ARB_OBS2_CHNL508_RDATA0_ADDR A:0xe62fe18
y.create.l HWIO_PMIC_ARB_OBS2_CHNL509_RDATA0_ADDR A:0xe62fe98
y.create.l HWIO_PMIC_ARB_OBS2_CHNL510_RDATA0_ADDR A:0xe62ff18
y.create.l HWIO_PMIC_ARB_OBS2_CHNL511_RDATA0_ADDR A:0xe62ff98
y.create.l HWIO_PMIC_ARB_OBS3_CHNL0_RDATA0_ADDR A:0xe630018
y.create.l HWIO_PMIC_ARB_OBS3_CHNL1_RDATA0_ADDR A:0xe630098
y.create.l HWIO_PMIC_ARB_OBS3_CHNL2_RDATA0_ADDR A:0xe630118
y.create.l HWIO_PMIC_ARB_OBS3_CHNL3_RDATA0_ADDR A:0xe630198
y.create.l HWIO_PMIC_ARB_OBS3_CHNL4_RDATA0_ADDR A:0xe630218
y.create.l HWIO_PMIC_ARB_OBS3_CHNL5_RDATA0_ADDR A:0xe630298
y.create.l HWIO_PMIC_ARB_OBS3_CHNL6_RDATA0_ADDR A:0xe630318
y.create.l HWIO_PMIC_ARB_OBS3_CHNL7_RDATA0_ADDR A:0xe630398
y.create.l HWIO_PMIC_ARB_OBS3_CHNL8_RDATA0_ADDR A:0xe630418
y.create.l HWIO_PMIC_ARB_OBS3_CHNL9_RDATA0_ADDR A:0xe630498
y.create.l HWIO_PMIC_ARB_OBS3_CHNL10_RDATA0_ADDR A:0xe630518
y.create.l HWIO_PMIC_ARB_OBS3_CHNL11_RDATA0_ADDR A:0xe630598
y.create.l HWIO_PMIC_ARB_OBS3_CHNL12_RDATA0_ADDR A:0xe630618
y.create.l HWIO_PMIC_ARB_OBS3_CHNL13_RDATA0_ADDR A:0xe630698
y.create.l HWIO_PMIC_ARB_OBS3_CHNL14_RDATA0_ADDR A:0xe630718
y.create.l HWIO_PMIC_ARB_OBS3_CHNL15_RDATA0_ADDR A:0xe630798
y.create.l HWIO_PMIC_ARB_OBS3_CHNL16_RDATA0_ADDR A:0xe630818
y.create.l HWIO_PMIC_ARB_OBS3_CHNL17_RDATA0_ADDR A:0xe630898
y.create.l HWIO_PMIC_ARB_OBS3_CHNL18_RDATA0_ADDR A:0xe630918
y.create.l HWIO_PMIC_ARB_OBS3_CHNL19_RDATA0_ADDR A:0xe630998
y.create.l HWIO_PMIC_ARB_OBS3_CHNL20_RDATA0_ADDR A:0xe630a18
y.create.l HWIO_PMIC_ARB_OBS3_CHNL21_RDATA0_ADDR A:0xe630a98
y.create.l HWIO_PMIC_ARB_OBS3_CHNL22_RDATA0_ADDR A:0xe630b18
y.create.l HWIO_PMIC_ARB_OBS3_CHNL23_RDATA0_ADDR A:0xe630b98
y.create.l HWIO_PMIC_ARB_OBS3_CHNL24_RDATA0_ADDR A:0xe630c18
y.create.l HWIO_PMIC_ARB_OBS3_CHNL25_RDATA0_ADDR A:0xe630c98
y.create.l HWIO_PMIC_ARB_OBS3_CHNL26_RDATA0_ADDR A:0xe630d18
y.create.l HWIO_PMIC_ARB_OBS3_CHNL27_RDATA0_ADDR A:0xe630d98
y.create.l HWIO_PMIC_ARB_OBS3_CHNL28_RDATA0_ADDR A:0xe630e18
y.create.l HWIO_PMIC_ARB_OBS3_CHNL29_RDATA0_ADDR A:0xe630e98
y.create.l HWIO_PMIC_ARB_OBS3_CHNL30_RDATA0_ADDR A:0xe630f18
y.create.l HWIO_PMIC_ARB_OBS3_CHNL31_RDATA0_ADDR A:0xe630f98
y.create.l HWIO_PMIC_ARB_OBS3_CHNL32_RDATA0_ADDR A:0xe631018
y.create.l HWIO_PMIC_ARB_OBS3_CHNL33_RDATA0_ADDR A:0xe631098
y.create.l HWIO_PMIC_ARB_OBS3_CHNL34_RDATA0_ADDR A:0xe631118
y.create.l HWIO_PMIC_ARB_OBS3_CHNL35_RDATA0_ADDR A:0xe631198
y.create.l HWIO_PMIC_ARB_OBS3_CHNL36_RDATA0_ADDR A:0xe631218
y.create.l HWIO_PMIC_ARB_OBS3_CHNL37_RDATA0_ADDR A:0xe631298
y.create.l HWIO_PMIC_ARB_OBS3_CHNL38_RDATA0_ADDR A:0xe631318
y.create.l HWIO_PMIC_ARB_OBS3_CHNL39_RDATA0_ADDR A:0xe631398
y.create.l HWIO_PMIC_ARB_OBS3_CHNL40_RDATA0_ADDR A:0xe631418
y.create.l HWIO_PMIC_ARB_OBS3_CHNL41_RDATA0_ADDR A:0xe631498
y.create.l HWIO_PMIC_ARB_OBS3_CHNL42_RDATA0_ADDR A:0xe631518
y.create.l HWIO_PMIC_ARB_OBS3_CHNL43_RDATA0_ADDR A:0xe631598
y.create.l HWIO_PMIC_ARB_OBS3_CHNL44_RDATA0_ADDR A:0xe631618
y.create.l HWIO_PMIC_ARB_OBS3_CHNL45_RDATA0_ADDR A:0xe631698
y.create.l HWIO_PMIC_ARB_OBS3_CHNL46_RDATA0_ADDR A:0xe631718
y.create.l HWIO_PMIC_ARB_OBS3_CHNL47_RDATA0_ADDR A:0xe631798
y.create.l HWIO_PMIC_ARB_OBS3_CHNL48_RDATA0_ADDR A:0xe631818
y.create.l HWIO_PMIC_ARB_OBS3_CHNL49_RDATA0_ADDR A:0xe631898
y.create.l HWIO_PMIC_ARB_OBS3_CHNL50_RDATA0_ADDR A:0xe631918
y.create.l HWIO_PMIC_ARB_OBS3_CHNL51_RDATA0_ADDR A:0xe631998
y.create.l HWIO_PMIC_ARB_OBS3_CHNL52_RDATA0_ADDR A:0xe631a18
y.create.l HWIO_PMIC_ARB_OBS3_CHNL53_RDATA0_ADDR A:0xe631a98
y.create.l HWIO_PMIC_ARB_OBS3_CHNL54_RDATA0_ADDR A:0xe631b18
y.create.l HWIO_PMIC_ARB_OBS3_CHNL55_RDATA0_ADDR A:0xe631b98
y.create.l HWIO_PMIC_ARB_OBS3_CHNL56_RDATA0_ADDR A:0xe631c18
y.create.l HWIO_PMIC_ARB_OBS3_CHNL57_RDATA0_ADDR A:0xe631c98
y.create.l HWIO_PMIC_ARB_OBS3_CHNL58_RDATA0_ADDR A:0xe631d18
y.create.l HWIO_PMIC_ARB_OBS3_CHNL59_RDATA0_ADDR A:0xe631d98
y.create.l HWIO_PMIC_ARB_OBS3_CHNL60_RDATA0_ADDR A:0xe631e18
y.create.l HWIO_PMIC_ARB_OBS3_CHNL61_RDATA0_ADDR A:0xe631e98
y.create.l HWIO_PMIC_ARB_OBS3_CHNL62_RDATA0_ADDR A:0xe631f18
y.create.l HWIO_PMIC_ARB_OBS3_CHNL63_RDATA0_ADDR A:0xe631f98
y.create.l HWIO_PMIC_ARB_OBS3_CHNL64_RDATA0_ADDR A:0xe632018
y.create.l HWIO_PMIC_ARB_OBS3_CHNL65_RDATA0_ADDR A:0xe632098
y.create.l HWIO_PMIC_ARB_OBS3_CHNL66_RDATA0_ADDR A:0xe632118
y.create.l HWIO_PMIC_ARB_OBS3_CHNL67_RDATA0_ADDR A:0xe632198
y.create.l HWIO_PMIC_ARB_OBS3_CHNL68_RDATA0_ADDR A:0xe632218
y.create.l HWIO_PMIC_ARB_OBS3_CHNL69_RDATA0_ADDR A:0xe632298
y.create.l HWIO_PMIC_ARB_OBS3_CHNL70_RDATA0_ADDR A:0xe632318
y.create.l HWIO_PMIC_ARB_OBS3_CHNL71_RDATA0_ADDR A:0xe632398
y.create.l HWIO_PMIC_ARB_OBS3_CHNL72_RDATA0_ADDR A:0xe632418
y.create.l HWIO_PMIC_ARB_OBS3_CHNL73_RDATA0_ADDR A:0xe632498
y.create.l HWIO_PMIC_ARB_OBS3_CHNL74_RDATA0_ADDR A:0xe632518
y.create.l HWIO_PMIC_ARB_OBS3_CHNL75_RDATA0_ADDR A:0xe632598
y.create.l HWIO_PMIC_ARB_OBS3_CHNL76_RDATA0_ADDR A:0xe632618
y.create.l HWIO_PMIC_ARB_OBS3_CHNL77_RDATA0_ADDR A:0xe632698
y.create.l HWIO_PMIC_ARB_OBS3_CHNL78_RDATA0_ADDR A:0xe632718
y.create.l HWIO_PMIC_ARB_OBS3_CHNL79_RDATA0_ADDR A:0xe632798
y.create.l HWIO_PMIC_ARB_OBS3_CHNL80_RDATA0_ADDR A:0xe632818
y.create.l HWIO_PMIC_ARB_OBS3_CHNL81_RDATA0_ADDR A:0xe632898
y.create.l HWIO_PMIC_ARB_OBS3_CHNL82_RDATA0_ADDR A:0xe632918
y.create.l HWIO_PMIC_ARB_OBS3_CHNL83_RDATA0_ADDR A:0xe632998
y.create.l HWIO_PMIC_ARB_OBS3_CHNL84_RDATA0_ADDR A:0xe632a18
y.create.l HWIO_PMIC_ARB_OBS3_CHNL85_RDATA0_ADDR A:0xe632a98
y.create.l HWIO_PMIC_ARB_OBS3_CHNL86_RDATA0_ADDR A:0xe632b18
y.create.l HWIO_PMIC_ARB_OBS3_CHNL87_RDATA0_ADDR A:0xe632b98
y.create.l HWIO_PMIC_ARB_OBS3_CHNL88_RDATA0_ADDR A:0xe632c18
y.create.l HWIO_PMIC_ARB_OBS3_CHNL89_RDATA0_ADDR A:0xe632c98
y.create.l HWIO_PMIC_ARB_OBS3_CHNL90_RDATA0_ADDR A:0xe632d18
y.create.l HWIO_PMIC_ARB_OBS3_CHNL91_RDATA0_ADDR A:0xe632d98
y.create.l HWIO_PMIC_ARB_OBS3_CHNL92_RDATA0_ADDR A:0xe632e18
y.create.l HWIO_PMIC_ARB_OBS3_CHNL93_RDATA0_ADDR A:0xe632e98
y.create.l HWIO_PMIC_ARB_OBS3_CHNL94_RDATA0_ADDR A:0xe632f18
y.create.l HWIO_PMIC_ARB_OBS3_CHNL95_RDATA0_ADDR A:0xe632f98
y.create.l HWIO_PMIC_ARB_OBS3_CHNL96_RDATA0_ADDR A:0xe633018
y.create.l HWIO_PMIC_ARB_OBS3_CHNL97_RDATA0_ADDR A:0xe633098
y.create.l HWIO_PMIC_ARB_OBS3_CHNL98_RDATA0_ADDR A:0xe633118
y.create.l HWIO_PMIC_ARB_OBS3_CHNL99_RDATA0_ADDR A:0xe633198
y.create.l HWIO_PMIC_ARB_OBS3_CHNL100_RDATA0_ADDR A:0xe633218
y.create.l HWIO_PMIC_ARB_OBS3_CHNL101_RDATA0_ADDR A:0xe633298
y.create.l HWIO_PMIC_ARB_OBS3_CHNL102_RDATA0_ADDR A:0xe633318
y.create.l HWIO_PMIC_ARB_OBS3_CHNL103_RDATA0_ADDR A:0xe633398
y.create.l HWIO_PMIC_ARB_OBS3_CHNL104_RDATA0_ADDR A:0xe633418
y.create.l HWIO_PMIC_ARB_OBS3_CHNL105_RDATA0_ADDR A:0xe633498
y.create.l HWIO_PMIC_ARB_OBS3_CHNL106_RDATA0_ADDR A:0xe633518
y.create.l HWIO_PMIC_ARB_OBS3_CHNL107_RDATA0_ADDR A:0xe633598
y.create.l HWIO_PMIC_ARB_OBS3_CHNL108_RDATA0_ADDR A:0xe633618
y.create.l HWIO_PMIC_ARB_OBS3_CHNL109_RDATA0_ADDR A:0xe633698
y.create.l HWIO_PMIC_ARB_OBS3_CHNL110_RDATA0_ADDR A:0xe633718
y.create.l HWIO_PMIC_ARB_OBS3_CHNL111_RDATA0_ADDR A:0xe633798
y.create.l HWIO_PMIC_ARB_OBS3_CHNL112_RDATA0_ADDR A:0xe633818
y.create.l HWIO_PMIC_ARB_OBS3_CHNL113_RDATA0_ADDR A:0xe633898
y.create.l HWIO_PMIC_ARB_OBS3_CHNL114_RDATA0_ADDR A:0xe633918
y.create.l HWIO_PMIC_ARB_OBS3_CHNL115_RDATA0_ADDR A:0xe633998
y.create.l HWIO_PMIC_ARB_OBS3_CHNL116_RDATA0_ADDR A:0xe633a18
y.create.l HWIO_PMIC_ARB_OBS3_CHNL117_RDATA0_ADDR A:0xe633a98
y.create.l HWIO_PMIC_ARB_OBS3_CHNL118_RDATA0_ADDR A:0xe633b18
y.create.l HWIO_PMIC_ARB_OBS3_CHNL119_RDATA0_ADDR A:0xe633b98
y.create.l HWIO_PMIC_ARB_OBS3_CHNL120_RDATA0_ADDR A:0xe633c18
y.create.l HWIO_PMIC_ARB_OBS3_CHNL121_RDATA0_ADDR A:0xe633c98
y.create.l HWIO_PMIC_ARB_OBS3_CHNL122_RDATA0_ADDR A:0xe633d18
y.create.l HWIO_PMIC_ARB_OBS3_CHNL123_RDATA0_ADDR A:0xe633d98
y.create.l HWIO_PMIC_ARB_OBS3_CHNL124_RDATA0_ADDR A:0xe633e18
y.create.l HWIO_PMIC_ARB_OBS3_CHNL125_RDATA0_ADDR A:0xe633e98
y.create.l HWIO_PMIC_ARB_OBS3_CHNL126_RDATA0_ADDR A:0xe633f18
y.create.l HWIO_PMIC_ARB_OBS3_CHNL127_RDATA0_ADDR A:0xe633f98
y.create.l HWIO_PMIC_ARB_OBS3_CHNL128_RDATA0_ADDR A:0xe634018
y.create.l HWIO_PMIC_ARB_OBS3_CHNL129_RDATA0_ADDR A:0xe634098
y.create.l HWIO_PMIC_ARB_OBS3_CHNL130_RDATA0_ADDR A:0xe634118
y.create.l HWIO_PMIC_ARB_OBS3_CHNL131_RDATA0_ADDR A:0xe634198
y.create.l HWIO_PMIC_ARB_OBS3_CHNL132_RDATA0_ADDR A:0xe634218
y.create.l HWIO_PMIC_ARB_OBS3_CHNL133_RDATA0_ADDR A:0xe634298
y.create.l HWIO_PMIC_ARB_OBS3_CHNL134_RDATA0_ADDR A:0xe634318
y.create.l HWIO_PMIC_ARB_OBS3_CHNL135_RDATA0_ADDR A:0xe634398
y.create.l HWIO_PMIC_ARB_OBS3_CHNL136_RDATA0_ADDR A:0xe634418
y.create.l HWIO_PMIC_ARB_OBS3_CHNL137_RDATA0_ADDR A:0xe634498
y.create.l HWIO_PMIC_ARB_OBS3_CHNL138_RDATA0_ADDR A:0xe634518
y.create.l HWIO_PMIC_ARB_OBS3_CHNL139_RDATA0_ADDR A:0xe634598
y.create.l HWIO_PMIC_ARB_OBS3_CHNL140_RDATA0_ADDR A:0xe634618
y.create.l HWIO_PMIC_ARB_OBS3_CHNL141_RDATA0_ADDR A:0xe634698
y.create.l HWIO_PMIC_ARB_OBS3_CHNL142_RDATA0_ADDR A:0xe634718
y.create.l HWIO_PMIC_ARB_OBS3_CHNL143_RDATA0_ADDR A:0xe634798
y.create.l HWIO_PMIC_ARB_OBS3_CHNL144_RDATA0_ADDR A:0xe634818
y.create.l HWIO_PMIC_ARB_OBS3_CHNL145_RDATA0_ADDR A:0xe634898
y.create.l HWIO_PMIC_ARB_OBS3_CHNL146_RDATA0_ADDR A:0xe634918
y.create.l HWIO_PMIC_ARB_OBS3_CHNL147_RDATA0_ADDR A:0xe634998
y.create.l HWIO_PMIC_ARB_OBS3_CHNL148_RDATA0_ADDR A:0xe634a18
y.create.l HWIO_PMIC_ARB_OBS3_CHNL149_RDATA0_ADDR A:0xe634a98
y.create.l HWIO_PMIC_ARB_OBS3_CHNL150_RDATA0_ADDR A:0xe634b18
y.create.l HWIO_PMIC_ARB_OBS3_CHNL151_RDATA0_ADDR A:0xe634b98
y.create.l HWIO_PMIC_ARB_OBS3_CHNL152_RDATA0_ADDR A:0xe634c18
y.create.l HWIO_PMIC_ARB_OBS3_CHNL153_RDATA0_ADDR A:0xe634c98
y.create.l HWIO_PMIC_ARB_OBS3_CHNL154_RDATA0_ADDR A:0xe634d18
y.create.l HWIO_PMIC_ARB_OBS3_CHNL155_RDATA0_ADDR A:0xe634d98
y.create.l HWIO_PMIC_ARB_OBS3_CHNL156_RDATA0_ADDR A:0xe634e18
y.create.l HWIO_PMIC_ARB_OBS3_CHNL157_RDATA0_ADDR A:0xe634e98
y.create.l HWIO_PMIC_ARB_OBS3_CHNL158_RDATA0_ADDR A:0xe634f18
y.create.l HWIO_PMIC_ARB_OBS3_CHNL159_RDATA0_ADDR A:0xe634f98
y.create.l HWIO_PMIC_ARB_OBS3_CHNL160_RDATA0_ADDR A:0xe635018
y.create.l HWIO_PMIC_ARB_OBS3_CHNL161_RDATA0_ADDR A:0xe635098
y.create.l HWIO_PMIC_ARB_OBS3_CHNL162_RDATA0_ADDR A:0xe635118
y.create.l HWIO_PMIC_ARB_OBS3_CHNL163_RDATA0_ADDR A:0xe635198
y.create.l HWIO_PMIC_ARB_OBS3_CHNL164_RDATA0_ADDR A:0xe635218
y.create.l HWIO_PMIC_ARB_OBS3_CHNL165_RDATA0_ADDR A:0xe635298
y.create.l HWIO_PMIC_ARB_OBS3_CHNL166_RDATA0_ADDR A:0xe635318
y.create.l HWIO_PMIC_ARB_OBS3_CHNL167_RDATA0_ADDR A:0xe635398
y.create.l HWIO_PMIC_ARB_OBS3_CHNL168_RDATA0_ADDR A:0xe635418
y.create.l HWIO_PMIC_ARB_OBS3_CHNL169_RDATA0_ADDR A:0xe635498
y.create.l HWIO_PMIC_ARB_OBS3_CHNL170_RDATA0_ADDR A:0xe635518
y.create.l HWIO_PMIC_ARB_OBS3_CHNL171_RDATA0_ADDR A:0xe635598
y.create.l HWIO_PMIC_ARB_OBS3_CHNL172_RDATA0_ADDR A:0xe635618
y.create.l HWIO_PMIC_ARB_OBS3_CHNL173_RDATA0_ADDR A:0xe635698
y.create.l HWIO_PMIC_ARB_OBS3_CHNL174_RDATA0_ADDR A:0xe635718
y.create.l HWIO_PMIC_ARB_OBS3_CHNL175_RDATA0_ADDR A:0xe635798
y.create.l HWIO_PMIC_ARB_OBS3_CHNL176_RDATA0_ADDR A:0xe635818
y.create.l HWIO_PMIC_ARB_OBS3_CHNL177_RDATA0_ADDR A:0xe635898
y.create.l HWIO_PMIC_ARB_OBS3_CHNL178_RDATA0_ADDR A:0xe635918
y.create.l HWIO_PMIC_ARB_OBS3_CHNL179_RDATA0_ADDR A:0xe635998
y.create.l HWIO_PMIC_ARB_OBS3_CHNL180_RDATA0_ADDR A:0xe635a18
y.create.l HWIO_PMIC_ARB_OBS3_CHNL181_RDATA0_ADDR A:0xe635a98
y.create.l HWIO_PMIC_ARB_OBS3_CHNL182_RDATA0_ADDR A:0xe635b18
y.create.l HWIO_PMIC_ARB_OBS3_CHNL183_RDATA0_ADDR A:0xe635b98
y.create.l HWIO_PMIC_ARB_OBS3_CHNL184_RDATA0_ADDR A:0xe635c18
y.create.l HWIO_PMIC_ARB_OBS3_CHNL185_RDATA0_ADDR A:0xe635c98
y.create.l HWIO_PMIC_ARB_OBS3_CHNL186_RDATA0_ADDR A:0xe635d18
y.create.l HWIO_PMIC_ARB_OBS3_CHNL187_RDATA0_ADDR A:0xe635d98
y.create.l HWIO_PMIC_ARB_OBS3_CHNL188_RDATA0_ADDR A:0xe635e18
y.create.l HWIO_PMIC_ARB_OBS3_CHNL189_RDATA0_ADDR A:0xe635e98
y.create.l HWIO_PMIC_ARB_OBS3_CHNL190_RDATA0_ADDR A:0xe635f18
y.create.l HWIO_PMIC_ARB_OBS3_CHNL191_RDATA0_ADDR A:0xe635f98
y.create.l HWIO_PMIC_ARB_OBS3_CHNL192_RDATA0_ADDR A:0xe636018
y.create.l HWIO_PMIC_ARB_OBS3_CHNL193_RDATA0_ADDR A:0xe636098
y.create.l HWIO_PMIC_ARB_OBS3_CHNL194_RDATA0_ADDR A:0xe636118
y.create.l HWIO_PMIC_ARB_OBS3_CHNL195_RDATA0_ADDR A:0xe636198
y.create.l HWIO_PMIC_ARB_OBS3_CHNL196_RDATA0_ADDR A:0xe636218
y.create.l HWIO_PMIC_ARB_OBS3_CHNL197_RDATA0_ADDR A:0xe636298
y.create.l HWIO_PMIC_ARB_OBS3_CHNL198_RDATA0_ADDR A:0xe636318
y.create.l HWIO_PMIC_ARB_OBS3_CHNL199_RDATA0_ADDR A:0xe636398
y.create.l HWIO_PMIC_ARB_OBS3_CHNL200_RDATA0_ADDR A:0xe636418
y.create.l HWIO_PMIC_ARB_OBS3_CHNL201_RDATA0_ADDR A:0xe636498
y.create.l HWIO_PMIC_ARB_OBS3_CHNL202_RDATA0_ADDR A:0xe636518
y.create.l HWIO_PMIC_ARB_OBS3_CHNL203_RDATA0_ADDR A:0xe636598
y.create.l HWIO_PMIC_ARB_OBS3_CHNL204_RDATA0_ADDR A:0xe636618
y.create.l HWIO_PMIC_ARB_OBS3_CHNL205_RDATA0_ADDR A:0xe636698
y.create.l HWIO_PMIC_ARB_OBS3_CHNL206_RDATA0_ADDR A:0xe636718
y.create.l HWIO_PMIC_ARB_OBS3_CHNL207_RDATA0_ADDR A:0xe636798
y.create.l HWIO_PMIC_ARB_OBS3_CHNL208_RDATA0_ADDR A:0xe636818
y.create.l HWIO_PMIC_ARB_OBS3_CHNL209_RDATA0_ADDR A:0xe636898
y.create.l HWIO_PMIC_ARB_OBS3_CHNL210_RDATA0_ADDR A:0xe636918
y.create.l HWIO_PMIC_ARB_OBS3_CHNL211_RDATA0_ADDR A:0xe636998
y.create.l HWIO_PMIC_ARB_OBS3_CHNL212_RDATA0_ADDR A:0xe636a18
y.create.l HWIO_PMIC_ARB_OBS3_CHNL213_RDATA0_ADDR A:0xe636a98
y.create.l HWIO_PMIC_ARB_OBS3_CHNL214_RDATA0_ADDR A:0xe636b18
y.create.l HWIO_PMIC_ARB_OBS3_CHNL215_RDATA0_ADDR A:0xe636b98
y.create.l HWIO_PMIC_ARB_OBS3_CHNL216_RDATA0_ADDR A:0xe636c18
y.create.l HWIO_PMIC_ARB_OBS3_CHNL217_RDATA0_ADDR A:0xe636c98
y.create.l HWIO_PMIC_ARB_OBS3_CHNL218_RDATA0_ADDR A:0xe636d18
y.create.l HWIO_PMIC_ARB_OBS3_CHNL219_RDATA0_ADDR A:0xe636d98
y.create.l HWIO_PMIC_ARB_OBS3_CHNL220_RDATA0_ADDR A:0xe636e18
y.create.l HWIO_PMIC_ARB_OBS3_CHNL221_RDATA0_ADDR A:0xe636e98
y.create.l HWIO_PMIC_ARB_OBS3_CHNL222_RDATA0_ADDR A:0xe636f18
y.create.l HWIO_PMIC_ARB_OBS3_CHNL223_RDATA0_ADDR A:0xe636f98
y.create.l HWIO_PMIC_ARB_OBS3_CHNL224_RDATA0_ADDR A:0xe637018
y.create.l HWIO_PMIC_ARB_OBS3_CHNL225_RDATA0_ADDR A:0xe637098
y.create.l HWIO_PMIC_ARB_OBS3_CHNL226_RDATA0_ADDR A:0xe637118
y.create.l HWIO_PMIC_ARB_OBS3_CHNL227_RDATA0_ADDR A:0xe637198
y.create.l HWIO_PMIC_ARB_OBS3_CHNL228_RDATA0_ADDR A:0xe637218
y.create.l HWIO_PMIC_ARB_OBS3_CHNL229_RDATA0_ADDR A:0xe637298
y.create.l HWIO_PMIC_ARB_OBS3_CHNL230_RDATA0_ADDR A:0xe637318
y.create.l HWIO_PMIC_ARB_OBS3_CHNL231_RDATA0_ADDR A:0xe637398
y.create.l HWIO_PMIC_ARB_OBS3_CHNL232_RDATA0_ADDR A:0xe637418
y.create.l HWIO_PMIC_ARB_OBS3_CHNL233_RDATA0_ADDR A:0xe637498
y.create.l HWIO_PMIC_ARB_OBS3_CHNL234_RDATA0_ADDR A:0xe637518
y.create.l HWIO_PMIC_ARB_OBS3_CHNL235_RDATA0_ADDR A:0xe637598
y.create.l HWIO_PMIC_ARB_OBS3_CHNL236_RDATA0_ADDR A:0xe637618
y.create.l HWIO_PMIC_ARB_OBS3_CHNL237_RDATA0_ADDR A:0xe637698
y.create.l HWIO_PMIC_ARB_OBS3_CHNL238_RDATA0_ADDR A:0xe637718
y.create.l HWIO_PMIC_ARB_OBS3_CHNL239_RDATA0_ADDR A:0xe637798
y.create.l HWIO_PMIC_ARB_OBS3_CHNL240_RDATA0_ADDR A:0xe637818
y.create.l HWIO_PMIC_ARB_OBS3_CHNL241_RDATA0_ADDR A:0xe637898
y.create.l HWIO_PMIC_ARB_OBS3_CHNL242_RDATA0_ADDR A:0xe637918
y.create.l HWIO_PMIC_ARB_OBS3_CHNL243_RDATA0_ADDR A:0xe637998
y.create.l HWIO_PMIC_ARB_OBS3_CHNL244_RDATA0_ADDR A:0xe637a18
y.create.l HWIO_PMIC_ARB_OBS3_CHNL245_RDATA0_ADDR A:0xe637a98
y.create.l HWIO_PMIC_ARB_OBS3_CHNL246_RDATA0_ADDR A:0xe637b18
y.create.l HWIO_PMIC_ARB_OBS3_CHNL247_RDATA0_ADDR A:0xe637b98
y.create.l HWIO_PMIC_ARB_OBS3_CHNL248_RDATA0_ADDR A:0xe637c18
y.create.l HWIO_PMIC_ARB_OBS3_CHNL249_RDATA0_ADDR A:0xe637c98
y.create.l HWIO_PMIC_ARB_OBS3_CHNL250_RDATA0_ADDR A:0xe637d18
y.create.l HWIO_PMIC_ARB_OBS3_CHNL251_RDATA0_ADDR A:0xe637d98
y.create.l HWIO_PMIC_ARB_OBS3_CHNL252_RDATA0_ADDR A:0xe637e18
y.create.l HWIO_PMIC_ARB_OBS3_CHNL253_RDATA0_ADDR A:0xe637e98
y.create.l HWIO_PMIC_ARB_OBS3_CHNL254_RDATA0_ADDR A:0xe637f18
y.create.l HWIO_PMIC_ARB_OBS3_CHNL255_RDATA0_ADDR A:0xe637f98
y.create.l HWIO_PMIC_ARB_OBS3_CHNL256_RDATA0_ADDR A:0xe638018
y.create.l HWIO_PMIC_ARB_OBS3_CHNL257_RDATA0_ADDR A:0xe638098
y.create.l HWIO_PMIC_ARB_OBS3_CHNL258_RDATA0_ADDR A:0xe638118
y.create.l HWIO_PMIC_ARB_OBS3_CHNL259_RDATA0_ADDR A:0xe638198
y.create.l HWIO_PMIC_ARB_OBS3_CHNL260_RDATA0_ADDR A:0xe638218
y.create.l HWIO_PMIC_ARB_OBS3_CHNL261_RDATA0_ADDR A:0xe638298
y.create.l HWIO_PMIC_ARB_OBS3_CHNL262_RDATA0_ADDR A:0xe638318
y.create.l HWIO_PMIC_ARB_OBS3_CHNL263_RDATA0_ADDR A:0xe638398
y.create.l HWIO_PMIC_ARB_OBS3_CHNL264_RDATA0_ADDR A:0xe638418
y.create.l HWIO_PMIC_ARB_OBS3_CHNL265_RDATA0_ADDR A:0xe638498
y.create.l HWIO_PMIC_ARB_OBS3_CHNL266_RDATA0_ADDR A:0xe638518
y.create.l HWIO_PMIC_ARB_OBS3_CHNL267_RDATA0_ADDR A:0xe638598
y.create.l HWIO_PMIC_ARB_OBS3_CHNL268_RDATA0_ADDR A:0xe638618
y.create.l HWIO_PMIC_ARB_OBS3_CHNL269_RDATA0_ADDR A:0xe638698
y.create.l HWIO_PMIC_ARB_OBS3_CHNL270_RDATA0_ADDR A:0xe638718
y.create.l HWIO_PMIC_ARB_OBS3_CHNL271_RDATA0_ADDR A:0xe638798
y.create.l HWIO_PMIC_ARB_OBS3_CHNL272_RDATA0_ADDR A:0xe638818
y.create.l HWIO_PMIC_ARB_OBS3_CHNL273_RDATA0_ADDR A:0xe638898
y.create.l HWIO_PMIC_ARB_OBS3_CHNL274_RDATA0_ADDR A:0xe638918
y.create.l HWIO_PMIC_ARB_OBS3_CHNL275_RDATA0_ADDR A:0xe638998
y.create.l HWIO_PMIC_ARB_OBS3_CHNL276_RDATA0_ADDR A:0xe638a18
y.create.l HWIO_PMIC_ARB_OBS3_CHNL277_RDATA0_ADDR A:0xe638a98
y.create.l HWIO_PMIC_ARB_OBS3_CHNL278_RDATA0_ADDR A:0xe638b18
y.create.l HWIO_PMIC_ARB_OBS3_CHNL279_RDATA0_ADDR A:0xe638b98
y.create.l HWIO_PMIC_ARB_OBS3_CHNL280_RDATA0_ADDR A:0xe638c18
y.create.l HWIO_PMIC_ARB_OBS3_CHNL281_RDATA0_ADDR A:0xe638c98
y.create.l HWIO_PMIC_ARB_OBS3_CHNL282_RDATA0_ADDR A:0xe638d18
y.create.l HWIO_PMIC_ARB_OBS3_CHNL283_RDATA0_ADDR A:0xe638d98
y.create.l HWIO_PMIC_ARB_OBS3_CHNL284_RDATA0_ADDR A:0xe638e18
y.create.l HWIO_PMIC_ARB_OBS3_CHNL285_RDATA0_ADDR A:0xe638e98
y.create.l HWIO_PMIC_ARB_OBS3_CHNL286_RDATA0_ADDR A:0xe638f18
y.create.l HWIO_PMIC_ARB_OBS3_CHNL287_RDATA0_ADDR A:0xe638f98
y.create.l HWIO_PMIC_ARB_OBS3_CHNL288_RDATA0_ADDR A:0xe639018
y.create.l HWIO_PMIC_ARB_OBS3_CHNL289_RDATA0_ADDR A:0xe639098
y.create.l HWIO_PMIC_ARB_OBS3_CHNL290_RDATA0_ADDR A:0xe639118
y.create.l HWIO_PMIC_ARB_OBS3_CHNL291_RDATA0_ADDR A:0xe639198
y.create.l HWIO_PMIC_ARB_OBS3_CHNL292_RDATA0_ADDR A:0xe639218
y.create.l HWIO_PMIC_ARB_OBS3_CHNL293_RDATA0_ADDR A:0xe639298
y.create.l HWIO_PMIC_ARB_OBS3_CHNL294_RDATA0_ADDR A:0xe639318
y.create.l HWIO_PMIC_ARB_OBS3_CHNL295_RDATA0_ADDR A:0xe639398
y.create.l HWIO_PMIC_ARB_OBS3_CHNL296_RDATA0_ADDR A:0xe639418
y.create.l HWIO_PMIC_ARB_OBS3_CHNL297_RDATA0_ADDR A:0xe639498
y.create.l HWIO_PMIC_ARB_OBS3_CHNL298_RDATA0_ADDR A:0xe639518
y.create.l HWIO_PMIC_ARB_OBS3_CHNL299_RDATA0_ADDR A:0xe639598
y.create.l HWIO_PMIC_ARB_OBS3_CHNL300_RDATA0_ADDR A:0xe639618
y.create.l HWIO_PMIC_ARB_OBS3_CHNL301_RDATA0_ADDR A:0xe639698
y.create.l HWIO_PMIC_ARB_OBS3_CHNL302_RDATA0_ADDR A:0xe639718
y.create.l HWIO_PMIC_ARB_OBS3_CHNL303_RDATA0_ADDR A:0xe639798
y.create.l HWIO_PMIC_ARB_OBS3_CHNL304_RDATA0_ADDR A:0xe639818
y.create.l HWIO_PMIC_ARB_OBS3_CHNL305_RDATA0_ADDR A:0xe639898
y.create.l HWIO_PMIC_ARB_OBS3_CHNL306_RDATA0_ADDR A:0xe639918
y.create.l HWIO_PMIC_ARB_OBS3_CHNL307_RDATA0_ADDR A:0xe639998
y.create.l HWIO_PMIC_ARB_OBS3_CHNL308_RDATA0_ADDR A:0xe639a18
y.create.l HWIO_PMIC_ARB_OBS3_CHNL309_RDATA0_ADDR A:0xe639a98
y.create.l HWIO_PMIC_ARB_OBS3_CHNL310_RDATA0_ADDR A:0xe639b18
y.create.l HWIO_PMIC_ARB_OBS3_CHNL311_RDATA0_ADDR A:0xe639b98
y.create.l HWIO_PMIC_ARB_OBS3_CHNL312_RDATA0_ADDR A:0xe639c18
y.create.l HWIO_PMIC_ARB_OBS3_CHNL313_RDATA0_ADDR A:0xe639c98
y.create.l HWIO_PMIC_ARB_OBS3_CHNL314_RDATA0_ADDR A:0xe639d18
y.create.l HWIO_PMIC_ARB_OBS3_CHNL315_RDATA0_ADDR A:0xe639d98
y.create.l HWIO_PMIC_ARB_OBS3_CHNL316_RDATA0_ADDR A:0xe639e18
y.create.l HWIO_PMIC_ARB_OBS3_CHNL317_RDATA0_ADDR A:0xe639e98
y.create.l HWIO_PMIC_ARB_OBS3_CHNL318_RDATA0_ADDR A:0xe639f18
y.create.l HWIO_PMIC_ARB_OBS3_CHNL319_RDATA0_ADDR A:0xe639f98
y.create.l HWIO_PMIC_ARB_OBS3_CHNL320_RDATA0_ADDR A:0xe63a018
y.create.l HWIO_PMIC_ARB_OBS3_CHNL321_RDATA0_ADDR A:0xe63a098
y.create.l HWIO_PMIC_ARB_OBS3_CHNL322_RDATA0_ADDR A:0xe63a118
y.create.l HWIO_PMIC_ARB_OBS3_CHNL323_RDATA0_ADDR A:0xe63a198
y.create.l HWIO_PMIC_ARB_OBS3_CHNL324_RDATA0_ADDR A:0xe63a218
y.create.l HWIO_PMIC_ARB_OBS3_CHNL325_RDATA0_ADDR A:0xe63a298
y.create.l HWIO_PMIC_ARB_OBS3_CHNL326_RDATA0_ADDR A:0xe63a318
y.create.l HWIO_PMIC_ARB_OBS3_CHNL327_RDATA0_ADDR A:0xe63a398
y.create.l HWIO_PMIC_ARB_OBS3_CHNL328_RDATA0_ADDR A:0xe63a418
y.create.l HWIO_PMIC_ARB_OBS3_CHNL329_RDATA0_ADDR A:0xe63a498
y.create.l HWIO_PMIC_ARB_OBS3_CHNL330_RDATA0_ADDR A:0xe63a518
y.create.l HWIO_PMIC_ARB_OBS3_CHNL331_RDATA0_ADDR A:0xe63a598
y.create.l HWIO_PMIC_ARB_OBS3_CHNL332_RDATA0_ADDR A:0xe63a618
y.create.l HWIO_PMIC_ARB_OBS3_CHNL333_RDATA0_ADDR A:0xe63a698
y.create.l HWIO_PMIC_ARB_OBS3_CHNL334_RDATA0_ADDR A:0xe63a718
y.create.l HWIO_PMIC_ARB_OBS3_CHNL335_RDATA0_ADDR A:0xe63a798
y.create.l HWIO_PMIC_ARB_OBS3_CHNL336_RDATA0_ADDR A:0xe63a818
y.create.l HWIO_PMIC_ARB_OBS3_CHNL337_RDATA0_ADDR A:0xe63a898
y.create.l HWIO_PMIC_ARB_OBS3_CHNL338_RDATA0_ADDR A:0xe63a918
y.create.l HWIO_PMIC_ARB_OBS3_CHNL339_RDATA0_ADDR A:0xe63a998
y.create.l HWIO_PMIC_ARB_OBS3_CHNL340_RDATA0_ADDR A:0xe63aa18
y.create.l HWIO_PMIC_ARB_OBS3_CHNL341_RDATA0_ADDR A:0xe63aa98
y.create.l HWIO_PMIC_ARB_OBS3_CHNL342_RDATA0_ADDR A:0xe63ab18
y.create.l HWIO_PMIC_ARB_OBS3_CHNL343_RDATA0_ADDR A:0xe63ab98
y.create.l HWIO_PMIC_ARB_OBS3_CHNL344_RDATA0_ADDR A:0xe63ac18
y.create.l HWIO_PMIC_ARB_OBS3_CHNL345_RDATA0_ADDR A:0xe63ac98
y.create.l HWIO_PMIC_ARB_OBS3_CHNL346_RDATA0_ADDR A:0xe63ad18
y.create.l HWIO_PMIC_ARB_OBS3_CHNL347_RDATA0_ADDR A:0xe63ad98
y.create.l HWIO_PMIC_ARB_OBS3_CHNL348_RDATA0_ADDR A:0xe63ae18
y.create.l HWIO_PMIC_ARB_OBS3_CHNL349_RDATA0_ADDR A:0xe63ae98
y.create.l HWIO_PMIC_ARB_OBS3_CHNL350_RDATA0_ADDR A:0xe63af18
y.create.l HWIO_PMIC_ARB_OBS3_CHNL351_RDATA0_ADDR A:0xe63af98
y.create.l HWIO_PMIC_ARB_OBS3_CHNL352_RDATA0_ADDR A:0xe63b018
y.create.l HWIO_PMIC_ARB_OBS3_CHNL353_RDATA0_ADDR A:0xe63b098
y.create.l HWIO_PMIC_ARB_OBS3_CHNL354_RDATA0_ADDR A:0xe63b118
y.create.l HWIO_PMIC_ARB_OBS3_CHNL355_RDATA0_ADDR A:0xe63b198
y.create.l HWIO_PMIC_ARB_OBS3_CHNL356_RDATA0_ADDR A:0xe63b218
y.create.l HWIO_PMIC_ARB_OBS3_CHNL357_RDATA0_ADDR A:0xe63b298
y.create.l HWIO_PMIC_ARB_OBS3_CHNL358_RDATA0_ADDR A:0xe63b318
y.create.l HWIO_PMIC_ARB_OBS3_CHNL359_RDATA0_ADDR A:0xe63b398
y.create.l HWIO_PMIC_ARB_OBS3_CHNL360_RDATA0_ADDR A:0xe63b418
y.create.l HWIO_PMIC_ARB_OBS3_CHNL361_RDATA0_ADDR A:0xe63b498
y.create.l HWIO_PMIC_ARB_OBS3_CHNL362_RDATA0_ADDR A:0xe63b518
y.create.l HWIO_PMIC_ARB_OBS3_CHNL363_RDATA0_ADDR A:0xe63b598
y.create.l HWIO_PMIC_ARB_OBS3_CHNL364_RDATA0_ADDR A:0xe63b618
y.create.l HWIO_PMIC_ARB_OBS3_CHNL365_RDATA0_ADDR A:0xe63b698
y.create.l HWIO_PMIC_ARB_OBS3_CHNL366_RDATA0_ADDR A:0xe63b718
y.create.l HWIO_PMIC_ARB_OBS3_CHNL367_RDATA0_ADDR A:0xe63b798
y.create.l HWIO_PMIC_ARB_OBS3_CHNL368_RDATA0_ADDR A:0xe63b818
y.create.l HWIO_PMIC_ARB_OBS3_CHNL369_RDATA0_ADDR A:0xe63b898
y.create.l HWIO_PMIC_ARB_OBS3_CHNL370_RDATA0_ADDR A:0xe63b918
y.create.l HWIO_PMIC_ARB_OBS3_CHNL371_RDATA0_ADDR A:0xe63b998
y.create.l HWIO_PMIC_ARB_OBS3_CHNL372_RDATA0_ADDR A:0xe63ba18
y.create.l HWIO_PMIC_ARB_OBS3_CHNL373_RDATA0_ADDR A:0xe63ba98
y.create.l HWIO_PMIC_ARB_OBS3_CHNL374_RDATA0_ADDR A:0xe63bb18
y.create.l HWIO_PMIC_ARB_OBS3_CHNL375_RDATA0_ADDR A:0xe63bb98
y.create.l HWIO_PMIC_ARB_OBS3_CHNL376_RDATA0_ADDR A:0xe63bc18
y.create.l HWIO_PMIC_ARB_OBS3_CHNL377_RDATA0_ADDR A:0xe63bc98
y.create.l HWIO_PMIC_ARB_OBS3_CHNL378_RDATA0_ADDR A:0xe63bd18
y.create.l HWIO_PMIC_ARB_OBS3_CHNL379_RDATA0_ADDR A:0xe63bd98
y.create.l HWIO_PMIC_ARB_OBS3_CHNL380_RDATA0_ADDR A:0xe63be18
y.create.l HWIO_PMIC_ARB_OBS3_CHNL381_RDATA0_ADDR A:0xe63be98
y.create.l HWIO_PMIC_ARB_OBS3_CHNL382_RDATA0_ADDR A:0xe63bf18
y.create.l HWIO_PMIC_ARB_OBS3_CHNL383_RDATA0_ADDR A:0xe63bf98
y.create.l HWIO_PMIC_ARB_OBS3_CHNL384_RDATA0_ADDR A:0xe63c018
y.create.l HWIO_PMIC_ARB_OBS3_CHNL385_RDATA0_ADDR A:0xe63c098
y.create.l HWIO_PMIC_ARB_OBS3_CHNL386_RDATA0_ADDR A:0xe63c118
y.create.l HWIO_PMIC_ARB_OBS3_CHNL387_RDATA0_ADDR A:0xe63c198
y.create.l HWIO_PMIC_ARB_OBS3_CHNL388_RDATA0_ADDR A:0xe63c218
y.create.l HWIO_PMIC_ARB_OBS3_CHNL389_RDATA0_ADDR A:0xe63c298
y.create.l HWIO_PMIC_ARB_OBS3_CHNL390_RDATA0_ADDR A:0xe63c318
y.create.l HWIO_PMIC_ARB_OBS3_CHNL391_RDATA0_ADDR A:0xe63c398
y.create.l HWIO_PMIC_ARB_OBS3_CHNL392_RDATA0_ADDR A:0xe63c418
y.create.l HWIO_PMIC_ARB_OBS3_CHNL393_RDATA0_ADDR A:0xe63c498
y.create.l HWIO_PMIC_ARB_OBS3_CHNL394_RDATA0_ADDR A:0xe63c518
y.create.l HWIO_PMIC_ARB_OBS3_CHNL395_RDATA0_ADDR A:0xe63c598
y.create.l HWIO_PMIC_ARB_OBS3_CHNL396_RDATA0_ADDR A:0xe63c618
y.create.l HWIO_PMIC_ARB_OBS3_CHNL397_RDATA0_ADDR A:0xe63c698
y.create.l HWIO_PMIC_ARB_OBS3_CHNL398_RDATA0_ADDR A:0xe63c718
y.create.l HWIO_PMIC_ARB_OBS3_CHNL399_RDATA0_ADDR A:0xe63c798
y.create.l HWIO_PMIC_ARB_OBS3_CHNL400_RDATA0_ADDR A:0xe63c818
y.create.l HWIO_PMIC_ARB_OBS3_CHNL401_RDATA0_ADDR A:0xe63c898
y.create.l HWIO_PMIC_ARB_OBS3_CHNL402_RDATA0_ADDR A:0xe63c918
y.create.l HWIO_PMIC_ARB_OBS3_CHNL403_RDATA0_ADDR A:0xe63c998
y.create.l HWIO_PMIC_ARB_OBS3_CHNL404_RDATA0_ADDR A:0xe63ca18
y.create.l HWIO_PMIC_ARB_OBS3_CHNL405_RDATA0_ADDR A:0xe63ca98
y.create.l HWIO_PMIC_ARB_OBS3_CHNL406_RDATA0_ADDR A:0xe63cb18
y.create.l HWIO_PMIC_ARB_OBS3_CHNL407_RDATA0_ADDR A:0xe63cb98
y.create.l HWIO_PMIC_ARB_OBS3_CHNL408_RDATA0_ADDR A:0xe63cc18
y.create.l HWIO_PMIC_ARB_OBS3_CHNL409_RDATA0_ADDR A:0xe63cc98
y.create.l HWIO_PMIC_ARB_OBS3_CHNL410_RDATA0_ADDR A:0xe63cd18
y.create.l HWIO_PMIC_ARB_OBS3_CHNL411_RDATA0_ADDR A:0xe63cd98
y.create.l HWIO_PMIC_ARB_OBS3_CHNL412_RDATA0_ADDR A:0xe63ce18
y.create.l HWIO_PMIC_ARB_OBS3_CHNL413_RDATA0_ADDR A:0xe63ce98
y.create.l HWIO_PMIC_ARB_OBS3_CHNL414_RDATA0_ADDR A:0xe63cf18
y.create.l HWIO_PMIC_ARB_OBS3_CHNL415_RDATA0_ADDR A:0xe63cf98
y.create.l HWIO_PMIC_ARB_OBS3_CHNL416_RDATA0_ADDR A:0xe63d018
y.create.l HWIO_PMIC_ARB_OBS3_CHNL417_RDATA0_ADDR A:0xe63d098
y.create.l HWIO_PMIC_ARB_OBS3_CHNL418_RDATA0_ADDR A:0xe63d118
y.create.l HWIO_PMIC_ARB_OBS3_CHNL419_RDATA0_ADDR A:0xe63d198
y.create.l HWIO_PMIC_ARB_OBS3_CHNL420_RDATA0_ADDR A:0xe63d218
y.create.l HWIO_PMIC_ARB_OBS3_CHNL421_RDATA0_ADDR A:0xe63d298
y.create.l HWIO_PMIC_ARB_OBS3_CHNL422_RDATA0_ADDR A:0xe63d318
y.create.l HWIO_PMIC_ARB_OBS3_CHNL423_RDATA0_ADDR A:0xe63d398
y.create.l HWIO_PMIC_ARB_OBS3_CHNL424_RDATA0_ADDR A:0xe63d418
y.create.l HWIO_PMIC_ARB_OBS3_CHNL425_RDATA0_ADDR A:0xe63d498
y.create.l HWIO_PMIC_ARB_OBS3_CHNL426_RDATA0_ADDR A:0xe63d518
y.create.l HWIO_PMIC_ARB_OBS3_CHNL427_RDATA0_ADDR A:0xe63d598
y.create.l HWIO_PMIC_ARB_OBS3_CHNL428_RDATA0_ADDR A:0xe63d618
y.create.l HWIO_PMIC_ARB_OBS3_CHNL429_RDATA0_ADDR A:0xe63d698
y.create.l HWIO_PMIC_ARB_OBS3_CHNL430_RDATA0_ADDR A:0xe63d718
y.create.l HWIO_PMIC_ARB_OBS3_CHNL431_RDATA0_ADDR A:0xe63d798
y.create.l HWIO_PMIC_ARB_OBS3_CHNL432_RDATA0_ADDR A:0xe63d818
y.create.l HWIO_PMIC_ARB_OBS3_CHNL433_RDATA0_ADDR A:0xe63d898
y.create.l HWIO_PMIC_ARB_OBS3_CHNL434_RDATA0_ADDR A:0xe63d918
y.create.l HWIO_PMIC_ARB_OBS3_CHNL435_RDATA0_ADDR A:0xe63d998
y.create.l HWIO_PMIC_ARB_OBS3_CHNL436_RDATA0_ADDR A:0xe63da18
y.create.l HWIO_PMIC_ARB_OBS3_CHNL437_RDATA0_ADDR A:0xe63da98
y.create.l HWIO_PMIC_ARB_OBS3_CHNL438_RDATA0_ADDR A:0xe63db18
y.create.l HWIO_PMIC_ARB_OBS3_CHNL439_RDATA0_ADDR A:0xe63db98
y.create.l HWIO_PMIC_ARB_OBS3_CHNL440_RDATA0_ADDR A:0xe63dc18
y.create.l HWIO_PMIC_ARB_OBS3_CHNL441_RDATA0_ADDR A:0xe63dc98
y.create.l HWIO_PMIC_ARB_OBS3_CHNL442_RDATA0_ADDR A:0xe63dd18
y.create.l HWIO_PMIC_ARB_OBS3_CHNL443_RDATA0_ADDR A:0xe63dd98
y.create.l HWIO_PMIC_ARB_OBS3_CHNL444_RDATA0_ADDR A:0xe63de18
y.create.l HWIO_PMIC_ARB_OBS3_CHNL445_RDATA0_ADDR A:0xe63de98
y.create.l HWIO_PMIC_ARB_OBS3_CHNL446_RDATA0_ADDR A:0xe63df18
y.create.l HWIO_PMIC_ARB_OBS3_CHNL447_RDATA0_ADDR A:0xe63df98
y.create.l HWIO_PMIC_ARB_OBS3_CHNL448_RDATA0_ADDR A:0xe63e018
y.create.l HWIO_PMIC_ARB_OBS3_CHNL449_RDATA0_ADDR A:0xe63e098
y.create.l HWIO_PMIC_ARB_OBS3_CHNL450_RDATA0_ADDR A:0xe63e118
y.create.l HWIO_PMIC_ARB_OBS3_CHNL451_RDATA0_ADDR A:0xe63e198
y.create.l HWIO_PMIC_ARB_OBS3_CHNL452_RDATA0_ADDR A:0xe63e218
y.create.l HWIO_PMIC_ARB_OBS3_CHNL453_RDATA0_ADDR A:0xe63e298
y.create.l HWIO_PMIC_ARB_OBS3_CHNL454_RDATA0_ADDR A:0xe63e318
y.create.l HWIO_PMIC_ARB_OBS3_CHNL455_RDATA0_ADDR A:0xe63e398
y.create.l HWIO_PMIC_ARB_OBS3_CHNL456_RDATA0_ADDR A:0xe63e418
y.create.l HWIO_PMIC_ARB_OBS3_CHNL457_RDATA0_ADDR A:0xe63e498
y.create.l HWIO_PMIC_ARB_OBS3_CHNL458_RDATA0_ADDR A:0xe63e518
y.create.l HWIO_PMIC_ARB_OBS3_CHNL459_RDATA0_ADDR A:0xe63e598
y.create.l HWIO_PMIC_ARB_OBS3_CHNL460_RDATA0_ADDR A:0xe63e618
y.create.l HWIO_PMIC_ARB_OBS3_CHNL461_RDATA0_ADDR A:0xe63e698
y.create.l HWIO_PMIC_ARB_OBS3_CHNL462_RDATA0_ADDR A:0xe63e718
y.create.l HWIO_PMIC_ARB_OBS3_CHNL463_RDATA0_ADDR A:0xe63e798
y.create.l HWIO_PMIC_ARB_OBS3_CHNL464_RDATA0_ADDR A:0xe63e818
y.create.l HWIO_PMIC_ARB_OBS3_CHNL465_RDATA0_ADDR A:0xe63e898
y.create.l HWIO_PMIC_ARB_OBS3_CHNL466_RDATA0_ADDR A:0xe63e918
y.create.l HWIO_PMIC_ARB_OBS3_CHNL467_RDATA0_ADDR A:0xe63e998
y.create.l HWIO_PMIC_ARB_OBS3_CHNL468_RDATA0_ADDR A:0xe63ea18
y.create.l HWIO_PMIC_ARB_OBS3_CHNL469_RDATA0_ADDR A:0xe63ea98
y.create.l HWIO_PMIC_ARB_OBS3_CHNL470_RDATA0_ADDR A:0xe63eb18
y.create.l HWIO_PMIC_ARB_OBS3_CHNL471_RDATA0_ADDR A:0xe63eb98
y.create.l HWIO_PMIC_ARB_OBS3_CHNL472_RDATA0_ADDR A:0xe63ec18
y.create.l HWIO_PMIC_ARB_OBS3_CHNL473_RDATA0_ADDR A:0xe63ec98
y.create.l HWIO_PMIC_ARB_OBS3_CHNL474_RDATA0_ADDR A:0xe63ed18
y.create.l HWIO_PMIC_ARB_OBS3_CHNL475_RDATA0_ADDR A:0xe63ed98
y.create.l HWIO_PMIC_ARB_OBS3_CHNL476_RDATA0_ADDR A:0xe63ee18
y.create.l HWIO_PMIC_ARB_OBS3_CHNL477_RDATA0_ADDR A:0xe63ee98
y.create.l HWIO_PMIC_ARB_OBS3_CHNL478_RDATA0_ADDR A:0xe63ef18
y.create.l HWIO_PMIC_ARB_OBS3_CHNL479_RDATA0_ADDR A:0xe63ef98
y.create.l HWIO_PMIC_ARB_OBS3_CHNL480_RDATA0_ADDR A:0xe63f018
y.create.l HWIO_PMIC_ARB_OBS3_CHNL481_RDATA0_ADDR A:0xe63f098
y.create.l HWIO_PMIC_ARB_OBS3_CHNL482_RDATA0_ADDR A:0xe63f118
y.create.l HWIO_PMIC_ARB_OBS3_CHNL483_RDATA0_ADDR A:0xe63f198
y.create.l HWIO_PMIC_ARB_OBS3_CHNL484_RDATA0_ADDR A:0xe63f218
y.create.l HWIO_PMIC_ARB_OBS3_CHNL485_RDATA0_ADDR A:0xe63f298
y.create.l HWIO_PMIC_ARB_OBS3_CHNL486_RDATA0_ADDR A:0xe63f318
y.create.l HWIO_PMIC_ARB_OBS3_CHNL487_RDATA0_ADDR A:0xe63f398
y.create.l HWIO_PMIC_ARB_OBS3_CHNL488_RDATA0_ADDR A:0xe63f418
y.create.l HWIO_PMIC_ARB_OBS3_CHNL489_RDATA0_ADDR A:0xe63f498
y.create.l HWIO_PMIC_ARB_OBS3_CHNL490_RDATA0_ADDR A:0xe63f518
y.create.l HWIO_PMIC_ARB_OBS3_CHNL491_RDATA0_ADDR A:0xe63f598
y.create.l HWIO_PMIC_ARB_OBS3_CHNL492_RDATA0_ADDR A:0xe63f618
y.create.l HWIO_PMIC_ARB_OBS3_CHNL493_RDATA0_ADDR A:0xe63f698
y.create.l HWIO_PMIC_ARB_OBS3_CHNL494_RDATA0_ADDR A:0xe63f718
y.create.l HWIO_PMIC_ARB_OBS3_CHNL495_RDATA0_ADDR A:0xe63f798
y.create.l HWIO_PMIC_ARB_OBS3_CHNL496_RDATA0_ADDR A:0xe63f818
y.create.l HWIO_PMIC_ARB_OBS3_CHNL497_RDATA0_ADDR A:0xe63f898
y.create.l HWIO_PMIC_ARB_OBS3_CHNL498_RDATA0_ADDR A:0xe63f918
y.create.l HWIO_PMIC_ARB_OBS3_CHNL499_RDATA0_ADDR A:0xe63f998
y.create.l HWIO_PMIC_ARB_OBS3_CHNL500_RDATA0_ADDR A:0xe63fa18
y.create.l HWIO_PMIC_ARB_OBS3_CHNL501_RDATA0_ADDR A:0xe63fa98
y.create.l HWIO_PMIC_ARB_OBS3_CHNL502_RDATA0_ADDR A:0xe63fb18
y.create.l HWIO_PMIC_ARB_OBS3_CHNL503_RDATA0_ADDR A:0xe63fb98
y.create.l HWIO_PMIC_ARB_OBS3_CHNL504_RDATA0_ADDR A:0xe63fc18
y.create.l HWIO_PMIC_ARB_OBS3_CHNL505_RDATA0_ADDR A:0xe63fc98
y.create.l HWIO_PMIC_ARB_OBS3_CHNL506_RDATA0_ADDR A:0xe63fd18
y.create.l HWIO_PMIC_ARB_OBS3_CHNL507_RDATA0_ADDR A:0xe63fd98
y.create.l HWIO_PMIC_ARB_OBS3_CHNL508_RDATA0_ADDR A:0xe63fe18
y.create.l HWIO_PMIC_ARB_OBS3_CHNL509_RDATA0_ADDR A:0xe63fe98
y.create.l HWIO_PMIC_ARB_OBS3_CHNL510_RDATA0_ADDR A:0xe63ff18
y.create.l HWIO_PMIC_ARB_OBS3_CHNL511_RDATA0_ADDR A:0xe63ff98
y.create.l HWIO_PMIC_ARB_OBS4_CHNL0_RDATA0_ADDR A:0xe640018
y.create.l HWIO_PMIC_ARB_OBS4_CHNL1_RDATA0_ADDR A:0xe640098
y.create.l HWIO_PMIC_ARB_OBS4_CHNL2_RDATA0_ADDR A:0xe640118
y.create.l HWIO_PMIC_ARB_OBS4_CHNL3_RDATA0_ADDR A:0xe640198
y.create.l HWIO_PMIC_ARB_OBS4_CHNL4_RDATA0_ADDR A:0xe640218
y.create.l HWIO_PMIC_ARB_OBS4_CHNL5_RDATA0_ADDR A:0xe640298
y.create.l HWIO_PMIC_ARB_OBS4_CHNL6_RDATA0_ADDR A:0xe640318
y.create.l HWIO_PMIC_ARB_OBS4_CHNL7_RDATA0_ADDR A:0xe640398
y.create.l HWIO_PMIC_ARB_OBS4_CHNL8_RDATA0_ADDR A:0xe640418
y.create.l HWIO_PMIC_ARB_OBS4_CHNL9_RDATA0_ADDR A:0xe640498
y.create.l HWIO_PMIC_ARB_OBS4_CHNL10_RDATA0_ADDR A:0xe640518
y.create.l HWIO_PMIC_ARB_OBS4_CHNL11_RDATA0_ADDR A:0xe640598
y.create.l HWIO_PMIC_ARB_OBS4_CHNL12_RDATA0_ADDR A:0xe640618
y.create.l HWIO_PMIC_ARB_OBS4_CHNL13_RDATA0_ADDR A:0xe640698
y.create.l HWIO_PMIC_ARB_OBS4_CHNL14_RDATA0_ADDR A:0xe640718
y.create.l HWIO_PMIC_ARB_OBS4_CHNL15_RDATA0_ADDR A:0xe640798
y.create.l HWIO_PMIC_ARB_OBS4_CHNL16_RDATA0_ADDR A:0xe640818
y.create.l HWIO_PMIC_ARB_OBS4_CHNL17_RDATA0_ADDR A:0xe640898
y.create.l HWIO_PMIC_ARB_OBS4_CHNL18_RDATA0_ADDR A:0xe640918
y.create.l HWIO_PMIC_ARB_OBS4_CHNL19_RDATA0_ADDR A:0xe640998
y.create.l HWIO_PMIC_ARB_OBS4_CHNL20_RDATA0_ADDR A:0xe640a18
y.create.l HWIO_PMIC_ARB_OBS4_CHNL21_RDATA0_ADDR A:0xe640a98
y.create.l HWIO_PMIC_ARB_OBS4_CHNL22_RDATA0_ADDR A:0xe640b18
y.create.l HWIO_PMIC_ARB_OBS4_CHNL23_RDATA0_ADDR A:0xe640b98
y.create.l HWIO_PMIC_ARB_OBS4_CHNL24_RDATA0_ADDR A:0xe640c18
y.create.l HWIO_PMIC_ARB_OBS4_CHNL25_RDATA0_ADDR A:0xe640c98
y.create.l HWIO_PMIC_ARB_OBS4_CHNL26_RDATA0_ADDR A:0xe640d18
y.create.l HWIO_PMIC_ARB_OBS4_CHNL27_RDATA0_ADDR A:0xe640d98
y.create.l HWIO_PMIC_ARB_OBS4_CHNL28_RDATA0_ADDR A:0xe640e18
y.create.l HWIO_PMIC_ARB_OBS4_CHNL29_RDATA0_ADDR A:0xe640e98
y.create.l HWIO_PMIC_ARB_OBS4_CHNL30_RDATA0_ADDR A:0xe640f18
y.create.l HWIO_PMIC_ARB_OBS4_CHNL31_RDATA0_ADDR A:0xe640f98
y.create.l HWIO_PMIC_ARB_OBS4_CHNL32_RDATA0_ADDR A:0xe641018
y.create.l HWIO_PMIC_ARB_OBS4_CHNL33_RDATA0_ADDR A:0xe641098
y.create.l HWIO_PMIC_ARB_OBS4_CHNL34_RDATA0_ADDR A:0xe641118
y.create.l HWIO_PMIC_ARB_OBS4_CHNL35_RDATA0_ADDR A:0xe641198
y.create.l HWIO_PMIC_ARB_OBS4_CHNL36_RDATA0_ADDR A:0xe641218
y.create.l HWIO_PMIC_ARB_OBS4_CHNL37_RDATA0_ADDR A:0xe641298
y.create.l HWIO_PMIC_ARB_OBS4_CHNL38_RDATA0_ADDR A:0xe641318
y.create.l HWIO_PMIC_ARB_OBS4_CHNL39_RDATA0_ADDR A:0xe641398
y.create.l HWIO_PMIC_ARB_OBS4_CHNL40_RDATA0_ADDR A:0xe641418
y.create.l HWIO_PMIC_ARB_OBS4_CHNL41_RDATA0_ADDR A:0xe641498
y.create.l HWIO_PMIC_ARB_OBS4_CHNL42_RDATA0_ADDR A:0xe641518
y.create.l HWIO_PMIC_ARB_OBS4_CHNL43_RDATA0_ADDR A:0xe641598
y.create.l HWIO_PMIC_ARB_OBS4_CHNL44_RDATA0_ADDR A:0xe641618
y.create.l HWIO_PMIC_ARB_OBS4_CHNL45_RDATA0_ADDR A:0xe641698
y.create.l HWIO_PMIC_ARB_OBS4_CHNL46_RDATA0_ADDR A:0xe641718
y.create.l HWIO_PMIC_ARB_OBS4_CHNL47_RDATA0_ADDR A:0xe641798
y.create.l HWIO_PMIC_ARB_OBS4_CHNL48_RDATA0_ADDR A:0xe641818
y.create.l HWIO_PMIC_ARB_OBS4_CHNL49_RDATA0_ADDR A:0xe641898
y.create.l HWIO_PMIC_ARB_OBS4_CHNL50_RDATA0_ADDR A:0xe641918
y.create.l HWIO_PMIC_ARB_OBS4_CHNL51_RDATA0_ADDR A:0xe641998
y.create.l HWIO_PMIC_ARB_OBS4_CHNL52_RDATA0_ADDR A:0xe641a18
y.create.l HWIO_PMIC_ARB_OBS4_CHNL53_RDATA0_ADDR A:0xe641a98
y.create.l HWIO_PMIC_ARB_OBS4_CHNL54_RDATA0_ADDR A:0xe641b18
y.create.l HWIO_PMIC_ARB_OBS4_CHNL55_RDATA0_ADDR A:0xe641b98
y.create.l HWIO_PMIC_ARB_OBS4_CHNL56_RDATA0_ADDR A:0xe641c18
y.create.l HWIO_PMIC_ARB_OBS4_CHNL57_RDATA0_ADDR A:0xe641c98
y.create.l HWIO_PMIC_ARB_OBS4_CHNL58_RDATA0_ADDR A:0xe641d18
y.create.l HWIO_PMIC_ARB_OBS4_CHNL59_RDATA0_ADDR A:0xe641d98
y.create.l HWIO_PMIC_ARB_OBS4_CHNL60_RDATA0_ADDR A:0xe641e18
y.create.l HWIO_PMIC_ARB_OBS4_CHNL61_RDATA0_ADDR A:0xe641e98
y.create.l HWIO_PMIC_ARB_OBS4_CHNL62_RDATA0_ADDR A:0xe641f18
y.create.l HWIO_PMIC_ARB_OBS4_CHNL63_RDATA0_ADDR A:0xe641f98
y.create.l HWIO_PMIC_ARB_OBS4_CHNL64_RDATA0_ADDR A:0xe642018
y.create.l HWIO_PMIC_ARB_OBS4_CHNL65_RDATA0_ADDR A:0xe642098
y.create.l HWIO_PMIC_ARB_OBS4_CHNL66_RDATA0_ADDR A:0xe642118
y.create.l HWIO_PMIC_ARB_OBS4_CHNL67_RDATA0_ADDR A:0xe642198
y.create.l HWIO_PMIC_ARB_OBS4_CHNL68_RDATA0_ADDR A:0xe642218
y.create.l HWIO_PMIC_ARB_OBS4_CHNL69_RDATA0_ADDR A:0xe642298
y.create.l HWIO_PMIC_ARB_OBS4_CHNL70_RDATA0_ADDR A:0xe642318
y.create.l HWIO_PMIC_ARB_OBS4_CHNL71_RDATA0_ADDR A:0xe642398
y.create.l HWIO_PMIC_ARB_OBS4_CHNL72_RDATA0_ADDR A:0xe642418
y.create.l HWIO_PMIC_ARB_OBS4_CHNL73_RDATA0_ADDR A:0xe642498
y.create.l HWIO_PMIC_ARB_OBS4_CHNL74_RDATA0_ADDR A:0xe642518
y.create.l HWIO_PMIC_ARB_OBS4_CHNL75_RDATA0_ADDR A:0xe642598
y.create.l HWIO_PMIC_ARB_OBS4_CHNL76_RDATA0_ADDR A:0xe642618
y.create.l HWIO_PMIC_ARB_OBS4_CHNL77_RDATA0_ADDR A:0xe642698
y.create.l HWIO_PMIC_ARB_OBS4_CHNL78_RDATA0_ADDR A:0xe642718
y.create.l HWIO_PMIC_ARB_OBS4_CHNL79_RDATA0_ADDR A:0xe642798
y.create.l HWIO_PMIC_ARB_OBS4_CHNL80_RDATA0_ADDR A:0xe642818
y.create.l HWIO_PMIC_ARB_OBS4_CHNL81_RDATA0_ADDR A:0xe642898
y.create.l HWIO_PMIC_ARB_OBS4_CHNL82_RDATA0_ADDR A:0xe642918
y.create.l HWIO_PMIC_ARB_OBS4_CHNL83_RDATA0_ADDR A:0xe642998
y.create.l HWIO_PMIC_ARB_OBS4_CHNL84_RDATA0_ADDR A:0xe642a18
y.create.l HWIO_PMIC_ARB_OBS4_CHNL85_RDATA0_ADDR A:0xe642a98
y.create.l HWIO_PMIC_ARB_OBS4_CHNL86_RDATA0_ADDR A:0xe642b18
y.create.l HWIO_PMIC_ARB_OBS4_CHNL87_RDATA0_ADDR A:0xe642b98
y.create.l HWIO_PMIC_ARB_OBS4_CHNL88_RDATA0_ADDR A:0xe642c18
y.create.l HWIO_PMIC_ARB_OBS4_CHNL89_RDATA0_ADDR A:0xe642c98
y.create.l HWIO_PMIC_ARB_OBS4_CHNL90_RDATA0_ADDR A:0xe642d18
y.create.l HWIO_PMIC_ARB_OBS4_CHNL91_RDATA0_ADDR A:0xe642d98
y.create.l HWIO_PMIC_ARB_OBS4_CHNL92_RDATA0_ADDR A:0xe642e18
y.create.l HWIO_PMIC_ARB_OBS4_CHNL93_RDATA0_ADDR A:0xe642e98
y.create.l HWIO_PMIC_ARB_OBS4_CHNL94_RDATA0_ADDR A:0xe642f18
y.create.l HWIO_PMIC_ARB_OBS4_CHNL95_RDATA0_ADDR A:0xe642f98
y.create.l HWIO_PMIC_ARB_OBS4_CHNL96_RDATA0_ADDR A:0xe643018
y.create.l HWIO_PMIC_ARB_OBS4_CHNL97_RDATA0_ADDR A:0xe643098
y.create.l HWIO_PMIC_ARB_OBS4_CHNL98_RDATA0_ADDR A:0xe643118
y.create.l HWIO_PMIC_ARB_OBS4_CHNL99_RDATA0_ADDR A:0xe643198
y.create.l HWIO_PMIC_ARB_OBS4_CHNL100_RDATA0_ADDR A:0xe643218
y.create.l HWIO_PMIC_ARB_OBS4_CHNL101_RDATA0_ADDR A:0xe643298
y.create.l HWIO_PMIC_ARB_OBS4_CHNL102_RDATA0_ADDR A:0xe643318
y.create.l HWIO_PMIC_ARB_OBS4_CHNL103_RDATA0_ADDR A:0xe643398
y.create.l HWIO_PMIC_ARB_OBS4_CHNL104_RDATA0_ADDR A:0xe643418
y.create.l HWIO_PMIC_ARB_OBS4_CHNL105_RDATA0_ADDR A:0xe643498
y.create.l HWIO_PMIC_ARB_OBS4_CHNL106_RDATA0_ADDR A:0xe643518
y.create.l HWIO_PMIC_ARB_OBS4_CHNL107_RDATA0_ADDR A:0xe643598
y.create.l HWIO_PMIC_ARB_OBS4_CHNL108_RDATA0_ADDR A:0xe643618
y.create.l HWIO_PMIC_ARB_OBS4_CHNL109_RDATA0_ADDR A:0xe643698
y.create.l HWIO_PMIC_ARB_OBS4_CHNL110_RDATA0_ADDR A:0xe643718
y.create.l HWIO_PMIC_ARB_OBS4_CHNL111_RDATA0_ADDR A:0xe643798
y.create.l HWIO_PMIC_ARB_OBS4_CHNL112_RDATA0_ADDR A:0xe643818
y.create.l HWIO_PMIC_ARB_OBS4_CHNL113_RDATA0_ADDR A:0xe643898
y.create.l HWIO_PMIC_ARB_OBS4_CHNL114_RDATA0_ADDR A:0xe643918
y.create.l HWIO_PMIC_ARB_OBS4_CHNL115_RDATA0_ADDR A:0xe643998
y.create.l HWIO_PMIC_ARB_OBS4_CHNL116_RDATA0_ADDR A:0xe643a18
y.create.l HWIO_PMIC_ARB_OBS4_CHNL117_RDATA0_ADDR A:0xe643a98
y.create.l HWIO_PMIC_ARB_OBS4_CHNL118_RDATA0_ADDR A:0xe643b18
y.create.l HWIO_PMIC_ARB_OBS4_CHNL119_RDATA0_ADDR A:0xe643b98
y.create.l HWIO_PMIC_ARB_OBS4_CHNL120_RDATA0_ADDR A:0xe643c18
y.create.l HWIO_PMIC_ARB_OBS4_CHNL121_RDATA0_ADDR A:0xe643c98
y.create.l HWIO_PMIC_ARB_OBS4_CHNL122_RDATA0_ADDR A:0xe643d18
y.create.l HWIO_PMIC_ARB_OBS4_CHNL123_RDATA0_ADDR A:0xe643d98
y.create.l HWIO_PMIC_ARB_OBS4_CHNL124_RDATA0_ADDR A:0xe643e18
y.create.l HWIO_PMIC_ARB_OBS4_CHNL125_RDATA0_ADDR A:0xe643e98
y.create.l HWIO_PMIC_ARB_OBS4_CHNL126_RDATA0_ADDR A:0xe643f18
y.create.l HWIO_PMIC_ARB_OBS4_CHNL127_RDATA0_ADDR A:0xe643f98
y.create.l HWIO_PMIC_ARB_OBS4_CHNL128_RDATA0_ADDR A:0xe644018
y.create.l HWIO_PMIC_ARB_OBS4_CHNL129_RDATA0_ADDR A:0xe644098
y.create.l HWIO_PMIC_ARB_OBS4_CHNL130_RDATA0_ADDR A:0xe644118
y.create.l HWIO_PMIC_ARB_OBS4_CHNL131_RDATA0_ADDR A:0xe644198
y.create.l HWIO_PMIC_ARB_OBS4_CHNL132_RDATA0_ADDR A:0xe644218
y.create.l HWIO_PMIC_ARB_OBS4_CHNL133_RDATA0_ADDR A:0xe644298
y.create.l HWIO_PMIC_ARB_OBS4_CHNL134_RDATA0_ADDR A:0xe644318
y.create.l HWIO_PMIC_ARB_OBS4_CHNL135_RDATA0_ADDR A:0xe644398
y.create.l HWIO_PMIC_ARB_OBS4_CHNL136_RDATA0_ADDR A:0xe644418
y.create.l HWIO_PMIC_ARB_OBS4_CHNL137_RDATA0_ADDR A:0xe644498
y.create.l HWIO_PMIC_ARB_OBS4_CHNL138_RDATA0_ADDR A:0xe644518
y.create.l HWIO_PMIC_ARB_OBS4_CHNL139_RDATA0_ADDR A:0xe644598
y.create.l HWIO_PMIC_ARB_OBS4_CHNL140_RDATA0_ADDR A:0xe644618
y.create.l HWIO_PMIC_ARB_OBS4_CHNL141_RDATA0_ADDR A:0xe644698
y.create.l HWIO_PMIC_ARB_OBS4_CHNL142_RDATA0_ADDR A:0xe644718
y.create.l HWIO_PMIC_ARB_OBS4_CHNL143_RDATA0_ADDR A:0xe644798
y.create.l HWIO_PMIC_ARB_OBS4_CHNL144_RDATA0_ADDR A:0xe644818
y.create.l HWIO_PMIC_ARB_OBS4_CHNL145_RDATA0_ADDR A:0xe644898
y.create.l HWIO_PMIC_ARB_OBS4_CHNL146_RDATA0_ADDR A:0xe644918
y.create.l HWIO_PMIC_ARB_OBS4_CHNL147_RDATA0_ADDR A:0xe644998
y.create.l HWIO_PMIC_ARB_OBS4_CHNL148_RDATA0_ADDR A:0xe644a18
y.create.l HWIO_PMIC_ARB_OBS4_CHNL149_RDATA0_ADDR A:0xe644a98
y.create.l HWIO_PMIC_ARB_OBS4_CHNL150_RDATA0_ADDR A:0xe644b18
y.create.l HWIO_PMIC_ARB_OBS4_CHNL151_RDATA0_ADDR A:0xe644b98
y.create.l HWIO_PMIC_ARB_OBS4_CHNL152_RDATA0_ADDR A:0xe644c18
y.create.l HWIO_PMIC_ARB_OBS4_CHNL153_RDATA0_ADDR A:0xe644c98
y.create.l HWIO_PMIC_ARB_OBS4_CHNL154_RDATA0_ADDR A:0xe644d18
y.create.l HWIO_PMIC_ARB_OBS4_CHNL155_RDATA0_ADDR A:0xe644d98
y.create.l HWIO_PMIC_ARB_OBS4_CHNL156_RDATA0_ADDR A:0xe644e18
y.create.l HWIO_PMIC_ARB_OBS4_CHNL157_RDATA0_ADDR A:0xe644e98
y.create.l HWIO_PMIC_ARB_OBS4_CHNL158_RDATA0_ADDR A:0xe644f18
y.create.l HWIO_PMIC_ARB_OBS4_CHNL159_RDATA0_ADDR A:0xe644f98
y.create.l HWIO_PMIC_ARB_OBS4_CHNL160_RDATA0_ADDR A:0xe645018
y.create.l HWIO_PMIC_ARB_OBS4_CHNL161_RDATA0_ADDR A:0xe645098
y.create.l HWIO_PMIC_ARB_OBS4_CHNL162_RDATA0_ADDR A:0xe645118
y.create.l HWIO_PMIC_ARB_OBS4_CHNL163_RDATA0_ADDR A:0xe645198
y.create.l HWIO_PMIC_ARB_OBS4_CHNL164_RDATA0_ADDR A:0xe645218
y.create.l HWIO_PMIC_ARB_OBS4_CHNL165_RDATA0_ADDR A:0xe645298
y.create.l HWIO_PMIC_ARB_OBS4_CHNL166_RDATA0_ADDR A:0xe645318
y.create.l HWIO_PMIC_ARB_OBS4_CHNL167_RDATA0_ADDR A:0xe645398
y.create.l HWIO_PMIC_ARB_OBS4_CHNL168_RDATA0_ADDR A:0xe645418
y.create.l HWIO_PMIC_ARB_OBS4_CHNL169_RDATA0_ADDR A:0xe645498
y.create.l HWIO_PMIC_ARB_OBS4_CHNL170_RDATA0_ADDR A:0xe645518
y.create.l HWIO_PMIC_ARB_OBS4_CHNL171_RDATA0_ADDR A:0xe645598
y.create.l HWIO_PMIC_ARB_OBS4_CHNL172_RDATA0_ADDR A:0xe645618
y.create.l HWIO_PMIC_ARB_OBS4_CHNL173_RDATA0_ADDR A:0xe645698
y.create.l HWIO_PMIC_ARB_OBS4_CHNL174_RDATA0_ADDR A:0xe645718
y.create.l HWIO_PMIC_ARB_OBS4_CHNL175_RDATA0_ADDR A:0xe645798
y.create.l HWIO_PMIC_ARB_OBS4_CHNL176_RDATA0_ADDR A:0xe645818
y.create.l HWIO_PMIC_ARB_OBS4_CHNL177_RDATA0_ADDR A:0xe645898
y.create.l HWIO_PMIC_ARB_OBS4_CHNL178_RDATA0_ADDR A:0xe645918
y.create.l HWIO_PMIC_ARB_OBS4_CHNL179_RDATA0_ADDR A:0xe645998
y.create.l HWIO_PMIC_ARB_OBS4_CHNL180_RDATA0_ADDR A:0xe645a18
y.create.l HWIO_PMIC_ARB_OBS4_CHNL181_RDATA0_ADDR A:0xe645a98
y.create.l HWIO_PMIC_ARB_OBS4_CHNL182_RDATA0_ADDR A:0xe645b18
y.create.l HWIO_PMIC_ARB_OBS4_CHNL183_RDATA0_ADDR A:0xe645b98
y.create.l HWIO_PMIC_ARB_OBS4_CHNL184_RDATA0_ADDR A:0xe645c18
y.create.l HWIO_PMIC_ARB_OBS4_CHNL185_RDATA0_ADDR A:0xe645c98
y.create.l HWIO_PMIC_ARB_OBS4_CHNL186_RDATA0_ADDR A:0xe645d18
y.create.l HWIO_PMIC_ARB_OBS4_CHNL187_RDATA0_ADDR A:0xe645d98
y.create.l HWIO_PMIC_ARB_OBS4_CHNL188_RDATA0_ADDR A:0xe645e18
y.create.l HWIO_PMIC_ARB_OBS4_CHNL189_RDATA0_ADDR A:0xe645e98
y.create.l HWIO_PMIC_ARB_OBS4_CHNL190_RDATA0_ADDR A:0xe645f18
y.create.l HWIO_PMIC_ARB_OBS4_CHNL191_RDATA0_ADDR A:0xe645f98
y.create.l HWIO_PMIC_ARB_OBS4_CHNL192_RDATA0_ADDR A:0xe646018
y.create.l HWIO_PMIC_ARB_OBS4_CHNL193_RDATA0_ADDR A:0xe646098
y.create.l HWIO_PMIC_ARB_OBS4_CHNL194_RDATA0_ADDR A:0xe646118
y.create.l HWIO_PMIC_ARB_OBS4_CHNL195_RDATA0_ADDR A:0xe646198
y.create.l HWIO_PMIC_ARB_OBS4_CHNL196_RDATA0_ADDR A:0xe646218
y.create.l HWIO_PMIC_ARB_OBS4_CHNL197_RDATA0_ADDR A:0xe646298
y.create.l HWIO_PMIC_ARB_OBS4_CHNL198_RDATA0_ADDR A:0xe646318
y.create.l HWIO_PMIC_ARB_OBS4_CHNL199_RDATA0_ADDR A:0xe646398
y.create.l HWIO_PMIC_ARB_OBS4_CHNL200_RDATA0_ADDR A:0xe646418
y.create.l HWIO_PMIC_ARB_OBS4_CHNL201_RDATA0_ADDR A:0xe646498
y.create.l HWIO_PMIC_ARB_OBS4_CHNL202_RDATA0_ADDR A:0xe646518
y.create.l HWIO_PMIC_ARB_OBS4_CHNL203_RDATA0_ADDR A:0xe646598
y.create.l HWIO_PMIC_ARB_OBS4_CHNL204_RDATA0_ADDR A:0xe646618
y.create.l HWIO_PMIC_ARB_OBS4_CHNL205_RDATA0_ADDR A:0xe646698
y.create.l HWIO_PMIC_ARB_OBS4_CHNL206_RDATA0_ADDR A:0xe646718
y.create.l HWIO_PMIC_ARB_OBS4_CHNL207_RDATA0_ADDR A:0xe646798
y.create.l HWIO_PMIC_ARB_OBS4_CHNL208_RDATA0_ADDR A:0xe646818
y.create.l HWIO_PMIC_ARB_OBS4_CHNL209_RDATA0_ADDR A:0xe646898
y.create.l HWIO_PMIC_ARB_OBS4_CHNL210_RDATA0_ADDR A:0xe646918
y.create.l HWIO_PMIC_ARB_OBS4_CHNL211_RDATA0_ADDR A:0xe646998
y.create.l HWIO_PMIC_ARB_OBS4_CHNL212_RDATA0_ADDR A:0xe646a18
y.create.l HWIO_PMIC_ARB_OBS4_CHNL213_RDATA0_ADDR A:0xe646a98
y.create.l HWIO_PMIC_ARB_OBS4_CHNL214_RDATA0_ADDR A:0xe646b18
y.create.l HWIO_PMIC_ARB_OBS4_CHNL215_RDATA0_ADDR A:0xe646b98
y.create.l HWIO_PMIC_ARB_OBS4_CHNL216_RDATA0_ADDR A:0xe646c18
y.create.l HWIO_PMIC_ARB_OBS4_CHNL217_RDATA0_ADDR A:0xe646c98
y.create.l HWIO_PMIC_ARB_OBS4_CHNL218_RDATA0_ADDR A:0xe646d18
y.create.l HWIO_PMIC_ARB_OBS4_CHNL219_RDATA0_ADDR A:0xe646d98
y.create.l HWIO_PMIC_ARB_OBS4_CHNL220_RDATA0_ADDR A:0xe646e18
y.create.l HWIO_PMIC_ARB_OBS4_CHNL221_RDATA0_ADDR A:0xe646e98
y.create.l HWIO_PMIC_ARB_OBS4_CHNL222_RDATA0_ADDR A:0xe646f18
y.create.l HWIO_PMIC_ARB_OBS4_CHNL223_RDATA0_ADDR A:0xe646f98
y.create.l HWIO_PMIC_ARB_OBS4_CHNL224_RDATA0_ADDR A:0xe647018
y.create.l HWIO_PMIC_ARB_OBS4_CHNL225_RDATA0_ADDR A:0xe647098
y.create.l HWIO_PMIC_ARB_OBS4_CHNL226_RDATA0_ADDR A:0xe647118
y.create.l HWIO_PMIC_ARB_OBS4_CHNL227_RDATA0_ADDR A:0xe647198
y.create.l HWIO_PMIC_ARB_OBS4_CHNL228_RDATA0_ADDR A:0xe647218
y.create.l HWIO_PMIC_ARB_OBS4_CHNL229_RDATA0_ADDR A:0xe647298
y.create.l HWIO_PMIC_ARB_OBS4_CHNL230_RDATA0_ADDR A:0xe647318
y.create.l HWIO_PMIC_ARB_OBS4_CHNL231_RDATA0_ADDR A:0xe647398
y.create.l HWIO_PMIC_ARB_OBS4_CHNL232_RDATA0_ADDR A:0xe647418
y.create.l HWIO_PMIC_ARB_OBS4_CHNL233_RDATA0_ADDR A:0xe647498
y.create.l HWIO_PMIC_ARB_OBS4_CHNL234_RDATA0_ADDR A:0xe647518
y.create.l HWIO_PMIC_ARB_OBS4_CHNL235_RDATA0_ADDR A:0xe647598
y.create.l HWIO_PMIC_ARB_OBS4_CHNL236_RDATA0_ADDR A:0xe647618
y.create.l HWIO_PMIC_ARB_OBS4_CHNL237_RDATA0_ADDR A:0xe647698
y.create.l HWIO_PMIC_ARB_OBS4_CHNL238_RDATA0_ADDR A:0xe647718
y.create.l HWIO_PMIC_ARB_OBS4_CHNL239_RDATA0_ADDR A:0xe647798
y.create.l HWIO_PMIC_ARB_OBS4_CHNL240_RDATA0_ADDR A:0xe647818
y.create.l HWIO_PMIC_ARB_OBS4_CHNL241_RDATA0_ADDR A:0xe647898
y.create.l HWIO_PMIC_ARB_OBS4_CHNL242_RDATA0_ADDR A:0xe647918
y.create.l HWIO_PMIC_ARB_OBS4_CHNL243_RDATA0_ADDR A:0xe647998
y.create.l HWIO_PMIC_ARB_OBS4_CHNL244_RDATA0_ADDR A:0xe647a18
y.create.l HWIO_PMIC_ARB_OBS4_CHNL245_RDATA0_ADDR A:0xe647a98
y.create.l HWIO_PMIC_ARB_OBS4_CHNL246_RDATA0_ADDR A:0xe647b18
y.create.l HWIO_PMIC_ARB_OBS4_CHNL247_RDATA0_ADDR A:0xe647b98
y.create.l HWIO_PMIC_ARB_OBS4_CHNL248_RDATA0_ADDR A:0xe647c18
y.create.l HWIO_PMIC_ARB_OBS4_CHNL249_RDATA0_ADDR A:0xe647c98
y.create.l HWIO_PMIC_ARB_OBS4_CHNL250_RDATA0_ADDR A:0xe647d18
y.create.l HWIO_PMIC_ARB_OBS4_CHNL251_RDATA0_ADDR A:0xe647d98
y.create.l HWIO_PMIC_ARB_OBS4_CHNL252_RDATA0_ADDR A:0xe647e18
y.create.l HWIO_PMIC_ARB_OBS4_CHNL253_RDATA0_ADDR A:0xe647e98
y.create.l HWIO_PMIC_ARB_OBS4_CHNL254_RDATA0_ADDR A:0xe647f18
y.create.l HWIO_PMIC_ARB_OBS4_CHNL255_RDATA0_ADDR A:0xe647f98
y.create.l HWIO_PMIC_ARB_OBS4_CHNL256_RDATA0_ADDR A:0xe648018
y.create.l HWIO_PMIC_ARB_OBS4_CHNL257_RDATA0_ADDR A:0xe648098
y.create.l HWIO_PMIC_ARB_OBS4_CHNL258_RDATA0_ADDR A:0xe648118
y.create.l HWIO_PMIC_ARB_OBS4_CHNL259_RDATA0_ADDR A:0xe648198
y.create.l HWIO_PMIC_ARB_OBS4_CHNL260_RDATA0_ADDR A:0xe648218
y.create.l HWIO_PMIC_ARB_OBS4_CHNL261_RDATA0_ADDR A:0xe648298
y.create.l HWIO_PMIC_ARB_OBS4_CHNL262_RDATA0_ADDR A:0xe648318
y.create.l HWIO_PMIC_ARB_OBS4_CHNL263_RDATA0_ADDR A:0xe648398
y.create.l HWIO_PMIC_ARB_OBS4_CHNL264_RDATA0_ADDR A:0xe648418
y.create.l HWIO_PMIC_ARB_OBS4_CHNL265_RDATA0_ADDR A:0xe648498
y.create.l HWIO_PMIC_ARB_OBS4_CHNL266_RDATA0_ADDR A:0xe648518
y.create.l HWIO_PMIC_ARB_OBS4_CHNL267_RDATA0_ADDR A:0xe648598
y.create.l HWIO_PMIC_ARB_OBS4_CHNL268_RDATA0_ADDR A:0xe648618
y.create.l HWIO_PMIC_ARB_OBS4_CHNL269_RDATA0_ADDR A:0xe648698
y.create.l HWIO_PMIC_ARB_OBS4_CHNL270_RDATA0_ADDR A:0xe648718
y.create.l HWIO_PMIC_ARB_OBS4_CHNL271_RDATA0_ADDR A:0xe648798
y.create.l HWIO_PMIC_ARB_OBS4_CHNL272_RDATA0_ADDR A:0xe648818
y.create.l HWIO_PMIC_ARB_OBS4_CHNL273_RDATA0_ADDR A:0xe648898
y.create.l HWIO_PMIC_ARB_OBS4_CHNL274_RDATA0_ADDR A:0xe648918
y.create.l HWIO_PMIC_ARB_OBS4_CHNL275_RDATA0_ADDR A:0xe648998
y.create.l HWIO_PMIC_ARB_OBS4_CHNL276_RDATA0_ADDR A:0xe648a18
y.create.l HWIO_PMIC_ARB_OBS4_CHNL277_RDATA0_ADDR A:0xe648a98
y.create.l HWIO_PMIC_ARB_OBS4_CHNL278_RDATA0_ADDR A:0xe648b18
y.create.l HWIO_PMIC_ARB_OBS4_CHNL279_RDATA0_ADDR A:0xe648b98
y.create.l HWIO_PMIC_ARB_OBS4_CHNL280_RDATA0_ADDR A:0xe648c18
y.create.l HWIO_PMIC_ARB_OBS4_CHNL281_RDATA0_ADDR A:0xe648c98
y.create.l HWIO_PMIC_ARB_OBS4_CHNL282_RDATA0_ADDR A:0xe648d18
y.create.l HWIO_PMIC_ARB_OBS4_CHNL283_RDATA0_ADDR A:0xe648d98
y.create.l HWIO_PMIC_ARB_OBS4_CHNL284_RDATA0_ADDR A:0xe648e18
y.create.l HWIO_PMIC_ARB_OBS4_CHNL285_RDATA0_ADDR A:0xe648e98
y.create.l HWIO_PMIC_ARB_OBS4_CHNL286_RDATA0_ADDR A:0xe648f18
y.create.l HWIO_PMIC_ARB_OBS4_CHNL287_RDATA0_ADDR A:0xe648f98
y.create.l HWIO_PMIC_ARB_OBS4_CHNL288_RDATA0_ADDR A:0xe649018
y.create.l HWIO_PMIC_ARB_OBS4_CHNL289_RDATA0_ADDR A:0xe649098
y.create.l HWIO_PMIC_ARB_OBS4_CHNL290_RDATA0_ADDR A:0xe649118
y.create.l HWIO_PMIC_ARB_OBS4_CHNL291_RDATA0_ADDR A:0xe649198
y.create.l HWIO_PMIC_ARB_OBS4_CHNL292_RDATA0_ADDR A:0xe649218
y.create.l HWIO_PMIC_ARB_OBS4_CHNL293_RDATA0_ADDR A:0xe649298
y.create.l HWIO_PMIC_ARB_OBS4_CHNL294_RDATA0_ADDR A:0xe649318
y.create.l HWIO_PMIC_ARB_OBS4_CHNL295_RDATA0_ADDR A:0xe649398
y.create.l HWIO_PMIC_ARB_OBS4_CHNL296_RDATA0_ADDR A:0xe649418
y.create.l HWIO_PMIC_ARB_OBS4_CHNL297_RDATA0_ADDR A:0xe649498
y.create.l HWIO_PMIC_ARB_OBS4_CHNL298_RDATA0_ADDR A:0xe649518
y.create.l HWIO_PMIC_ARB_OBS4_CHNL299_RDATA0_ADDR A:0xe649598
y.create.l HWIO_PMIC_ARB_OBS4_CHNL300_RDATA0_ADDR A:0xe649618
y.create.l HWIO_PMIC_ARB_OBS4_CHNL301_RDATA0_ADDR A:0xe649698
y.create.l HWIO_PMIC_ARB_OBS4_CHNL302_RDATA0_ADDR A:0xe649718
y.create.l HWIO_PMIC_ARB_OBS4_CHNL303_RDATA0_ADDR A:0xe649798
y.create.l HWIO_PMIC_ARB_OBS4_CHNL304_RDATA0_ADDR A:0xe649818
y.create.l HWIO_PMIC_ARB_OBS4_CHNL305_RDATA0_ADDR A:0xe649898
y.create.l HWIO_PMIC_ARB_OBS4_CHNL306_RDATA0_ADDR A:0xe649918
y.create.l HWIO_PMIC_ARB_OBS4_CHNL307_RDATA0_ADDR A:0xe649998
y.create.l HWIO_PMIC_ARB_OBS4_CHNL308_RDATA0_ADDR A:0xe649a18
y.create.l HWIO_PMIC_ARB_OBS4_CHNL309_RDATA0_ADDR A:0xe649a98
y.create.l HWIO_PMIC_ARB_OBS4_CHNL310_RDATA0_ADDR A:0xe649b18
y.create.l HWIO_PMIC_ARB_OBS4_CHNL311_RDATA0_ADDR A:0xe649b98
y.create.l HWIO_PMIC_ARB_OBS4_CHNL312_RDATA0_ADDR A:0xe649c18
y.create.l HWIO_PMIC_ARB_OBS4_CHNL313_RDATA0_ADDR A:0xe649c98
y.create.l HWIO_PMIC_ARB_OBS4_CHNL314_RDATA0_ADDR A:0xe649d18
y.create.l HWIO_PMIC_ARB_OBS4_CHNL315_RDATA0_ADDR A:0xe649d98
y.create.l HWIO_PMIC_ARB_OBS4_CHNL316_RDATA0_ADDR A:0xe649e18
y.create.l HWIO_PMIC_ARB_OBS4_CHNL317_RDATA0_ADDR A:0xe649e98
y.create.l HWIO_PMIC_ARB_OBS4_CHNL318_RDATA0_ADDR A:0xe649f18
y.create.l HWIO_PMIC_ARB_OBS4_CHNL319_RDATA0_ADDR A:0xe649f98
y.create.l HWIO_PMIC_ARB_OBS4_CHNL320_RDATA0_ADDR A:0xe64a018
y.create.l HWIO_PMIC_ARB_OBS4_CHNL321_RDATA0_ADDR A:0xe64a098
y.create.l HWIO_PMIC_ARB_OBS4_CHNL322_RDATA0_ADDR A:0xe64a118
y.create.l HWIO_PMIC_ARB_OBS4_CHNL323_RDATA0_ADDR A:0xe64a198
y.create.l HWIO_PMIC_ARB_OBS4_CHNL324_RDATA0_ADDR A:0xe64a218
y.create.l HWIO_PMIC_ARB_OBS4_CHNL325_RDATA0_ADDR A:0xe64a298
y.create.l HWIO_PMIC_ARB_OBS4_CHNL326_RDATA0_ADDR A:0xe64a318
y.create.l HWIO_PMIC_ARB_OBS4_CHNL327_RDATA0_ADDR A:0xe64a398
y.create.l HWIO_PMIC_ARB_OBS4_CHNL328_RDATA0_ADDR A:0xe64a418
y.create.l HWIO_PMIC_ARB_OBS4_CHNL329_RDATA0_ADDR A:0xe64a498
y.create.l HWIO_PMIC_ARB_OBS4_CHNL330_RDATA0_ADDR A:0xe64a518
y.create.l HWIO_PMIC_ARB_OBS4_CHNL331_RDATA0_ADDR A:0xe64a598
y.create.l HWIO_PMIC_ARB_OBS4_CHNL332_RDATA0_ADDR A:0xe64a618
y.create.l HWIO_PMIC_ARB_OBS4_CHNL333_RDATA0_ADDR A:0xe64a698
y.create.l HWIO_PMIC_ARB_OBS4_CHNL334_RDATA0_ADDR A:0xe64a718
y.create.l HWIO_PMIC_ARB_OBS4_CHNL335_RDATA0_ADDR A:0xe64a798
y.create.l HWIO_PMIC_ARB_OBS4_CHNL336_RDATA0_ADDR A:0xe64a818
y.create.l HWIO_PMIC_ARB_OBS4_CHNL337_RDATA0_ADDR A:0xe64a898
y.create.l HWIO_PMIC_ARB_OBS4_CHNL338_RDATA0_ADDR A:0xe64a918
y.create.l HWIO_PMIC_ARB_OBS4_CHNL339_RDATA0_ADDR A:0xe64a998
y.create.l HWIO_PMIC_ARB_OBS4_CHNL340_RDATA0_ADDR A:0xe64aa18
y.create.l HWIO_PMIC_ARB_OBS4_CHNL341_RDATA0_ADDR A:0xe64aa98
y.create.l HWIO_PMIC_ARB_OBS4_CHNL342_RDATA0_ADDR A:0xe64ab18
y.create.l HWIO_PMIC_ARB_OBS4_CHNL343_RDATA0_ADDR A:0xe64ab98
y.create.l HWIO_PMIC_ARB_OBS4_CHNL344_RDATA0_ADDR A:0xe64ac18
y.create.l HWIO_PMIC_ARB_OBS4_CHNL345_RDATA0_ADDR A:0xe64ac98
y.create.l HWIO_PMIC_ARB_OBS4_CHNL346_RDATA0_ADDR A:0xe64ad18
y.create.l HWIO_PMIC_ARB_OBS4_CHNL347_RDATA0_ADDR A:0xe64ad98
y.create.l HWIO_PMIC_ARB_OBS4_CHNL348_RDATA0_ADDR A:0xe64ae18
y.create.l HWIO_PMIC_ARB_OBS4_CHNL349_RDATA0_ADDR A:0xe64ae98
y.create.l HWIO_PMIC_ARB_OBS4_CHNL350_RDATA0_ADDR A:0xe64af18
y.create.l HWIO_PMIC_ARB_OBS4_CHNL351_RDATA0_ADDR A:0xe64af98
y.create.l HWIO_PMIC_ARB_OBS4_CHNL352_RDATA0_ADDR A:0xe64b018
y.create.l HWIO_PMIC_ARB_OBS4_CHNL353_RDATA0_ADDR A:0xe64b098
y.create.l HWIO_PMIC_ARB_OBS4_CHNL354_RDATA0_ADDR A:0xe64b118
y.create.l HWIO_PMIC_ARB_OBS4_CHNL355_RDATA0_ADDR A:0xe64b198
y.create.l HWIO_PMIC_ARB_OBS4_CHNL356_RDATA0_ADDR A:0xe64b218
y.create.l HWIO_PMIC_ARB_OBS4_CHNL357_RDATA0_ADDR A:0xe64b298
y.create.l HWIO_PMIC_ARB_OBS4_CHNL358_RDATA0_ADDR A:0xe64b318
y.create.l HWIO_PMIC_ARB_OBS4_CHNL359_RDATA0_ADDR A:0xe64b398
y.create.l HWIO_PMIC_ARB_OBS4_CHNL360_RDATA0_ADDR A:0xe64b418
y.create.l HWIO_PMIC_ARB_OBS4_CHNL361_RDATA0_ADDR A:0xe64b498
y.create.l HWIO_PMIC_ARB_OBS4_CHNL362_RDATA0_ADDR A:0xe64b518
y.create.l HWIO_PMIC_ARB_OBS4_CHNL363_RDATA0_ADDR A:0xe64b598
y.create.l HWIO_PMIC_ARB_OBS4_CHNL364_RDATA0_ADDR A:0xe64b618
y.create.l HWIO_PMIC_ARB_OBS4_CHNL365_RDATA0_ADDR A:0xe64b698
y.create.l HWIO_PMIC_ARB_OBS4_CHNL366_RDATA0_ADDR A:0xe64b718
y.create.l HWIO_PMIC_ARB_OBS4_CHNL367_RDATA0_ADDR A:0xe64b798
y.create.l HWIO_PMIC_ARB_OBS4_CHNL368_RDATA0_ADDR A:0xe64b818
y.create.l HWIO_PMIC_ARB_OBS4_CHNL369_RDATA0_ADDR A:0xe64b898
y.create.l HWIO_PMIC_ARB_OBS4_CHNL370_RDATA0_ADDR A:0xe64b918
y.create.l HWIO_PMIC_ARB_OBS4_CHNL371_RDATA0_ADDR A:0xe64b998
y.create.l HWIO_PMIC_ARB_OBS4_CHNL372_RDATA0_ADDR A:0xe64ba18
y.create.l HWIO_PMIC_ARB_OBS4_CHNL373_RDATA0_ADDR A:0xe64ba98
y.create.l HWIO_PMIC_ARB_OBS4_CHNL374_RDATA0_ADDR A:0xe64bb18
y.create.l HWIO_PMIC_ARB_OBS4_CHNL375_RDATA0_ADDR A:0xe64bb98
y.create.l HWIO_PMIC_ARB_OBS4_CHNL376_RDATA0_ADDR A:0xe64bc18
y.create.l HWIO_PMIC_ARB_OBS4_CHNL377_RDATA0_ADDR A:0xe64bc98
y.create.l HWIO_PMIC_ARB_OBS4_CHNL378_RDATA0_ADDR A:0xe64bd18
y.create.l HWIO_PMIC_ARB_OBS4_CHNL379_RDATA0_ADDR A:0xe64bd98
y.create.l HWIO_PMIC_ARB_OBS4_CHNL380_RDATA0_ADDR A:0xe64be18
y.create.l HWIO_PMIC_ARB_OBS4_CHNL381_RDATA0_ADDR A:0xe64be98
y.create.l HWIO_PMIC_ARB_OBS4_CHNL382_RDATA0_ADDR A:0xe64bf18
y.create.l HWIO_PMIC_ARB_OBS4_CHNL383_RDATA0_ADDR A:0xe64bf98
y.create.l HWIO_PMIC_ARB_OBS4_CHNL384_RDATA0_ADDR A:0xe64c018
y.create.l HWIO_PMIC_ARB_OBS4_CHNL385_RDATA0_ADDR A:0xe64c098
y.create.l HWIO_PMIC_ARB_OBS4_CHNL386_RDATA0_ADDR A:0xe64c118
y.create.l HWIO_PMIC_ARB_OBS4_CHNL387_RDATA0_ADDR A:0xe64c198
y.create.l HWIO_PMIC_ARB_OBS4_CHNL388_RDATA0_ADDR A:0xe64c218
y.create.l HWIO_PMIC_ARB_OBS4_CHNL389_RDATA0_ADDR A:0xe64c298
y.create.l HWIO_PMIC_ARB_OBS4_CHNL390_RDATA0_ADDR A:0xe64c318
y.create.l HWIO_PMIC_ARB_OBS4_CHNL391_RDATA0_ADDR A:0xe64c398
y.create.l HWIO_PMIC_ARB_OBS4_CHNL392_RDATA0_ADDR A:0xe64c418
y.create.l HWIO_PMIC_ARB_OBS4_CHNL393_RDATA0_ADDR A:0xe64c498
y.create.l HWIO_PMIC_ARB_OBS4_CHNL394_RDATA0_ADDR A:0xe64c518
y.create.l HWIO_PMIC_ARB_OBS4_CHNL395_RDATA0_ADDR A:0xe64c598
y.create.l HWIO_PMIC_ARB_OBS4_CHNL396_RDATA0_ADDR A:0xe64c618
y.create.l HWIO_PMIC_ARB_OBS4_CHNL397_RDATA0_ADDR A:0xe64c698
y.create.l HWIO_PMIC_ARB_OBS4_CHNL398_RDATA0_ADDR A:0xe64c718
y.create.l HWIO_PMIC_ARB_OBS4_CHNL399_RDATA0_ADDR A:0xe64c798
y.create.l HWIO_PMIC_ARB_OBS4_CHNL400_RDATA0_ADDR A:0xe64c818
y.create.l HWIO_PMIC_ARB_OBS4_CHNL401_RDATA0_ADDR A:0xe64c898
y.create.l HWIO_PMIC_ARB_OBS4_CHNL402_RDATA0_ADDR A:0xe64c918
y.create.l HWIO_PMIC_ARB_OBS4_CHNL403_RDATA0_ADDR A:0xe64c998
y.create.l HWIO_PMIC_ARB_OBS4_CHNL404_RDATA0_ADDR A:0xe64ca18
y.create.l HWIO_PMIC_ARB_OBS4_CHNL405_RDATA0_ADDR A:0xe64ca98
y.create.l HWIO_PMIC_ARB_OBS4_CHNL406_RDATA0_ADDR A:0xe64cb18
y.create.l HWIO_PMIC_ARB_OBS4_CHNL407_RDATA0_ADDR A:0xe64cb98
y.create.l HWIO_PMIC_ARB_OBS4_CHNL408_RDATA0_ADDR A:0xe64cc18
y.create.l HWIO_PMIC_ARB_OBS4_CHNL409_RDATA0_ADDR A:0xe64cc98
y.create.l HWIO_PMIC_ARB_OBS4_CHNL410_RDATA0_ADDR A:0xe64cd18
y.create.l HWIO_PMIC_ARB_OBS4_CHNL411_RDATA0_ADDR A:0xe64cd98
y.create.l HWIO_PMIC_ARB_OBS4_CHNL412_RDATA0_ADDR A:0xe64ce18
y.create.l HWIO_PMIC_ARB_OBS4_CHNL413_RDATA0_ADDR A:0xe64ce98
y.create.l HWIO_PMIC_ARB_OBS4_CHNL414_RDATA0_ADDR A:0xe64cf18
y.create.l HWIO_PMIC_ARB_OBS4_CHNL415_RDATA0_ADDR A:0xe64cf98
y.create.l HWIO_PMIC_ARB_OBS4_CHNL416_RDATA0_ADDR A:0xe64d018
y.create.l HWIO_PMIC_ARB_OBS4_CHNL417_RDATA0_ADDR A:0xe64d098
y.create.l HWIO_PMIC_ARB_OBS4_CHNL418_RDATA0_ADDR A:0xe64d118
y.create.l HWIO_PMIC_ARB_OBS4_CHNL419_RDATA0_ADDR A:0xe64d198
y.create.l HWIO_PMIC_ARB_OBS4_CHNL420_RDATA0_ADDR A:0xe64d218
y.create.l HWIO_PMIC_ARB_OBS4_CHNL421_RDATA0_ADDR A:0xe64d298
y.create.l HWIO_PMIC_ARB_OBS4_CHNL422_RDATA0_ADDR A:0xe64d318
y.create.l HWIO_PMIC_ARB_OBS4_CHNL423_RDATA0_ADDR A:0xe64d398
y.create.l HWIO_PMIC_ARB_OBS4_CHNL424_RDATA0_ADDR A:0xe64d418
y.create.l HWIO_PMIC_ARB_OBS4_CHNL425_RDATA0_ADDR A:0xe64d498
y.create.l HWIO_PMIC_ARB_OBS4_CHNL426_RDATA0_ADDR A:0xe64d518
y.create.l HWIO_PMIC_ARB_OBS4_CHNL427_RDATA0_ADDR A:0xe64d598
y.create.l HWIO_PMIC_ARB_OBS4_CHNL428_RDATA0_ADDR A:0xe64d618
y.create.l HWIO_PMIC_ARB_OBS4_CHNL429_RDATA0_ADDR A:0xe64d698
y.create.l HWIO_PMIC_ARB_OBS4_CHNL430_RDATA0_ADDR A:0xe64d718
y.create.l HWIO_PMIC_ARB_OBS4_CHNL431_RDATA0_ADDR A:0xe64d798
y.create.l HWIO_PMIC_ARB_OBS4_CHNL432_RDATA0_ADDR A:0xe64d818
y.create.l HWIO_PMIC_ARB_OBS4_CHNL433_RDATA0_ADDR A:0xe64d898
y.create.l HWIO_PMIC_ARB_OBS4_CHNL434_RDATA0_ADDR A:0xe64d918
y.create.l HWIO_PMIC_ARB_OBS4_CHNL435_RDATA0_ADDR A:0xe64d998
y.create.l HWIO_PMIC_ARB_OBS4_CHNL436_RDATA0_ADDR A:0xe64da18
y.create.l HWIO_PMIC_ARB_OBS4_CHNL437_RDATA0_ADDR A:0xe64da98
y.create.l HWIO_PMIC_ARB_OBS4_CHNL438_RDATA0_ADDR A:0xe64db18
y.create.l HWIO_PMIC_ARB_OBS4_CHNL439_RDATA0_ADDR A:0xe64db98
y.create.l HWIO_PMIC_ARB_OBS4_CHNL440_RDATA0_ADDR A:0xe64dc18
y.create.l HWIO_PMIC_ARB_OBS4_CHNL441_RDATA0_ADDR A:0xe64dc98
y.create.l HWIO_PMIC_ARB_OBS4_CHNL442_RDATA0_ADDR A:0xe64dd18
y.create.l HWIO_PMIC_ARB_OBS4_CHNL443_RDATA0_ADDR A:0xe64dd98
y.create.l HWIO_PMIC_ARB_OBS4_CHNL444_RDATA0_ADDR A:0xe64de18
y.create.l HWIO_PMIC_ARB_OBS4_CHNL445_RDATA0_ADDR A:0xe64de98
y.create.l HWIO_PMIC_ARB_OBS4_CHNL446_RDATA0_ADDR A:0xe64df18
y.create.l HWIO_PMIC_ARB_OBS4_CHNL447_RDATA0_ADDR A:0xe64df98
y.create.l HWIO_PMIC_ARB_OBS4_CHNL448_RDATA0_ADDR A:0xe64e018
y.create.l HWIO_PMIC_ARB_OBS4_CHNL449_RDATA0_ADDR A:0xe64e098
y.create.l HWIO_PMIC_ARB_OBS4_CHNL450_RDATA0_ADDR A:0xe64e118
y.create.l HWIO_PMIC_ARB_OBS4_CHNL451_RDATA0_ADDR A:0xe64e198
y.create.l HWIO_PMIC_ARB_OBS4_CHNL452_RDATA0_ADDR A:0xe64e218
y.create.l HWIO_PMIC_ARB_OBS4_CHNL453_RDATA0_ADDR A:0xe64e298
y.create.l HWIO_PMIC_ARB_OBS4_CHNL454_RDATA0_ADDR A:0xe64e318
y.create.l HWIO_PMIC_ARB_OBS4_CHNL455_RDATA0_ADDR A:0xe64e398
y.create.l HWIO_PMIC_ARB_OBS4_CHNL456_RDATA0_ADDR A:0xe64e418
y.create.l HWIO_PMIC_ARB_OBS4_CHNL457_RDATA0_ADDR A:0xe64e498
y.create.l HWIO_PMIC_ARB_OBS4_CHNL458_RDATA0_ADDR A:0xe64e518
y.create.l HWIO_PMIC_ARB_OBS4_CHNL459_RDATA0_ADDR A:0xe64e598
y.create.l HWIO_PMIC_ARB_OBS4_CHNL460_RDATA0_ADDR A:0xe64e618
y.create.l HWIO_PMIC_ARB_OBS4_CHNL461_RDATA0_ADDR A:0xe64e698
y.create.l HWIO_PMIC_ARB_OBS4_CHNL462_RDATA0_ADDR A:0xe64e718
y.create.l HWIO_PMIC_ARB_OBS4_CHNL463_RDATA0_ADDR A:0xe64e798
y.create.l HWIO_PMIC_ARB_OBS4_CHNL464_RDATA0_ADDR A:0xe64e818
y.create.l HWIO_PMIC_ARB_OBS4_CHNL465_RDATA0_ADDR A:0xe64e898
y.create.l HWIO_PMIC_ARB_OBS4_CHNL466_RDATA0_ADDR A:0xe64e918
y.create.l HWIO_PMIC_ARB_OBS4_CHNL467_RDATA0_ADDR A:0xe64e998
y.create.l HWIO_PMIC_ARB_OBS4_CHNL468_RDATA0_ADDR A:0xe64ea18
y.create.l HWIO_PMIC_ARB_OBS4_CHNL469_RDATA0_ADDR A:0xe64ea98
y.create.l HWIO_PMIC_ARB_OBS4_CHNL470_RDATA0_ADDR A:0xe64eb18
y.create.l HWIO_PMIC_ARB_OBS4_CHNL471_RDATA0_ADDR A:0xe64eb98
y.create.l HWIO_PMIC_ARB_OBS4_CHNL472_RDATA0_ADDR A:0xe64ec18
y.create.l HWIO_PMIC_ARB_OBS4_CHNL473_RDATA0_ADDR A:0xe64ec98
y.create.l HWIO_PMIC_ARB_OBS4_CHNL474_RDATA0_ADDR A:0xe64ed18
y.create.l HWIO_PMIC_ARB_OBS4_CHNL475_RDATA0_ADDR A:0xe64ed98
y.create.l HWIO_PMIC_ARB_OBS4_CHNL476_RDATA0_ADDR A:0xe64ee18
y.create.l HWIO_PMIC_ARB_OBS4_CHNL477_RDATA0_ADDR A:0xe64ee98
y.create.l HWIO_PMIC_ARB_OBS4_CHNL478_RDATA0_ADDR A:0xe64ef18
y.create.l HWIO_PMIC_ARB_OBS4_CHNL479_RDATA0_ADDR A:0xe64ef98
y.create.l HWIO_PMIC_ARB_OBS4_CHNL480_RDATA0_ADDR A:0xe64f018
y.create.l HWIO_PMIC_ARB_OBS4_CHNL481_RDATA0_ADDR A:0xe64f098
y.create.l HWIO_PMIC_ARB_OBS4_CHNL482_RDATA0_ADDR A:0xe64f118
y.create.l HWIO_PMIC_ARB_OBS4_CHNL483_RDATA0_ADDR A:0xe64f198
y.create.l HWIO_PMIC_ARB_OBS4_CHNL484_RDATA0_ADDR A:0xe64f218
y.create.l HWIO_PMIC_ARB_OBS4_CHNL485_RDATA0_ADDR A:0xe64f298
y.create.l HWIO_PMIC_ARB_OBS4_CHNL486_RDATA0_ADDR A:0xe64f318
y.create.l HWIO_PMIC_ARB_OBS4_CHNL487_RDATA0_ADDR A:0xe64f398
y.create.l HWIO_PMIC_ARB_OBS4_CHNL488_RDATA0_ADDR A:0xe64f418
y.create.l HWIO_PMIC_ARB_OBS4_CHNL489_RDATA0_ADDR A:0xe64f498
y.create.l HWIO_PMIC_ARB_OBS4_CHNL490_RDATA0_ADDR A:0xe64f518
y.create.l HWIO_PMIC_ARB_OBS4_CHNL491_RDATA0_ADDR A:0xe64f598
y.create.l HWIO_PMIC_ARB_OBS4_CHNL492_RDATA0_ADDR A:0xe64f618
y.create.l HWIO_PMIC_ARB_OBS4_CHNL493_RDATA0_ADDR A:0xe64f698
y.create.l HWIO_PMIC_ARB_OBS4_CHNL494_RDATA0_ADDR A:0xe64f718
y.create.l HWIO_PMIC_ARB_OBS4_CHNL495_RDATA0_ADDR A:0xe64f798
y.create.l HWIO_PMIC_ARB_OBS4_CHNL496_RDATA0_ADDR A:0xe64f818
y.create.l HWIO_PMIC_ARB_OBS4_CHNL497_RDATA0_ADDR A:0xe64f898
y.create.l HWIO_PMIC_ARB_OBS4_CHNL498_RDATA0_ADDR A:0xe64f918
y.create.l HWIO_PMIC_ARB_OBS4_CHNL499_RDATA0_ADDR A:0xe64f998
y.create.l HWIO_PMIC_ARB_OBS4_CHNL500_RDATA0_ADDR A:0xe64fa18
y.create.l HWIO_PMIC_ARB_OBS4_CHNL501_RDATA0_ADDR A:0xe64fa98
y.create.l HWIO_PMIC_ARB_OBS4_CHNL502_RDATA0_ADDR A:0xe64fb18
y.create.l HWIO_PMIC_ARB_OBS4_CHNL503_RDATA0_ADDR A:0xe64fb98
y.create.l HWIO_PMIC_ARB_OBS4_CHNL504_RDATA0_ADDR A:0xe64fc18
y.create.l HWIO_PMIC_ARB_OBS4_CHNL505_RDATA0_ADDR A:0xe64fc98
y.create.l HWIO_PMIC_ARB_OBS4_CHNL506_RDATA0_ADDR A:0xe64fd18
y.create.l HWIO_PMIC_ARB_OBS4_CHNL507_RDATA0_ADDR A:0xe64fd98
y.create.l HWIO_PMIC_ARB_OBS4_CHNL508_RDATA0_ADDR A:0xe64fe18
y.create.l HWIO_PMIC_ARB_OBS4_CHNL509_RDATA0_ADDR A:0xe64fe98
y.create.l HWIO_PMIC_ARB_OBS4_CHNL510_RDATA0_ADDR A:0xe64ff18
y.create.l HWIO_PMIC_ARB_OBS4_CHNL511_RDATA0_ADDR A:0xe64ff98
y.create.l HWIO_PMIC_ARB_OBS5_CHNL0_RDATA0_ADDR A:0xe650018
y.create.l HWIO_PMIC_ARB_OBS5_CHNL1_RDATA0_ADDR A:0xe650098
y.create.l HWIO_PMIC_ARB_OBS5_CHNL2_RDATA0_ADDR A:0xe650118
y.create.l HWIO_PMIC_ARB_OBS5_CHNL3_RDATA0_ADDR A:0xe650198
y.create.l HWIO_PMIC_ARB_OBS5_CHNL4_RDATA0_ADDR A:0xe650218
y.create.l HWIO_PMIC_ARB_OBS5_CHNL5_RDATA0_ADDR A:0xe650298
y.create.l HWIO_PMIC_ARB_OBS5_CHNL6_RDATA0_ADDR A:0xe650318
y.create.l HWIO_PMIC_ARB_OBS5_CHNL7_RDATA0_ADDR A:0xe650398
y.create.l HWIO_PMIC_ARB_OBS5_CHNL8_RDATA0_ADDR A:0xe650418
y.create.l HWIO_PMIC_ARB_OBS5_CHNL9_RDATA0_ADDR A:0xe650498
y.create.l HWIO_PMIC_ARB_OBS5_CHNL10_RDATA0_ADDR A:0xe650518
y.create.l HWIO_PMIC_ARB_OBS5_CHNL11_RDATA0_ADDR A:0xe650598
y.create.l HWIO_PMIC_ARB_OBS5_CHNL12_RDATA0_ADDR A:0xe650618
y.create.l HWIO_PMIC_ARB_OBS5_CHNL13_RDATA0_ADDR A:0xe650698
y.create.l HWIO_PMIC_ARB_OBS5_CHNL14_RDATA0_ADDR A:0xe650718
y.create.l HWIO_PMIC_ARB_OBS5_CHNL15_RDATA0_ADDR A:0xe650798
y.create.l HWIO_PMIC_ARB_OBS5_CHNL16_RDATA0_ADDR A:0xe650818
y.create.l HWIO_PMIC_ARB_OBS5_CHNL17_RDATA0_ADDR A:0xe650898
y.create.l HWIO_PMIC_ARB_OBS5_CHNL18_RDATA0_ADDR A:0xe650918
y.create.l HWIO_PMIC_ARB_OBS5_CHNL19_RDATA0_ADDR A:0xe650998
y.create.l HWIO_PMIC_ARB_OBS5_CHNL20_RDATA0_ADDR A:0xe650a18
y.create.l HWIO_PMIC_ARB_OBS5_CHNL21_RDATA0_ADDR A:0xe650a98
y.create.l HWIO_PMIC_ARB_OBS5_CHNL22_RDATA0_ADDR A:0xe650b18
y.create.l HWIO_PMIC_ARB_OBS5_CHNL23_RDATA0_ADDR A:0xe650b98
y.create.l HWIO_PMIC_ARB_OBS5_CHNL24_RDATA0_ADDR A:0xe650c18
y.create.l HWIO_PMIC_ARB_OBS5_CHNL25_RDATA0_ADDR A:0xe650c98
y.create.l HWIO_PMIC_ARB_OBS5_CHNL26_RDATA0_ADDR A:0xe650d18
y.create.l HWIO_PMIC_ARB_OBS5_CHNL27_RDATA0_ADDR A:0xe650d98
y.create.l HWIO_PMIC_ARB_OBS5_CHNL28_RDATA0_ADDR A:0xe650e18
y.create.l HWIO_PMIC_ARB_OBS5_CHNL29_RDATA0_ADDR A:0xe650e98
y.create.l HWIO_PMIC_ARB_OBS5_CHNL30_RDATA0_ADDR A:0xe650f18
y.create.l HWIO_PMIC_ARB_OBS5_CHNL31_RDATA0_ADDR A:0xe650f98
y.create.l HWIO_PMIC_ARB_OBS5_CHNL32_RDATA0_ADDR A:0xe651018
y.create.l HWIO_PMIC_ARB_OBS5_CHNL33_RDATA0_ADDR A:0xe651098
y.create.l HWIO_PMIC_ARB_OBS5_CHNL34_RDATA0_ADDR A:0xe651118
y.create.l HWIO_PMIC_ARB_OBS5_CHNL35_RDATA0_ADDR A:0xe651198
y.create.l HWIO_PMIC_ARB_OBS5_CHNL36_RDATA0_ADDR A:0xe651218
y.create.l HWIO_PMIC_ARB_OBS5_CHNL37_RDATA0_ADDR A:0xe651298
y.create.l HWIO_PMIC_ARB_OBS5_CHNL38_RDATA0_ADDR A:0xe651318
y.create.l HWIO_PMIC_ARB_OBS5_CHNL39_RDATA0_ADDR A:0xe651398
y.create.l HWIO_PMIC_ARB_OBS5_CHNL40_RDATA0_ADDR A:0xe651418
y.create.l HWIO_PMIC_ARB_OBS5_CHNL41_RDATA0_ADDR A:0xe651498
y.create.l HWIO_PMIC_ARB_OBS5_CHNL42_RDATA0_ADDR A:0xe651518
y.create.l HWIO_PMIC_ARB_OBS5_CHNL43_RDATA0_ADDR A:0xe651598
y.create.l HWIO_PMIC_ARB_OBS5_CHNL44_RDATA0_ADDR A:0xe651618
y.create.l HWIO_PMIC_ARB_OBS5_CHNL45_RDATA0_ADDR A:0xe651698
y.create.l HWIO_PMIC_ARB_OBS5_CHNL46_RDATA0_ADDR A:0xe651718
y.create.l HWIO_PMIC_ARB_OBS5_CHNL47_RDATA0_ADDR A:0xe651798
y.create.l HWIO_PMIC_ARB_OBS5_CHNL48_RDATA0_ADDR A:0xe651818
y.create.l HWIO_PMIC_ARB_OBS5_CHNL49_RDATA0_ADDR A:0xe651898
y.create.l HWIO_PMIC_ARB_OBS5_CHNL50_RDATA0_ADDR A:0xe651918
y.create.l HWIO_PMIC_ARB_OBS5_CHNL51_RDATA0_ADDR A:0xe651998
y.create.l HWIO_PMIC_ARB_OBS5_CHNL52_RDATA0_ADDR A:0xe651a18
y.create.l HWIO_PMIC_ARB_OBS5_CHNL53_RDATA0_ADDR A:0xe651a98
y.create.l HWIO_PMIC_ARB_OBS5_CHNL54_RDATA0_ADDR A:0xe651b18
y.create.l HWIO_PMIC_ARB_OBS5_CHNL55_RDATA0_ADDR A:0xe651b98
y.create.l HWIO_PMIC_ARB_OBS5_CHNL56_RDATA0_ADDR A:0xe651c18
y.create.l HWIO_PMIC_ARB_OBS5_CHNL57_RDATA0_ADDR A:0xe651c98
y.create.l HWIO_PMIC_ARB_OBS5_CHNL58_RDATA0_ADDR A:0xe651d18
y.create.l HWIO_PMIC_ARB_OBS5_CHNL59_RDATA0_ADDR A:0xe651d98
y.create.l HWIO_PMIC_ARB_OBS5_CHNL60_RDATA0_ADDR A:0xe651e18
y.create.l HWIO_PMIC_ARB_OBS5_CHNL61_RDATA0_ADDR A:0xe651e98
y.create.l HWIO_PMIC_ARB_OBS5_CHNL62_RDATA0_ADDR A:0xe651f18
y.create.l HWIO_PMIC_ARB_OBS5_CHNL63_RDATA0_ADDR A:0xe651f98
y.create.l HWIO_PMIC_ARB_OBS5_CHNL64_RDATA0_ADDR A:0xe652018
y.create.l HWIO_PMIC_ARB_OBS5_CHNL65_RDATA0_ADDR A:0xe652098
y.create.l HWIO_PMIC_ARB_OBS5_CHNL66_RDATA0_ADDR A:0xe652118
y.create.l HWIO_PMIC_ARB_OBS5_CHNL67_RDATA0_ADDR A:0xe652198
y.create.l HWIO_PMIC_ARB_OBS5_CHNL68_RDATA0_ADDR A:0xe652218
y.create.l HWIO_PMIC_ARB_OBS5_CHNL69_RDATA0_ADDR A:0xe652298
y.create.l HWIO_PMIC_ARB_OBS5_CHNL70_RDATA0_ADDR A:0xe652318
y.create.l HWIO_PMIC_ARB_OBS5_CHNL71_RDATA0_ADDR A:0xe652398
y.create.l HWIO_PMIC_ARB_OBS5_CHNL72_RDATA0_ADDR A:0xe652418
y.create.l HWIO_PMIC_ARB_OBS5_CHNL73_RDATA0_ADDR A:0xe652498
y.create.l HWIO_PMIC_ARB_OBS5_CHNL74_RDATA0_ADDR A:0xe652518
y.create.l HWIO_PMIC_ARB_OBS5_CHNL75_RDATA0_ADDR A:0xe652598
y.create.l HWIO_PMIC_ARB_OBS5_CHNL76_RDATA0_ADDR A:0xe652618
y.create.l HWIO_PMIC_ARB_OBS5_CHNL77_RDATA0_ADDR A:0xe652698
y.create.l HWIO_PMIC_ARB_OBS5_CHNL78_RDATA0_ADDR A:0xe652718
y.create.l HWIO_PMIC_ARB_OBS5_CHNL79_RDATA0_ADDR A:0xe652798
y.create.l HWIO_PMIC_ARB_OBS5_CHNL80_RDATA0_ADDR A:0xe652818
y.create.l HWIO_PMIC_ARB_OBS5_CHNL81_RDATA0_ADDR A:0xe652898
y.create.l HWIO_PMIC_ARB_OBS5_CHNL82_RDATA0_ADDR A:0xe652918
y.create.l HWIO_PMIC_ARB_OBS5_CHNL83_RDATA0_ADDR A:0xe652998
y.create.l HWIO_PMIC_ARB_OBS5_CHNL84_RDATA0_ADDR A:0xe652a18
y.create.l HWIO_PMIC_ARB_OBS5_CHNL85_RDATA0_ADDR A:0xe652a98
y.create.l HWIO_PMIC_ARB_OBS5_CHNL86_RDATA0_ADDR A:0xe652b18
y.create.l HWIO_PMIC_ARB_OBS5_CHNL87_RDATA0_ADDR A:0xe652b98
y.create.l HWIO_PMIC_ARB_OBS5_CHNL88_RDATA0_ADDR A:0xe652c18
y.create.l HWIO_PMIC_ARB_OBS5_CHNL89_RDATA0_ADDR A:0xe652c98
y.create.l HWIO_PMIC_ARB_OBS5_CHNL90_RDATA0_ADDR A:0xe652d18
y.create.l HWIO_PMIC_ARB_OBS5_CHNL91_RDATA0_ADDR A:0xe652d98
y.create.l HWIO_PMIC_ARB_OBS5_CHNL92_RDATA0_ADDR A:0xe652e18
y.create.l HWIO_PMIC_ARB_OBS5_CHNL93_RDATA0_ADDR A:0xe652e98
y.create.l HWIO_PMIC_ARB_OBS5_CHNL94_RDATA0_ADDR A:0xe652f18
y.create.l HWIO_PMIC_ARB_OBS5_CHNL95_RDATA0_ADDR A:0xe652f98
y.create.l HWIO_PMIC_ARB_OBS5_CHNL96_RDATA0_ADDR A:0xe653018
y.create.l HWIO_PMIC_ARB_OBS5_CHNL97_RDATA0_ADDR A:0xe653098
y.create.l HWIO_PMIC_ARB_OBS5_CHNL98_RDATA0_ADDR A:0xe653118
y.create.l HWIO_PMIC_ARB_OBS5_CHNL99_RDATA0_ADDR A:0xe653198
y.create.l HWIO_PMIC_ARB_OBS5_CHNL100_RDATA0_ADDR A:0xe653218
y.create.l HWIO_PMIC_ARB_OBS5_CHNL101_RDATA0_ADDR A:0xe653298
y.create.l HWIO_PMIC_ARB_OBS5_CHNL102_RDATA0_ADDR A:0xe653318
y.create.l HWIO_PMIC_ARB_OBS5_CHNL103_RDATA0_ADDR A:0xe653398
y.create.l HWIO_PMIC_ARB_OBS5_CHNL104_RDATA0_ADDR A:0xe653418
y.create.l HWIO_PMIC_ARB_OBS5_CHNL105_RDATA0_ADDR A:0xe653498
y.create.l HWIO_PMIC_ARB_OBS5_CHNL106_RDATA0_ADDR A:0xe653518
y.create.l HWIO_PMIC_ARB_OBS5_CHNL107_RDATA0_ADDR A:0xe653598
y.create.l HWIO_PMIC_ARB_OBS5_CHNL108_RDATA0_ADDR A:0xe653618
y.create.l HWIO_PMIC_ARB_OBS5_CHNL109_RDATA0_ADDR A:0xe653698
y.create.l HWIO_PMIC_ARB_OBS5_CHNL110_RDATA0_ADDR A:0xe653718
y.create.l HWIO_PMIC_ARB_OBS5_CHNL111_RDATA0_ADDR A:0xe653798
y.create.l HWIO_PMIC_ARB_OBS5_CHNL112_RDATA0_ADDR A:0xe653818
y.create.l HWIO_PMIC_ARB_OBS5_CHNL113_RDATA0_ADDR A:0xe653898
y.create.l HWIO_PMIC_ARB_OBS5_CHNL114_RDATA0_ADDR A:0xe653918
y.create.l HWIO_PMIC_ARB_OBS5_CHNL115_RDATA0_ADDR A:0xe653998
y.create.l HWIO_PMIC_ARB_OBS5_CHNL116_RDATA0_ADDR A:0xe653a18
y.create.l HWIO_PMIC_ARB_OBS5_CHNL117_RDATA0_ADDR A:0xe653a98
y.create.l HWIO_PMIC_ARB_OBS5_CHNL118_RDATA0_ADDR A:0xe653b18
y.create.l HWIO_PMIC_ARB_OBS5_CHNL119_RDATA0_ADDR A:0xe653b98
y.create.l HWIO_PMIC_ARB_OBS5_CHNL120_RDATA0_ADDR A:0xe653c18
y.create.l HWIO_PMIC_ARB_OBS5_CHNL121_RDATA0_ADDR A:0xe653c98
y.create.l HWIO_PMIC_ARB_OBS5_CHNL122_RDATA0_ADDR A:0xe653d18
y.create.l HWIO_PMIC_ARB_OBS5_CHNL123_RDATA0_ADDR A:0xe653d98
y.create.l HWIO_PMIC_ARB_OBS5_CHNL124_RDATA0_ADDR A:0xe653e18
y.create.l HWIO_PMIC_ARB_OBS5_CHNL125_RDATA0_ADDR A:0xe653e98
y.create.l HWIO_PMIC_ARB_OBS5_CHNL126_RDATA0_ADDR A:0xe653f18
y.create.l HWIO_PMIC_ARB_OBS5_CHNL127_RDATA0_ADDR A:0xe653f98
y.create.l HWIO_PMIC_ARB_OBS5_CHNL128_RDATA0_ADDR A:0xe654018
y.create.l HWIO_PMIC_ARB_OBS5_CHNL129_RDATA0_ADDR A:0xe654098
y.create.l HWIO_PMIC_ARB_OBS5_CHNL130_RDATA0_ADDR A:0xe654118
y.create.l HWIO_PMIC_ARB_OBS5_CHNL131_RDATA0_ADDR A:0xe654198
y.create.l HWIO_PMIC_ARB_OBS5_CHNL132_RDATA0_ADDR A:0xe654218
y.create.l HWIO_PMIC_ARB_OBS5_CHNL133_RDATA0_ADDR A:0xe654298
y.create.l HWIO_PMIC_ARB_OBS5_CHNL134_RDATA0_ADDR A:0xe654318
y.create.l HWIO_PMIC_ARB_OBS5_CHNL135_RDATA0_ADDR A:0xe654398
y.create.l HWIO_PMIC_ARB_OBS5_CHNL136_RDATA0_ADDR A:0xe654418
y.create.l HWIO_PMIC_ARB_OBS5_CHNL137_RDATA0_ADDR A:0xe654498
y.create.l HWIO_PMIC_ARB_OBS5_CHNL138_RDATA0_ADDR A:0xe654518
y.create.l HWIO_PMIC_ARB_OBS5_CHNL139_RDATA0_ADDR A:0xe654598
y.create.l HWIO_PMIC_ARB_OBS5_CHNL140_RDATA0_ADDR A:0xe654618
y.create.l HWIO_PMIC_ARB_OBS5_CHNL141_RDATA0_ADDR A:0xe654698
y.create.l HWIO_PMIC_ARB_OBS5_CHNL142_RDATA0_ADDR A:0xe654718
y.create.l HWIO_PMIC_ARB_OBS5_CHNL143_RDATA0_ADDR A:0xe654798
y.create.l HWIO_PMIC_ARB_OBS5_CHNL144_RDATA0_ADDR A:0xe654818
y.create.l HWIO_PMIC_ARB_OBS5_CHNL145_RDATA0_ADDR A:0xe654898
y.create.l HWIO_PMIC_ARB_OBS5_CHNL146_RDATA0_ADDR A:0xe654918
y.create.l HWIO_PMIC_ARB_OBS5_CHNL147_RDATA0_ADDR A:0xe654998
y.create.l HWIO_PMIC_ARB_OBS5_CHNL148_RDATA0_ADDR A:0xe654a18
y.create.l HWIO_PMIC_ARB_OBS5_CHNL149_RDATA0_ADDR A:0xe654a98
y.create.l HWIO_PMIC_ARB_OBS5_CHNL150_RDATA0_ADDR A:0xe654b18
y.create.l HWIO_PMIC_ARB_OBS5_CHNL151_RDATA0_ADDR A:0xe654b98
y.create.l HWIO_PMIC_ARB_OBS5_CHNL152_RDATA0_ADDR A:0xe654c18
y.create.l HWIO_PMIC_ARB_OBS5_CHNL153_RDATA0_ADDR A:0xe654c98
y.create.l HWIO_PMIC_ARB_OBS5_CHNL154_RDATA0_ADDR A:0xe654d18
y.create.l HWIO_PMIC_ARB_OBS5_CHNL155_RDATA0_ADDR A:0xe654d98
y.create.l HWIO_PMIC_ARB_OBS5_CHNL156_RDATA0_ADDR A:0xe654e18
y.create.l HWIO_PMIC_ARB_OBS5_CHNL157_RDATA0_ADDR A:0xe654e98
y.create.l HWIO_PMIC_ARB_OBS5_CHNL158_RDATA0_ADDR A:0xe654f18
y.create.l HWIO_PMIC_ARB_OBS5_CHNL159_RDATA0_ADDR A:0xe654f98
y.create.l HWIO_PMIC_ARB_OBS5_CHNL160_RDATA0_ADDR A:0xe655018
y.create.l HWIO_PMIC_ARB_OBS5_CHNL161_RDATA0_ADDR A:0xe655098
y.create.l HWIO_PMIC_ARB_OBS5_CHNL162_RDATA0_ADDR A:0xe655118
y.create.l HWIO_PMIC_ARB_OBS5_CHNL163_RDATA0_ADDR A:0xe655198
y.create.l HWIO_PMIC_ARB_OBS5_CHNL164_RDATA0_ADDR A:0xe655218
y.create.l HWIO_PMIC_ARB_OBS5_CHNL165_RDATA0_ADDR A:0xe655298
y.create.l HWIO_PMIC_ARB_OBS5_CHNL166_RDATA0_ADDR A:0xe655318
y.create.l HWIO_PMIC_ARB_OBS5_CHNL167_RDATA0_ADDR A:0xe655398
y.create.l HWIO_PMIC_ARB_OBS5_CHNL168_RDATA0_ADDR A:0xe655418
y.create.l HWIO_PMIC_ARB_OBS5_CHNL169_RDATA0_ADDR A:0xe655498
y.create.l HWIO_PMIC_ARB_OBS5_CHNL170_RDATA0_ADDR A:0xe655518
y.create.l HWIO_PMIC_ARB_OBS5_CHNL171_RDATA0_ADDR A:0xe655598
y.create.l HWIO_PMIC_ARB_OBS5_CHNL172_RDATA0_ADDR A:0xe655618
y.create.l HWIO_PMIC_ARB_OBS5_CHNL173_RDATA0_ADDR A:0xe655698
y.create.l HWIO_PMIC_ARB_OBS5_CHNL174_RDATA0_ADDR A:0xe655718
y.create.l HWIO_PMIC_ARB_OBS5_CHNL175_RDATA0_ADDR A:0xe655798
y.create.l HWIO_PMIC_ARB_OBS5_CHNL176_RDATA0_ADDR A:0xe655818
y.create.l HWIO_PMIC_ARB_OBS5_CHNL177_RDATA0_ADDR A:0xe655898
y.create.l HWIO_PMIC_ARB_OBS5_CHNL178_RDATA0_ADDR A:0xe655918
y.create.l HWIO_PMIC_ARB_OBS5_CHNL179_RDATA0_ADDR A:0xe655998
y.create.l HWIO_PMIC_ARB_OBS5_CHNL180_RDATA0_ADDR A:0xe655a18
y.create.l HWIO_PMIC_ARB_OBS5_CHNL181_RDATA0_ADDR A:0xe655a98
y.create.l HWIO_PMIC_ARB_OBS5_CHNL182_RDATA0_ADDR A:0xe655b18
y.create.l HWIO_PMIC_ARB_OBS5_CHNL183_RDATA0_ADDR A:0xe655b98
y.create.l HWIO_PMIC_ARB_OBS5_CHNL184_RDATA0_ADDR A:0xe655c18
y.create.l HWIO_PMIC_ARB_OBS5_CHNL185_RDATA0_ADDR A:0xe655c98
y.create.l HWIO_PMIC_ARB_OBS5_CHNL186_RDATA0_ADDR A:0xe655d18
y.create.l HWIO_PMIC_ARB_OBS5_CHNL187_RDATA0_ADDR A:0xe655d98
y.create.l HWIO_PMIC_ARB_OBS5_CHNL188_RDATA0_ADDR A:0xe655e18
y.create.l HWIO_PMIC_ARB_OBS5_CHNL189_RDATA0_ADDR A:0xe655e98
y.create.l HWIO_PMIC_ARB_OBS5_CHNL190_RDATA0_ADDR A:0xe655f18
y.create.l HWIO_PMIC_ARB_OBS5_CHNL191_RDATA0_ADDR A:0xe655f98
y.create.l HWIO_PMIC_ARB_OBS5_CHNL192_RDATA0_ADDR A:0xe656018
y.create.l HWIO_PMIC_ARB_OBS5_CHNL193_RDATA0_ADDR A:0xe656098
y.create.l HWIO_PMIC_ARB_OBS5_CHNL194_RDATA0_ADDR A:0xe656118
y.create.l HWIO_PMIC_ARB_OBS5_CHNL195_RDATA0_ADDR A:0xe656198
y.create.l HWIO_PMIC_ARB_OBS5_CHNL196_RDATA0_ADDR A:0xe656218
y.create.l HWIO_PMIC_ARB_OBS5_CHNL197_RDATA0_ADDR A:0xe656298
y.create.l HWIO_PMIC_ARB_OBS5_CHNL198_RDATA0_ADDR A:0xe656318
y.create.l HWIO_PMIC_ARB_OBS5_CHNL199_RDATA0_ADDR A:0xe656398
y.create.l HWIO_PMIC_ARB_OBS5_CHNL200_RDATA0_ADDR A:0xe656418
y.create.l HWIO_PMIC_ARB_OBS5_CHNL201_RDATA0_ADDR A:0xe656498
y.create.l HWIO_PMIC_ARB_OBS5_CHNL202_RDATA0_ADDR A:0xe656518
y.create.l HWIO_PMIC_ARB_OBS5_CHNL203_RDATA0_ADDR A:0xe656598
y.create.l HWIO_PMIC_ARB_OBS5_CHNL204_RDATA0_ADDR A:0xe656618
y.create.l HWIO_PMIC_ARB_OBS5_CHNL205_RDATA0_ADDR A:0xe656698
y.create.l HWIO_PMIC_ARB_OBS5_CHNL206_RDATA0_ADDR A:0xe656718
y.create.l HWIO_PMIC_ARB_OBS5_CHNL207_RDATA0_ADDR A:0xe656798
y.create.l HWIO_PMIC_ARB_OBS5_CHNL208_RDATA0_ADDR A:0xe656818
y.create.l HWIO_PMIC_ARB_OBS5_CHNL209_RDATA0_ADDR A:0xe656898
y.create.l HWIO_PMIC_ARB_OBS5_CHNL210_RDATA0_ADDR A:0xe656918
y.create.l HWIO_PMIC_ARB_OBS5_CHNL211_RDATA0_ADDR A:0xe656998
y.create.l HWIO_PMIC_ARB_OBS5_CHNL212_RDATA0_ADDR A:0xe656a18
y.create.l HWIO_PMIC_ARB_OBS5_CHNL213_RDATA0_ADDR A:0xe656a98
y.create.l HWIO_PMIC_ARB_OBS5_CHNL214_RDATA0_ADDR A:0xe656b18
y.create.l HWIO_PMIC_ARB_OBS5_CHNL215_RDATA0_ADDR A:0xe656b98
y.create.l HWIO_PMIC_ARB_OBS5_CHNL216_RDATA0_ADDR A:0xe656c18
y.create.l HWIO_PMIC_ARB_OBS5_CHNL217_RDATA0_ADDR A:0xe656c98
y.create.l HWIO_PMIC_ARB_OBS5_CHNL218_RDATA0_ADDR A:0xe656d18
y.create.l HWIO_PMIC_ARB_OBS5_CHNL219_RDATA0_ADDR A:0xe656d98
y.create.l HWIO_PMIC_ARB_OBS5_CHNL220_RDATA0_ADDR A:0xe656e18
y.create.l HWIO_PMIC_ARB_OBS5_CHNL221_RDATA0_ADDR A:0xe656e98
y.create.l HWIO_PMIC_ARB_OBS5_CHNL222_RDATA0_ADDR A:0xe656f18
y.create.l HWIO_PMIC_ARB_OBS5_CHNL223_RDATA0_ADDR A:0xe656f98
y.create.l HWIO_PMIC_ARB_OBS5_CHNL224_RDATA0_ADDR A:0xe657018
y.create.l HWIO_PMIC_ARB_OBS5_CHNL225_RDATA0_ADDR A:0xe657098
y.create.l HWIO_PMIC_ARB_OBS5_CHNL226_RDATA0_ADDR A:0xe657118
y.create.l HWIO_PMIC_ARB_OBS5_CHNL227_RDATA0_ADDR A:0xe657198
y.create.l HWIO_PMIC_ARB_OBS5_CHNL228_RDATA0_ADDR A:0xe657218
y.create.l HWIO_PMIC_ARB_OBS5_CHNL229_RDATA0_ADDR A:0xe657298
y.create.l HWIO_PMIC_ARB_OBS5_CHNL230_RDATA0_ADDR A:0xe657318
y.create.l HWIO_PMIC_ARB_OBS5_CHNL231_RDATA0_ADDR A:0xe657398
y.create.l HWIO_PMIC_ARB_OBS5_CHNL232_RDATA0_ADDR A:0xe657418
y.create.l HWIO_PMIC_ARB_OBS5_CHNL233_RDATA0_ADDR A:0xe657498
y.create.l HWIO_PMIC_ARB_OBS5_CHNL234_RDATA0_ADDR A:0xe657518
y.create.l HWIO_PMIC_ARB_OBS5_CHNL235_RDATA0_ADDR A:0xe657598
y.create.l HWIO_PMIC_ARB_OBS5_CHNL236_RDATA0_ADDR A:0xe657618
y.create.l HWIO_PMIC_ARB_OBS5_CHNL237_RDATA0_ADDR A:0xe657698
y.create.l HWIO_PMIC_ARB_OBS5_CHNL238_RDATA0_ADDR A:0xe657718
y.create.l HWIO_PMIC_ARB_OBS5_CHNL239_RDATA0_ADDR A:0xe657798
y.create.l HWIO_PMIC_ARB_OBS5_CHNL240_RDATA0_ADDR A:0xe657818
y.create.l HWIO_PMIC_ARB_OBS5_CHNL241_RDATA0_ADDR A:0xe657898
y.create.l HWIO_PMIC_ARB_OBS5_CHNL242_RDATA0_ADDR A:0xe657918
y.create.l HWIO_PMIC_ARB_OBS5_CHNL243_RDATA0_ADDR A:0xe657998
y.create.l HWIO_PMIC_ARB_OBS5_CHNL244_RDATA0_ADDR A:0xe657a18
y.create.l HWIO_PMIC_ARB_OBS5_CHNL245_RDATA0_ADDR A:0xe657a98
y.create.l HWIO_PMIC_ARB_OBS5_CHNL246_RDATA0_ADDR A:0xe657b18
y.create.l HWIO_PMIC_ARB_OBS5_CHNL247_RDATA0_ADDR A:0xe657b98
y.create.l HWIO_PMIC_ARB_OBS5_CHNL248_RDATA0_ADDR A:0xe657c18
y.create.l HWIO_PMIC_ARB_OBS5_CHNL249_RDATA0_ADDR A:0xe657c98
y.create.l HWIO_PMIC_ARB_OBS5_CHNL250_RDATA0_ADDR A:0xe657d18
y.create.l HWIO_PMIC_ARB_OBS5_CHNL251_RDATA0_ADDR A:0xe657d98
y.create.l HWIO_PMIC_ARB_OBS5_CHNL252_RDATA0_ADDR A:0xe657e18
y.create.l HWIO_PMIC_ARB_OBS5_CHNL253_RDATA0_ADDR A:0xe657e98
y.create.l HWIO_PMIC_ARB_OBS5_CHNL254_RDATA0_ADDR A:0xe657f18
y.create.l HWIO_PMIC_ARB_OBS5_CHNL255_RDATA0_ADDR A:0xe657f98
y.create.l HWIO_PMIC_ARB_OBS5_CHNL256_RDATA0_ADDR A:0xe658018
y.create.l HWIO_PMIC_ARB_OBS5_CHNL257_RDATA0_ADDR A:0xe658098
y.create.l HWIO_PMIC_ARB_OBS5_CHNL258_RDATA0_ADDR A:0xe658118
y.create.l HWIO_PMIC_ARB_OBS5_CHNL259_RDATA0_ADDR A:0xe658198
y.create.l HWIO_PMIC_ARB_OBS5_CHNL260_RDATA0_ADDR A:0xe658218
y.create.l HWIO_PMIC_ARB_OBS5_CHNL261_RDATA0_ADDR A:0xe658298
y.create.l HWIO_PMIC_ARB_OBS5_CHNL262_RDATA0_ADDR A:0xe658318
y.create.l HWIO_PMIC_ARB_OBS5_CHNL263_RDATA0_ADDR A:0xe658398
y.create.l HWIO_PMIC_ARB_OBS5_CHNL264_RDATA0_ADDR A:0xe658418
y.create.l HWIO_PMIC_ARB_OBS5_CHNL265_RDATA0_ADDR A:0xe658498
y.create.l HWIO_PMIC_ARB_OBS5_CHNL266_RDATA0_ADDR A:0xe658518
y.create.l HWIO_PMIC_ARB_OBS5_CHNL267_RDATA0_ADDR A:0xe658598
y.create.l HWIO_PMIC_ARB_OBS5_CHNL268_RDATA0_ADDR A:0xe658618
y.create.l HWIO_PMIC_ARB_OBS5_CHNL269_RDATA0_ADDR A:0xe658698
y.create.l HWIO_PMIC_ARB_OBS5_CHNL270_RDATA0_ADDR A:0xe658718
y.create.l HWIO_PMIC_ARB_OBS5_CHNL271_RDATA0_ADDR A:0xe658798
y.create.l HWIO_PMIC_ARB_OBS5_CHNL272_RDATA0_ADDR A:0xe658818
y.create.l HWIO_PMIC_ARB_OBS5_CHNL273_RDATA0_ADDR A:0xe658898
y.create.l HWIO_PMIC_ARB_OBS5_CHNL274_RDATA0_ADDR A:0xe658918
y.create.l HWIO_PMIC_ARB_OBS5_CHNL275_RDATA0_ADDR A:0xe658998
y.create.l HWIO_PMIC_ARB_OBS5_CHNL276_RDATA0_ADDR A:0xe658a18
y.create.l HWIO_PMIC_ARB_OBS5_CHNL277_RDATA0_ADDR A:0xe658a98
y.create.l HWIO_PMIC_ARB_OBS5_CHNL278_RDATA0_ADDR A:0xe658b18
y.create.l HWIO_PMIC_ARB_OBS5_CHNL279_RDATA0_ADDR A:0xe658b98
y.create.l HWIO_PMIC_ARB_OBS5_CHNL280_RDATA0_ADDR A:0xe658c18
y.create.l HWIO_PMIC_ARB_OBS5_CHNL281_RDATA0_ADDR A:0xe658c98
y.create.l HWIO_PMIC_ARB_OBS5_CHNL282_RDATA0_ADDR A:0xe658d18
y.create.l HWIO_PMIC_ARB_OBS5_CHNL283_RDATA0_ADDR A:0xe658d98
y.create.l HWIO_PMIC_ARB_OBS5_CHNL284_RDATA0_ADDR A:0xe658e18
y.create.l HWIO_PMIC_ARB_OBS5_CHNL285_RDATA0_ADDR A:0xe658e98
y.create.l HWIO_PMIC_ARB_OBS5_CHNL286_RDATA0_ADDR A:0xe658f18
y.create.l HWIO_PMIC_ARB_OBS5_CHNL287_RDATA0_ADDR A:0xe658f98
y.create.l HWIO_PMIC_ARB_OBS5_CHNL288_RDATA0_ADDR A:0xe659018
y.create.l HWIO_PMIC_ARB_OBS5_CHNL289_RDATA0_ADDR A:0xe659098
y.create.l HWIO_PMIC_ARB_OBS5_CHNL290_RDATA0_ADDR A:0xe659118
y.create.l HWIO_PMIC_ARB_OBS5_CHNL291_RDATA0_ADDR A:0xe659198
y.create.l HWIO_PMIC_ARB_OBS5_CHNL292_RDATA0_ADDR A:0xe659218
y.create.l HWIO_PMIC_ARB_OBS5_CHNL293_RDATA0_ADDR A:0xe659298
y.create.l HWIO_PMIC_ARB_OBS5_CHNL294_RDATA0_ADDR A:0xe659318
y.create.l HWIO_PMIC_ARB_OBS5_CHNL295_RDATA0_ADDR A:0xe659398
y.create.l HWIO_PMIC_ARB_OBS5_CHNL296_RDATA0_ADDR A:0xe659418
y.create.l HWIO_PMIC_ARB_OBS5_CHNL297_RDATA0_ADDR A:0xe659498
y.create.l HWIO_PMIC_ARB_OBS5_CHNL298_RDATA0_ADDR A:0xe659518
y.create.l HWIO_PMIC_ARB_OBS5_CHNL299_RDATA0_ADDR A:0xe659598
y.create.l HWIO_PMIC_ARB_OBS5_CHNL300_RDATA0_ADDR A:0xe659618
y.create.l HWIO_PMIC_ARB_OBS5_CHNL301_RDATA0_ADDR A:0xe659698
y.create.l HWIO_PMIC_ARB_OBS5_CHNL302_RDATA0_ADDR A:0xe659718
y.create.l HWIO_PMIC_ARB_OBS5_CHNL303_RDATA0_ADDR A:0xe659798
y.create.l HWIO_PMIC_ARB_OBS5_CHNL304_RDATA0_ADDR A:0xe659818
y.create.l HWIO_PMIC_ARB_OBS5_CHNL305_RDATA0_ADDR A:0xe659898
y.create.l HWIO_PMIC_ARB_OBS5_CHNL306_RDATA0_ADDR A:0xe659918
y.create.l HWIO_PMIC_ARB_OBS5_CHNL307_RDATA0_ADDR A:0xe659998
y.create.l HWIO_PMIC_ARB_OBS5_CHNL308_RDATA0_ADDR A:0xe659a18
y.create.l HWIO_PMIC_ARB_OBS5_CHNL309_RDATA0_ADDR A:0xe659a98
y.create.l HWIO_PMIC_ARB_OBS5_CHNL310_RDATA0_ADDR A:0xe659b18
y.create.l HWIO_PMIC_ARB_OBS5_CHNL311_RDATA0_ADDR A:0xe659b98
y.create.l HWIO_PMIC_ARB_OBS5_CHNL312_RDATA0_ADDR A:0xe659c18
y.create.l HWIO_PMIC_ARB_OBS5_CHNL313_RDATA0_ADDR A:0xe659c98
y.create.l HWIO_PMIC_ARB_OBS5_CHNL314_RDATA0_ADDR A:0xe659d18
y.create.l HWIO_PMIC_ARB_OBS5_CHNL315_RDATA0_ADDR A:0xe659d98
y.create.l HWIO_PMIC_ARB_OBS5_CHNL316_RDATA0_ADDR A:0xe659e18
y.create.l HWIO_PMIC_ARB_OBS5_CHNL317_RDATA0_ADDR A:0xe659e98
y.create.l HWIO_PMIC_ARB_OBS5_CHNL318_RDATA0_ADDR A:0xe659f18
y.create.l HWIO_PMIC_ARB_OBS5_CHNL319_RDATA0_ADDR A:0xe659f98
y.create.l HWIO_PMIC_ARB_OBS5_CHNL320_RDATA0_ADDR A:0xe65a018
y.create.l HWIO_PMIC_ARB_OBS5_CHNL321_RDATA0_ADDR A:0xe65a098
y.create.l HWIO_PMIC_ARB_OBS5_CHNL322_RDATA0_ADDR A:0xe65a118
y.create.l HWIO_PMIC_ARB_OBS5_CHNL323_RDATA0_ADDR A:0xe65a198
y.create.l HWIO_PMIC_ARB_OBS5_CHNL324_RDATA0_ADDR A:0xe65a218
y.create.l HWIO_PMIC_ARB_OBS5_CHNL325_RDATA0_ADDR A:0xe65a298
y.create.l HWIO_PMIC_ARB_OBS5_CHNL326_RDATA0_ADDR A:0xe65a318
y.create.l HWIO_PMIC_ARB_OBS5_CHNL327_RDATA0_ADDR A:0xe65a398
y.create.l HWIO_PMIC_ARB_OBS5_CHNL328_RDATA0_ADDR A:0xe65a418
y.create.l HWIO_PMIC_ARB_OBS5_CHNL329_RDATA0_ADDR A:0xe65a498
y.create.l HWIO_PMIC_ARB_OBS5_CHNL330_RDATA0_ADDR A:0xe65a518
y.create.l HWIO_PMIC_ARB_OBS5_CHNL331_RDATA0_ADDR A:0xe65a598
y.create.l HWIO_PMIC_ARB_OBS5_CHNL332_RDATA0_ADDR A:0xe65a618
y.create.l HWIO_PMIC_ARB_OBS5_CHNL333_RDATA0_ADDR A:0xe65a698
y.create.l HWIO_PMIC_ARB_OBS5_CHNL334_RDATA0_ADDR A:0xe65a718
y.create.l HWIO_PMIC_ARB_OBS5_CHNL335_RDATA0_ADDR A:0xe65a798
y.create.l HWIO_PMIC_ARB_OBS5_CHNL336_RDATA0_ADDR A:0xe65a818
y.create.l HWIO_PMIC_ARB_OBS5_CHNL337_RDATA0_ADDR A:0xe65a898
y.create.l HWIO_PMIC_ARB_OBS5_CHNL338_RDATA0_ADDR A:0xe65a918
y.create.l HWIO_PMIC_ARB_OBS5_CHNL339_RDATA0_ADDR A:0xe65a998
y.create.l HWIO_PMIC_ARB_OBS5_CHNL340_RDATA0_ADDR A:0xe65aa18
y.create.l HWIO_PMIC_ARB_OBS5_CHNL341_RDATA0_ADDR A:0xe65aa98
y.create.l HWIO_PMIC_ARB_OBS5_CHNL342_RDATA0_ADDR A:0xe65ab18
y.create.l HWIO_PMIC_ARB_OBS5_CHNL343_RDATA0_ADDR A:0xe65ab98
y.create.l HWIO_PMIC_ARB_OBS5_CHNL344_RDATA0_ADDR A:0xe65ac18
y.create.l HWIO_PMIC_ARB_OBS5_CHNL345_RDATA0_ADDR A:0xe65ac98
y.create.l HWIO_PMIC_ARB_OBS5_CHNL346_RDATA0_ADDR A:0xe65ad18
y.create.l HWIO_PMIC_ARB_OBS5_CHNL347_RDATA0_ADDR A:0xe65ad98
y.create.l HWIO_PMIC_ARB_OBS5_CHNL348_RDATA0_ADDR A:0xe65ae18
y.create.l HWIO_PMIC_ARB_OBS5_CHNL349_RDATA0_ADDR A:0xe65ae98
y.create.l HWIO_PMIC_ARB_OBS5_CHNL350_RDATA0_ADDR A:0xe65af18
y.create.l HWIO_PMIC_ARB_OBS5_CHNL351_RDATA0_ADDR A:0xe65af98
y.create.l HWIO_PMIC_ARB_OBS5_CHNL352_RDATA0_ADDR A:0xe65b018
y.create.l HWIO_PMIC_ARB_OBS5_CHNL353_RDATA0_ADDR A:0xe65b098
y.create.l HWIO_PMIC_ARB_OBS5_CHNL354_RDATA0_ADDR A:0xe65b118
y.create.l HWIO_PMIC_ARB_OBS5_CHNL355_RDATA0_ADDR A:0xe65b198
y.create.l HWIO_PMIC_ARB_OBS5_CHNL356_RDATA0_ADDR A:0xe65b218
y.create.l HWIO_PMIC_ARB_OBS5_CHNL357_RDATA0_ADDR A:0xe65b298
y.create.l HWIO_PMIC_ARB_OBS5_CHNL358_RDATA0_ADDR A:0xe65b318
y.create.l HWIO_PMIC_ARB_OBS5_CHNL359_RDATA0_ADDR A:0xe65b398
y.create.l HWIO_PMIC_ARB_OBS5_CHNL360_RDATA0_ADDR A:0xe65b418
y.create.l HWIO_PMIC_ARB_OBS5_CHNL361_RDATA0_ADDR A:0xe65b498
y.create.l HWIO_PMIC_ARB_OBS5_CHNL362_RDATA0_ADDR A:0xe65b518
y.create.l HWIO_PMIC_ARB_OBS5_CHNL363_RDATA0_ADDR A:0xe65b598
y.create.l HWIO_PMIC_ARB_OBS5_CHNL364_RDATA0_ADDR A:0xe65b618
y.create.l HWIO_PMIC_ARB_OBS5_CHNL365_RDATA0_ADDR A:0xe65b698
y.create.l HWIO_PMIC_ARB_OBS5_CHNL366_RDATA0_ADDR A:0xe65b718
y.create.l HWIO_PMIC_ARB_OBS5_CHNL367_RDATA0_ADDR A:0xe65b798
y.create.l HWIO_PMIC_ARB_OBS5_CHNL368_RDATA0_ADDR A:0xe65b818
y.create.l HWIO_PMIC_ARB_OBS5_CHNL369_RDATA0_ADDR A:0xe65b898
y.create.l HWIO_PMIC_ARB_OBS5_CHNL370_RDATA0_ADDR A:0xe65b918
y.create.l HWIO_PMIC_ARB_OBS5_CHNL371_RDATA0_ADDR A:0xe65b998
y.create.l HWIO_PMIC_ARB_OBS5_CHNL372_RDATA0_ADDR A:0xe65ba18
y.create.l HWIO_PMIC_ARB_OBS5_CHNL373_RDATA0_ADDR A:0xe65ba98
y.create.l HWIO_PMIC_ARB_OBS5_CHNL374_RDATA0_ADDR A:0xe65bb18
y.create.l HWIO_PMIC_ARB_OBS5_CHNL375_RDATA0_ADDR A:0xe65bb98
y.create.l HWIO_PMIC_ARB_OBS5_CHNL376_RDATA0_ADDR A:0xe65bc18
y.create.l HWIO_PMIC_ARB_OBS5_CHNL377_RDATA0_ADDR A:0xe65bc98
y.create.l HWIO_PMIC_ARB_OBS5_CHNL378_RDATA0_ADDR A:0xe65bd18
y.create.l HWIO_PMIC_ARB_OBS5_CHNL379_RDATA0_ADDR A:0xe65bd98
y.create.l HWIO_PMIC_ARB_OBS5_CHNL380_RDATA0_ADDR A:0xe65be18
y.create.l HWIO_PMIC_ARB_OBS5_CHNL381_RDATA0_ADDR A:0xe65be98
y.create.l HWIO_PMIC_ARB_OBS5_CHNL382_RDATA0_ADDR A:0xe65bf18
y.create.l HWIO_PMIC_ARB_OBS5_CHNL383_RDATA0_ADDR A:0xe65bf98
y.create.l HWIO_PMIC_ARB_OBS5_CHNL384_RDATA0_ADDR A:0xe65c018
y.create.l HWIO_PMIC_ARB_OBS5_CHNL385_RDATA0_ADDR A:0xe65c098
y.create.l HWIO_PMIC_ARB_OBS5_CHNL386_RDATA0_ADDR A:0xe65c118
y.create.l HWIO_PMIC_ARB_OBS5_CHNL387_RDATA0_ADDR A:0xe65c198
y.create.l HWIO_PMIC_ARB_OBS5_CHNL388_RDATA0_ADDR A:0xe65c218
y.create.l HWIO_PMIC_ARB_OBS5_CHNL389_RDATA0_ADDR A:0xe65c298
y.create.l HWIO_PMIC_ARB_OBS5_CHNL390_RDATA0_ADDR A:0xe65c318
y.create.l HWIO_PMIC_ARB_OBS5_CHNL391_RDATA0_ADDR A:0xe65c398
y.create.l HWIO_PMIC_ARB_OBS5_CHNL392_RDATA0_ADDR A:0xe65c418
y.create.l HWIO_PMIC_ARB_OBS5_CHNL393_RDATA0_ADDR A:0xe65c498
y.create.l HWIO_PMIC_ARB_OBS5_CHNL394_RDATA0_ADDR A:0xe65c518
y.create.l HWIO_PMIC_ARB_OBS5_CHNL395_RDATA0_ADDR A:0xe65c598
y.create.l HWIO_PMIC_ARB_OBS5_CHNL396_RDATA0_ADDR A:0xe65c618
y.create.l HWIO_PMIC_ARB_OBS5_CHNL397_RDATA0_ADDR A:0xe65c698
y.create.l HWIO_PMIC_ARB_OBS5_CHNL398_RDATA0_ADDR A:0xe65c718
y.create.l HWIO_PMIC_ARB_OBS5_CHNL399_RDATA0_ADDR A:0xe65c798
y.create.l HWIO_PMIC_ARB_OBS5_CHNL400_RDATA0_ADDR A:0xe65c818
y.create.l HWIO_PMIC_ARB_OBS5_CHNL401_RDATA0_ADDR A:0xe65c898
y.create.l HWIO_PMIC_ARB_OBS5_CHNL402_RDATA0_ADDR A:0xe65c918
y.create.l HWIO_PMIC_ARB_OBS5_CHNL403_RDATA0_ADDR A:0xe65c998
y.create.l HWIO_PMIC_ARB_OBS5_CHNL404_RDATA0_ADDR A:0xe65ca18
y.create.l HWIO_PMIC_ARB_OBS5_CHNL405_RDATA0_ADDR A:0xe65ca98
y.create.l HWIO_PMIC_ARB_OBS5_CHNL406_RDATA0_ADDR A:0xe65cb18
y.create.l HWIO_PMIC_ARB_OBS5_CHNL407_RDATA0_ADDR A:0xe65cb98
y.create.l HWIO_PMIC_ARB_OBS5_CHNL408_RDATA0_ADDR A:0xe65cc18
y.create.l HWIO_PMIC_ARB_OBS5_CHNL409_RDATA0_ADDR A:0xe65cc98
y.create.l HWIO_PMIC_ARB_OBS5_CHNL410_RDATA0_ADDR A:0xe65cd18
y.create.l HWIO_PMIC_ARB_OBS5_CHNL411_RDATA0_ADDR A:0xe65cd98
y.create.l HWIO_PMIC_ARB_OBS5_CHNL412_RDATA0_ADDR A:0xe65ce18
y.create.l HWIO_PMIC_ARB_OBS5_CHNL413_RDATA0_ADDR A:0xe65ce98
y.create.l HWIO_PMIC_ARB_OBS5_CHNL414_RDATA0_ADDR A:0xe65cf18
y.create.l HWIO_PMIC_ARB_OBS5_CHNL415_RDATA0_ADDR A:0xe65cf98
y.create.l HWIO_PMIC_ARB_OBS5_CHNL416_RDATA0_ADDR A:0xe65d018
y.create.l HWIO_PMIC_ARB_OBS5_CHNL417_RDATA0_ADDR A:0xe65d098
y.create.l HWIO_PMIC_ARB_OBS5_CHNL418_RDATA0_ADDR A:0xe65d118
y.create.l HWIO_PMIC_ARB_OBS5_CHNL419_RDATA0_ADDR A:0xe65d198
y.create.l HWIO_PMIC_ARB_OBS5_CHNL420_RDATA0_ADDR A:0xe65d218
y.create.l HWIO_PMIC_ARB_OBS5_CHNL421_RDATA0_ADDR A:0xe65d298
y.create.l HWIO_PMIC_ARB_OBS5_CHNL422_RDATA0_ADDR A:0xe65d318
y.create.l HWIO_PMIC_ARB_OBS5_CHNL423_RDATA0_ADDR A:0xe65d398
y.create.l HWIO_PMIC_ARB_OBS5_CHNL424_RDATA0_ADDR A:0xe65d418
y.create.l HWIO_PMIC_ARB_OBS5_CHNL425_RDATA0_ADDR A:0xe65d498
y.create.l HWIO_PMIC_ARB_OBS5_CHNL426_RDATA0_ADDR A:0xe65d518
y.create.l HWIO_PMIC_ARB_OBS5_CHNL427_RDATA0_ADDR A:0xe65d598
y.create.l HWIO_PMIC_ARB_OBS5_CHNL428_RDATA0_ADDR A:0xe65d618
y.create.l HWIO_PMIC_ARB_OBS5_CHNL429_RDATA0_ADDR A:0xe65d698
y.create.l HWIO_PMIC_ARB_OBS5_CHNL430_RDATA0_ADDR A:0xe65d718
y.create.l HWIO_PMIC_ARB_OBS5_CHNL431_RDATA0_ADDR A:0xe65d798
y.create.l HWIO_PMIC_ARB_OBS5_CHNL432_RDATA0_ADDR A:0xe65d818
y.create.l HWIO_PMIC_ARB_OBS5_CHNL433_RDATA0_ADDR A:0xe65d898
y.create.l HWIO_PMIC_ARB_OBS5_CHNL434_RDATA0_ADDR A:0xe65d918
y.create.l HWIO_PMIC_ARB_OBS5_CHNL435_RDATA0_ADDR A:0xe65d998
y.create.l HWIO_PMIC_ARB_OBS5_CHNL436_RDATA0_ADDR A:0xe65da18
y.create.l HWIO_PMIC_ARB_OBS5_CHNL437_RDATA0_ADDR A:0xe65da98
y.create.l HWIO_PMIC_ARB_OBS5_CHNL438_RDATA0_ADDR A:0xe65db18
y.create.l HWIO_PMIC_ARB_OBS5_CHNL439_RDATA0_ADDR A:0xe65db98
y.create.l HWIO_PMIC_ARB_OBS5_CHNL440_RDATA0_ADDR A:0xe65dc18
y.create.l HWIO_PMIC_ARB_OBS5_CHNL441_RDATA0_ADDR A:0xe65dc98
y.create.l HWIO_PMIC_ARB_OBS5_CHNL442_RDATA0_ADDR A:0xe65dd18
y.create.l HWIO_PMIC_ARB_OBS5_CHNL443_RDATA0_ADDR A:0xe65dd98
y.create.l HWIO_PMIC_ARB_OBS5_CHNL444_RDATA0_ADDR A:0xe65de18
y.create.l HWIO_PMIC_ARB_OBS5_CHNL445_RDATA0_ADDR A:0xe65de98
y.create.l HWIO_PMIC_ARB_OBS5_CHNL446_RDATA0_ADDR A:0xe65df18
y.create.l HWIO_PMIC_ARB_OBS5_CHNL447_RDATA0_ADDR A:0xe65df98
y.create.l HWIO_PMIC_ARB_OBS5_CHNL448_RDATA0_ADDR A:0xe65e018
y.create.l HWIO_PMIC_ARB_OBS5_CHNL449_RDATA0_ADDR A:0xe65e098
y.create.l HWIO_PMIC_ARB_OBS5_CHNL450_RDATA0_ADDR A:0xe65e118
y.create.l HWIO_PMIC_ARB_OBS5_CHNL451_RDATA0_ADDR A:0xe65e198
y.create.l HWIO_PMIC_ARB_OBS5_CHNL452_RDATA0_ADDR A:0xe65e218
y.create.l HWIO_PMIC_ARB_OBS5_CHNL453_RDATA0_ADDR A:0xe65e298
y.create.l HWIO_PMIC_ARB_OBS5_CHNL454_RDATA0_ADDR A:0xe65e318
y.create.l HWIO_PMIC_ARB_OBS5_CHNL455_RDATA0_ADDR A:0xe65e398
y.create.l HWIO_PMIC_ARB_OBS5_CHNL456_RDATA0_ADDR A:0xe65e418
y.create.l HWIO_PMIC_ARB_OBS5_CHNL457_RDATA0_ADDR A:0xe65e498
y.create.l HWIO_PMIC_ARB_OBS5_CHNL458_RDATA0_ADDR A:0xe65e518
y.create.l HWIO_PMIC_ARB_OBS5_CHNL459_RDATA0_ADDR A:0xe65e598
y.create.l HWIO_PMIC_ARB_OBS5_CHNL460_RDATA0_ADDR A:0xe65e618
y.create.l HWIO_PMIC_ARB_OBS5_CHNL461_RDATA0_ADDR A:0xe65e698
y.create.l HWIO_PMIC_ARB_OBS5_CHNL462_RDATA0_ADDR A:0xe65e718
y.create.l HWIO_PMIC_ARB_OBS5_CHNL463_RDATA0_ADDR A:0xe65e798
y.create.l HWIO_PMIC_ARB_OBS5_CHNL464_RDATA0_ADDR A:0xe65e818
y.create.l HWIO_PMIC_ARB_OBS5_CHNL465_RDATA0_ADDR A:0xe65e898
y.create.l HWIO_PMIC_ARB_OBS5_CHNL466_RDATA0_ADDR A:0xe65e918
y.create.l HWIO_PMIC_ARB_OBS5_CHNL467_RDATA0_ADDR A:0xe65e998
y.create.l HWIO_PMIC_ARB_OBS5_CHNL468_RDATA0_ADDR A:0xe65ea18
y.create.l HWIO_PMIC_ARB_OBS5_CHNL469_RDATA0_ADDR A:0xe65ea98
y.create.l HWIO_PMIC_ARB_OBS5_CHNL470_RDATA0_ADDR A:0xe65eb18
y.create.l HWIO_PMIC_ARB_OBS5_CHNL471_RDATA0_ADDR A:0xe65eb98
y.create.l HWIO_PMIC_ARB_OBS5_CHNL472_RDATA0_ADDR A:0xe65ec18
y.create.l HWIO_PMIC_ARB_OBS5_CHNL473_RDATA0_ADDR A:0xe65ec98
y.create.l HWIO_PMIC_ARB_OBS5_CHNL474_RDATA0_ADDR A:0xe65ed18
y.create.l HWIO_PMIC_ARB_OBS5_CHNL475_RDATA0_ADDR A:0xe65ed98
y.create.l HWIO_PMIC_ARB_OBS5_CHNL476_RDATA0_ADDR A:0xe65ee18
y.create.l HWIO_PMIC_ARB_OBS5_CHNL477_RDATA0_ADDR A:0xe65ee98
y.create.l HWIO_PMIC_ARB_OBS5_CHNL478_RDATA0_ADDR A:0xe65ef18
y.create.l HWIO_PMIC_ARB_OBS5_CHNL479_RDATA0_ADDR A:0xe65ef98
y.create.l HWIO_PMIC_ARB_OBS5_CHNL480_RDATA0_ADDR A:0xe65f018
y.create.l HWIO_PMIC_ARB_OBS5_CHNL481_RDATA0_ADDR A:0xe65f098
y.create.l HWIO_PMIC_ARB_OBS5_CHNL482_RDATA0_ADDR A:0xe65f118
y.create.l HWIO_PMIC_ARB_OBS5_CHNL483_RDATA0_ADDR A:0xe65f198
y.create.l HWIO_PMIC_ARB_OBS5_CHNL484_RDATA0_ADDR A:0xe65f218
y.create.l HWIO_PMIC_ARB_OBS5_CHNL485_RDATA0_ADDR A:0xe65f298
y.create.l HWIO_PMIC_ARB_OBS5_CHNL486_RDATA0_ADDR A:0xe65f318
y.create.l HWIO_PMIC_ARB_OBS5_CHNL487_RDATA0_ADDR A:0xe65f398
y.create.l HWIO_PMIC_ARB_OBS5_CHNL488_RDATA0_ADDR A:0xe65f418
y.create.l HWIO_PMIC_ARB_OBS5_CHNL489_RDATA0_ADDR A:0xe65f498
y.create.l HWIO_PMIC_ARB_OBS5_CHNL490_RDATA0_ADDR A:0xe65f518
y.create.l HWIO_PMIC_ARB_OBS5_CHNL491_RDATA0_ADDR A:0xe65f598
y.create.l HWIO_PMIC_ARB_OBS5_CHNL492_RDATA0_ADDR A:0xe65f618
y.create.l HWIO_PMIC_ARB_OBS5_CHNL493_RDATA0_ADDR A:0xe65f698
y.create.l HWIO_PMIC_ARB_OBS5_CHNL494_RDATA0_ADDR A:0xe65f718
y.create.l HWIO_PMIC_ARB_OBS5_CHNL495_RDATA0_ADDR A:0xe65f798
y.create.l HWIO_PMIC_ARB_OBS5_CHNL496_RDATA0_ADDR A:0xe65f818
y.create.l HWIO_PMIC_ARB_OBS5_CHNL497_RDATA0_ADDR A:0xe65f898
y.create.l HWIO_PMIC_ARB_OBS5_CHNL498_RDATA0_ADDR A:0xe65f918
y.create.l HWIO_PMIC_ARB_OBS5_CHNL499_RDATA0_ADDR A:0xe65f998
y.create.l HWIO_PMIC_ARB_OBS5_CHNL500_RDATA0_ADDR A:0xe65fa18
y.create.l HWIO_PMIC_ARB_OBS5_CHNL501_RDATA0_ADDR A:0xe65fa98
y.create.l HWIO_PMIC_ARB_OBS5_CHNL502_RDATA0_ADDR A:0xe65fb18
y.create.l HWIO_PMIC_ARB_OBS5_CHNL503_RDATA0_ADDR A:0xe65fb98
y.create.l HWIO_PMIC_ARB_OBS5_CHNL504_RDATA0_ADDR A:0xe65fc18
y.create.l HWIO_PMIC_ARB_OBS5_CHNL505_RDATA0_ADDR A:0xe65fc98
y.create.l HWIO_PMIC_ARB_OBS5_CHNL506_RDATA0_ADDR A:0xe65fd18
y.create.l HWIO_PMIC_ARB_OBS5_CHNL507_RDATA0_ADDR A:0xe65fd98
y.create.l HWIO_PMIC_ARB_OBS5_CHNL508_RDATA0_ADDR A:0xe65fe18
y.create.l HWIO_PMIC_ARB_OBS5_CHNL509_RDATA0_ADDR A:0xe65fe98
y.create.l HWIO_PMIC_ARB_OBS5_CHNL510_RDATA0_ADDR A:0xe65ff18
y.create.l HWIO_PMIC_ARB_OBS5_CHNL511_RDATA0_ADDR A:0xe65ff98
y.create.l HWIO_PMIC_ARB_OBS6_CHNL0_RDATA0_ADDR A:0xe660018
y.create.l HWIO_PMIC_ARB_OBS6_CHNL1_RDATA0_ADDR A:0xe660098
y.create.l HWIO_PMIC_ARB_OBS6_CHNL2_RDATA0_ADDR A:0xe660118
y.create.l HWIO_PMIC_ARB_OBS6_CHNL3_RDATA0_ADDR A:0xe660198
y.create.l HWIO_PMIC_ARB_OBS6_CHNL4_RDATA0_ADDR A:0xe660218
y.create.l HWIO_PMIC_ARB_OBS6_CHNL5_RDATA0_ADDR A:0xe660298
y.create.l HWIO_PMIC_ARB_OBS6_CHNL6_RDATA0_ADDR A:0xe660318
y.create.l HWIO_PMIC_ARB_OBS6_CHNL7_RDATA0_ADDR A:0xe660398
y.create.l HWIO_PMIC_ARB_OBS6_CHNL8_RDATA0_ADDR A:0xe660418
y.create.l HWIO_PMIC_ARB_OBS6_CHNL9_RDATA0_ADDR A:0xe660498
y.create.l HWIO_PMIC_ARB_OBS6_CHNL10_RDATA0_ADDR A:0xe660518
y.create.l HWIO_PMIC_ARB_OBS6_CHNL11_RDATA0_ADDR A:0xe660598
y.create.l HWIO_PMIC_ARB_OBS6_CHNL12_RDATA0_ADDR A:0xe660618
y.create.l HWIO_PMIC_ARB_OBS6_CHNL13_RDATA0_ADDR A:0xe660698
y.create.l HWIO_PMIC_ARB_OBS6_CHNL14_RDATA0_ADDR A:0xe660718
y.create.l HWIO_PMIC_ARB_OBS6_CHNL15_RDATA0_ADDR A:0xe660798
y.create.l HWIO_PMIC_ARB_OBS6_CHNL16_RDATA0_ADDR A:0xe660818
y.create.l HWIO_PMIC_ARB_OBS6_CHNL17_RDATA0_ADDR A:0xe660898
y.create.l HWIO_PMIC_ARB_OBS6_CHNL18_RDATA0_ADDR A:0xe660918
y.create.l HWIO_PMIC_ARB_OBS6_CHNL19_RDATA0_ADDR A:0xe660998
y.create.l HWIO_PMIC_ARB_OBS6_CHNL20_RDATA0_ADDR A:0xe660a18
y.create.l HWIO_PMIC_ARB_OBS6_CHNL21_RDATA0_ADDR A:0xe660a98
y.create.l HWIO_PMIC_ARB_OBS6_CHNL22_RDATA0_ADDR A:0xe660b18
y.create.l HWIO_PMIC_ARB_OBS6_CHNL23_RDATA0_ADDR A:0xe660b98
y.create.l HWIO_PMIC_ARB_OBS6_CHNL24_RDATA0_ADDR A:0xe660c18
y.create.l HWIO_PMIC_ARB_OBS6_CHNL25_RDATA0_ADDR A:0xe660c98
y.create.l HWIO_PMIC_ARB_OBS6_CHNL26_RDATA0_ADDR A:0xe660d18
y.create.l HWIO_PMIC_ARB_OBS6_CHNL27_RDATA0_ADDR A:0xe660d98
y.create.l HWIO_PMIC_ARB_OBS6_CHNL28_RDATA0_ADDR A:0xe660e18
y.create.l HWIO_PMIC_ARB_OBS6_CHNL29_RDATA0_ADDR A:0xe660e98
y.create.l HWIO_PMIC_ARB_OBS6_CHNL30_RDATA0_ADDR A:0xe660f18
y.create.l HWIO_PMIC_ARB_OBS6_CHNL31_RDATA0_ADDR A:0xe660f98
y.create.l HWIO_PMIC_ARB_OBS6_CHNL32_RDATA0_ADDR A:0xe661018
y.create.l HWIO_PMIC_ARB_OBS6_CHNL33_RDATA0_ADDR A:0xe661098
y.create.l HWIO_PMIC_ARB_OBS6_CHNL34_RDATA0_ADDR A:0xe661118
y.create.l HWIO_PMIC_ARB_OBS6_CHNL35_RDATA0_ADDR A:0xe661198
y.create.l HWIO_PMIC_ARB_OBS6_CHNL36_RDATA0_ADDR A:0xe661218
y.create.l HWIO_PMIC_ARB_OBS6_CHNL37_RDATA0_ADDR A:0xe661298
y.create.l HWIO_PMIC_ARB_OBS6_CHNL38_RDATA0_ADDR A:0xe661318
y.create.l HWIO_PMIC_ARB_OBS6_CHNL39_RDATA0_ADDR A:0xe661398
y.create.l HWIO_PMIC_ARB_OBS6_CHNL40_RDATA0_ADDR A:0xe661418
y.create.l HWIO_PMIC_ARB_OBS6_CHNL41_RDATA0_ADDR A:0xe661498
y.create.l HWIO_PMIC_ARB_OBS6_CHNL42_RDATA0_ADDR A:0xe661518
y.create.l HWIO_PMIC_ARB_OBS6_CHNL43_RDATA0_ADDR A:0xe661598
y.create.l HWIO_PMIC_ARB_OBS6_CHNL44_RDATA0_ADDR A:0xe661618
y.create.l HWIO_PMIC_ARB_OBS6_CHNL45_RDATA0_ADDR A:0xe661698
y.create.l HWIO_PMIC_ARB_OBS6_CHNL46_RDATA0_ADDR A:0xe661718
y.create.l HWIO_PMIC_ARB_OBS6_CHNL47_RDATA0_ADDR A:0xe661798
y.create.l HWIO_PMIC_ARB_OBS6_CHNL48_RDATA0_ADDR A:0xe661818
y.create.l HWIO_PMIC_ARB_OBS6_CHNL49_RDATA0_ADDR A:0xe661898
y.create.l HWIO_PMIC_ARB_OBS6_CHNL50_RDATA0_ADDR A:0xe661918
y.create.l HWIO_PMIC_ARB_OBS6_CHNL51_RDATA0_ADDR A:0xe661998
y.create.l HWIO_PMIC_ARB_OBS6_CHNL52_RDATA0_ADDR A:0xe661a18
y.create.l HWIO_PMIC_ARB_OBS6_CHNL53_RDATA0_ADDR A:0xe661a98
y.create.l HWIO_PMIC_ARB_OBS6_CHNL54_RDATA0_ADDR A:0xe661b18
y.create.l HWIO_PMIC_ARB_OBS6_CHNL55_RDATA0_ADDR A:0xe661b98
y.create.l HWIO_PMIC_ARB_OBS6_CHNL56_RDATA0_ADDR A:0xe661c18
y.create.l HWIO_PMIC_ARB_OBS6_CHNL57_RDATA0_ADDR A:0xe661c98
y.create.l HWIO_PMIC_ARB_OBS6_CHNL58_RDATA0_ADDR A:0xe661d18
y.create.l HWIO_PMIC_ARB_OBS6_CHNL59_RDATA0_ADDR A:0xe661d98
y.create.l HWIO_PMIC_ARB_OBS6_CHNL60_RDATA0_ADDR A:0xe661e18
y.create.l HWIO_PMIC_ARB_OBS6_CHNL61_RDATA0_ADDR A:0xe661e98
y.create.l HWIO_PMIC_ARB_OBS6_CHNL62_RDATA0_ADDR A:0xe661f18
y.create.l HWIO_PMIC_ARB_OBS6_CHNL63_RDATA0_ADDR A:0xe661f98
y.create.l HWIO_PMIC_ARB_OBS6_CHNL64_RDATA0_ADDR A:0xe662018
y.create.l HWIO_PMIC_ARB_OBS6_CHNL65_RDATA0_ADDR A:0xe662098
y.create.l HWIO_PMIC_ARB_OBS6_CHNL66_RDATA0_ADDR A:0xe662118
y.create.l HWIO_PMIC_ARB_OBS6_CHNL67_RDATA0_ADDR A:0xe662198
y.create.l HWIO_PMIC_ARB_OBS6_CHNL68_RDATA0_ADDR A:0xe662218
y.create.l HWIO_PMIC_ARB_OBS6_CHNL69_RDATA0_ADDR A:0xe662298
y.create.l HWIO_PMIC_ARB_OBS6_CHNL70_RDATA0_ADDR A:0xe662318
y.create.l HWIO_PMIC_ARB_OBS6_CHNL71_RDATA0_ADDR A:0xe662398
y.create.l HWIO_PMIC_ARB_OBS6_CHNL72_RDATA0_ADDR A:0xe662418
y.create.l HWIO_PMIC_ARB_OBS6_CHNL73_RDATA0_ADDR A:0xe662498
y.create.l HWIO_PMIC_ARB_OBS6_CHNL74_RDATA0_ADDR A:0xe662518
y.create.l HWIO_PMIC_ARB_OBS6_CHNL75_RDATA0_ADDR A:0xe662598
y.create.l HWIO_PMIC_ARB_OBS6_CHNL76_RDATA0_ADDR A:0xe662618
y.create.l HWIO_PMIC_ARB_OBS6_CHNL77_RDATA0_ADDR A:0xe662698
y.create.l HWIO_PMIC_ARB_OBS6_CHNL78_RDATA0_ADDR A:0xe662718
y.create.l HWIO_PMIC_ARB_OBS6_CHNL79_RDATA0_ADDR A:0xe662798
y.create.l HWIO_PMIC_ARB_OBS6_CHNL80_RDATA0_ADDR A:0xe662818
y.create.l HWIO_PMIC_ARB_OBS6_CHNL81_RDATA0_ADDR A:0xe662898
y.create.l HWIO_PMIC_ARB_OBS6_CHNL82_RDATA0_ADDR A:0xe662918
y.create.l HWIO_PMIC_ARB_OBS6_CHNL83_RDATA0_ADDR A:0xe662998
y.create.l HWIO_PMIC_ARB_OBS6_CHNL84_RDATA0_ADDR A:0xe662a18
y.create.l HWIO_PMIC_ARB_OBS6_CHNL85_RDATA0_ADDR A:0xe662a98
y.create.l HWIO_PMIC_ARB_OBS6_CHNL86_RDATA0_ADDR A:0xe662b18
y.create.l HWIO_PMIC_ARB_OBS6_CHNL87_RDATA0_ADDR A:0xe662b98
y.create.l HWIO_PMIC_ARB_OBS6_CHNL88_RDATA0_ADDR A:0xe662c18
y.create.l HWIO_PMIC_ARB_OBS6_CHNL89_RDATA0_ADDR A:0xe662c98
y.create.l HWIO_PMIC_ARB_OBS6_CHNL90_RDATA0_ADDR A:0xe662d18
y.create.l HWIO_PMIC_ARB_OBS6_CHNL91_RDATA0_ADDR A:0xe662d98
y.create.l HWIO_PMIC_ARB_OBS6_CHNL92_RDATA0_ADDR A:0xe662e18
y.create.l HWIO_PMIC_ARB_OBS6_CHNL93_RDATA0_ADDR A:0xe662e98
y.create.l HWIO_PMIC_ARB_OBS6_CHNL94_RDATA0_ADDR A:0xe662f18
y.create.l HWIO_PMIC_ARB_OBS6_CHNL95_RDATA0_ADDR A:0xe662f98
y.create.l HWIO_PMIC_ARB_OBS6_CHNL96_RDATA0_ADDR A:0xe663018
y.create.l HWIO_PMIC_ARB_OBS6_CHNL97_RDATA0_ADDR A:0xe663098
y.create.l HWIO_PMIC_ARB_OBS6_CHNL98_RDATA0_ADDR A:0xe663118
y.create.l HWIO_PMIC_ARB_OBS6_CHNL99_RDATA0_ADDR A:0xe663198
y.create.l HWIO_PMIC_ARB_OBS6_CHNL100_RDATA0_ADDR A:0xe663218
y.create.l HWIO_PMIC_ARB_OBS6_CHNL101_RDATA0_ADDR A:0xe663298
y.create.l HWIO_PMIC_ARB_OBS6_CHNL102_RDATA0_ADDR A:0xe663318
y.create.l HWIO_PMIC_ARB_OBS6_CHNL103_RDATA0_ADDR A:0xe663398
y.create.l HWIO_PMIC_ARB_OBS6_CHNL104_RDATA0_ADDR A:0xe663418
y.create.l HWIO_PMIC_ARB_OBS6_CHNL105_RDATA0_ADDR A:0xe663498
y.create.l HWIO_PMIC_ARB_OBS6_CHNL106_RDATA0_ADDR A:0xe663518
y.create.l HWIO_PMIC_ARB_OBS6_CHNL107_RDATA0_ADDR A:0xe663598
y.create.l HWIO_PMIC_ARB_OBS6_CHNL108_RDATA0_ADDR A:0xe663618
y.create.l HWIO_PMIC_ARB_OBS6_CHNL109_RDATA0_ADDR A:0xe663698
y.create.l HWIO_PMIC_ARB_OBS6_CHNL110_RDATA0_ADDR A:0xe663718
y.create.l HWIO_PMIC_ARB_OBS6_CHNL111_RDATA0_ADDR A:0xe663798
y.create.l HWIO_PMIC_ARB_OBS6_CHNL112_RDATA0_ADDR A:0xe663818
y.create.l HWIO_PMIC_ARB_OBS6_CHNL113_RDATA0_ADDR A:0xe663898
y.create.l HWIO_PMIC_ARB_OBS6_CHNL114_RDATA0_ADDR A:0xe663918
y.create.l HWIO_PMIC_ARB_OBS6_CHNL115_RDATA0_ADDR A:0xe663998
y.create.l HWIO_PMIC_ARB_OBS6_CHNL116_RDATA0_ADDR A:0xe663a18
y.create.l HWIO_PMIC_ARB_OBS6_CHNL117_RDATA0_ADDR A:0xe663a98
y.create.l HWIO_PMIC_ARB_OBS6_CHNL118_RDATA0_ADDR A:0xe663b18
y.create.l HWIO_PMIC_ARB_OBS6_CHNL119_RDATA0_ADDR A:0xe663b98
y.create.l HWIO_PMIC_ARB_OBS6_CHNL120_RDATA0_ADDR A:0xe663c18
y.create.l HWIO_PMIC_ARB_OBS6_CHNL121_RDATA0_ADDR A:0xe663c98
y.create.l HWIO_PMIC_ARB_OBS6_CHNL122_RDATA0_ADDR A:0xe663d18
y.create.l HWIO_PMIC_ARB_OBS6_CHNL123_RDATA0_ADDR A:0xe663d98
y.create.l HWIO_PMIC_ARB_OBS6_CHNL124_RDATA0_ADDR A:0xe663e18
y.create.l HWIO_PMIC_ARB_OBS6_CHNL125_RDATA0_ADDR A:0xe663e98
y.create.l HWIO_PMIC_ARB_OBS6_CHNL126_RDATA0_ADDR A:0xe663f18
y.create.l HWIO_PMIC_ARB_OBS6_CHNL127_RDATA0_ADDR A:0xe663f98
y.create.l HWIO_PMIC_ARB_OBS6_CHNL128_RDATA0_ADDR A:0xe664018
y.create.l HWIO_PMIC_ARB_OBS6_CHNL129_RDATA0_ADDR A:0xe664098
y.create.l HWIO_PMIC_ARB_OBS6_CHNL130_RDATA0_ADDR A:0xe664118
y.create.l HWIO_PMIC_ARB_OBS6_CHNL131_RDATA0_ADDR A:0xe664198
y.create.l HWIO_PMIC_ARB_OBS6_CHNL132_RDATA0_ADDR A:0xe664218
y.create.l HWIO_PMIC_ARB_OBS6_CHNL133_RDATA0_ADDR A:0xe664298
y.create.l HWIO_PMIC_ARB_OBS6_CHNL134_RDATA0_ADDR A:0xe664318
y.create.l HWIO_PMIC_ARB_OBS6_CHNL135_RDATA0_ADDR A:0xe664398
y.create.l HWIO_PMIC_ARB_OBS6_CHNL136_RDATA0_ADDR A:0xe664418
y.create.l HWIO_PMIC_ARB_OBS6_CHNL137_RDATA0_ADDR A:0xe664498
y.create.l HWIO_PMIC_ARB_OBS6_CHNL138_RDATA0_ADDR A:0xe664518
y.create.l HWIO_PMIC_ARB_OBS6_CHNL139_RDATA0_ADDR A:0xe664598
y.create.l HWIO_PMIC_ARB_OBS6_CHNL140_RDATA0_ADDR A:0xe664618
y.create.l HWIO_PMIC_ARB_OBS6_CHNL141_RDATA0_ADDR A:0xe664698
y.create.l HWIO_PMIC_ARB_OBS6_CHNL142_RDATA0_ADDR A:0xe664718
y.create.l HWIO_PMIC_ARB_OBS6_CHNL143_RDATA0_ADDR A:0xe664798
y.create.l HWIO_PMIC_ARB_OBS6_CHNL144_RDATA0_ADDR A:0xe664818
y.create.l HWIO_PMIC_ARB_OBS6_CHNL145_RDATA0_ADDR A:0xe664898
y.create.l HWIO_PMIC_ARB_OBS6_CHNL146_RDATA0_ADDR A:0xe664918
y.create.l HWIO_PMIC_ARB_OBS6_CHNL147_RDATA0_ADDR A:0xe664998
y.create.l HWIO_PMIC_ARB_OBS6_CHNL148_RDATA0_ADDR A:0xe664a18
y.create.l HWIO_PMIC_ARB_OBS6_CHNL149_RDATA0_ADDR A:0xe664a98
y.create.l HWIO_PMIC_ARB_OBS6_CHNL150_RDATA0_ADDR A:0xe664b18
y.create.l HWIO_PMIC_ARB_OBS6_CHNL151_RDATA0_ADDR A:0xe664b98
y.create.l HWIO_PMIC_ARB_OBS6_CHNL152_RDATA0_ADDR A:0xe664c18
y.create.l HWIO_PMIC_ARB_OBS6_CHNL153_RDATA0_ADDR A:0xe664c98
y.create.l HWIO_PMIC_ARB_OBS6_CHNL154_RDATA0_ADDR A:0xe664d18
y.create.l HWIO_PMIC_ARB_OBS6_CHNL155_RDATA0_ADDR A:0xe664d98
y.create.l HWIO_PMIC_ARB_OBS6_CHNL156_RDATA0_ADDR A:0xe664e18
y.create.l HWIO_PMIC_ARB_OBS6_CHNL157_RDATA0_ADDR A:0xe664e98
y.create.l HWIO_PMIC_ARB_OBS6_CHNL158_RDATA0_ADDR A:0xe664f18
y.create.l HWIO_PMIC_ARB_OBS6_CHNL159_RDATA0_ADDR A:0xe664f98
y.create.l HWIO_PMIC_ARB_OBS6_CHNL160_RDATA0_ADDR A:0xe665018
y.create.l HWIO_PMIC_ARB_OBS6_CHNL161_RDATA0_ADDR A:0xe665098
y.create.l HWIO_PMIC_ARB_OBS6_CHNL162_RDATA0_ADDR A:0xe665118
y.create.l HWIO_PMIC_ARB_OBS6_CHNL163_RDATA0_ADDR A:0xe665198
y.create.l HWIO_PMIC_ARB_OBS6_CHNL164_RDATA0_ADDR A:0xe665218
y.create.l HWIO_PMIC_ARB_OBS6_CHNL165_RDATA0_ADDR A:0xe665298
y.create.l HWIO_PMIC_ARB_OBS6_CHNL166_RDATA0_ADDR A:0xe665318
y.create.l HWIO_PMIC_ARB_OBS6_CHNL167_RDATA0_ADDR A:0xe665398
y.create.l HWIO_PMIC_ARB_OBS6_CHNL168_RDATA0_ADDR A:0xe665418
y.create.l HWIO_PMIC_ARB_OBS6_CHNL169_RDATA0_ADDR A:0xe665498
y.create.l HWIO_PMIC_ARB_OBS6_CHNL170_RDATA0_ADDR A:0xe665518
y.create.l HWIO_PMIC_ARB_OBS6_CHNL171_RDATA0_ADDR A:0xe665598
y.create.l HWIO_PMIC_ARB_OBS6_CHNL172_RDATA0_ADDR A:0xe665618
y.create.l HWIO_PMIC_ARB_OBS6_CHNL173_RDATA0_ADDR A:0xe665698
y.create.l HWIO_PMIC_ARB_OBS6_CHNL174_RDATA0_ADDR A:0xe665718
y.create.l HWIO_PMIC_ARB_OBS6_CHNL175_RDATA0_ADDR A:0xe665798
y.create.l HWIO_PMIC_ARB_OBS6_CHNL176_RDATA0_ADDR A:0xe665818
y.create.l HWIO_PMIC_ARB_OBS6_CHNL177_RDATA0_ADDR A:0xe665898
y.create.l HWIO_PMIC_ARB_OBS6_CHNL178_RDATA0_ADDR A:0xe665918
y.create.l HWIO_PMIC_ARB_OBS6_CHNL179_RDATA0_ADDR A:0xe665998
y.create.l HWIO_PMIC_ARB_OBS6_CHNL180_RDATA0_ADDR A:0xe665a18
y.create.l HWIO_PMIC_ARB_OBS6_CHNL181_RDATA0_ADDR A:0xe665a98
y.create.l HWIO_PMIC_ARB_OBS6_CHNL182_RDATA0_ADDR A:0xe665b18
y.create.l HWIO_PMIC_ARB_OBS6_CHNL183_RDATA0_ADDR A:0xe665b98
y.create.l HWIO_PMIC_ARB_OBS6_CHNL184_RDATA0_ADDR A:0xe665c18
y.create.l HWIO_PMIC_ARB_OBS6_CHNL185_RDATA0_ADDR A:0xe665c98
y.create.l HWIO_PMIC_ARB_OBS6_CHNL186_RDATA0_ADDR A:0xe665d18
y.create.l HWIO_PMIC_ARB_OBS6_CHNL187_RDATA0_ADDR A:0xe665d98
y.create.l HWIO_PMIC_ARB_OBS6_CHNL188_RDATA0_ADDR A:0xe665e18
y.create.l HWIO_PMIC_ARB_OBS6_CHNL189_RDATA0_ADDR A:0xe665e98
y.create.l HWIO_PMIC_ARB_OBS6_CHNL190_RDATA0_ADDR A:0xe665f18
y.create.l HWIO_PMIC_ARB_OBS6_CHNL191_RDATA0_ADDR A:0xe665f98
y.create.l HWIO_PMIC_ARB_OBS6_CHNL192_RDATA0_ADDR A:0xe666018
y.create.l HWIO_PMIC_ARB_OBS6_CHNL193_RDATA0_ADDR A:0xe666098
y.create.l HWIO_PMIC_ARB_OBS6_CHNL194_RDATA0_ADDR A:0xe666118
y.create.l HWIO_PMIC_ARB_OBS6_CHNL195_RDATA0_ADDR A:0xe666198
y.create.l HWIO_PMIC_ARB_OBS6_CHNL196_RDATA0_ADDR A:0xe666218
y.create.l HWIO_PMIC_ARB_OBS6_CHNL197_RDATA0_ADDR A:0xe666298
y.create.l HWIO_PMIC_ARB_OBS6_CHNL198_RDATA0_ADDR A:0xe666318
y.create.l HWIO_PMIC_ARB_OBS6_CHNL199_RDATA0_ADDR A:0xe666398
y.create.l HWIO_PMIC_ARB_OBS6_CHNL200_RDATA0_ADDR A:0xe666418
y.create.l HWIO_PMIC_ARB_OBS6_CHNL201_RDATA0_ADDR A:0xe666498
y.create.l HWIO_PMIC_ARB_OBS6_CHNL202_RDATA0_ADDR A:0xe666518
y.create.l HWIO_PMIC_ARB_OBS6_CHNL203_RDATA0_ADDR A:0xe666598
y.create.l HWIO_PMIC_ARB_OBS6_CHNL204_RDATA0_ADDR A:0xe666618
y.create.l HWIO_PMIC_ARB_OBS6_CHNL205_RDATA0_ADDR A:0xe666698
y.create.l HWIO_PMIC_ARB_OBS6_CHNL206_RDATA0_ADDR A:0xe666718
y.create.l HWIO_PMIC_ARB_OBS6_CHNL207_RDATA0_ADDR A:0xe666798
y.create.l HWIO_PMIC_ARB_OBS6_CHNL208_RDATA0_ADDR A:0xe666818
y.create.l HWIO_PMIC_ARB_OBS6_CHNL209_RDATA0_ADDR A:0xe666898
y.create.l HWIO_PMIC_ARB_OBS6_CHNL210_RDATA0_ADDR A:0xe666918
y.create.l HWIO_PMIC_ARB_OBS6_CHNL211_RDATA0_ADDR A:0xe666998
y.create.l HWIO_PMIC_ARB_OBS6_CHNL212_RDATA0_ADDR A:0xe666a18
y.create.l HWIO_PMIC_ARB_OBS6_CHNL213_RDATA0_ADDR A:0xe666a98
y.create.l HWIO_PMIC_ARB_OBS6_CHNL214_RDATA0_ADDR A:0xe666b18
y.create.l HWIO_PMIC_ARB_OBS6_CHNL215_RDATA0_ADDR A:0xe666b98
y.create.l HWIO_PMIC_ARB_OBS6_CHNL216_RDATA0_ADDR A:0xe666c18
y.create.l HWIO_PMIC_ARB_OBS6_CHNL217_RDATA0_ADDR A:0xe666c98
y.create.l HWIO_PMIC_ARB_OBS6_CHNL218_RDATA0_ADDR A:0xe666d18
y.create.l HWIO_PMIC_ARB_OBS6_CHNL219_RDATA0_ADDR A:0xe666d98
y.create.l HWIO_PMIC_ARB_OBS6_CHNL220_RDATA0_ADDR A:0xe666e18
y.create.l HWIO_PMIC_ARB_OBS6_CHNL221_RDATA0_ADDR A:0xe666e98
y.create.l HWIO_PMIC_ARB_OBS6_CHNL222_RDATA0_ADDR A:0xe666f18
y.create.l HWIO_PMIC_ARB_OBS6_CHNL223_RDATA0_ADDR A:0xe666f98
y.create.l HWIO_PMIC_ARB_OBS6_CHNL224_RDATA0_ADDR A:0xe667018
y.create.l HWIO_PMIC_ARB_OBS6_CHNL225_RDATA0_ADDR A:0xe667098
y.create.l HWIO_PMIC_ARB_OBS6_CHNL226_RDATA0_ADDR A:0xe667118
y.create.l HWIO_PMIC_ARB_OBS6_CHNL227_RDATA0_ADDR A:0xe667198
y.create.l HWIO_PMIC_ARB_OBS6_CHNL228_RDATA0_ADDR A:0xe667218
y.create.l HWIO_PMIC_ARB_OBS6_CHNL229_RDATA0_ADDR A:0xe667298
y.create.l HWIO_PMIC_ARB_OBS6_CHNL230_RDATA0_ADDR A:0xe667318
y.create.l HWIO_PMIC_ARB_OBS6_CHNL231_RDATA0_ADDR A:0xe667398
y.create.l HWIO_PMIC_ARB_OBS6_CHNL232_RDATA0_ADDR A:0xe667418
y.create.l HWIO_PMIC_ARB_OBS6_CHNL233_RDATA0_ADDR A:0xe667498
y.create.l HWIO_PMIC_ARB_OBS6_CHNL234_RDATA0_ADDR A:0xe667518
y.create.l HWIO_PMIC_ARB_OBS6_CHNL235_RDATA0_ADDR A:0xe667598
y.create.l HWIO_PMIC_ARB_OBS6_CHNL236_RDATA0_ADDR A:0xe667618
y.create.l HWIO_PMIC_ARB_OBS6_CHNL237_RDATA0_ADDR A:0xe667698
y.create.l HWIO_PMIC_ARB_OBS6_CHNL238_RDATA0_ADDR A:0xe667718
y.create.l HWIO_PMIC_ARB_OBS6_CHNL239_RDATA0_ADDR A:0xe667798
y.create.l HWIO_PMIC_ARB_OBS6_CHNL240_RDATA0_ADDR A:0xe667818
y.create.l HWIO_PMIC_ARB_OBS6_CHNL241_RDATA0_ADDR A:0xe667898
y.create.l HWIO_PMIC_ARB_OBS6_CHNL242_RDATA0_ADDR A:0xe667918
y.create.l HWIO_PMIC_ARB_OBS6_CHNL243_RDATA0_ADDR A:0xe667998
y.create.l HWIO_PMIC_ARB_OBS6_CHNL244_RDATA0_ADDR A:0xe667a18
y.create.l HWIO_PMIC_ARB_OBS6_CHNL245_RDATA0_ADDR A:0xe667a98
y.create.l HWIO_PMIC_ARB_OBS6_CHNL246_RDATA0_ADDR A:0xe667b18
y.create.l HWIO_PMIC_ARB_OBS6_CHNL247_RDATA0_ADDR A:0xe667b98
y.create.l HWIO_PMIC_ARB_OBS6_CHNL248_RDATA0_ADDR A:0xe667c18
y.create.l HWIO_PMIC_ARB_OBS6_CHNL249_RDATA0_ADDR A:0xe667c98
y.create.l HWIO_PMIC_ARB_OBS6_CHNL250_RDATA0_ADDR A:0xe667d18
y.create.l HWIO_PMIC_ARB_OBS6_CHNL251_RDATA0_ADDR A:0xe667d98
y.create.l HWIO_PMIC_ARB_OBS6_CHNL252_RDATA0_ADDR A:0xe667e18
y.create.l HWIO_PMIC_ARB_OBS6_CHNL253_RDATA0_ADDR A:0xe667e98
y.create.l HWIO_PMIC_ARB_OBS6_CHNL254_RDATA0_ADDR A:0xe667f18
y.create.l HWIO_PMIC_ARB_OBS6_CHNL255_RDATA0_ADDR A:0xe667f98
y.create.l HWIO_PMIC_ARB_OBS6_CHNL256_RDATA0_ADDR A:0xe668018
y.create.l HWIO_PMIC_ARB_OBS6_CHNL257_RDATA0_ADDR A:0xe668098
y.create.l HWIO_PMIC_ARB_OBS6_CHNL258_RDATA0_ADDR A:0xe668118
y.create.l HWIO_PMIC_ARB_OBS6_CHNL259_RDATA0_ADDR A:0xe668198
y.create.l HWIO_PMIC_ARB_OBS6_CHNL260_RDATA0_ADDR A:0xe668218
y.create.l HWIO_PMIC_ARB_OBS6_CHNL261_RDATA0_ADDR A:0xe668298
y.create.l HWIO_PMIC_ARB_OBS6_CHNL262_RDATA0_ADDR A:0xe668318
y.create.l HWIO_PMIC_ARB_OBS6_CHNL263_RDATA0_ADDR A:0xe668398
y.create.l HWIO_PMIC_ARB_OBS6_CHNL264_RDATA0_ADDR A:0xe668418
y.create.l HWIO_PMIC_ARB_OBS6_CHNL265_RDATA0_ADDR A:0xe668498
y.create.l HWIO_PMIC_ARB_OBS6_CHNL266_RDATA0_ADDR A:0xe668518
y.create.l HWIO_PMIC_ARB_OBS6_CHNL267_RDATA0_ADDR A:0xe668598
y.create.l HWIO_PMIC_ARB_OBS6_CHNL268_RDATA0_ADDR A:0xe668618
y.create.l HWIO_PMIC_ARB_OBS6_CHNL269_RDATA0_ADDR A:0xe668698
y.create.l HWIO_PMIC_ARB_OBS6_CHNL270_RDATA0_ADDR A:0xe668718
y.create.l HWIO_PMIC_ARB_OBS6_CHNL271_RDATA0_ADDR A:0xe668798
y.create.l HWIO_PMIC_ARB_OBS6_CHNL272_RDATA0_ADDR A:0xe668818
y.create.l HWIO_PMIC_ARB_OBS6_CHNL273_RDATA0_ADDR A:0xe668898
y.create.l HWIO_PMIC_ARB_OBS6_CHNL274_RDATA0_ADDR A:0xe668918
y.create.l HWIO_PMIC_ARB_OBS6_CHNL275_RDATA0_ADDR A:0xe668998
y.create.l HWIO_PMIC_ARB_OBS6_CHNL276_RDATA0_ADDR A:0xe668a18
y.create.l HWIO_PMIC_ARB_OBS6_CHNL277_RDATA0_ADDR A:0xe668a98
y.create.l HWIO_PMIC_ARB_OBS6_CHNL278_RDATA0_ADDR A:0xe668b18
y.create.l HWIO_PMIC_ARB_OBS6_CHNL279_RDATA0_ADDR A:0xe668b98
y.create.l HWIO_PMIC_ARB_OBS6_CHNL280_RDATA0_ADDR A:0xe668c18
y.create.l HWIO_PMIC_ARB_OBS6_CHNL281_RDATA0_ADDR A:0xe668c98
y.create.l HWIO_PMIC_ARB_OBS6_CHNL282_RDATA0_ADDR A:0xe668d18
y.create.l HWIO_PMIC_ARB_OBS6_CHNL283_RDATA0_ADDR A:0xe668d98
y.create.l HWIO_PMIC_ARB_OBS6_CHNL284_RDATA0_ADDR A:0xe668e18
y.create.l HWIO_PMIC_ARB_OBS6_CHNL285_RDATA0_ADDR A:0xe668e98
y.create.l HWIO_PMIC_ARB_OBS6_CHNL286_RDATA0_ADDR A:0xe668f18
y.create.l HWIO_PMIC_ARB_OBS6_CHNL287_RDATA0_ADDR A:0xe668f98
y.create.l HWIO_PMIC_ARB_OBS6_CHNL288_RDATA0_ADDR A:0xe669018
y.create.l HWIO_PMIC_ARB_OBS6_CHNL289_RDATA0_ADDR A:0xe669098
y.create.l HWIO_PMIC_ARB_OBS6_CHNL290_RDATA0_ADDR A:0xe669118
y.create.l HWIO_PMIC_ARB_OBS6_CHNL291_RDATA0_ADDR A:0xe669198
y.create.l HWIO_PMIC_ARB_OBS6_CHNL292_RDATA0_ADDR A:0xe669218
y.create.l HWIO_PMIC_ARB_OBS6_CHNL293_RDATA0_ADDR A:0xe669298
y.create.l HWIO_PMIC_ARB_OBS6_CHNL294_RDATA0_ADDR A:0xe669318
y.create.l HWIO_PMIC_ARB_OBS6_CHNL295_RDATA0_ADDR A:0xe669398
y.create.l HWIO_PMIC_ARB_OBS6_CHNL296_RDATA0_ADDR A:0xe669418
y.create.l HWIO_PMIC_ARB_OBS6_CHNL297_RDATA0_ADDR A:0xe669498
y.create.l HWIO_PMIC_ARB_OBS6_CHNL298_RDATA0_ADDR A:0xe669518
y.create.l HWIO_PMIC_ARB_OBS6_CHNL299_RDATA0_ADDR A:0xe669598
y.create.l HWIO_PMIC_ARB_OBS6_CHNL300_RDATA0_ADDR A:0xe669618
y.create.l HWIO_PMIC_ARB_OBS6_CHNL301_RDATA0_ADDR A:0xe669698
y.create.l HWIO_PMIC_ARB_OBS6_CHNL302_RDATA0_ADDR A:0xe669718
y.create.l HWIO_PMIC_ARB_OBS6_CHNL303_RDATA0_ADDR A:0xe669798
y.create.l HWIO_PMIC_ARB_OBS6_CHNL304_RDATA0_ADDR A:0xe669818
y.create.l HWIO_PMIC_ARB_OBS6_CHNL305_RDATA0_ADDR A:0xe669898
y.create.l HWIO_PMIC_ARB_OBS6_CHNL306_RDATA0_ADDR A:0xe669918
y.create.l HWIO_PMIC_ARB_OBS6_CHNL307_RDATA0_ADDR A:0xe669998
y.create.l HWIO_PMIC_ARB_OBS6_CHNL308_RDATA0_ADDR A:0xe669a18
y.create.l HWIO_PMIC_ARB_OBS6_CHNL309_RDATA0_ADDR A:0xe669a98
y.create.l HWIO_PMIC_ARB_OBS6_CHNL310_RDATA0_ADDR A:0xe669b18
y.create.l HWIO_PMIC_ARB_OBS6_CHNL311_RDATA0_ADDR A:0xe669b98
y.create.l HWIO_PMIC_ARB_OBS6_CHNL312_RDATA0_ADDR A:0xe669c18
y.create.l HWIO_PMIC_ARB_OBS6_CHNL313_RDATA0_ADDR A:0xe669c98
y.create.l HWIO_PMIC_ARB_OBS6_CHNL314_RDATA0_ADDR A:0xe669d18
y.create.l HWIO_PMIC_ARB_OBS6_CHNL315_RDATA0_ADDR A:0xe669d98
y.create.l HWIO_PMIC_ARB_OBS6_CHNL316_RDATA0_ADDR A:0xe669e18
y.create.l HWIO_PMIC_ARB_OBS6_CHNL317_RDATA0_ADDR A:0xe669e98
y.create.l HWIO_PMIC_ARB_OBS6_CHNL318_RDATA0_ADDR A:0xe669f18
y.create.l HWIO_PMIC_ARB_OBS6_CHNL319_RDATA0_ADDR A:0xe669f98
y.create.l HWIO_PMIC_ARB_OBS6_CHNL320_RDATA0_ADDR A:0xe66a018
y.create.l HWIO_PMIC_ARB_OBS6_CHNL321_RDATA0_ADDR A:0xe66a098
y.create.l HWIO_PMIC_ARB_OBS6_CHNL322_RDATA0_ADDR A:0xe66a118
y.create.l HWIO_PMIC_ARB_OBS6_CHNL323_RDATA0_ADDR A:0xe66a198
y.create.l HWIO_PMIC_ARB_OBS6_CHNL324_RDATA0_ADDR A:0xe66a218
y.create.l HWIO_PMIC_ARB_OBS6_CHNL325_RDATA0_ADDR A:0xe66a298
y.create.l HWIO_PMIC_ARB_OBS6_CHNL326_RDATA0_ADDR A:0xe66a318
y.create.l HWIO_PMIC_ARB_OBS6_CHNL327_RDATA0_ADDR A:0xe66a398
y.create.l HWIO_PMIC_ARB_OBS6_CHNL328_RDATA0_ADDR A:0xe66a418
y.create.l HWIO_PMIC_ARB_OBS6_CHNL329_RDATA0_ADDR A:0xe66a498
y.create.l HWIO_PMIC_ARB_OBS6_CHNL330_RDATA0_ADDR A:0xe66a518
y.create.l HWIO_PMIC_ARB_OBS6_CHNL331_RDATA0_ADDR A:0xe66a598
y.create.l HWIO_PMIC_ARB_OBS6_CHNL332_RDATA0_ADDR A:0xe66a618
y.create.l HWIO_PMIC_ARB_OBS6_CHNL333_RDATA0_ADDR A:0xe66a698
y.create.l HWIO_PMIC_ARB_OBS6_CHNL334_RDATA0_ADDR A:0xe66a718
y.create.l HWIO_PMIC_ARB_OBS6_CHNL335_RDATA0_ADDR A:0xe66a798
y.create.l HWIO_PMIC_ARB_OBS6_CHNL336_RDATA0_ADDR A:0xe66a818
y.create.l HWIO_PMIC_ARB_OBS6_CHNL337_RDATA0_ADDR A:0xe66a898
y.create.l HWIO_PMIC_ARB_OBS6_CHNL338_RDATA0_ADDR A:0xe66a918
y.create.l HWIO_PMIC_ARB_OBS6_CHNL339_RDATA0_ADDR A:0xe66a998
y.create.l HWIO_PMIC_ARB_OBS6_CHNL340_RDATA0_ADDR A:0xe66aa18
y.create.l HWIO_PMIC_ARB_OBS6_CHNL341_RDATA0_ADDR A:0xe66aa98
y.create.l HWIO_PMIC_ARB_OBS6_CHNL342_RDATA0_ADDR A:0xe66ab18
y.create.l HWIO_PMIC_ARB_OBS6_CHNL343_RDATA0_ADDR A:0xe66ab98
y.create.l HWIO_PMIC_ARB_OBS6_CHNL344_RDATA0_ADDR A:0xe66ac18
y.create.l HWIO_PMIC_ARB_OBS6_CHNL345_RDATA0_ADDR A:0xe66ac98
y.create.l HWIO_PMIC_ARB_OBS6_CHNL346_RDATA0_ADDR A:0xe66ad18
y.create.l HWIO_PMIC_ARB_OBS6_CHNL347_RDATA0_ADDR A:0xe66ad98
y.create.l HWIO_PMIC_ARB_OBS6_CHNL348_RDATA0_ADDR A:0xe66ae18
y.create.l HWIO_PMIC_ARB_OBS6_CHNL349_RDATA0_ADDR A:0xe66ae98
y.create.l HWIO_PMIC_ARB_OBS6_CHNL350_RDATA0_ADDR A:0xe66af18
y.create.l HWIO_PMIC_ARB_OBS6_CHNL351_RDATA0_ADDR A:0xe66af98
y.create.l HWIO_PMIC_ARB_OBS6_CHNL352_RDATA0_ADDR A:0xe66b018
y.create.l HWIO_PMIC_ARB_OBS6_CHNL353_RDATA0_ADDR A:0xe66b098
y.create.l HWIO_PMIC_ARB_OBS6_CHNL354_RDATA0_ADDR A:0xe66b118
y.create.l HWIO_PMIC_ARB_OBS6_CHNL355_RDATA0_ADDR A:0xe66b198
y.create.l HWIO_PMIC_ARB_OBS6_CHNL356_RDATA0_ADDR A:0xe66b218
y.create.l HWIO_PMIC_ARB_OBS6_CHNL357_RDATA0_ADDR A:0xe66b298
y.create.l HWIO_PMIC_ARB_OBS6_CHNL358_RDATA0_ADDR A:0xe66b318
y.create.l HWIO_PMIC_ARB_OBS6_CHNL359_RDATA0_ADDR A:0xe66b398
y.create.l HWIO_PMIC_ARB_OBS6_CHNL360_RDATA0_ADDR A:0xe66b418
y.create.l HWIO_PMIC_ARB_OBS6_CHNL361_RDATA0_ADDR A:0xe66b498
y.create.l HWIO_PMIC_ARB_OBS6_CHNL362_RDATA0_ADDR A:0xe66b518
y.create.l HWIO_PMIC_ARB_OBS6_CHNL363_RDATA0_ADDR A:0xe66b598
y.create.l HWIO_PMIC_ARB_OBS6_CHNL364_RDATA0_ADDR A:0xe66b618
y.create.l HWIO_PMIC_ARB_OBS6_CHNL365_RDATA0_ADDR A:0xe66b698
y.create.l HWIO_PMIC_ARB_OBS6_CHNL366_RDATA0_ADDR A:0xe66b718
y.create.l HWIO_PMIC_ARB_OBS6_CHNL367_RDATA0_ADDR A:0xe66b798
y.create.l HWIO_PMIC_ARB_OBS6_CHNL368_RDATA0_ADDR A:0xe66b818
y.create.l HWIO_PMIC_ARB_OBS6_CHNL369_RDATA0_ADDR A:0xe66b898
y.create.l HWIO_PMIC_ARB_OBS6_CHNL370_RDATA0_ADDR A:0xe66b918
y.create.l HWIO_PMIC_ARB_OBS6_CHNL371_RDATA0_ADDR A:0xe66b998
y.create.l HWIO_PMIC_ARB_OBS6_CHNL372_RDATA0_ADDR A:0xe66ba18
y.create.l HWIO_PMIC_ARB_OBS6_CHNL373_RDATA0_ADDR A:0xe66ba98
y.create.l HWIO_PMIC_ARB_OBS6_CHNL374_RDATA0_ADDR A:0xe66bb18
y.create.l HWIO_PMIC_ARB_OBS6_CHNL375_RDATA0_ADDR A:0xe66bb98
y.create.l HWIO_PMIC_ARB_OBS6_CHNL376_RDATA0_ADDR A:0xe66bc18
y.create.l HWIO_PMIC_ARB_OBS6_CHNL377_RDATA0_ADDR A:0xe66bc98
y.create.l HWIO_PMIC_ARB_OBS6_CHNL378_RDATA0_ADDR A:0xe66bd18
y.create.l HWIO_PMIC_ARB_OBS6_CHNL379_RDATA0_ADDR A:0xe66bd98
y.create.l HWIO_PMIC_ARB_OBS6_CHNL380_RDATA0_ADDR A:0xe66be18
y.create.l HWIO_PMIC_ARB_OBS6_CHNL381_RDATA0_ADDR A:0xe66be98
y.create.l HWIO_PMIC_ARB_OBS6_CHNL382_RDATA0_ADDR A:0xe66bf18
y.create.l HWIO_PMIC_ARB_OBS6_CHNL383_RDATA0_ADDR A:0xe66bf98
y.create.l HWIO_PMIC_ARB_OBS6_CHNL384_RDATA0_ADDR A:0xe66c018
y.create.l HWIO_PMIC_ARB_OBS6_CHNL385_RDATA0_ADDR A:0xe66c098
y.create.l HWIO_PMIC_ARB_OBS6_CHNL386_RDATA0_ADDR A:0xe66c118
y.create.l HWIO_PMIC_ARB_OBS6_CHNL387_RDATA0_ADDR A:0xe66c198
y.create.l HWIO_PMIC_ARB_OBS6_CHNL388_RDATA0_ADDR A:0xe66c218
y.create.l HWIO_PMIC_ARB_OBS6_CHNL389_RDATA0_ADDR A:0xe66c298
y.create.l HWIO_PMIC_ARB_OBS6_CHNL390_RDATA0_ADDR A:0xe66c318
y.create.l HWIO_PMIC_ARB_OBS6_CHNL391_RDATA0_ADDR A:0xe66c398
y.create.l HWIO_PMIC_ARB_OBS6_CHNL392_RDATA0_ADDR A:0xe66c418
y.create.l HWIO_PMIC_ARB_OBS6_CHNL393_RDATA0_ADDR A:0xe66c498
y.create.l HWIO_PMIC_ARB_OBS6_CHNL394_RDATA0_ADDR A:0xe66c518
y.create.l HWIO_PMIC_ARB_OBS6_CHNL395_RDATA0_ADDR A:0xe66c598
y.create.l HWIO_PMIC_ARB_OBS6_CHNL396_RDATA0_ADDR A:0xe66c618
y.create.l HWIO_PMIC_ARB_OBS6_CHNL397_RDATA0_ADDR A:0xe66c698
y.create.l HWIO_PMIC_ARB_OBS6_CHNL398_RDATA0_ADDR A:0xe66c718
y.create.l HWIO_PMIC_ARB_OBS6_CHNL399_RDATA0_ADDR A:0xe66c798
y.create.l HWIO_PMIC_ARB_OBS6_CHNL400_RDATA0_ADDR A:0xe66c818
y.create.l HWIO_PMIC_ARB_OBS6_CHNL401_RDATA0_ADDR A:0xe66c898
y.create.l HWIO_PMIC_ARB_OBS6_CHNL402_RDATA0_ADDR A:0xe66c918
y.create.l HWIO_PMIC_ARB_OBS6_CHNL403_RDATA0_ADDR A:0xe66c998
y.create.l HWIO_PMIC_ARB_OBS6_CHNL404_RDATA0_ADDR A:0xe66ca18
y.create.l HWIO_PMIC_ARB_OBS6_CHNL405_RDATA0_ADDR A:0xe66ca98
y.create.l HWIO_PMIC_ARB_OBS6_CHNL406_RDATA0_ADDR A:0xe66cb18
y.create.l HWIO_PMIC_ARB_OBS6_CHNL407_RDATA0_ADDR A:0xe66cb98
y.create.l HWIO_PMIC_ARB_OBS6_CHNL408_RDATA0_ADDR A:0xe66cc18
y.create.l HWIO_PMIC_ARB_OBS6_CHNL409_RDATA0_ADDR A:0xe66cc98
y.create.l HWIO_PMIC_ARB_OBS6_CHNL410_RDATA0_ADDR A:0xe66cd18
y.create.l HWIO_PMIC_ARB_OBS6_CHNL411_RDATA0_ADDR A:0xe66cd98
y.create.l HWIO_PMIC_ARB_OBS6_CHNL412_RDATA0_ADDR A:0xe66ce18
y.create.l HWIO_PMIC_ARB_OBS6_CHNL413_RDATA0_ADDR A:0xe66ce98
y.create.l HWIO_PMIC_ARB_OBS6_CHNL414_RDATA0_ADDR A:0xe66cf18
y.create.l HWIO_PMIC_ARB_OBS6_CHNL415_RDATA0_ADDR A:0xe66cf98
y.create.l HWIO_PMIC_ARB_OBS6_CHNL416_RDATA0_ADDR A:0xe66d018
y.create.l HWIO_PMIC_ARB_OBS6_CHNL417_RDATA0_ADDR A:0xe66d098
y.create.l HWIO_PMIC_ARB_OBS6_CHNL418_RDATA0_ADDR A:0xe66d118
y.create.l HWIO_PMIC_ARB_OBS6_CHNL419_RDATA0_ADDR A:0xe66d198
y.create.l HWIO_PMIC_ARB_OBS6_CHNL420_RDATA0_ADDR A:0xe66d218
y.create.l HWIO_PMIC_ARB_OBS6_CHNL421_RDATA0_ADDR A:0xe66d298
y.create.l HWIO_PMIC_ARB_OBS6_CHNL422_RDATA0_ADDR A:0xe66d318
y.create.l HWIO_PMIC_ARB_OBS6_CHNL423_RDATA0_ADDR A:0xe66d398
y.create.l HWIO_PMIC_ARB_OBS6_CHNL424_RDATA0_ADDR A:0xe66d418
y.create.l HWIO_PMIC_ARB_OBS6_CHNL425_RDATA0_ADDR A:0xe66d498
y.create.l HWIO_PMIC_ARB_OBS6_CHNL426_RDATA0_ADDR A:0xe66d518
y.create.l HWIO_PMIC_ARB_OBS6_CHNL427_RDATA0_ADDR A:0xe66d598
y.create.l HWIO_PMIC_ARB_OBS6_CHNL428_RDATA0_ADDR A:0xe66d618
y.create.l HWIO_PMIC_ARB_OBS6_CHNL429_RDATA0_ADDR A:0xe66d698
y.create.l HWIO_PMIC_ARB_OBS6_CHNL430_RDATA0_ADDR A:0xe66d718
y.create.l HWIO_PMIC_ARB_OBS6_CHNL431_RDATA0_ADDR A:0xe66d798
y.create.l HWIO_PMIC_ARB_OBS6_CHNL432_RDATA0_ADDR A:0xe66d818
y.create.l HWIO_PMIC_ARB_OBS6_CHNL433_RDATA0_ADDR A:0xe66d898
y.create.l HWIO_PMIC_ARB_OBS6_CHNL434_RDATA0_ADDR A:0xe66d918
y.create.l HWIO_PMIC_ARB_OBS6_CHNL435_RDATA0_ADDR A:0xe66d998
y.create.l HWIO_PMIC_ARB_OBS6_CHNL436_RDATA0_ADDR A:0xe66da18
y.create.l HWIO_PMIC_ARB_OBS6_CHNL437_RDATA0_ADDR A:0xe66da98
y.create.l HWIO_PMIC_ARB_OBS6_CHNL438_RDATA0_ADDR A:0xe66db18
y.create.l HWIO_PMIC_ARB_OBS6_CHNL439_RDATA0_ADDR A:0xe66db98
y.create.l HWIO_PMIC_ARB_OBS6_CHNL440_RDATA0_ADDR A:0xe66dc18
y.create.l HWIO_PMIC_ARB_OBS6_CHNL441_RDATA0_ADDR A:0xe66dc98
y.create.l HWIO_PMIC_ARB_OBS6_CHNL442_RDATA0_ADDR A:0xe66dd18
y.create.l HWIO_PMIC_ARB_OBS6_CHNL443_RDATA0_ADDR A:0xe66dd98
y.create.l HWIO_PMIC_ARB_OBS6_CHNL444_RDATA0_ADDR A:0xe66de18
y.create.l HWIO_PMIC_ARB_OBS6_CHNL445_RDATA0_ADDR A:0xe66de98
y.create.l HWIO_PMIC_ARB_OBS6_CHNL446_RDATA0_ADDR A:0xe66df18
y.create.l HWIO_PMIC_ARB_OBS6_CHNL447_RDATA0_ADDR A:0xe66df98
y.create.l HWIO_PMIC_ARB_OBS6_CHNL448_RDATA0_ADDR A:0xe66e018
y.create.l HWIO_PMIC_ARB_OBS6_CHNL449_RDATA0_ADDR A:0xe66e098
y.create.l HWIO_PMIC_ARB_OBS6_CHNL450_RDATA0_ADDR A:0xe66e118
y.create.l HWIO_PMIC_ARB_OBS6_CHNL451_RDATA0_ADDR A:0xe66e198
y.create.l HWIO_PMIC_ARB_OBS6_CHNL452_RDATA0_ADDR A:0xe66e218
y.create.l HWIO_PMIC_ARB_OBS6_CHNL453_RDATA0_ADDR A:0xe66e298
y.create.l HWIO_PMIC_ARB_OBS6_CHNL454_RDATA0_ADDR A:0xe66e318
y.create.l HWIO_PMIC_ARB_OBS6_CHNL455_RDATA0_ADDR A:0xe66e398
y.create.l HWIO_PMIC_ARB_OBS6_CHNL456_RDATA0_ADDR A:0xe66e418
y.create.l HWIO_PMIC_ARB_OBS6_CHNL457_RDATA0_ADDR A:0xe66e498
y.create.l HWIO_PMIC_ARB_OBS6_CHNL458_RDATA0_ADDR A:0xe66e518
y.create.l HWIO_PMIC_ARB_OBS6_CHNL459_RDATA0_ADDR A:0xe66e598
y.create.l HWIO_PMIC_ARB_OBS6_CHNL460_RDATA0_ADDR A:0xe66e618
y.create.l HWIO_PMIC_ARB_OBS6_CHNL461_RDATA0_ADDR A:0xe66e698
y.create.l HWIO_PMIC_ARB_OBS6_CHNL462_RDATA0_ADDR A:0xe66e718
y.create.l HWIO_PMIC_ARB_OBS6_CHNL463_RDATA0_ADDR A:0xe66e798
y.create.l HWIO_PMIC_ARB_OBS6_CHNL464_RDATA0_ADDR A:0xe66e818
y.create.l HWIO_PMIC_ARB_OBS6_CHNL465_RDATA0_ADDR A:0xe66e898
y.create.l HWIO_PMIC_ARB_OBS6_CHNL466_RDATA0_ADDR A:0xe66e918
y.create.l HWIO_PMIC_ARB_OBS6_CHNL467_RDATA0_ADDR A:0xe66e998
y.create.l HWIO_PMIC_ARB_OBS6_CHNL468_RDATA0_ADDR A:0xe66ea18
y.create.l HWIO_PMIC_ARB_OBS6_CHNL469_RDATA0_ADDR A:0xe66ea98
y.create.l HWIO_PMIC_ARB_OBS6_CHNL470_RDATA0_ADDR A:0xe66eb18
y.create.l HWIO_PMIC_ARB_OBS6_CHNL471_RDATA0_ADDR A:0xe66eb98
y.create.l HWIO_PMIC_ARB_OBS6_CHNL472_RDATA0_ADDR A:0xe66ec18
y.create.l HWIO_PMIC_ARB_OBS6_CHNL473_RDATA0_ADDR A:0xe66ec98
y.create.l HWIO_PMIC_ARB_OBS6_CHNL474_RDATA0_ADDR A:0xe66ed18
y.create.l HWIO_PMIC_ARB_OBS6_CHNL475_RDATA0_ADDR A:0xe66ed98
y.create.l HWIO_PMIC_ARB_OBS6_CHNL476_RDATA0_ADDR A:0xe66ee18
y.create.l HWIO_PMIC_ARB_OBS6_CHNL477_RDATA0_ADDR A:0xe66ee98
y.create.l HWIO_PMIC_ARB_OBS6_CHNL478_RDATA0_ADDR A:0xe66ef18
y.create.l HWIO_PMIC_ARB_OBS6_CHNL479_RDATA0_ADDR A:0xe66ef98
y.create.l HWIO_PMIC_ARB_OBS6_CHNL480_RDATA0_ADDR A:0xe66f018
y.create.l HWIO_PMIC_ARB_OBS6_CHNL481_RDATA0_ADDR A:0xe66f098
y.create.l HWIO_PMIC_ARB_OBS6_CHNL482_RDATA0_ADDR A:0xe66f118
y.create.l HWIO_PMIC_ARB_OBS6_CHNL483_RDATA0_ADDR A:0xe66f198
y.create.l HWIO_PMIC_ARB_OBS6_CHNL484_RDATA0_ADDR A:0xe66f218
y.create.l HWIO_PMIC_ARB_OBS6_CHNL485_RDATA0_ADDR A:0xe66f298
y.create.l HWIO_PMIC_ARB_OBS6_CHNL486_RDATA0_ADDR A:0xe66f318
y.create.l HWIO_PMIC_ARB_OBS6_CHNL487_RDATA0_ADDR A:0xe66f398
y.create.l HWIO_PMIC_ARB_OBS6_CHNL488_RDATA0_ADDR A:0xe66f418
y.create.l HWIO_PMIC_ARB_OBS6_CHNL489_RDATA0_ADDR A:0xe66f498
y.create.l HWIO_PMIC_ARB_OBS6_CHNL490_RDATA0_ADDR A:0xe66f518
y.create.l HWIO_PMIC_ARB_OBS6_CHNL491_RDATA0_ADDR A:0xe66f598
y.create.l HWIO_PMIC_ARB_OBS6_CHNL492_RDATA0_ADDR A:0xe66f618
y.create.l HWIO_PMIC_ARB_OBS6_CHNL493_RDATA0_ADDR A:0xe66f698
y.create.l HWIO_PMIC_ARB_OBS6_CHNL494_RDATA0_ADDR A:0xe66f718
y.create.l HWIO_PMIC_ARB_OBS6_CHNL495_RDATA0_ADDR A:0xe66f798
y.create.l HWIO_PMIC_ARB_OBS6_CHNL496_RDATA0_ADDR A:0xe66f818
y.create.l HWIO_PMIC_ARB_OBS6_CHNL497_RDATA0_ADDR A:0xe66f898
y.create.l HWIO_PMIC_ARB_OBS6_CHNL498_RDATA0_ADDR A:0xe66f918
y.create.l HWIO_PMIC_ARB_OBS6_CHNL499_RDATA0_ADDR A:0xe66f998
y.create.l HWIO_PMIC_ARB_OBS6_CHNL500_RDATA0_ADDR A:0xe66fa18
y.create.l HWIO_PMIC_ARB_OBS6_CHNL501_RDATA0_ADDR A:0xe66fa98
y.create.l HWIO_PMIC_ARB_OBS6_CHNL502_RDATA0_ADDR A:0xe66fb18
y.create.l HWIO_PMIC_ARB_OBS6_CHNL503_RDATA0_ADDR A:0xe66fb98
y.create.l HWIO_PMIC_ARB_OBS6_CHNL504_RDATA0_ADDR A:0xe66fc18
y.create.l HWIO_PMIC_ARB_OBS6_CHNL505_RDATA0_ADDR A:0xe66fc98
y.create.l HWIO_PMIC_ARB_OBS6_CHNL506_RDATA0_ADDR A:0xe66fd18
y.create.l HWIO_PMIC_ARB_OBS6_CHNL507_RDATA0_ADDR A:0xe66fd98
y.create.l HWIO_PMIC_ARB_OBS6_CHNL508_RDATA0_ADDR A:0xe66fe18
y.create.l HWIO_PMIC_ARB_OBS6_CHNL509_RDATA0_ADDR A:0xe66fe98
y.create.l HWIO_PMIC_ARB_OBS6_CHNL510_RDATA0_ADDR A:0xe66ff18
y.create.l HWIO_PMIC_ARB_OBS6_CHNL511_RDATA0_ADDR A:0xe66ff98
y.create.l HWIO_PMIC_ARB_OBS0_CHNL0_RDATA1_ADDR A:0xe60001c
y.create.l HWIO_PMIC_ARB_OBS0_CHNL1_RDATA1_ADDR A:0xe60009c
y.create.l HWIO_PMIC_ARB_OBS0_CHNL2_RDATA1_ADDR A:0xe60011c
y.create.l HWIO_PMIC_ARB_OBS0_CHNL3_RDATA1_ADDR A:0xe60019c
y.create.l HWIO_PMIC_ARB_OBS0_CHNL4_RDATA1_ADDR A:0xe60021c
y.create.l HWIO_PMIC_ARB_OBS0_CHNL5_RDATA1_ADDR A:0xe60029c
y.create.l HWIO_PMIC_ARB_OBS0_CHNL6_RDATA1_ADDR A:0xe60031c
y.create.l HWIO_PMIC_ARB_OBS0_CHNL7_RDATA1_ADDR A:0xe60039c
y.create.l HWIO_PMIC_ARB_OBS0_CHNL8_RDATA1_ADDR A:0xe60041c
y.create.l HWIO_PMIC_ARB_OBS0_CHNL9_RDATA1_ADDR A:0xe60049c
y.create.l HWIO_PMIC_ARB_OBS0_CHNL10_RDATA1_ADDR A:0xe60051c
y.create.l HWIO_PMIC_ARB_OBS0_CHNL11_RDATA1_ADDR A:0xe60059c
y.create.l HWIO_PMIC_ARB_OBS0_CHNL12_RDATA1_ADDR A:0xe60061c
y.create.l HWIO_PMIC_ARB_OBS0_CHNL13_RDATA1_ADDR A:0xe60069c
y.create.l HWIO_PMIC_ARB_OBS0_CHNL14_RDATA1_ADDR A:0xe60071c
y.create.l HWIO_PMIC_ARB_OBS0_CHNL15_RDATA1_ADDR A:0xe60079c
y.create.l HWIO_PMIC_ARB_OBS0_CHNL16_RDATA1_ADDR A:0xe60081c
y.create.l HWIO_PMIC_ARB_OBS0_CHNL17_RDATA1_ADDR A:0xe60089c
y.create.l HWIO_PMIC_ARB_OBS0_CHNL18_RDATA1_ADDR A:0xe60091c
y.create.l HWIO_PMIC_ARB_OBS0_CHNL19_RDATA1_ADDR A:0xe60099c
y.create.l HWIO_PMIC_ARB_OBS0_CHNL20_RDATA1_ADDR A:0xe600a1c
y.create.l HWIO_PMIC_ARB_OBS0_CHNL21_RDATA1_ADDR A:0xe600a9c
y.create.l HWIO_PMIC_ARB_OBS0_CHNL22_RDATA1_ADDR A:0xe600b1c
y.create.l HWIO_PMIC_ARB_OBS0_CHNL23_RDATA1_ADDR A:0xe600b9c
y.create.l HWIO_PMIC_ARB_OBS0_CHNL24_RDATA1_ADDR A:0xe600c1c
y.create.l HWIO_PMIC_ARB_OBS0_CHNL25_RDATA1_ADDR A:0xe600c9c
y.create.l HWIO_PMIC_ARB_OBS0_CHNL26_RDATA1_ADDR A:0xe600d1c
y.create.l HWIO_PMIC_ARB_OBS0_CHNL27_RDATA1_ADDR A:0xe600d9c
y.create.l HWIO_PMIC_ARB_OBS0_CHNL28_RDATA1_ADDR A:0xe600e1c
y.create.l HWIO_PMIC_ARB_OBS0_CHNL29_RDATA1_ADDR A:0xe600e9c
y.create.l HWIO_PMIC_ARB_OBS0_CHNL30_RDATA1_ADDR A:0xe600f1c
y.create.l HWIO_PMIC_ARB_OBS0_CHNL31_RDATA1_ADDR A:0xe600f9c
y.create.l HWIO_PMIC_ARB_OBS0_CHNL32_RDATA1_ADDR A:0xe60101c
y.create.l HWIO_PMIC_ARB_OBS0_CHNL33_RDATA1_ADDR A:0xe60109c
y.create.l HWIO_PMIC_ARB_OBS0_CHNL34_RDATA1_ADDR A:0xe60111c
y.create.l HWIO_PMIC_ARB_OBS0_CHNL35_RDATA1_ADDR A:0xe60119c
y.create.l HWIO_PMIC_ARB_OBS0_CHNL36_RDATA1_ADDR A:0xe60121c
y.create.l HWIO_PMIC_ARB_OBS0_CHNL37_RDATA1_ADDR A:0xe60129c
y.create.l HWIO_PMIC_ARB_OBS0_CHNL38_RDATA1_ADDR A:0xe60131c
y.create.l HWIO_PMIC_ARB_OBS0_CHNL39_RDATA1_ADDR A:0xe60139c
y.create.l HWIO_PMIC_ARB_OBS0_CHNL40_RDATA1_ADDR A:0xe60141c
y.create.l HWIO_PMIC_ARB_OBS0_CHNL41_RDATA1_ADDR A:0xe60149c
y.create.l HWIO_PMIC_ARB_OBS0_CHNL42_RDATA1_ADDR A:0xe60151c
y.create.l HWIO_PMIC_ARB_OBS0_CHNL43_RDATA1_ADDR A:0xe60159c
y.create.l HWIO_PMIC_ARB_OBS0_CHNL44_RDATA1_ADDR A:0xe60161c
y.create.l HWIO_PMIC_ARB_OBS0_CHNL45_RDATA1_ADDR A:0xe60169c
y.create.l HWIO_PMIC_ARB_OBS0_CHNL46_RDATA1_ADDR A:0xe60171c
y.create.l HWIO_PMIC_ARB_OBS0_CHNL47_RDATA1_ADDR A:0xe60179c
y.create.l HWIO_PMIC_ARB_OBS0_CHNL48_RDATA1_ADDR A:0xe60181c
y.create.l HWIO_PMIC_ARB_OBS0_CHNL49_RDATA1_ADDR A:0xe60189c
y.create.l HWIO_PMIC_ARB_OBS0_CHNL50_RDATA1_ADDR A:0xe60191c
y.create.l HWIO_PMIC_ARB_OBS0_CHNL51_RDATA1_ADDR A:0xe60199c
y.create.l HWIO_PMIC_ARB_OBS0_CHNL52_RDATA1_ADDR A:0xe601a1c
y.create.l HWIO_PMIC_ARB_OBS0_CHNL53_RDATA1_ADDR A:0xe601a9c
y.create.l HWIO_PMIC_ARB_OBS0_CHNL54_RDATA1_ADDR A:0xe601b1c
y.create.l HWIO_PMIC_ARB_OBS0_CHNL55_RDATA1_ADDR A:0xe601b9c
y.create.l HWIO_PMIC_ARB_OBS0_CHNL56_RDATA1_ADDR A:0xe601c1c
y.create.l HWIO_PMIC_ARB_OBS0_CHNL57_RDATA1_ADDR A:0xe601c9c
y.create.l HWIO_PMIC_ARB_OBS0_CHNL58_RDATA1_ADDR A:0xe601d1c
y.create.l HWIO_PMIC_ARB_OBS0_CHNL59_RDATA1_ADDR A:0xe601d9c
y.create.l HWIO_PMIC_ARB_OBS0_CHNL60_RDATA1_ADDR A:0xe601e1c
y.create.l HWIO_PMIC_ARB_OBS0_CHNL61_RDATA1_ADDR A:0xe601e9c
y.create.l HWIO_PMIC_ARB_OBS0_CHNL62_RDATA1_ADDR A:0xe601f1c
y.create.l HWIO_PMIC_ARB_OBS0_CHNL63_RDATA1_ADDR A:0xe601f9c
y.create.l HWIO_PMIC_ARB_OBS0_CHNL64_RDATA1_ADDR A:0xe60201c
y.create.l HWIO_PMIC_ARB_OBS0_CHNL65_RDATA1_ADDR A:0xe60209c
y.create.l HWIO_PMIC_ARB_OBS0_CHNL66_RDATA1_ADDR A:0xe60211c
y.create.l HWIO_PMIC_ARB_OBS0_CHNL67_RDATA1_ADDR A:0xe60219c
y.create.l HWIO_PMIC_ARB_OBS0_CHNL68_RDATA1_ADDR A:0xe60221c
y.create.l HWIO_PMIC_ARB_OBS0_CHNL69_RDATA1_ADDR A:0xe60229c
y.create.l HWIO_PMIC_ARB_OBS0_CHNL70_RDATA1_ADDR A:0xe60231c
y.create.l HWIO_PMIC_ARB_OBS0_CHNL71_RDATA1_ADDR A:0xe60239c
y.create.l HWIO_PMIC_ARB_OBS0_CHNL72_RDATA1_ADDR A:0xe60241c
y.create.l HWIO_PMIC_ARB_OBS0_CHNL73_RDATA1_ADDR A:0xe60249c
y.create.l HWIO_PMIC_ARB_OBS0_CHNL74_RDATA1_ADDR A:0xe60251c
y.create.l HWIO_PMIC_ARB_OBS0_CHNL75_RDATA1_ADDR A:0xe60259c
y.create.l HWIO_PMIC_ARB_OBS0_CHNL76_RDATA1_ADDR A:0xe60261c
y.create.l HWIO_PMIC_ARB_OBS0_CHNL77_RDATA1_ADDR A:0xe60269c
y.create.l HWIO_PMIC_ARB_OBS0_CHNL78_RDATA1_ADDR A:0xe60271c
y.create.l HWIO_PMIC_ARB_OBS0_CHNL79_RDATA1_ADDR A:0xe60279c
y.create.l HWIO_PMIC_ARB_OBS0_CHNL80_RDATA1_ADDR A:0xe60281c
y.create.l HWIO_PMIC_ARB_OBS0_CHNL81_RDATA1_ADDR A:0xe60289c
y.create.l HWIO_PMIC_ARB_OBS0_CHNL82_RDATA1_ADDR A:0xe60291c
y.create.l HWIO_PMIC_ARB_OBS0_CHNL83_RDATA1_ADDR A:0xe60299c
y.create.l HWIO_PMIC_ARB_OBS0_CHNL84_RDATA1_ADDR A:0xe602a1c
y.create.l HWIO_PMIC_ARB_OBS0_CHNL85_RDATA1_ADDR A:0xe602a9c
y.create.l HWIO_PMIC_ARB_OBS0_CHNL86_RDATA1_ADDR A:0xe602b1c
y.create.l HWIO_PMIC_ARB_OBS0_CHNL87_RDATA1_ADDR A:0xe602b9c
y.create.l HWIO_PMIC_ARB_OBS0_CHNL88_RDATA1_ADDR A:0xe602c1c
y.create.l HWIO_PMIC_ARB_OBS0_CHNL89_RDATA1_ADDR A:0xe602c9c
y.create.l HWIO_PMIC_ARB_OBS0_CHNL90_RDATA1_ADDR A:0xe602d1c
y.create.l HWIO_PMIC_ARB_OBS0_CHNL91_RDATA1_ADDR A:0xe602d9c
y.create.l HWIO_PMIC_ARB_OBS0_CHNL92_RDATA1_ADDR A:0xe602e1c
y.create.l HWIO_PMIC_ARB_OBS0_CHNL93_RDATA1_ADDR A:0xe602e9c
y.create.l HWIO_PMIC_ARB_OBS0_CHNL94_RDATA1_ADDR A:0xe602f1c
y.create.l HWIO_PMIC_ARB_OBS0_CHNL95_RDATA1_ADDR A:0xe602f9c
y.create.l HWIO_PMIC_ARB_OBS0_CHNL96_RDATA1_ADDR A:0xe60301c
y.create.l HWIO_PMIC_ARB_OBS0_CHNL97_RDATA1_ADDR A:0xe60309c
y.create.l HWIO_PMIC_ARB_OBS0_CHNL98_RDATA1_ADDR A:0xe60311c
y.create.l HWIO_PMIC_ARB_OBS0_CHNL99_RDATA1_ADDR A:0xe60319c
y.create.l HWIO_PMIC_ARB_OBS0_CHNL100_RDATA1_ADDR A:0xe60321c
y.create.l HWIO_PMIC_ARB_OBS0_CHNL101_RDATA1_ADDR A:0xe60329c
y.create.l HWIO_PMIC_ARB_OBS0_CHNL102_RDATA1_ADDR A:0xe60331c
y.create.l HWIO_PMIC_ARB_OBS0_CHNL103_RDATA1_ADDR A:0xe60339c
y.create.l HWIO_PMIC_ARB_OBS0_CHNL104_RDATA1_ADDR A:0xe60341c
y.create.l HWIO_PMIC_ARB_OBS0_CHNL105_RDATA1_ADDR A:0xe60349c
y.create.l HWIO_PMIC_ARB_OBS0_CHNL106_RDATA1_ADDR A:0xe60351c
y.create.l HWIO_PMIC_ARB_OBS0_CHNL107_RDATA1_ADDR A:0xe60359c
y.create.l HWIO_PMIC_ARB_OBS0_CHNL108_RDATA1_ADDR A:0xe60361c
y.create.l HWIO_PMIC_ARB_OBS0_CHNL109_RDATA1_ADDR A:0xe60369c
y.create.l HWIO_PMIC_ARB_OBS0_CHNL110_RDATA1_ADDR A:0xe60371c
y.create.l HWIO_PMIC_ARB_OBS0_CHNL111_RDATA1_ADDR A:0xe60379c
y.create.l HWIO_PMIC_ARB_OBS0_CHNL112_RDATA1_ADDR A:0xe60381c
y.create.l HWIO_PMIC_ARB_OBS0_CHNL113_RDATA1_ADDR A:0xe60389c
y.create.l HWIO_PMIC_ARB_OBS0_CHNL114_RDATA1_ADDR A:0xe60391c
y.create.l HWIO_PMIC_ARB_OBS0_CHNL115_RDATA1_ADDR A:0xe60399c
y.create.l HWIO_PMIC_ARB_OBS0_CHNL116_RDATA1_ADDR A:0xe603a1c
y.create.l HWIO_PMIC_ARB_OBS0_CHNL117_RDATA1_ADDR A:0xe603a9c
y.create.l HWIO_PMIC_ARB_OBS0_CHNL118_RDATA1_ADDR A:0xe603b1c
y.create.l HWIO_PMIC_ARB_OBS0_CHNL119_RDATA1_ADDR A:0xe603b9c
y.create.l HWIO_PMIC_ARB_OBS0_CHNL120_RDATA1_ADDR A:0xe603c1c
y.create.l HWIO_PMIC_ARB_OBS0_CHNL121_RDATA1_ADDR A:0xe603c9c
y.create.l HWIO_PMIC_ARB_OBS0_CHNL122_RDATA1_ADDR A:0xe603d1c
y.create.l HWIO_PMIC_ARB_OBS0_CHNL123_RDATA1_ADDR A:0xe603d9c
y.create.l HWIO_PMIC_ARB_OBS0_CHNL124_RDATA1_ADDR A:0xe603e1c
y.create.l HWIO_PMIC_ARB_OBS0_CHNL125_RDATA1_ADDR A:0xe603e9c
y.create.l HWIO_PMIC_ARB_OBS0_CHNL126_RDATA1_ADDR A:0xe603f1c
y.create.l HWIO_PMIC_ARB_OBS0_CHNL127_RDATA1_ADDR A:0xe603f9c
y.create.l HWIO_PMIC_ARB_OBS0_CHNL128_RDATA1_ADDR A:0xe60401c
y.create.l HWIO_PMIC_ARB_OBS0_CHNL129_RDATA1_ADDR A:0xe60409c
y.create.l HWIO_PMIC_ARB_OBS0_CHNL130_RDATA1_ADDR A:0xe60411c
y.create.l HWIO_PMIC_ARB_OBS0_CHNL131_RDATA1_ADDR A:0xe60419c
y.create.l HWIO_PMIC_ARB_OBS0_CHNL132_RDATA1_ADDR A:0xe60421c
y.create.l HWIO_PMIC_ARB_OBS0_CHNL133_RDATA1_ADDR A:0xe60429c
y.create.l HWIO_PMIC_ARB_OBS0_CHNL134_RDATA1_ADDR A:0xe60431c
y.create.l HWIO_PMIC_ARB_OBS0_CHNL135_RDATA1_ADDR A:0xe60439c
y.create.l HWIO_PMIC_ARB_OBS0_CHNL136_RDATA1_ADDR A:0xe60441c
y.create.l HWIO_PMIC_ARB_OBS0_CHNL137_RDATA1_ADDR A:0xe60449c
y.create.l HWIO_PMIC_ARB_OBS0_CHNL138_RDATA1_ADDR A:0xe60451c
y.create.l HWIO_PMIC_ARB_OBS0_CHNL139_RDATA1_ADDR A:0xe60459c
y.create.l HWIO_PMIC_ARB_OBS0_CHNL140_RDATA1_ADDR A:0xe60461c
y.create.l HWIO_PMIC_ARB_OBS0_CHNL141_RDATA1_ADDR A:0xe60469c
y.create.l HWIO_PMIC_ARB_OBS0_CHNL142_RDATA1_ADDR A:0xe60471c
y.create.l HWIO_PMIC_ARB_OBS0_CHNL143_RDATA1_ADDR A:0xe60479c
y.create.l HWIO_PMIC_ARB_OBS0_CHNL144_RDATA1_ADDR A:0xe60481c
y.create.l HWIO_PMIC_ARB_OBS0_CHNL145_RDATA1_ADDR A:0xe60489c
y.create.l HWIO_PMIC_ARB_OBS0_CHNL146_RDATA1_ADDR A:0xe60491c
y.create.l HWIO_PMIC_ARB_OBS0_CHNL147_RDATA1_ADDR A:0xe60499c
y.create.l HWIO_PMIC_ARB_OBS0_CHNL148_RDATA1_ADDR A:0xe604a1c
y.create.l HWIO_PMIC_ARB_OBS0_CHNL149_RDATA1_ADDR A:0xe604a9c
y.create.l HWIO_PMIC_ARB_OBS0_CHNL150_RDATA1_ADDR A:0xe604b1c
y.create.l HWIO_PMIC_ARB_OBS0_CHNL151_RDATA1_ADDR A:0xe604b9c
y.create.l HWIO_PMIC_ARB_OBS0_CHNL152_RDATA1_ADDR A:0xe604c1c
y.create.l HWIO_PMIC_ARB_OBS0_CHNL153_RDATA1_ADDR A:0xe604c9c
y.create.l HWIO_PMIC_ARB_OBS0_CHNL154_RDATA1_ADDR A:0xe604d1c
y.create.l HWIO_PMIC_ARB_OBS0_CHNL155_RDATA1_ADDR A:0xe604d9c
y.create.l HWIO_PMIC_ARB_OBS0_CHNL156_RDATA1_ADDR A:0xe604e1c
y.create.l HWIO_PMIC_ARB_OBS0_CHNL157_RDATA1_ADDR A:0xe604e9c
y.create.l HWIO_PMIC_ARB_OBS0_CHNL158_RDATA1_ADDR A:0xe604f1c
y.create.l HWIO_PMIC_ARB_OBS0_CHNL159_RDATA1_ADDR A:0xe604f9c
y.create.l HWIO_PMIC_ARB_OBS0_CHNL160_RDATA1_ADDR A:0xe60501c
y.create.l HWIO_PMIC_ARB_OBS0_CHNL161_RDATA1_ADDR A:0xe60509c
y.create.l HWIO_PMIC_ARB_OBS0_CHNL162_RDATA1_ADDR A:0xe60511c
y.create.l HWIO_PMIC_ARB_OBS0_CHNL163_RDATA1_ADDR A:0xe60519c
y.create.l HWIO_PMIC_ARB_OBS0_CHNL164_RDATA1_ADDR A:0xe60521c
y.create.l HWIO_PMIC_ARB_OBS0_CHNL165_RDATA1_ADDR A:0xe60529c
y.create.l HWIO_PMIC_ARB_OBS0_CHNL166_RDATA1_ADDR A:0xe60531c
y.create.l HWIO_PMIC_ARB_OBS0_CHNL167_RDATA1_ADDR A:0xe60539c
y.create.l HWIO_PMIC_ARB_OBS0_CHNL168_RDATA1_ADDR A:0xe60541c
y.create.l HWIO_PMIC_ARB_OBS0_CHNL169_RDATA1_ADDR A:0xe60549c
y.create.l HWIO_PMIC_ARB_OBS0_CHNL170_RDATA1_ADDR A:0xe60551c
y.create.l HWIO_PMIC_ARB_OBS0_CHNL171_RDATA1_ADDR A:0xe60559c
y.create.l HWIO_PMIC_ARB_OBS0_CHNL172_RDATA1_ADDR A:0xe60561c
y.create.l HWIO_PMIC_ARB_OBS0_CHNL173_RDATA1_ADDR A:0xe60569c
y.create.l HWIO_PMIC_ARB_OBS0_CHNL174_RDATA1_ADDR A:0xe60571c
y.create.l HWIO_PMIC_ARB_OBS0_CHNL175_RDATA1_ADDR A:0xe60579c
y.create.l HWIO_PMIC_ARB_OBS0_CHNL176_RDATA1_ADDR A:0xe60581c
y.create.l HWIO_PMIC_ARB_OBS0_CHNL177_RDATA1_ADDR A:0xe60589c
y.create.l HWIO_PMIC_ARB_OBS0_CHNL178_RDATA1_ADDR A:0xe60591c
y.create.l HWIO_PMIC_ARB_OBS0_CHNL179_RDATA1_ADDR A:0xe60599c
y.create.l HWIO_PMIC_ARB_OBS0_CHNL180_RDATA1_ADDR A:0xe605a1c
y.create.l HWIO_PMIC_ARB_OBS0_CHNL181_RDATA1_ADDR A:0xe605a9c
y.create.l HWIO_PMIC_ARB_OBS0_CHNL182_RDATA1_ADDR A:0xe605b1c
y.create.l HWIO_PMIC_ARB_OBS0_CHNL183_RDATA1_ADDR A:0xe605b9c
y.create.l HWIO_PMIC_ARB_OBS0_CHNL184_RDATA1_ADDR A:0xe605c1c
y.create.l HWIO_PMIC_ARB_OBS0_CHNL185_RDATA1_ADDR A:0xe605c9c
y.create.l HWIO_PMIC_ARB_OBS0_CHNL186_RDATA1_ADDR A:0xe605d1c
y.create.l HWIO_PMIC_ARB_OBS0_CHNL187_RDATA1_ADDR A:0xe605d9c
y.create.l HWIO_PMIC_ARB_OBS0_CHNL188_RDATA1_ADDR A:0xe605e1c
y.create.l HWIO_PMIC_ARB_OBS0_CHNL189_RDATA1_ADDR A:0xe605e9c
y.create.l HWIO_PMIC_ARB_OBS0_CHNL190_RDATA1_ADDR A:0xe605f1c
y.create.l HWIO_PMIC_ARB_OBS0_CHNL191_RDATA1_ADDR A:0xe605f9c
y.create.l HWIO_PMIC_ARB_OBS0_CHNL192_RDATA1_ADDR A:0xe60601c
y.create.l HWIO_PMIC_ARB_OBS0_CHNL193_RDATA1_ADDR A:0xe60609c
y.create.l HWIO_PMIC_ARB_OBS0_CHNL194_RDATA1_ADDR A:0xe60611c
y.create.l HWIO_PMIC_ARB_OBS0_CHNL195_RDATA1_ADDR A:0xe60619c
y.create.l HWIO_PMIC_ARB_OBS0_CHNL196_RDATA1_ADDR A:0xe60621c
y.create.l HWIO_PMIC_ARB_OBS0_CHNL197_RDATA1_ADDR A:0xe60629c
y.create.l HWIO_PMIC_ARB_OBS0_CHNL198_RDATA1_ADDR A:0xe60631c
y.create.l HWIO_PMIC_ARB_OBS0_CHNL199_RDATA1_ADDR A:0xe60639c
y.create.l HWIO_PMIC_ARB_OBS0_CHNL200_RDATA1_ADDR A:0xe60641c
y.create.l HWIO_PMIC_ARB_OBS0_CHNL201_RDATA1_ADDR A:0xe60649c
y.create.l HWIO_PMIC_ARB_OBS0_CHNL202_RDATA1_ADDR A:0xe60651c
y.create.l HWIO_PMIC_ARB_OBS0_CHNL203_RDATA1_ADDR A:0xe60659c
y.create.l HWIO_PMIC_ARB_OBS0_CHNL204_RDATA1_ADDR A:0xe60661c
y.create.l HWIO_PMIC_ARB_OBS0_CHNL205_RDATA1_ADDR A:0xe60669c
y.create.l HWIO_PMIC_ARB_OBS0_CHNL206_RDATA1_ADDR A:0xe60671c
y.create.l HWIO_PMIC_ARB_OBS0_CHNL207_RDATA1_ADDR A:0xe60679c
y.create.l HWIO_PMIC_ARB_OBS0_CHNL208_RDATA1_ADDR A:0xe60681c
y.create.l HWIO_PMIC_ARB_OBS0_CHNL209_RDATA1_ADDR A:0xe60689c
y.create.l HWIO_PMIC_ARB_OBS0_CHNL210_RDATA1_ADDR A:0xe60691c
y.create.l HWIO_PMIC_ARB_OBS0_CHNL211_RDATA1_ADDR A:0xe60699c
y.create.l HWIO_PMIC_ARB_OBS0_CHNL212_RDATA1_ADDR A:0xe606a1c
y.create.l HWIO_PMIC_ARB_OBS0_CHNL213_RDATA1_ADDR A:0xe606a9c
y.create.l HWIO_PMIC_ARB_OBS0_CHNL214_RDATA1_ADDR A:0xe606b1c
y.create.l HWIO_PMIC_ARB_OBS0_CHNL215_RDATA1_ADDR A:0xe606b9c
y.create.l HWIO_PMIC_ARB_OBS0_CHNL216_RDATA1_ADDR A:0xe606c1c
y.create.l HWIO_PMIC_ARB_OBS0_CHNL217_RDATA1_ADDR A:0xe606c9c
y.create.l HWIO_PMIC_ARB_OBS0_CHNL218_RDATA1_ADDR A:0xe606d1c
y.create.l HWIO_PMIC_ARB_OBS0_CHNL219_RDATA1_ADDR A:0xe606d9c
y.create.l HWIO_PMIC_ARB_OBS0_CHNL220_RDATA1_ADDR A:0xe606e1c
y.create.l HWIO_PMIC_ARB_OBS0_CHNL221_RDATA1_ADDR A:0xe606e9c
y.create.l HWIO_PMIC_ARB_OBS0_CHNL222_RDATA1_ADDR A:0xe606f1c
y.create.l HWIO_PMIC_ARB_OBS0_CHNL223_RDATA1_ADDR A:0xe606f9c
y.create.l HWIO_PMIC_ARB_OBS0_CHNL224_RDATA1_ADDR A:0xe60701c
y.create.l HWIO_PMIC_ARB_OBS0_CHNL225_RDATA1_ADDR A:0xe60709c
y.create.l HWIO_PMIC_ARB_OBS0_CHNL226_RDATA1_ADDR A:0xe60711c
y.create.l HWIO_PMIC_ARB_OBS0_CHNL227_RDATA1_ADDR A:0xe60719c
y.create.l HWIO_PMIC_ARB_OBS0_CHNL228_RDATA1_ADDR A:0xe60721c
y.create.l HWIO_PMIC_ARB_OBS0_CHNL229_RDATA1_ADDR A:0xe60729c
y.create.l HWIO_PMIC_ARB_OBS0_CHNL230_RDATA1_ADDR A:0xe60731c
y.create.l HWIO_PMIC_ARB_OBS0_CHNL231_RDATA1_ADDR A:0xe60739c
y.create.l HWIO_PMIC_ARB_OBS0_CHNL232_RDATA1_ADDR A:0xe60741c
y.create.l HWIO_PMIC_ARB_OBS0_CHNL233_RDATA1_ADDR A:0xe60749c
y.create.l HWIO_PMIC_ARB_OBS0_CHNL234_RDATA1_ADDR A:0xe60751c
y.create.l HWIO_PMIC_ARB_OBS0_CHNL235_RDATA1_ADDR A:0xe60759c
y.create.l HWIO_PMIC_ARB_OBS0_CHNL236_RDATA1_ADDR A:0xe60761c
y.create.l HWIO_PMIC_ARB_OBS0_CHNL237_RDATA1_ADDR A:0xe60769c
y.create.l HWIO_PMIC_ARB_OBS0_CHNL238_RDATA1_ADDR A:0xe60771c
y.create.l HWIO_PMIC_ARB_OBS0_CHNL239_RDATA1_ADDR A:0xe60779c
y.create.l HWIO_PMIC_ARB_OBS0_CHNL240_RDATA1_ADDR A:0xe60781c
y.create.l HWIO_PMIC_ARB_OBS0_CHNL241_RDATA1_ADDR A:0xe60789c
y.create.l HWIO_PMIC_ARB_OBS0_CHNL242_RDATA1_ADDR A:0xe60791c
y.create.l HWIO_PMIC_ARB_OBS0_CHNL243_RDATA1_ADDR A:0xe60799c
y.create.l HWIO_PMIC_ARB_OBS0_CHNL244_RDATA1_ADDR A:0xe607a1c
y.create.l HWIO_PMIC_ARB_OBS0_CHNL245_RDATA1_ADDR A:0xe607a9c
y.create.l HWIO_PMIC_ARB_OBS0_CHNL246_RDATA1_ADDR A:0xe607b1c
y.create.l HWIO_PMIC_ARB_OBS0_CHNL247_RDATA1_ADDR A:0xe607b9c
y.create.l HWIO_PMIC_ARB_OBS0_CHNL248_RDATA1_ADDR A:0xe607c1c
y.create.l HWIO_PMIC_ARB_OBS0_CHNL249_RDATA1_ADDR A:0xe607c9c
y.create.l HWIO_PMIC_ARB_OBS0_CHNL250_RDATA1_ADDR A:0xe607d1c
y.create.l HWIO_PMIC_ARB_OBS0_CHNL251_RDATA1_ADDR A:0xe607d9c
y.create.l HWIO_PMIC_ARB_OBS0_CHNL252_RDATA1_ADDR A:0xe607e1c
y.create.l HWIO_PMIC_ARB_OBS0_CHNL253_RDATA1_ADDR A:0xe607e9c
y.create.l HWIO_PMIC_ARB_OBS0_CHNL254_RDATA1_ADDR A:0xe607f1c
y.create.l HWIO_PMIC_ARB_OBS0_CHNL255_RDATA1_ADDR A:0xe607f9c
y.create.l HWIO_PMIC_ARB_OBS0_CHNL256_RDATA1_ADDR A:0xe60801c
y.create.l HWIO_PMIC_ARB_OBS0_CHNL257_RDATA1_ADDR A:0xe60809c
y.create.l HWIO_PMIC_ARB_OBS0_CHNL258_RDATA1_ADDR A:0xe60811c
y.create.l HWIO_PMIC_ARB_OBS0_CHNL259_RDATA1_ADDR A:0xe60819c
y.create.l HWIO_PMIC_ARB_OBS0_CHNL260_RDATA1_ADDR A:0xe60821c
y.create.l HWIO_PMIC_ARB_OBS0_CHNL261_RDATA1_ADDR A:0xe60829c
y.create.l HWIO_PMIC_ARB_OBS0_CHNL262_RDATA1_ADDR A:0xe60831c
y.create.l HWIO_PMIC_ARB_OBS0_CHNL263_RDATA1_ADDR A:0xe60839c
y.create.l HWIO_PMIC_ARB_OBS0_CHNL264_RDATA1_ADDR A:0xe60841c
y.create.l HWIO_PMIC_ARB_OBS0_CHNL265_RDATA1_ADDR A:0xe60849c
y.create.l HWIO_PMIC_ARB_OBS0_CHNL266_RDATA1_ADDR A:0xe60851c
y.create.l HWIO_PMIC_ARB_OBS0_CHNL267_RDATA1_ADDR A:0xe60859c
y.create.l HWIO_PMIC_ARB_OBS0_CHNL268_RDATA1_ADDR A:0xe60861c
y.create.l HWIO_PMIC_ARB_OBS0_CHNL269_RDATA1_ADDR A:0xe60869c
y.create.l HWIO_PMIC_ARB_OBS0_CHNL270_RDATA1_ADDR A:0xe60871c
y.create.l HWIO_PMIC_ARB_OBS0_CHNL271_RDATA1_ADDR A:0xe60879c
y.create.l HWIO_PMIC_ARB_OBS0_CHNL272_RDATA1_ADDR A:0xe60881c
y.create.l HWIO_PMIC_ARB_OBS0_CHNL273_RDATA1_ADDR A:0xe60889c
y.create.l HWIO_PMIC_ARB_OBS0_CHNL274_RDATA1_ADDR A:0xe60891c
y.create.l HWIO_PMIC_ARB_OBS0_CHNL275_RDATA1_ADDR A:0xe60899c
y.create.l HWIO_PMIC_ARB_OBS0_CHNL276_RDATA1_ADDR A:0xe608a1c
y.create.l HWIO_PMIC_ARB_OBS0_CHNL277_RDATA1_ADDR A:0xe608a9c
y.create.l HWIO_PMIC_ARB_OBS0_CHNL278_RDATA1_ADDR A:0xe608b1c
y.create.l HWIO_PMIC_ARB_OBS0_CHNL279_RDATA1_ADDR A:0xe608b9c
y.create.l HWIO_PMIC_ARB_OBS0_CHNL280_RDATA1_ADDR A:0xe608c1c
y.create.l HWIO_PMIC_ARB_OBS0_CHNL281_RDATA1_ADDR A:0xe608c9c
y.create.l HWIO_PMIC_ARB_OBS0_CHNL282_RDATA1_ADDR A:0xe608d1c
y.create.l HWIO_PMIC_ARB_OBS0_CHNL283_RDATA1_ADDR A:0xe608d9c
y.create.l HWIO_PMIC_ARB_OBS0_CHNL284_RDATA1_ADDR A:0xe608e1c
y.create.l HWIO_PMIC_ARB_OBS0_CHNL285_RDATA1_ADDR A:0xe608e9c
y.create.l HWIO_PMIC_ARB_OBS0_CHNL286_RDATA1_ADDR A:0xe608f1c
y.create.l HWIO_PMIC_ARB_OBS0_CHNL287_RDATA1_ADDR A:0xe608f9c
y.create.l HWIO_PMIC_ARB_OBS0_CHNL288_RDATA1_ADDR A:0xe60901c
y.create.l HWIO_PMIC_ARB_OBS0_CHNL289_RDATA1_ADDR A:0xe60909c
y.create.l HWIO_PMIC_ARB_OBS0_CHNL290_RDATA1_ADDR A:0xe60911c
y.create.l HWIO_PMIC_ARB_OBS0_CHNL291_RDATA1_ADDR A:0xe60919c
y.create.l HWIO_PMIC_ARB_OBS0_CHNL292_RDATA1_ADDR A:0xe60921c
y.create.l HWIO_PMIC_ARB_OBS0_CHNL293_RDATA1_ADDR A:0xe60929c
y.create.l HWIO_PMIC_ARB_OBS0_CHNL294_RDATA1_ADDR A:0xe60931c
y.create.l HWIO_PMIC_ARB_OBS0_CHNL295_RDATA1_ADDR A:0xe60939c
y.create.l HWIO_PMIC_ARB_OBS0_CHNL296_RDATA1_ADDR A:0xe60941c
y.create.l HWIO_PMIC_ARB_OBS0_CHNL297_RDATA1_ADDR A:0xe60949c
y.create.l HWIO_PMIC_ARB_OBS0_CHNL298_RDATA1_ADDR A:0xe60951c
y.create.l HWIO_PMIC_ARB_OBS0_CHNL299_RDATA1_ADDR A:0xe60959c
y.create.l HWIO_PMIC_ARB_OBS0_CHNL300_RDATA1_ADDR A:0xe60961c
y.create.l HWIO_PMIC_ARB_OBS0_CHNL301_RDATA1_ADDR A:0xe60969c
y.create.l HWIO_PMIC_ARB_OBS0_CHNL302_RDATA1_ADDR A:0xe60971c
y.create.l HWIO_PMIC_ARB_OBS0_CHNL303_RDATA1_ADDR A:0xe60979c
y.create.l HWIO_PMIC_ARB_OBS0_CHNL304_RDATA1_ADDR A:0xe60981c
y.create.l HWIO_PMIC_ARB_OBS0_CHNL305_RDATA1_ADDR A:0xe60989c
y.create.l HWIO_PMIC_ARB_OBS0_CHNL306_RDATA1_ADDR A:0xe60991c
y.create.l HWIO_PMIC_ARB_OBS0_CHNL307_RDATA1_ADDR A:0xe60999c
y.create.l HWIO_PMIC_ARB_OBS0_CHNL308_RDATA1_ADDR A:0xe609a1c
y.create.l HWIO_PMIC_ARB_OBS0_CHNL309_RDATA1_ADDR A:0xe609a9c
y.create.l HWIO_PMIC_ARB_OBS0_CHNL310_RDATA1_ADDR A:0xe609b1c
y.create.l HWIO_PMIC_ARB_OBS0_CHNL311_RDATA1_ADDR A:0xe609b9c
y.create.l HWIO_PMIC_ARB_OBS0_CHNL312_RDATA1_ADDR A:0xe609c1c
y.create.l HWIO_PMIC_ARB_OBS0_CHNL313_RDATA1_ADDR A:0xe609c9c
y.create.l HWIO_PMIC_ARB_OBS0_CHNL314_RDATA1_ADDR A:0xe609d1c
y.create.l HWIO_PMIC_ARB_OBS0_CHNL315_RDATA1_ADDR A:0xe609d9c
y.create.l HWIO_PMIC_ARB_OBS0_CHNL316_RDATA1_ADDR A:0xe609e1c
y.create.l HWIO_PMIC_ARB_OBS0_CHNL317_RDATA1_ADDR A:0xe609e9c
y.create.l HWIO_PMIC_ARB_OBS0_CHNL318_RDATA1_ADDR A:0xe609f1c
y.create.l HWIO_PMIC_ARB_OBS0_CHNL319_RDATA1_ADDR A:0xe609f9c
y.create.l HWIO_PMIC_ARB_OBS0_CHNL320_RDATA1_ADDR A:0xe60a01c
y.create.l HWIO_PMIC_ARB_OBS0_CHNL321_RDATA1_ADDR A:0xe60a09c
y.create.l HWIO_PMIC_ARB_OBS0_CHNL322_RDATA1_ADDR A:0xe60a11c
y.create.l HWIO_PMIC_ARB_OBS0_CHNL323_RDATA1_ADDR A:0xe60a19c
y.create.l HWIO_PMIC_ARB_OBS0_CHNL324_RDATA1_ADDR A:0xe60a21c
y.create.l HWIO_PMIC_ARB_OBS0_CHNL325_RDATA1_ADDR A:0xe60a29c
y.create.l HWIO_PMIC_ARB_OBS0_CHNL326_RDATA1_ADDR A:0xe60a31c
y.create.l HWIO_PMIC_ARB_OBS0_CHNL327_RDATA1_ADDR A:0xe60a39c
y.create.l HWIO_PMIC_ARB_OBS0_CHNL328_RDATA1_ADDR A:0xe60a41c
y.create.l HWIO_PMIC_ARB_OBS0_CHNL329_RDATA1_ADDR A:0xe60a49c
y.create.l HWIO_PMIC_ARB_OBS0_CHNL330_RDATA1_ADDR A:0xe60a51c
y.create.l HWIO_PMIC_ARB_OBS0_CHNL331_RDATA1_ADDR A:0xe60a59c
y.create.l HWIO_PMIC_ARB_OBS0_CHNL332_RDATA1_ADDR A:0xe60a61c
y.create.l HWIO_PMIC_ARB_OBS0_CHNL333_RDATA1_ADDR A:0xe60a69c
y.create.l HWIO_PMIC_ARB_OBS0_CHNL334_RDATA1_ADDR A:0xe60a71c
y.create.l HWIO_PMIC_ARB_OBS0_CHNL335_RDATA1_ADDR A:0xe60a79c
y.create.l HWIO_PMIC_ARB_OBS0_CHNL336_RDATA1_ADDR A:0xe60a81c
y.create.l HWIO_PMIC_ARB_OBS0_CHNL337_RDATA1_ADDR A:0xe60a89c
y.create.l HWIO_PMIC_ARB_OBS0_CHNL338_RDATA1_ADDR A:0xe60a91c
y.create.l HWIO_PMIC_ARB_OBS0_CHNL339_RDATA1_ADDR A:0xe60a99c
y.create.l HWIO_PMIC_ARB_OBS0_CHNL340_RDATA1_ADDR A:0xe60aa1c
y.create.l HWIO_PMIC_ARB_OBS0_CHNL341_RDATA1_ADDR A:0xe60aa9c
y.create.l HWIO_PMIC_ARB_OBS0_CHNL342_RDATA1_ADDR A:0xe60ab1c
y.create.l HWIO_PMIC_ARB_OBS0_CHNL343_RDATA1_ADDR A:0xe60ab9c
y.create.l HWIO_PMIC_ARB_OBS0_CHNL344_RDATA1_ADDR A:0xe60ac1c
y.create.l HWIO_PMIC_ARB_OBS0_CHNL345_RDATA1_ADDR A:0xe60ac9c
y.create.l HWIO_PMIC_ARB_OBS0_CHNL346_RDATA1_ADDR A:0xe60ad1c
y.create.l HWIO_PMIC_ARB_OBS0_CHNL347_RDATA1_ADDR A:0xe60ad9c
y.create.l HWIO_PMIC_ARB_OBS0_CHNL348_RDATA1_ADDR A:0xe60ae1c
y.create.l HWIO_PMIC_ARB_OBS0_CHNL349_RDATA1_ADDR A:0xe60ae9c
y.create.l HWIO_PMIC_ARB_OBS0_CHNL350_RDATA1_ADDR A:0xe60af1c
y.create.l HWIO_PMIC_ARB_OBS0_CHNL351_RDATA1_ADDR A:0xe60af9c
y.create.l HWIO_PMIC_ARB_OBS0_CHNL352_RDATA1_ADDR A:0xe60b01c
y.create.l HWIO_PMIC_ARB_OBS0_CHNL353_RDATA1_ADDR A:0xe60b09c
y.create.l HWIO_PMIC_ARB_OBS0_CHNL354_RDATA1_ADDR A:0xe60b11c
y.create.l HWIO_PMIC_ARB_OBS0_CHNL355_RDATA1_ADDR A:0xe60b19c
y.create.l HWIO_PMIC_ARB_OBS0_CHNL356_RDATA1_ADDR A:0xe60b21c
y.create.l HWIO_PMIC_ARB_OBS0_CHNL357_RDATA1_ADDR A:0xe60b29c
y.create.l HWIO_PMIC_ARB_OBS0_CHNL358_RDATA1_ADDR A:0xe60b31c
y.create.l HWIO_PMIC_ARB_OBS0_CHNL359_RDATA1_ADDR A:0xe60b39c
y.create.l HWIO_PMIC_ARB_OBS0_CHNL360_RDATA1_ADDR A:0xe60b41c
y.create.l HWIO_PMIC_ARB_OBS0_CHNL361_RDATA1_ADDR A:0xe60b49c
y.create.l HWIO_PMIC_ARB_OBS0_CHNL362_RDATA1_ADDR A:0xe60b51c
y.create.l HWIO_PMIC_ARB_OBS0_CHNL363_RDATA1_ADDR A:0xe60b59c
y.create.l HWIO_PMIC_ARB_OBS0_CHNL364_RDATA1_ADDR A:0xe60b61c
y.create.l HWIO_PMIC_ARB_OBS0_CHNL365_RDATA1_ADDR A:0xe60b69c
y.create.l HWIO_PMIC_ARB_OBS0_CHNL366_RDATA1_ADDR A:0xe60b71c
y.create.l HWIO_PMIC_ARB_OBS0_CHNL367_RDATA1_ADDR A:0xe60b79c
y.create.l HWIO_PMIC_ARB_OBS0_CHNL368_RDATA1_ADDR A:0xe60b81c
y.create.l HWIO_PMIC_ARB_OBS0_CHNL369_RDATA1_ADDR A:0xe60b89c
y.create.l HWIO_PMIC_ARB_OBS0_CHNL370_RDATA1_ADDR A:0xe60b91c
y.create.l HWIO_PMIC_ARB_OBS0_CHNL371_RDATA1_ADDR A:0xe60b99c
y.create.l HWIO_PMIC_ARB_OBS0_CHNL372_RDATA1_ADDR A:0xe60ba1c
y.create.l HWIO_PMIC_ARB_OBS0_CHNL373_RDATA1_ADDR A:0xe60ba9c
y.create.l HWIO_PMIC_ARB_OBS0_CHNL374_RDATA1_ADDR A:0xe60bb1c
y.create.l HWIO_PMIC_ARB_OBS0_CHNL375_RDATA1_ADDR A:0xe60bb9c
y.create.l HWIO_PMIC_ARB_OBS0_CHNL376_RDATA1_ADDR A:0xe60bc1c
y.create.l HWIO_PMIC_ARB_OBS0_CHNL377_RDATA1_ADDR A:0xe60bc9c
y.create.l HWIO_PMIC_ARB_OBS0_CHNL378_RDATA1_ADDR A:0xe60bd1c
y.create.l HWIO_PMIC_ARB_OBS0_CHNL379_RDATA1_ADDR A:0xe60bd9c
y.create.l HWIO_PMIC_ARB_OBS0_CHNL380_RDATA1_ADDR A:0xe60be1c
y.create.l HWIO_PMIC_ARB_OBS0_CHNL381_RDATA1_ADDR A:0xe60be9c
y.create.l HWIO_PMIC_ARB_OBS0_CHNL382_RDATA1_ADDR A:0xe60bf1c
y.create.l HWIO_PMIC_ARB_OBS0_CHNL383_RDATA1_ADDR A:0xe60bf9c
y.create.l HWIO_PMIC_ARB_OBS0_CHNL384_RDATA1_ADDR A:0xe60c01c
y.create.l HWIO_PMIC_ARB_OBS0_CHNL385_RDATA1_ADDR A:0xe60c09c
y.create.l HWIO_PMIC_ARB_OBS0_CHNL386_RDATA1_ADDR A:0xe60c11c
y.create.l HWIO_PMIC_ARB_OBS0_CHNL387_RDATA1_ADDR A:0xe60c19c
y.create.l HWIO_PMIC_ARB_OBS0_CHNL388_RDATA1_ADDR A:0xe60c21c
y.create.l HWIO_PMIC_ARB_OBS0_CHNL389_RDATA1_ADDR A:0xe60c29c
y.create.l HWIO_PMIC_ARB_OBS0_CHNL390_RDATA1_ADDR A:0xe60c31c
y.create.l HWIO_PMIC_ARB_OBS0_CHNL391_RDATA1_ADDR A:0xe60c39c
y.create.l HWIO_PMIC_ARB_OBS0_CHNL392_RDATA1_ADDR A:0xe60c41c
y.create.l HWIO_PMIC_ARB_OBS0_CHNL393_RDATA1_ADDR A:0xe60c49c
y.create.l HWIO_PMIC_ARB_OBS0_CHNL394_RDATA1_ADDR A:0xe60c51c
y.create.l HWIO_PMIC_ARB_OBS0_CHNL395_RDATA1_ADDR A:0xe60c59c
y.create.l HWIO_PMIC_ARB_OBS0_CHNL396_RDATA1_ADDR A:0xe60c61c
y.create.l HWIO_PMIC_ARB_OBS0_CHNL397_RDATA1_ADDR A:0xe60c69c
y.create.l HWIO_PMIC_ARB_OBS0_CHNL398_RDATA1_ADDR A:0xe60c71c
y.create.l HWIO_PMIC_ARB_OBS0_CHNL399_RDATA1_ADDR A:0xe60c79c
y.create.l HWIO_PMIC_ARB_OBS0_CHNL400_RDATA1_ADDR A:0xe60c81c
y.create.l HWIO_PMIC_ARB_OBS0_CHNL401_RDATA1_ADDR A:0xe60c89c
y.create.l HWIO_PMIC_ARB_OBS0_CHNL402_RDATA1_ADDR A:0xe60c91c
y.create.l HWIO_PMIC_ARB_OBS0_CHNL403_RDATA1_ADDR A:0xe60c99c
y.create.l HWIO_PMIC_ARB_OBS0_CHNL404_RDATA1_ADDR A:0xe60ca1c
y.create.l HWIO_PMIC_ARB_OBS0_CHNL405_RDATA1_ADDR A:0xe60ca9c
y.create.l HWIO_PMIC_ARB_OBS0_CHNL406_RDATA1_ADDR A:0xe60cb1c
y.create.l HWIO_PMIC_ARB_OBS0_CHNL407_RDATA1_ADDR A:0xe60cb9c
y.create.l HWIO_PMIC_ARB_OBS0_CHNL408_RDATA1_ADDR A:0xe60cc1c
y.create.l HWIO_PMIC_ARB_OBS0_CHNL409_RDATA1_ADDR A:0xe60cc9c
y.create.l HWIO_PMIC_ARB_OBS0_CHNL410_RDATA1_ADDR A:0xe60cd1c
y.create.l HWIO_PMIC_ARB_OBS0_CHNL411_RDATA1_ADDR A:0xe60cd9c
y.create.l HWIO_PMIC_ARB_OBS0_CHNL412_RDATA1_ADDR A:0xe60ce1c
y.create.l HWIO_PMIC_ARB_OBS0_CHNL413_RDATA1_ADDR A:0xe60ce9c
y.create.l HWIO_PMIC_ARB_OBS0_CHNL414_RDATA1_ADDR A:0xe60cf1c
y.create.l HWIO_PMIC_ARB_OBS0_CHNL415_RDATA1_ADDR A:0xe60cf9c
y.create.l HWIO_PMIC_ARB_OBS0_CHNL416_RDATA1_ADDR A:0xe60d01c
y.create.l HWIO_PMIC_ARB_OBS0_CHNL417_RDATA1_ADDR A:0xe60d09c
y.create.l HWIO_PMIC_ARB_OBS0_CHNL418_RDATA1_ADDR A:0xe60d11c
y.create.l HWIO_PMIC_ARB_OBS0_CHNL419_RDATA1_ADDR A:0xe60d19c
y.create.l HWIO_PMIC_ARB_OBS0_CHNL420_RDATA1_ADDR A:0xe60d21c
y.create.l HWIO_PMIC_ARB_OBS0_CHNL421_RDATA1_ADDR A:0xe60d29c
y.create.l HWIO_PMIC_ARB_OBS0_CHNL422_RDATA1_ADDR A:0xe60d31c
y.create.l HWIO_PMIC_ARB_OBS0_CHNL423_RDATA1_ADDR A:0xe60d39c
y.create.l HWIO_PMIC_ARB_OBS0_CHNL424_RDATA1_ADDR A:0xe60d41c
y.create.l HWIO_PMIC_ARB_OBS0_CHNL425_RDATA1_ADDR A:0xe60d49c
y.create.l HWIO_PMIC_ARB_OBS0_CHNL426_RDATA1_ADDR A:0xe60d51c
y.create.l HWIO_PMIC_ARB_OBS0_CHNL427_RDATA1_ADDR A:0xe60d59c
y.create.l HWIO_PMIC_ARB_OBS0_CHNL428_RDATA1_ADDR A:0xe60d61c
y.create.l HWIO_PMIC_ARB_OBS0_CHNL429_RDATA1_ADDR A:0xe60d69c
y.create.l HWIO_PMIC_ARB_OBS0_CHNL430_RDATA1_ADDR A:0xe60d71c
y.create.l HWIO_PMIC_ARB_OBS0_CHNL431_RDATA1_ADDR A:0xe60d79c
y.create.l HWIO_PMIC_ARB_OBS0_CHNL432_RDATA1_ADDR A:0xe60d81c
y.create.l HWIO_PMIC_ARB_OBS0_CHNL433_RDATA1_ADDR A:0xe60d89c
y.create.l HWIO_PMIC_ARB_OBS0_CHNL434_RDATA1_ADDR A:0xe60d91c
y.create.l HWIO_PMIC_ARB_OBS0_CHNL435_RDATA1_ADDR A:0xe60d99c
y.create.l HWIO_PMIC_ARB_OBS0_CHNL436_RDATA1_ADDR A:0xe60da1c
y.create.l HWIO_PMIC_ARB_OBS0_CHNL437_RDATA1_ADDR A:0xe60da9c
y.create.l HWIO_PMIC_ARB_OBS0_CHNL438_RDATA1_ADDR A:0xe60db1c
y.create.l HWIO_PMIC_ARB_OBS0_CHNL439_RDATA1_ADDR A:0xe60db9c
y.create.l HWIO_PMIC_ARB_OBS0_CHNL440_RDATA1_ADDR A:0xe60dc1c
y.create.l HWIO_PMIC_ARB_OBS0_CHNL441_RDATA1_ADDR A:0xe60dc9c
y.create.l HWIO_PMIC_ARB_OBS0_CHNL442_RDATA1_ADDR A:0xe60dd1c
y.create.l HWIO_PMIC_ARB_OBS0_CHNL443_RDATA1_ADDR A:0xe60dd9c
y.create.l HWIO_PMIC_ARB_OBS0_CHNL444_RDATA1_ADDR A:0xe60de1c
y.create.l HWIO_PMIC_ARB_OBS0_CHNL445_RDATA1_ADDR A:0xe60de9c
y.create.l HWIO_PMIC_ARB_OBS0_CHNL446_RDATA1_ADDR A:0xe60df1c
y.create.l HWIO_PMIC_ARB_OBS0_CHNL447_RDATA1_ADDR A:0xe60df9c
y.create.l HWIO_PMIC_ARB_OBS0_CHNL448_RDATA1_ADDR A:0xe60e01c
y.create.l HWIO_PMIC_ARB_OBS0_CHNL449_RDATA1_ADDR A:0xe60e09c
y.create.l HWIO_PMIC_ARB_OBS0_CHNL450_RDATA1_ADDR A:0xe60e11c
y.create.l HWIO_PMIC_ARB_OBS0_CHNL451_RDATA1_ADDR A:0xe60e19c
y.create.l HWIO_PMIC_ARB_OBS0_CHNL452_RDATA1_ADDR A:0xe60e21c
y.create.l HWIO_PMIC_ARB_OBS0_CHNL453_RDATA1_ADDR A:0xe60e29c
y.create.l HWIO_PMIC_ARB_OBS0_CHNL454_RDATA1_ADDR A:0xe60e31c
y.create.l HWIO_PMIC_ARB_OBS0_CHNL455_RDATA1_ADDR A:0xe60e39c
y.create.l HWIO_PMIC_ARB_OBS0_CHNL456_RDATA1_ADDR A:0xe60e41c
y.create.l HWIO_PMIC_ARB_OBS0_CHNL457_RDATA1_ADDR A:0xe60e49c
y.create.l HWIO_PMIC_ARB_OBS0_CHNL458_RDATA1_ADDR A:0xe60e51c
y.create.l HWIO_PMIC_ARB_OBS0_CHNL459_RDATA1_ADDR A:0xe60e59c
y.create.l HWIO_PMIC_ARB_OBS0_CHNL460_RDATA1_ADDR A:0xe60e61c
y.create.l HWIO_PMIC_ARB_OBS0_CHNL461_RDATA1_ADDR A:0xe60e69c
y.create.l HWIO_PMIC_ARB_OBS0_CHNL462_RDATA1_ADDR A:0xe60e71c
y.create.l HWIO_PMIC_ARB_OBS0_CHNL463_RDATA1_ADDR A:0xe60e79c
y.create.l HWIO_PMIC_ARB_OBS0_CHNL464_RDATA1_ADDR A:0xe60e81c
y.create.l HWIO_PMIC_ARB_OBS0_CHNL465_RDATA1_ADDR A:0xe60e89c
y.create.l HWIO_PMIC_ARB_OBS0_CHNL466_RDATA1_ADDR A:0xe60e91c
y.create.l HWIO_PMIC_ARB_OBS0_CHNL467_RDATA1_ADDR A:0xe60e99c
y.create.l HWIO_PMIC_ARB_OBS0_CHNL468_RDATA1_ADDR A:0xe60ea1c
y.create.l HWIO_PMIC_ARB_OBS0_CHNL469_RDATA1_ADDR A:0xe60ea9c
y.create.l HWIO_PMIC_ARB_OBS0_CHNL470_RDATA1_ADDR A:0xe60eb1c
y.create.l HWIO_PMIC_ARB_OBS0_CHNL471_RDATA1_ADDR A:0xe60eb9c
y.create.l HWIO_PMIC_ARB_OBS0_CHNL472_RDATA1_ADDR A:0xe60ec1c
y.create.l HWIO_PMIC_ARB_OBS0_CHNL473_RDATA1_ADDR A:0xe60ec9c
y.create.l HWIO_PMIC_ARB_OBS0_CHNL474_RDATA1_ADDR A:0xe60ed1c
y.create.l HWIO_PMIC_ARB_OBS0_CHNL475_RDATA1_ADDR A:0xe60ed9c
y.create.l HWIO_PMIC_ARB_OBS0_CHNL476_RDATA1_ADDR A:0xe60ee1c
y.create.l HWIO_PMIC_ARB_OBS0_CHNL477_RDATA1_ADDR A:0xe60ee9c
y.create.l HWIO_PMIC_ARB_OBS0_CHNL478_RDATA1_ADDR A:0xe60ef1c
y.create.l HWIO_PMIC_ARB_OBS0_CHNL479_RDATA1_ADDR A:0xe60ef9c
y.create.l HWIO_PMIC_ARB_OBS0_CHNL480_RDATA1_ADDR A:0xe60f01c
y.create.l HWIO_PMIC_ARB_OBS0_CHNL481_RDATA1_ADDR A:0xe60f09c
y.create.l HWIO_PMIC_ARB_OBS0_CHNL482_RDATA1_ADDR A:0xe60f11c
y.create.l HWIO_PMIC_ARB_OBS0_CHNL483_RDATA1_ADDR A:0xe60f19c
y.create.l HWIO_PMIC_ARB_OBS0_CHNL484_RDATA1_ADDR A:0xe60f21c
y.create.l HWIO_PMIC_ARB_OBS0_CHNL485_RDATA1_ADDR A:0xe60f29c
y.create.l HWIO_PMIC_ARB_OBS0_CHNL486_RDATA1_ADDR A:0xe60f31c
y.create.l HWIO_PMIC_ARB_OBS0_CHNL487_RDATA1_ADDR A:0xe60f39c
y.create.l HWIO_PMIC_ARB_OBS0_CHNL488_RDATA1_ADDR A:0xe60f41c
y.create.l HWIO_PMIC_ARB_OBS0_CHNL489_RDATA1_ADDR A:0xe60f49c
y.create.l HWIO_PMIC_ARB_OBS0_CHNL490_RDATA1_ADDR A:0xe60f51c
y.create.l HWIO_PMIC_ARB_OBS0_CHNL491_RDATA1_ADDR A:0xe60f59c
y.create.l HWIO_PMIC_ARB_OBS0_CHNL492_RDATA1_ADDR A:0xe60f61c
y.create.l HWIO_PMIC_ARB_OBS0_CHNL493_RDATA1_ADDR A:0xe60f69c
y.create.l HWIO_PMIC_ARB_OBS0_CHNL494_RDATA1_ADDR A:0xe60f71c
y.create.l HWIO_PMIC_ARB_OBS0_CHNL495_RDATA1_ADDR A:0xe60f79c
y.create.l HWIO_PMIC_ARB_OBS0_CHNL496_RDATA1_ADDR A:0xe60f81c
y.create.l HWIO_PMIC_ARB_OBS0_CHNL497_RDATA1_ADDR A:0xe60f89c
y.create.l HWIO_PMIC_ARB_OBS0_CHNL498_RDATA1_ADDR A:0xe60f91c
y.create.l HWIO_PMIC_ARB_OBS0_CHNL499_RDATA1_ADDR A:0xe60f99c
y.create.l HWIO_PMIC_ARB_OBS0_CHNL500_RDATA1_ADDR A:0xe60fa1c
y.create.l HWIO_PMIC_ARB_OBS0_CHNL501_RDATA1_ADDR A:0xe60fa9c
y.create.l HWIO_PMIC_ARB_OBS0_CHNL502_RDATA1_ADDR A:0xe60fb1c
y.create.l HWIO_PMIC_ARB_OBS0_CHNL503_RDATA1_ADDR A:0xe60fb9c
y.create.l HWIO_PMIC_ARB_OBS0_CHNL504_RDATA1_ADDR A:0xe60fc1c
y.create.l HWIO_PMIC_ARB_OBS0_CHNL505_RDATA1_ADDR A:0xe60fc9c
y.create.l HWIO_PMIC_ARB_OBS0_CHNL506_RDATA1_ADDR A:0xe60fd1c
y.create.l HWIO_PMIC_ARB_OBS0_CHNL507_RDATA1_ADDR A:0xe60fd9c
y.create.l HWIO_PMIC_ARB_OBS0_CHNL508_RDATA1_ADDR A:0xe60fe1c
y.create.l HWIO_PMIC_ARB_OBS0_CHNL509_RDATA1_ADDR A:0xe60fe9c
y.create.l HWIO_PMIC_ARB_OBS0_CHNL510_RDATA1_ADDR A:0xe60ff1c
y.create.l HWIO_PMIC_ARB_OBS0_CHNL511_RDATA1_ADDR A:0xe60ff9c
y.create.l HWIO_PMIC_ARB_OBS1_CHNL0_RDATA1_ADDR A:0xe61001c
y.create.l HWIO_PMIC_ARB_OBS1_CHNL1_RDATA1_ADDR A:0xe61009c
y.create.l HWIO_PMIC_ARB_OBS1_CHNL2_RDATA1_ADDR A:0xe61011c
y.create.l HWIO_PMIC_ARB_OBS1_CHNL3_RDATA1_ADDR A:0xe61019c
y.create.l HWIO_PMIC_ARB_OBS1_CHNL4_RDATA1_ADDR A:0xe61021c
y.create.l HWIO_PMIC_ARB_OBS1_CHNL5_RDATA1_ADDR A:0xe61029c
y.create.l HWIO_PMIC_ARB_OBS1_CHNL6_RDATA1_ADDR A:0xe61031c
y.create.l HWIO_PMIC_ARB_OBS1_CHNL7_RDATA1_ADDR A:0xe61039c
y.create.l HWIO_PMIC_ARB_OBS1_CHNL8_RDATA1_ADDR A:0xe61041c
y.create.l HWIO_PMIC_ARB_OBS1_CHNL9_RDATA1_ADDR A:0xe61049c
y.create.l HWIO_PMIC_ARB_OBS1_CHNL10_RDATA1_ADDR A:0xe61051c
y.create.l HWIO_PMIC_ARB_OBS1_CHNL11_RDATA1_ADDR A:0xe61059c
y.create.l HWIO_PMIC_ARB_OBS1_CHNL12_RDATA1_ADDR A:0xe61061c
y.create.l HWIO_PMIC_ARB_OBS1_CHNL13_RDATA1_ADDR A:0xe61069c
y.create.l HWIO_PMIC_ARB_OBS1_CHNL14_RDATA1_ADDR A:0xe61071c
y.create.l HWIO_PMIC_ARB_OBS1_CHNL15_RDATA1_ADDR A:0xe61079c
y.create.l HWIO_PMIC_ARB_OBS1_CHNL16_RDATA1_ADDR A:0xe61081c
y.create.l HWIO_PMIC_ARB_OBS1_CHNL17_RDATA1_ADDR A:0xe61089c
y.create.l HWIO_PMIC_ARB_OBS1_CHNL18_RDATA1_ADDR A:0xe61091c
y.create.l HWIO_PMIC_ARB_OBS1_CHNL19_RDATA1_ADDR A:0xe61099c
y.create.l HWIO_PMIC_ARB_OBS1_CHNL20_RDATA1_ADDR A:0xe610a1c
y.create.l HWIO_PMIC_ARB_OBS1_CHNL21_RDATA1_ADDR A:0xe610a9c
y.create.l HWIO_PMIC_ARB_OBS1_CHNL22_RDATA1_ADDR A:0xe610b1c
y.create.l HWIO_PMIC_ARB_OBS1_CHNL23_RDATA1_ADDR A:0xe610b9c
y.create.l HWIO_PMIC_ARB_OBS1_CHNL24_RDATA1_ADDR A:0xe610c1c
y.create.l HWIO_PMIC_ARB_OBS1_CHNL25_RDATA1_ADDR A:0xe610c9c
y.create.l HWIO_PMIC_ARB_OBS1_CHNL26_RDATA1_ADDR A:0xe610d1c
y.create.l HWIO_PMIC_ARB_OBS1_CHNL27_RDATA1_ADDR A:0xe610d9c
y.create.l HWIO_PMIC_ARB_OBS1_CHNL28_RDATA1_ADDR A:0xe610e1c
y.create.l HWIO_PMIC_ARB_OBS1_CHNL29_RDATA1_ADDR A:0xe610e9c
y.create.l HWIO_PMIC_ARB_OBS1_CHNL30_RDATA1_ADDR A:0xe610f1c
y.create.l HWIO_PMIC_ARB_OBS1_CHNL31_RDATA1_ADDR A:0xe610f9c
y.create.l HWIO_PMIC_ARB_OBS1_CHNL32_RDATA1_ADDR A:0xe61101c
y.create.l HWIO_PMIC_ARB_OBS1_CHNL33_RDATA1_ADDR A:0xe61109c
y.create.l HWIO_PMIC_ARB_OBS1_CHNL34_RDATA1_ADDR A:0xe61111c
y.create.l HWIO_PMIC_ARB_OBS1_CHNL35_RDATA1_ADDR A:0xe61119c
y.create.l HWIO_PMIC_ARB_OBS1_CHNL36_RDATA1_ADDR A:0xe61121c
y.create.l HWIO_PMIC_ARB_OBS1_CHNL37_RDATA1_ADDR A:0xe61129c
y.create.l HWIO_PMIC_ARB_OBS1_CHNL38_RDATA1_ADDR A:0xe61131c
y.create.l HWIO_PMIC_ARB_OBS1_CHNL39_RDATA1_ADDR A:0xe61139c
y.create.l HWIO_PMIC_ARB_OBS1_CHNL40_RDATA1_ADDR A:0xe61141c
y.create.l HWIO_PMIC_ARB_OBS1_CHNL41_RDATA1_ADDR A:0xe61149c
y.create.l HWIO_PMIC_ARB_OBS1_CHNL42_RDATA1_ADDR A:0xe61151c
y.create.l HWIO_PMIC_ARB_OBS1_CHNL43_RDATA1_ADDR A:0xe61159c
y.create.l HWIO_PMIC_ARB_OBS1_CHNL44_RDATA1_ADDR A:0xe61161c
y.create.l HWIO_PMIC_ARB_OBS1_CHNL45_RDATA1_ADDR A:0xe61169c
y.create.l HWIO_PMIC_ARB_OBS1_CHNL46_RDATA1_ADDR A:0xe61171c
y.create.l HWIO_PMIC_ARB_OBS1_CHNL47_RDATA1_ADDR A:0xe61179c
y.create.l HWIO_PMIC_ARB_OBS1_CHNL48_RDATA1_ADDR A:0xe61181c
y.create.l HWIO_PMIC_ARB_OBS1_CHNL49_RDATA1_ADDR A:0xe61189c
y.create.l HWIO_PMIC_ARB_OBS1_CHNL50_RDATA1_ADDR A:0xe61191c
y.create.l HWIO_PMIC_ARB_OBS1_CHNL51_RDATA1_ADDR A:0xe61199c
y.create.l HWIO_PMIC_ARB_OBS1_CHNL52_RDATA1_ADDR A:0xe611a1c
y.create.l HWIO_PMIC_ARB_OBS1_CHNL53_RDATA1_ADDR A:0xe611a9c
y.create.l HWIO_PMIC_ARB_OBS1_CHNL54_RDATA1_ADDR A:0xe611b1c
y.create.l HWIO_PMIC_ARB_OBS1_CHNL55_RDATA1_ADDR A:0xe611b9c
y.create.l HWIO_PMIC_ARB_OBS1_CHNL56_RDATA1_ADDR A:0xe611c1c
y.create.l HWIO_PMIC_ARB_OBS1_CHNL57_RDATA1_ADDR A:0xe611c9c
y.create.l HWIO_PMIC_ARB_OBS1_CHNL58_RDATA1_ADDR A:0xe611d1c
y.create.l HWIO_PMIC_ARB_OBS1_CHNL59_RDATA1_ADDR A:0xe611d9c
y.create.l HWIO_PMIC_ARB_OBS1_CHNL60_RDATA1_ADDR A:0xe611e1c
y.create.l HWIO_PMIC_ARB_OBS1_CHNL61_RDATA1_ADDR A:0xe611e9c
y.create.l HWIO_PMIC_ARB_OBS1_CHNL62_RDATA1_ADDR A:0xe611f1c
y.create.l HWIO_PMIC_ARB_OBS1_CHNL63_RDATA1_ADDR A:0xe611f9c
y.create.l HWIO_PMIC_ARB_OBS1_CHNL64_RDATA1_ADDR A:0xe61201c
y.create.l HWIO_PMIC_ARB_OBS1_CHNL65_RDATA1_ADDR A:0xe61209c
y.create.l HWIO_PMIC_ARB_OBS1_CHNL66_RDATA1_ADDR A:0xe61211c
y.create.l HWIO_PMIC_ARB_OBS1_CHNL67_RDATA1_ADDR A:0xe61219c
y.create.l HWIO_PMIC_ARB_OBS1_CHNL68_RDATA1_ADDR A:0xe61221c
y.create.l HWIO_PMIC_ARB_OBS1_CHNL69_RDATA1_ADDR A:0xe61229c
y.create.l HWIO_PMIC_ARB_OBS1_CHNL70_RDATA1_ADDR A:0xe61231c
y.create.l HWIO_PMIC_ARB_OBS1_CHNL71_RDATA1_ADDR A:0xe61239c
y.create.l HWIO_PMIC_ARB_OBS1_CHNL72_RDATA1_ADDR A:0xe61241c
y.create.l HWIO_PMIC_ARB_OBS1_CHNL73_RDATA1_ADDR A:0xe61249c
y.create.l HWIO_PMIC_ARB_OBS1_CHNL74_RDATA1_ADDR A:0xe61251c
y.create.l HWIO_PMIC_ARB_OBS1_CHNL75_RDATA1_ADDR A:0xe61259c
y.create.l HWIO_PMIC_ARB_OBS1_CHNL76_RDATA1_ADDR A:0xe61261c
y.create.l HWIO_PMIC_ARB_OBS1_CHNL77_RDATA1_ADDR A:0xe61269c
y.create.l HWIO_PMIC_ARB_OBS1_CHNL78_RDATA1_ADDR A:0xe61271c
y.create.l HWIO_PMIC_ARB_OBS1_CHNL79_RDATA1_ADDR A:0xe61279c
y.create.l HWIO_PMIC_ARB_OBS1_CHNL80_RDATA1_ADDR A:0xe61281c
y.create.l HWIO_PMIC_ARB_OBS1_CHNL81_RDATA1_ADDR A:0xe61289c
y.create.l HWIO_PMIC_ARB_OBS1_CHNL82_RDATA1_ADDR A:0xe61291c
y.create.l HWIO_PMIC_ARB_OBS1_CHNL83_RDATA1_ADDR A:0xe61299c
y.create.l HWIO_PMIC_ARB_OBS1_CHNL84_RDATA1_ADDR A:0xe612a1c
y.create.l HWIO_PMIC_ARB_OBS1_CHNL85_RDATA1_ADDR A:0xe612a9c
y.create.l HWIO_PMIC_ARB_OBS1_CHNL86_RDATA1_ADDR A:0xe612b1c
y.create.l HWIO_PMIC_ARB_OBS1_CHNL87_RDATA1_ADDR A:0xe612b9c
y.create.l HWIO_PMIC_ARB_OBS1_CHNL88_RDATA1_ADDR A:0xe612c1c
y.create.l HWIO_PMIC_ARB_OBS1_CHNL89_RDATA1_ADDR A:0xe612c9c
y.create.l HWIO_PMIC_ARB_OBS1_CHNL90_RDATA1_ADDR A:0xe612d1c
y.create.l HWIO_PMIC_ARB_OBS1_CHNL91_RDATA1_ADDR A:0xe612d9c
y.create.l HWIO_PMIC_ARB_OBS1_CHNL92_RDATA1_ADDR A:0xe612e1c
y.create.l HWIO_PMIC_ARB_OBS1_CHNL93_RDATA1_ADDR A:0xe612e9c
y.create.l HWIO_PMIC_ARB_OBS1_CHNL94_RDATA1_ADDR A:0xe612f1c
y.create.l HWIO_PMIC_ARB_OBS1_CHNL95_RDATA1_ADDR A:0xe612f9c
y.create.l HWIO_PMIC_ARB_OBS1_CHNL96_RDATA1_ADDR A:0xe61301c
y.create.l HWIO_PMIC_ARB_OBS1_CHNL97_RDATA1_ADDR A:0xe61309c
y.create.l HWIO_PMIC_ARB_OBS1_CHNL98_RDATA1_ADDR A:0xe61311c
y.create.l HWIO_PMIC_ARB_OBS1_CHNL99_RDATA1_ADDR A:0xe61319c
y.create.l HWIO_PMIC_ARB_OBS1_CHNL100_RDATA1_ADDR A:0xe61321c
y.create.l HWIO_PMIC_ARB_OBS1_CHNL101_RDATA1_ADDR A:0xe61329c
y.create.l HWIO_PMIC_ARB_OBS1_CHNL102_RDATA1_ADDR A:0xe61331c
y.create.l HWIO_PMIC_ARB_OBS1_CHNL103_RDATA1_ADDR A:0xe61339c
y.create.l HWIO_PMIC_ARB_OBS1_CHNL104_RDATA1_ADDR A:0xe61341c
y.create.l HWIO_PMIC_ARB_OBS1_CHNL105_RDATA1_ADDR A:0xe61349c
y.create.l HWIO_PMIC_ARB_OBS1_CHNL106_RDATA1_ADDR A:0xe61351c
y.create.l HWIO_PMIC_ARB_OBS1_CHNL107_RDATA1_ADDR A:0xe61359c
y.create.l HWIO_PMIC_ARB_OBS1_CHNL108_RDATA1_ADDR A:0xe61361c
y.create.l HWIO_PMIC_ARB_OBS1_CHNL109_RDATA1_ADDR A:0xe61369c
y.create.l HWIO_PMIC_ARB_OBS1_CHNL110_RDATA1_ADDR A:0xe61371c
y.create.l HWIO_PMIC_ARB_OBS1_CHNL111_RDATA1_ADDR A:0xe61379c
y.create.l HWIO_PMIC_ARB_OBS1_CHNL112_RDATA1_ADDR A:0xe61381c
y.create.l HWIO_PMIC_ARB_OBS1_CHNL113_RDATA1_ADDR A:0xe61389c
y.create.l HWIO_PMIC_ARB_OBS1_CHNL114_RDATA1_ADDR A:0xe61391c
y.create.l HWIO_PMIC_ARB_OBS1_CHNL115_RDATA1_ADDR A:0xe61399c
y.create.l HWIO_PMIC_ARB_OBS1_CHNL116_RDATA1_ADDR A:0xe613a1c
y.create.l HWIO_PMIC_ARB_OBS1_CHNL117_RDATA1_ADDR A:0xe613a9c
y.create.l HWIO_PMIC_ARB_OBS1_CHNL118_RDATA1_ADDR A:0xe613b1c
y.create.l HWIO_PMIC_ARB_OBS1_CHNL119_RDATA1_ADDR A:0xe613b9c
y.create.l HWIO_PMIC_ARB_OBS1_CHNL120_RDATA1_ADDR A:0xe613c1c
y.create.l HWIO_PMIC_ARB_OBS1_CHNL121_RDATA1_ADDR A:0xe613c9c
y.create.l HWIO_PMIC_ARB_OBS1_CHNL122_RDATA1_ADDR A:0xe613d1c
y.create.l HWIO_PMIC_ARB_OBS1_CHNL123_RDATA1_ADDR A:0xe613d9c
y.create.l HWIO_PMIC_ARB_OBS1_CHNL124_RDATA1_ADDR A:0xe613e1c
y.create.l HWIO_PMIC_ARB_OBS1_CHNL125_RDATA1_ADDR A:0xe613e9c
y.create.l HWIO_PMIC_ARB_OBS1_CHNL126_RDATA1_ADDR A:0xe613f1c
y.create.l HWIO_PMIC_ARB_OBS1_CHNL127_RDATA1_ADDR A:0xe613f9c
y.create.l HWIO_PMIC_ARB_OBS1_CHNL128_RDATA1_ADDR A:0xe61401c
y.create.l HWIO_PMIC_ARB_OBS1_CHNL129_RDATA1_ADDR A:0xe61409c
y.create.l HWIO_PMIC_ARB_OBS1_CHNL130_RDATA1_ADDR A:0xe61411c
y.create.l HWIO_PMIC_ARB_OBS1_CHNL131_RDATA1_ADDR A:0xe61419c
y.create.l HWIO_PMIC_ARB_OBS1_CHNL132_RDATA1_ADDR A:0xe61421c
y.create.l HWIO_PMIC_ARB_OBS1_CHNL133_RDATA1_ADDR A:0xe61429c
y.create.l HWIO_PMIC_ARB_OBS1_CHNL134_RDATA1_ADDR A:0xe61431c
y.create.l HWIO_PMIC_ARB_OBS1_CHNL135_RDATA1_ADDR A:0xe61439c
y.create.l HWIO_PMIC_ARB_OBS1_CHNL136_RDATA1_ADDR A:0xe61441c
y.create.l HWIO_PMIC_ARB_OBS1_CHNL137_RDATA1_ADDR A:0xe61449c
y.create.l HWIO_PMIC_ARB_OBS1_CHNL138_RDATA1_ADDR A:0xe61451c
y.create.l HWIO_PMIC_ARB_OBS1_CHNL139_RDATA1_ADDR A:0xe61459c
y.create.l HWIO_PMIC_ARB_OBS1_CHNL140_RDATA1_ADDR A:0xe61461c
y.create.l HWIO_PMIC_ARB_OBS1_CHNL141_RDATA1_ADDR A:0xe61469c
y.create.l HWIO_PMIC_ARB_OBS1_CHNL142_RDATA1_ADDR A:0xe61471c
y.create.l HWIO_PMIC_ARB_OBS1_CHNL143_RDATA1_ADDR A:0xe61479c
y.create.l HWIO_PMIC_ARB_OBS1_CHNL144_RDATA1_ADDR A:0xe61481c
y.create.l HWIO_PMIC_ARB_OBS1_CHNL145_RDATA1_ADDR A:0xe61489c
y.create.l HWIO_PMIC_ARB_OBS1_CHNL146_RDATA1_ADDR A:0xe61491c
y.create.l HWIO_PMIC_ARB_OBS1_CHNL147_RDATA1_ADDR A:0xe61499c
y.create.l HWIO_PMIC_ARB_OBS1_CHNL148_RDATA1_ADDR A:0xe614a1c
y.create.l HWIO_PMIC_ARB_OBS1_CHNL149_RDATA1_ADDR A:0xe614a9c
y.create.l HWIO_PMIC_ARB_OBS1_CHNL150_RDATA1_ADDR A:0xe614b1c
y.create.l HWIO_PMIC_ARB_OBS1_CHNL151_RDATA1_ADDR A:0xe614b9c
y.create.l HWIO_PMIC_ARB_OBS1_CHNL152_RDATA1_ADDR A:0xe614c1c
y.create.l HWIO_PMIC_ARB_OBS1_CHNL153_RDATA1_ADDR A:0xe614c9c
y.create.l HWIO_PMIC_ARB_OBS1_CHNL154_RDATA1_ADDR A:0xe614d1c
y.create.l HWIO_PMIC_ARB_OBS1_CHNL155_RDATA1_ADDR A:0xe614d9c
y.create.l HWIO_PMIC_ARB_OBS1_CHNL156_RDATA1_ADDR A:0xe614e1c
y.create.l HWIO_PMIC_ARB_OBS1_CHNL157_RDATA1_ADDR A:0xe614e9c
y.create.l HWIO_PMIC_ARB_OBS1_CHNL158_RDATA1_ADDR A:0xe614f1c
y.create.l HWIO_PMIC_ARB_OBS1_CHNL159_RDATA1_ADDR A:0xe614f9c
y.create.l HWIO_PMIC_ARB_OBS1_CHNL160_RDATA1_ADDR A:0xe61501c
y.create.l HWIO_PMIC_ARB_OBS1_CHNL161_RDATA1_ADDR A:0xe61509c
y.create.l HWIO_PMIC_ARB_OBS1_CHNL162_RDATA1_ADDR A:0xe61511c
y.create.l HWIO_PMIC_ARB_OBS1_CHNL163_RDATA1_ADDR A:0xe61519c
y.create.l HWIO_PMIC_ARB_OBS1_CHNL164_RDATA1_ADDR A:0xe61521c
y.create.l HWIO_PMIC_ARB_OBS1_CHNL165_RDATA1_ADDR A:0xe61529c
y.create.l HWIO_PMIC_ARB_OBS1_CHNL166_RDATA1_ADDR A:0xe61531c
y.create.l HWIO_PMIC_ARB_OBS1_CHNL167_RDATA1_ADDR A:0xe61539c
y.create.l HWIO_PMIC_ARB_OBS1_CHNL168_RDATA1_ADDR A:0xe61541c
y.create.l HWIO_PMIC_ARB_OBS1_CHNL169_RDATA1_ADDR A:0xe61549c
y.create.l HWIO_PMIC_ARB_OBS1_CHNL170_RDATA1_ADDR A:0xe61551c
y.create.l HWIO_PMIC_ARB_OBS1_CHNL171_RDATA1_ADDR A:0xe61559c
y.create.l HWIO_PMIC_ARB_OBS1_CHNL172_RDATA1_ADDR A:0xe61561c
y.create.l HWIO_PMIC_ARB_OBS1_CHNL173_RDATA1_ADDR A:0xe61569c
y.create.l HWIO_PMIC_ARB_OBS1_CHNL174_RDATA1_ADDR A:0xe61571c
y.create.l HWIO_PMIC_ARB_OBS1_CHNL175_RDATA1_ADDR A:0xe61579c
y.create.l HWIO_PMIC_ARB_OBS1_CHNL176_RDATA1_ADDR A:0xe61581c
y.create.l HWIO_PMIC_ARB_OBS1_CHNL177_RDATA1_ADDR A:0xe61589c
y.create.l HWIO_PMIC_ARB_OBS1_CHNL178_RDATA1_ADDR A:0xe61591c
y.create.l HWIO_PMIC_ARB_OBS1_CHNL179_RDATA1_ADDR A:0xe61599c
y.create.l HWIO_PMIC_ARB_OBS1_CHNL180_RDATA1_ADDR A:0xe615a1c
y.create.l HWIO_PMIC_ARB_OBS1_CHNL181_RDATA1_ADDR A:0xe615a9c
y.create.l HWIO_PMIC_ARB_OBS1_CHNL182_RDATA1_ADDR A:0xe615b1c
y.create.l HWIO_PMIC_ARB_OBS1_CHNL183_RDATA1_ADDR A:0xe615b9c
y.create.l HWIO_PMIC_ARB_OBS1_CHNL184_RDATA1_ADDR A:0xe615c1c
y.create.l HWIO_PMIC_ARB_OBS1_CHNL185_RDATA1_ADDR A:0xe615c9c
y.create.l HWIO_PMIC_ARB_OBS1_CHNL186_RDATA1_ADDR A:0xe615d1c
y.create.l HWIO_PMIC_ARB_OBS1_CHNL187_RDATA1_ADDR A:0xe615d9c
y.create.l HWIO_PMIC_ARB_OBS1_CHNL188_RDATA1_ADDR A:0xe615e1c
y.create.l HWIO_PMIC_ARB_OBS1_CHNL189_RDATA1_ADDR A:0xe615e9c
y.create.l HWIO_PMIC_ARB_OBS1_CHNL190_RDATA1_ADDR A:0xe615f1c
y.create.l HWIO_PMIC_ARB_OBS1_CHNL191_RDATA1_ADDR A:0xe615f9c
y.create.l HWIO_PMIC_ARB_OBS1_CHNL192_RDATA1_ADDR A:0xe61601c
y.create.l HWIO_PMIC_ARB_OBS1_CHNL193_RDATA1_ADDR A:0xe61609c
y.create.l HWIO_PMIC_ARB_OBS1_CHNL194_RDATA1_ADDR A:0xe61611c
y.create.l HWIO_PMIC_ARB_OBS1_CHNL195_RDATA1_ADDR A:0xe61619c
y.create.l HWIO_PMIC_ARB_OBS1_CHNL196_RDATA1_ADDR A:0xe61621c
y.create.l HWIO_PMIC_ARB_OBS1_CHNL197_RDATA1_ADDR A:0xe61629c
y.create.l HWIO_PMIC_ARB_OBS1_CHNL198_RDATA1_ADDR A:0xe61631c
y.create.l HWIO_PMIC_ARB_OBS1_CHNL199_RDATA1_ADDR A:0xe61639c
y.create.l HWIO_PMIC_ARB_OBS1_CHNL200_RDATA1_ADDR A:0xe61641c
y.create.l HWIO_PMIC_ARB_OBS1_CHNL201_RDATA1_ADDR A:0xe61649c
y.create.l HWIO_PMIC_ARB_OBS1_CHNL202_RDATA1_ADDR A:0xe61651c
y.create.l HWIO_PMIC_ARB_OBS1_CHNL203_RDATA1_ADDR A:0xe61659c
y.create.l HWIO_PMIC_ARB_OBS1_CHNL204_RDATA1_ADDR A:0xe61661c
y.create.l HWIO_PMIC_ARB_OBS1_CHNL205_RDATA1_ADDR A:0xe61669c
y.create.l HWIO_PMIC_ARB_OBS1_CHNL206_RDATA1_ADDR A:0xe61671c
y.create.l HWIO_PMIC_ARB_OBS1_CHNL207_RDATA1_ADDR A:0xe61679c
y.create.l HWIO_PMIC_ARB_OBS1_CHNL208_RDATA1_ADDR A:0xe61681c
y.create.l HWIO_PMIC_ARB_OBS1_CHNL209_RDATA1_ADDR A:0xe61689c
y.create.l HWIO_PMIC_ARB_OBS1_CHNL210_RDATA1_ADDR A:0xe61691c
y.create.l HWIO_PMIC_ARB_OBS1_CHNL211_RDATA1_ADDR A:0xe61699c
y.create.l HWIO_PMIC_ARB_OBS1_CHNL212_RDATA1_ADDR A:0xe616a1c
y.create.l HWIO_PMIC_ARB_OBS1_CHNL213_RDATA1_ADDR A:0xe616a9c
y.create.l HWIO_PMIC_ARB_OBS1_CHNL214_RDATA1_ADDR A:0xe616b1c
y.create.l HWIO_PMIC_ARB_OBS1_CHNL215_RDATA1_ADDR A:0xe616b9c
y.create.l HWIO_PMIC_ARB_OBS1_CHNL216_RDATA1_ADDR A:0xe616c1c
y.create.l HWIO_PMIC_ARB_OBS1_CHNL217_RDATA1_ADDR A:0xe616c9c
y.create.l HWIO_PMIC_ARB_OBS1_CHNL218_RDATA1_ADDR A:0xe616d1c
y.create.l HWIO_PMIC_ARB_OBS1_CHNL219_RDATA1_ADDR A:0xe616d9c
y.create.l HWIO_PMIC_ARB_OBS1_CHNL220_RDATA1_ADDR A:0xe616e1c
y.create.l HWIO_PMIC_ARB_OBS1_CHNL221_RDATA1_ADDR A:0xe616e9c
y.create.l HWIO_PMIC_ARB_OBS1_CHNL222_RDATA1_ADDR A:0xe616f1c
y.create.l HWIO_PMIC_ARB_OBS1_CHNL223_RDATA1_ADDR A:0xe616f9c
y.create.l HWIO_PMIC_ARB_OBS1_CHNL224_RDATA1_ADDR A:0xe61701c
y.create.l HWIO_PMIC_ARB_OBS1_CHNL225_RDATA1_ADDR A:0xe61709c
y.create.l HWIO_PMIC_ARB_OBS1_CHNL226_RDATA1_ADDR A:0xe61711c
y.create.l HWIO_PMIC_ARB_OBS1_CHNL227_RDATA1_ADDR A:0xe61719c
y.create.l HWIO_PMIC_ARB_OBS1_CHNL228_RDATA1_ADDR A:0xe61721c
y.create.l HWIO_PMIC_ARB_OBS1_CHNL229_RDATA1_ADDR A:0xe61729c
y.create.l HWIO_PMIC_ARB_OBS1_CHNL230_RDATA1_ADDR A:0xe61731c
y.create.l HWIO_PMIC_ARB_OBS1_CHNL231_RDATA1_ADDR A:0xe61739c
y.create.l HWIO_PMIC_ARB_OBS1_CHNL232_RDATA1_ADDR A:0xe61741c
y.create.l HWIO_PMIC_ARB_OBS1_CHNL233_RDATA1_ADDR A:0xe61749c
y.create.l HWIO_PMIC_ARB_OBS1_CHNL234_RDATA1_ADDR A:0xe61751c
y.create.l HWIO_PMIC_ARB_OBS1_CHNL235_RDATA1_ADDR A:0xe61759c
y.create.l HWIO_PMIC_ARB_OBS1_CHNL236_RDATA1_ADDR A:0xe61761c
y.create.l HWIO_PMIC_ARB_OBS1_CHNL237_RDATA1_ADDR A:0xe61769c
y.create.l HWIO_PMIC_ARB_OBS1_CHNL238_RDATA1_ADDR A:0xe61771c
y.create.l HWIO_PMIC_ARB_OBS1_CHNL239_RDATA1_ADDR A:0xe61779c
y.create.l HWIO_PMIC_ARB_OBS1_CHNL240_RDATA1_ADDR A:0xe61781c
y.create.l HWIO_PMIC_ARB_OBS1_CHNL241_RDATA1_ADDR A:0xe61789c
y.create.l HWIO_PMIC_ARB_OBS1_CHNL242_RDATA1_ADDR A:0xe61791c
y.create.l HWIO_PMIC_ARB_OBS1_CHNL243_RDATA1_ADDR A:0xe61799c
y.create.l HWIO_PMIC_ARB_OBS1_CHNL244_RDATA1_ADDR A:0xe617a1c
y.create.l HWIO_PMIC_ARB_OBS1_CHNL245_RDATA1_ADDR A:0xe617a9c
y.create.l HWIO_PMIC_ARB_OBS1_CHNL246_RDATA1_ADDR A:0xe617b1c
y.create.l HWIO_PMIC_ARB_OBS1_CHNL247_RDATA1_ADDR A:0xe617b9c
y.create.l HWIO_PMIC_ARB_OBS1_CHNL248_RDATA1_ADDR A:0xe617c1c
y.create.l HWIO_PMIC_ARB_OBS1_CHNL249_RDATA1_ADDR A:0xe617c9c
y.create.l HWIO_PMIC_ARB_OBS1_CHNL250_RDATA1_ADDR A:0xe617d1c
y.create.l HWIO_PMIC_ARB_OBS1_CHNL251_RDATA1_ADDR A:0xe617d9c
y.create.l HWIO_PMIC_ARB_OBS1_CHNL252_RDATA1_ADDR A:0xe617e1c
y.create.l HWIO_PMIC_ARB_OBS1_CHNL253_RDATA1_ADDR A:0xe617e9c
y.create.l HWIO_PMIC_ARB_OBS1_CHNL254_RDATA1_ADDR A:0xe617f1c
y.create.l HWIO_PMIC_ARB_OBS1_CHNL255_RDATA1_ADDR A:0xe617f9c
y.create.l HWIO_PMIC_ARB_OBS1_CHNL256_RDATA1_ADDR A:0xe61801c
y.create.l HWIO_PMIC_ARB_OBS1_CHNL257_RDATA1_ADDR A:0xe61809c
y.create.l HWIO_PMIC_ARB_OBS1_CHNL258_RDATA1_ADDR A:0xe61811c
y.create.l HWIO_PMIC_ARB_OBS1_CHNL259_RDATA1_ADDR A:0xe61819c
y.create.l HWIO_PMIC_ARB_OBS1_CHNL260_RDATA1_ADDR A:0xe61821c
y.create.l HWIO_PMIC_ARB_OBS1_CHNL261_RDATA1_ADDR A:0xe61829c
y.create.l HWIO_PMIC_ARB_OBS1_CHNL262_RDATA1_ADDR A:0xe61831c
y.create.l HWIO_PMIC_ARB_OBS1_CHNL263_RDATA1_ADDR A:0xe61839c
y.create.l HWIO_PMIC_ARB_OBS1_CHNL264_RDATA1_ADDR A:0xe61841c
y.create.l HWIO_PMIC_ARB_OBS1_CHNL265_RDATA1_ADDR A:0xe61849c
y.create.l HWIO_PMIC_ARB_OBS1_CHNL266_RDATA1_ADDR A:0xe61851c
y.create.l HWIO_PMIC_ARB_OBS1_CHNL267_RDATA1_ADDR A:0xe61859c
y.create.l HWIO_PMIC_ARB_OBS1_CHNL268_RDATA1_ADDR A:0xe61861c
y.create.l HWIO_PMIC_ARB_OBS1_CHNL269_RDATA1_ADDR A:0xe61869c
y.create.l HWIO_PMIC_ARB_OBS1_CHNL270_RDATA1_ADDR A:0xe61871c
y.create.l HWIO_PMIC_ARB_OBS1_CHNL271_RDATA1_ADDR A:0xe61879c
y.create.l HWIO_PMIC_ARB_OBS1_CHNL272_RDATA1_ADDR A:0xe61881c
y.create.l HWIO_PMIC_ARB_OBS1_CHNL273_RDATA1_ADDR A:0xe61889c
y.create.l HWIO_PMIC_ARB_OBS1_CHNL274_RDATA1_ADDR A:0xe61891c
y.create.l HWIO_PMIC_ARB_OBS1_CHNL275_RDATA1_ADDR A:0xe61899c
y.create.l HWIO_PMIC_ARB_OBS1_CHNL276_RDATA1_ADDR A:0xe618a1c
y.create.l HWIO_PMIC_ARB_OBS1_CHNL277_RDATA1_ADDR A:0xe618a9c
y.create.l HWIO_PMIC_ARB_OBS1_CHNL278_RDATA1_ADDR A:0xe618b1c
y.create.l HWIO_PMIC_ARB_OBS1_CHNL279_RDATA1_ADDR A:0xe618b9c
y.create.l HWIO_PMIC_ARB_OBS1_CHNL280_RDATA1_ADDR A:0xe618c1c
y.create.l HWIO_PMIC_ARB_OBS1_CHNL281_RDATA1_ADDR A:0xe618c9c
y.create.l HWIO_PMIC_ARB_OBS1_CHNL282_RDATA1_ADDR A:0xe618d1c
y.create.l HWIO_PMIC_ARB_OBS1_CHNL283_RDATA1_ADDR A:0xe618d9c
y.create.l HWIO_PMIC_ARB_OBS1_CHNL284_RDATA1_ADDR A:0xe618e1c
y.create.l HWIO_PMIC_ARB_OBS1_CHNL285_RDATA1_ADDR A:0xe618e9c
y.create.l HWIO_PMIC_ARB_OBS1_CHNL286_RDATA1_ADDR A:0xe618f1c
y.create.l HWIO_PMIC_ARB_OBS1_CHNL287_RDATA1_ADDR A:0xe618f9c
y.create.l HWIO_PMIC_ARB_OBS1_CHNL288_RDATA1_ADDR A:0xe61901c
y.create.l HWIO_PMIC_ARB_OBS1_CHNL289_RDATA1_ADDR A:0xe61909c
y.create.l HWIO_PMIC_ARB_OBS1_CHNL290_RDATA1_ADDR A:0xe61911c
y.create.l HWIO_PMIC_ARB_OBS1_CHNL291_RDATA1_ADDR A:0xe61919c
y.create.l HWIO_PMIC_ARB_OBS1_CHNL292_RDATA1_ADDR A:0xe61921c
y.create.l HWIO_PMIC_ARB_OBS1_CHNL293_RDATA1_ADDR A:0xe61929c
y.create.l HWIO_PMIC_ARB_OBS1_CHNL294_RDATA1_ADDR A:0xe61931c
y.create.l HWIO_PMIC_ARB_OBS1_CHNL295_RDATA1_ADDR A:0xe61939c
y.create.l HWIO_PMIC_ARB_OBS1_CHNL296_RDATA1_ADDR A:0xe61941c
y.create.l HWIO_PMIC_ARB_OBS1_CHNL297_RDATA1_ADDR A:0xe61949c
y.create.l HWIO_PMIC_ARB_OBS1_CHNL298_RDATA1_ADDR A:0xe61951c
y.create.l HWIO_PMIC_ARB_OBS1_CHNL299_RDATA1_ADDR A:0xe61959c
y.create.l HWIO_PMIC_ARB_OBS1_CHNL300_RDATA1_ADDR A:0xe61961c
y.create.l HWIO_PMIC_ARB_OBS1_CHNL301_RDATA1_ADDR A:0xe61969c
y.create.l HWIO_PMIC_ARB_OBS1_CHNL302_RDATA1_ADDR A:0xe61971c
y.create.l HWIO_PMIC_ARB_OBS1_CHNL303_RDATA1_ADDR A:0xe61979c
y.create.l HWIO_PMIC_ARB_OBS1_CHNL304_RDATA1_ADDR A:0xe61981c
y.create.l HWIO_PMIC_ARB_OBS1_CHNL305_RDATA1_ADDR A:0xe61989c
y.create.l HWIO_PMIC_ARB_OBS1_CHNL306_RDATA1_ADDR A:0xe61991c
y.create.l HWIO_PMIC_ARB_OBS1_CHNL307_RDATA1_ADDR A:0xe61999c
y.create.l HWIO_PMIC_ARB_OBS1_CHNL308_RDATA1_ADDR A:0xe619a1c
y.create.l HWIO_PMIC_ARB_OBS1_CHNL309_RDATA1_ADDR A:0xe619a9c
y.create.l HWIO_PMIC_ARB_OBS1_CHNL310_RDATA1_ADDR A:0xe619b1c
y.create.l HWIO_PMIC_ARB_OBS1_CHNL311_RDATA1_ADDR A:0xe619b9c
y.create.l HWIO_PMIC_ARB_OBS1_CHNL312_RDATA1_ADDR A:0xe619c1c
y.create.l HWIO_PMIC_ARB_OBS1_CHNL313_RDATA1_ADDR A:0xe619c9c
y.create.l HWIO_PMIC_ARB_OBS1_CHNL314_RDATA1_ADDR A:0xe619d1c
y.create.l HWIO_PMIC_ARB_OBS1_CHNL315_RDATA1_ADDR A:0xe619d9c
y.create.l HWIO_PMIC_ARB_OBS1_CHNL316_RDATA1_ADDR A:0xe619e1c
y.create.l HWIO_PMIC_ARB_OBS1_CHNL317_RDATA1_ADDR A:0xe619e9c
y.create.l HWIO_PMIC_ARB_OBS1_CHNL318_RDATA1_ADDR A:0xe619f1c
y.create.l HWIO_PMIC_ARB_OBS1_CHNL319_RDATA1_ADDR A:0xe619f9c
y.create.l HWIO_PMIC_ARB_OBS1_CHNL320_RDATA1_ADDR A:0xe61a01c
y.create.l HWIO_PMIC_ARB_OBS1_CHNL321_RDATA1_ADDR A:0xe61a09c
y.create.l HWIO_PMIC_ARB_OBS1_CHNL322_RDATA1_ADDR A:0xe61a11c
y.create.l HWIO_PMIC_ARB_OBS1_CHNL323_RDATA1_ADDR A:0xe61a19c
y.create.l HWIO_PMIC_ARB_OBS1_CHNL324_RDATA1_ADDR A:0xe61a21c
y.create.l HWIO_PMIC_ARB_OBS1_CHNL325_RDATA1_ADDR A:0xe61a29c
y.create.l HWIO_PMIC_ARB_OBS1_CHNL326_RDATA1_ADDR A:0xe61a31c
y.create.l HWIO_PMIC_ARB_OBS1_CHNL327_RDATA1_ADDR A:0xe61a39c
y.create.l HWIO_PMIC_ARB_OBS1_CHNL328_RDATA1_ADDR A:0xe61a41c
y.create.l HWIO_PMIC_ARB_OBS1_CHNL329_RDATA1_ADDR A:0xe61a49c
y.create.l HWIO_PMIC_ARB_OBS1_CHNL330_RDATA1_ADDR A:0xe61a51c
y.create.l HWIO_PMIC_ARB_OBS1_CHNL331_RDATA1_ADDR A:0xe61a59c
y.create.l HWIO_PMIC_ARB_OBS1_CHNL332_RDATA1_ADDR A:0xe61a61c
y.create.l HWIO_PMIC_ARB_OBS1_CHNL333_RDATA1_ADDR A:0xe61a69c
y.create.l HWIO_PMIC_ARB_OBS1_CHNL334_RDATA1_ADDR A:0xe61a71c
y.create.l HWIO_PMIC_ARB_OBS1_CHNL335_RDATA1_ADDR A:0xe61a79c
y.create.l HWIO_PMIC_ARB_OBS1_CHNL336_RDATA1_ADDR A:0xe61a81c
y.create.l HWIO_PMIC_ARB_OBS1_CHNL337_RDATA1_ADDR A:0xe61a89c
y.create.l HWIO_PMIC_ARB_OBS1_CHNL338_RDATA1_ADDR A:0xe61a91c
y.create.l HWIO_PMIC_ARB_OBS1_CHNL339_RDATA1_ADDR A:0xe61a99c
y.create.l HWIO_PMIC_ARB_OBS1_CHNL340_RDATA1_ADDR A:0xe61aa1c
y.create.l HWIO_PMIC_ARB_OBS1_CHNL341_RDATA1_ADDR A:0xe61aa9c
y.create.l HWIO_PMIC_ARB_OBS1_CHNL342_RDATA1_ADDR A:0xe61ab1c
y.create.l HWIO_PMIC_ARB_OBS1_CHNL343_RDATA1_ADDR A:0xe61ab9c
y.create.l HWIO_PMIC_ARB_OBS1_CHNL344_RDATA1_ADDR A:0xe61ac1c
y.create.l HWIO_PMIC_ARB_OBS1_CHNL345_RDATA1_ADDR A:0xe61ac9c
y.create.l HWIO_PMIC_ARB_OBS1_CHNL346_RDATA1_ADDR A:0xe61ad1c
y.create.l HWIO_PMIC_ARB_OBS1_CHNL347_RDATA1_ADDR A:0xe61ad9c
y.create.l HWIO_PMIC_ARB_OBS1_CHNL348_RDATA1_ADDR A:0xe61ae1c
y.create.l HWIO_PMIC_ARB_OBS1_CHNL349_RDATA1_ADDR A:0xe61ae9c
y.create.l HWIO_PMIC_ARB_OBS1_CHNL350_RDATA1_ADDR A:0xe61af1c
y.create.l HWIO_PMIC_ARB_OBS1_CHNL351_RDATA1_ADDR A:0xe61af9c
y.create.l HWIO_PMIC_ARB_OBS1_CHNL352_RDATA1_ADDR A:0xe61b01c
y.create.l HWIO_PMIC_ARB_OBS1_CHNL353_RDATA1_ADDR A:0xe61b09c
y.create.l HWIO_PMIC_ARB_OBS1_CHNL354_RDATA1_ADDR A:0xe61b11c
y.create.l HWIO_PMIC_ARB_OBS1_CHNL355_RDATA1_ADDR A:0xe61b19c
y.create.l HWIO_PMIC_ARB_OBS1_CHNL356_RDATA1_ADDR A:0xe61b21c
y.create.l HWIO_PMIC_ARB_OBS1_CHNL357_RDATA1_ADDR A:0xe61b29c
y.create.l HWIO_PMIC_ARB_OBS1_CHNL358_RDATA1_ADDR A:0xe61b31c
y.create.l HWIO_PMIC_ARB_OBS1_CHNL359_RDATA1_ADDR A:0xe61b39c
y.create.l HWIO_PMIC_ARB_OBS1_CHNL360_RDATA1_ADDR A:0xe61b41c
y.create.l HWIO_PMIC_ARB_OBS1_CHNL361_RDATA1_ADDR A:0xe61b49c
y.create.l HWIO_PMIC_ARB_OBS1_CHNL362_RDATA1_ADDR A:0xe61b51c
y.create.l HWIO_PMIC_ARB_OBS1_CHNL363_RDATA1_ADDR A:0xe61b59c
y.create.l HWIO_PMIC_ARB_OBS1_CHNL364_RDATA1_ADDR A:0xe61b61c
y.create.l HWIO_PMIC_ARB_OBS1_CHNL365_RDATA1_ADDR A:0xe61b69c
y.create.l HWIO_PMIC_ARB_OBS1_CHNL366_RDATA1_ADDR A:0xe61b71c
y.create.l HWIO_PMIC_ARB_OBS1_CHNL367_RDATA1_ADDR A:0xe61b79c
y.create.l HWIO_PMIC_ARB_OBS1_CHNL368_RDATA1_ADDR A:0xe61b81c
y.create.l HWIO_PMIC_ARB_OBS1_CHNL369_RDATA1_ADDR A:0xe61b89c
y.create.l HWIO_PMIC_ARB_OBS1_CHNL370_RDATA1_ADDR A:0xe61b91c
y.create.l HWIO_PMIC_ARB_OBS1_CHNL371_RDATA1_ADDR A:0xe61b99c
y.create.l HWIO_PMIC_ARB_OBS1_CHNL372_RDATA1_ADDR A:0xe61ba1c
y.create.l HWIO_PMIC_ARB_OBS1_CHNL373_RDATA1_ADDR A:0xe61ba9c
y.create.l HWIO_PMIC_ARB_OBS1_CHNL374_RDATA1_ADDR A:0xe61bb1c
y.create.l HWIO_PMIC_ARB_OBS1_CHNL375_RDATA1_ADDR A:0xe61bb9c
y.create.l HWIO_PMIC_ARB_OBS1_CHNL376_RDATA1_ADDR A:0xe61bc1c
y.create.l HWIO_PMIC_ARB_OBS1_CHNL377_RDATA1_ADDR A:0xe61bc9c
y.create.l HWIO_PMIC_ARB_OBS1_CHNL378_RDATA1_ADDR A:0xe61bd1c
y.create.l HWIO_PMIC_ARB_OBS1_CHNL379_RDATA1_ADDR A:0xe61bd9c
y.create.l HWIO_PMIC_ARB_OBS1_CHNL380_RDATA1_ADDR A:0xe61be1c
y.create.l HWIO_PMIC_ARB_OBS1_CHNL381_RDATA1_ADDR A:0xe61be9c
y.create.l HWIO_PMIC_ARB_OBS1_CHNL382_RDATA1_ADDR A:0xe61bf1c
y.create.l HWIO_PMIC_ARB_OBS1_CHNL383_RDATA1_ADDR A:0xe61bf9c
y.create.l HWIO_PMIC_ARB_OBS1_CHNL384_RDATA1_ADDR A:0xe61c01c
y.create.l HWIO_PMIC_ARB_OBS1_CHNL385_RDATA1_ADDR A:0xe61c09c
y.create.l HWIO_PMIC_ARB_OBS1_CHNL386_RDATA1_ADDR A:0xe61c11c
y.create.l HWIO_PMIC_ARB_OBS1_CHNL387_RDATA1_ADDR A:0xe61c19c
y.create.l HWIO_PMIC_ARB_OBS1_CHNL388_RDATA1_ADDR A:0xe61c21c
y.create.l HWIO_PMIC_ARB_OBS1_CHNL389_RDATA1_ADDR A:0xe61c29c
y.create.l HWIO_PMIC_ARB_OBS1_CHNL390_RDATA1_ADDR A:0xe61c31c
y.create.l HWIO_PMIC_ARB_OBS1_CHNL391_RDATA1_ADDR A:0xe61c39c
y.create.l HWIO_PMIC_ARB_OBS1_CHNL392_RDATA1_ADDR A:0xe61c41c
y.create.l HWIO_PMIC_ARB_OBS1_CHNL393_RDATA1_ADDR A:0xe61c49c
y.create.l HWIO_PMIC_ARB_OBS1_CHNL394_RDATA1_ADDR A:0xe61c51c
y.create.l HWIO_PMIC_ARB_OBS1_CHNL395_RDATA1_ADDR A:0xe61c59c
y.create.l HWIO_PMIC_ARB_OBS1_CHNL396_RDATA1_ADDR A:0xe61c61c
y.create.l HWIO_PMIC_ARB_OBS1_CHNL397_RDATA1_ADDR A:0xe61c69c
y.create.l HWIO_PMIC_ARB_OBS1_CHNL398_RDATA1_ADDR A:0xe61c71c
y.create.l HWIO_PMIC_ARB_OBS1_CHNL399_RDATA1_ADDR A:0xe61c79c
y.create.l HWIO_PMIC_ARB_OBS1_CHNL400_RDATA1_ADDR A:0xe61c81c
y.create.l HWIO_PMIC_ARB_OBS1_CHNL401_RDATA1_ADDR A:0xe61c89c
y.create.l HWIO_PMIC_ARB_OBS1_CHNL402_RDATA1_ADDR A:0xe61c91c
y.create.l HWIO_PMIC_ARB_OBS1_CHNL403_RDATA1_ADDR A:0xe61c99c
y.create.l HWIO_PMIC_ARB_OBS1_CHNL404_RDATA1_ADDR A:0xe61ca1c
y.create.l HWIO_PMIC_ARB_OBS1_CHNL405_RDATA1_ADDR A:0xe61ca9c
y.create.l HWIO_PMIC_ARB_OBS1_CHNL406_RDATA1_ADDR A:0xe61cb1c
y.create.l HWIO_PMIC_ARB_OBS1_CHNL407_RDATA1_ADDR A:0xe61cb9c
y.create.l HWIO_PMIC_ARB_OBS1_CHNL408_RDATA1_ADDR A:0xe61cc1c
y.create.l HWIO_PMIC_ARB_OBS1_CHNL409_RDATA1_ADDR A:0xe61cc9c
y.create.l HWIO_PMIC_ARB_OBS1_CHNL410_RDATA1_ADDR A:0xe61cd1c
y.create.l HWIO_PMIC_ARB_OBS1_CHNL411_RDATA1_ADDR A:0xe61cd9c
y.create.l HWIO_PMIC_ARB_OBS1_CHNL412_RDATA1_ADDR A:0xe61ce1c
y.create.l HWIO_PMIC_ARB_OBS1_CHNL413_RDATA1_ADDR A:0xe61ce9c
y.create.l HWIO_PMIC_ARB_OBS1_CHNL414_RDATA1_ADDR A:0xe61cf1c
y.create.l HWIO_PMIC_ARB_OBS1_CHNL415_RDATA1_ADDR A:0xe61cf9c
y.create.l HWIO_PMIC_ARB_OBS1_CHNL416_RDATA1_ADDR A:0xe61d01c
y.create.l HWIO_PMIC_ARB_OBS1_CHNL417_RDATA1_ADDR A:0xe61d09c
y.create.l HWIO_PMIC_ARB_OBS1_CHNL418_RDATA1_ADDR A:0xe61d11c
y.create.l HWIO_PMIC_ARB_OBS1_CHNL419_RDATA1_ADDR A:0xe61d19c
y.create.l HWIO_PMIC_ARB_OBS1_CHNL420_RDATA1_ADDR A:0xe61d21c
y.create.l HWIO_PMIC_ARB_OBS1_CHNL421_RDATA1_ADDR A:0xe61d29c
y.create.l HWIO_PMIC_ARB_OBS1_CHNL422_RDATA1_ADDR A:0xe61d31c
y.create.l HWIO_PMIC_ARB_OBS1_CHNL423_RDATA1_ADDR A:0xe61d39c
y.create.l HWIO_PMIC_ARB_OBS1_CHNL424_RDATA1_ADDR A:0xe61d41c
y.create.l HWIO_PMIC_ARB_OBS1_CHNL425_RDATA1_ADDR A:0xe61d49c
y.create.l HWIO_PMIC_ARB_OBS1_CHNL426_RDATA1_ADDR A:0xe61d51c
y.create.l HWIO_PMIC_ARB_OBS1_CHNL427_RDATA1_ADDR A:0xe61d59c
y.create.l HWIO_PMIC_ARB_OBS1_CHNL428_RDATA1_ADDR A:0xe61d61c
y.create.l HWIO_PMIC_ARB_OBS1_CHNL429_RDATA1_ADDR A:0xe61d69c
y.create.l HWIO_PMIC_ARB_OBS1_CHNL430_RDATA1_ADDR A:0xe61d71c
y.create.l HWIO_PMIC_ARB_OBS1_CHNL431_RDATA1_ADDR A:0xe61d79c
y.create.l HWIO_PMIC_ARB_OBS1_CHNL432_RDATA1_ADDR A:0xe61d81c
y.create.l HWIO_PMIC_ARB_OBS1_CHNL433_RDATA1_ADDR A:0xe61d89c
y.create.l HWIO_PMIC_ARB_OBS1_CHNL434_RDATA1_ADDR A:0xe61d91c
y.create.l HWIO_PMIC_ARB_OBS1_CHNL435_RDATA1_ADDR A:0xe61d99c
y.create.l HWIO_PMIC_ARB_OBS1_CHNL436_RDATA1_ADDR A:0xe61da1c
y.create.l HWIO_PMIC_ARB_OBS1_CHNL437_RDATA1_ADDR A:0xe61da9c
y.create.l HWIO_PMIC_ARB_OBS1_CHNL438_RDATA1_ADDR A:0xe61db1c
y.create.l HWIO_PMIC_ARB_OBS1_CHNL439_RDATA1_ADDR A:0xe61db9c
y.create.l HWIO_PMIC_ARB_OBS1_CHNL440_RDATA1_ADDR A:0xe61dc1c
y.create.l HWIO_PMIC_ARB_OBS1_CHNL441_RDATA1_ADDR A:0xe61dc9c
y.create.l HWIO_PMIC_ARB_OBS1_CHNL442_RDATA1_ADDR A:0xe61dd1c
y.create.l HWIO_PMIC_ARB_OBS1_CHNL443_RDATA1_ADDR A:0xe61dd9c
y.create.l HWIO_PMIC_ARB_OBS1_CHNL444_RDATA1_ADDR A:0xe61de1c
y.create.l HWIO_PMIC_ARB_OBS1_CHNL445_RDATA1_ADDR A:0xe61de9c
y.create.l HWIO_PMIC_ARB_OBS1_CHNL446_RDATA1_ADDR A:0xe61df1c
y.create.l HWIO_PMIC_ARB_OBS1_CHNL447_RDATA1_ADDR A:0xe61df9c
y.create.l HWIO_PMIC_ARB_OBS1_CHNL448_RDATA1_ADDR A:0xe61e01c
y.create.l HWIO_PMIC_ARB_OBS1_CHNL449_RDATA1_ADDR A:0xe61e09c
y.create.l HWIO_PMIC_ARB_OBS1_CHNL450_RDATA1_ADDR A:0xe61e11c
y.create.l HWIO_PMIC_ARB_OBS1_CHNL451_RDATA1_ADDR A:0xe61e19c
y.create.l HWIO_PMIC_ARB_OBS1_CHNL452_RDATA1_ADDR A:0xe61e21c
y.create.l HWIO_PMIC_ARB_OBS1_CHNL453_RDATA1_ADDR A:0xe61e29c
y.create.l HWIO_PMIC_ARB_OBS1_CHNL454_RDATA1_ADDR A:0xe61e31c
y.create.l HWIO_PMIC_ARB_OBS1_CHNL455_RDATA1_ADDR A:0xe61e39c
y.create.l HWIO_PMIC_ARB_OBS1_CHNL456_RDATA1_ADDR A:0xe61e41c
y.create.l HWIO_PMIC_ARB_OBS1_CHNL457_RDATA1_ADDR A:0xe61e49c
y.create.l HWIO_PMIC_ARB_OBS1_CHNL458_RDATA1_ADDR A:0xe61e51c
y.create.l HWIO_PMIC_ARB_OBS1_CHNL459_RDATA1_ADDR A:0xe61e59c
y.create.l HWIO_PMIC_ARB_OBS1_CHNL460_RDATA1_ADDR A:0xe61e61c
y.create.l HWIO_PMIC_ARB_OBS1_CHNL461_RDATA1_ADDR A:0xe61e69c
y.create.l HWIO_PMIC_ARB_OBS1_CHNL462_RDATA1_ADDR A:0xe61e71c
y.create.l HWIO_PMIC_ARB_OBS1_CHNL463_RDATA1_ADDR A:0xe61e79c
y.create.l HWIO_PMIC_ARB_OBS1_CHNL464_RDATA1_ADDR A:0xe61e81c
y.create.l HWIO_PMIC_ARB_OBS1_CHNL465_RDATA1_ADDR A:0xe61e89c
y.create.l HWIO_PMIC_ARB_OBS1_CHNL466_RDATA1_ADDR A:0xe61e91c
y.create.l HWIO_PMIC_ARB_OBS1_CHNL467_RDATA1_ADDR A:0xe61e99c
y.create.l HWIO_PMIC_ARB_OBS1_CHNL468_RDATA1_ADDR A:0xe61ea1c
y.create.l HWIO_PMIC_ARB_OBS1_CHNL469_RDATA1_ADDR A:0xe61ea9c
y.create.l HWIO_PMIC_ARB_OBS1_CHNL470_RDATA1_ADDR A:0xe61eb1c
y.create.l HWIO_PMIC_ARB_OBS1_CHNL471_RDATA1_ADDR A:0xe61eb9c
y.create.l HWIO_PMIC_ARB_OBS1_CHNL472_RDATA1_ADDR A:0xe61ec1c
y.create.l HWIO_PMIC_ARB_OBS1_CHNL473_RDATA1_ADDR A:0xe61ec9c
y.create.l HWIO_PMIC_ARB_OBS1_CHNL474_RDATA1_ADDR A:0xe61ed1c
y.create.l HWIO_PMIC_ARB_OBS1_CHNL475_RDATA1_ADDR A:0xe61ed9c
y.create.l HWIO_PMIC_ARB_OBS1_CHNL476_RDATA1_ADDR A:0xe61ee1c
y.create.l HWIO_PMIC_ARB_OBS1_CHNL477_RDATA1_ADDR A:0xe61ee9c
y.create.l HWIO_PMIC_ARB_OBS1_CHNL478_RDATA1_ADDR A:0xe61ef1c
y.create.l HWIO_PMIC_ARB_OBS1_CHNL479_RDATA1_ADDR A:0xe61ef9c
y.create.l HWIO_PMIC_ARB_OBS1_CHNL480_RDATA1_ADDR A:0xe61f01c
y.create.l HWIO_PMIC_ARB_OBS1_CHNL481_RDATA1_ADDR A:0xe61f09c
y.create.l HWIO_PMIC_ARB_OBS1_CHNL482_RDATA1_ADDR A:0xe61f11c
y.create.l HWIO_PMIC_ARB_OBS1_CHNL483_RDATA1_ADDR A:0xe61f19c
y.create.l HWIO_PMIC_ARB_OBS1_CHNL484_RDATA1_ADDR A:0xe61f21c
y.create.l HWIO_PMIC_ARB_OBS1_CHNL485_RDATA1_ADDR A:0xe61f29c
y.create.l HWIO_PMIC_ARB_OBS1_CHNL486_RDATA1_ADDR A:0xe61f31c
y.create.l HWIO_PMIC_ARB_OBS1_CHNL487_RDATA1_ADDR A:0xe61f39c
y.create.l HWIO_PMIC_ARB_OBS1_CHNL488_RDATA1_ADDR A:0xe61f41c
y.create.l HWIO_PMIC_ARB_OBS1_CHNL489_RDATA1_ADDR A:0xe61f49c
y.create.l HWIO_PMIC_ARB_OBS1_CHNL490_RDATA1_ADDR A:0xe61f51c
y.create.l HWIO_PMIC_ARB_OBS1_CHNL491_RDATA1_ADDR A:0xe61f59c
y.create.l HWIO_PMIC_ARB_OBS1_CHNL492_RDATA1_ADDR A:0xe61f61c
y.create.l HWIO_PMIC_ARB_OBS1_CHNL493_RDATA1_ADDR A:0xe61f69c
y.create.l HWIO_PMIC_ARB_OBS1_CHNL494_RDATA1_ADDR A:0xe61f71c
y.create.l HWIO_PMIC_ARB_OBS1_CHNL495_RDATA1_ADDR A:0xe61f79c
y.create.l HWIO_PMIC_ARB_OBS1_CHNL496_RDATA1_ADDR A:0xe61f81c
y.create.l HWIO_PMIC_ARB_OBS1_CHNL497_RDATA1_ADDR A:0xe61f89c
y.create.l HWIO_PMIC_ARB_OBS1_CHNL498_RDATA1_ADDR A:0xe61f91c
y.create.l HWIO_PMIC_ARB_OBS1_CHNL499_RDATA1_ADDR A:0xe61f99c
y.create.l HWIO_PMIC_ARB_OBS1_CHNL500_RDATA1_ADDR A:0xe61fa1c
y.create.l HWIO_PMIC_ARB_OBS1_CHNL501_RDATA1_ADDR A:0xe61fa9c
y.create.l HWIO_PMIC_ARB_OBS1_CHNL502_RDATA1_ADDR A:0xe61fb1c
y.create.l HWIO_PMIC_ARB_OBS1_CHNL503_RDATA1_ADDR A:0xe61fb9c
y.create.l HWIO_PMIC_ARB_OBS1_CHNL504_RDATA1_ADDR A:0xe61fc1c
y.create.l HWIO_PMIC_ARB_OBS1_CHNL505_RDATA1_ADDR A:0xe61fc9c
y.create.l HWIO_PMIC_ARB_OBS1_CHNL506_RDATA1_ADDR A:0xe61fd1c
y.create.l HWIO_PMIC_ARB_OBS1_CHNL507_RDATA1_ADDR A:0xe61fd9c
y.create.l HWIO_PMIC_ARB_OBS1_CHNL508_RDATA1_ADDR A:0xe61fe1c
y.create.l HWIO_PMIC_ARB_OBS1_CHNL509_RDATA1_ADDR A:0xe61fe9c
y.create.l HWIO_PMIC_ARB_OBS1_CHNL510_RDATA1_ADDR A:0xe61ff1c
y.create.l HWIO_PMIC_ARB_OBS1_CHNL511_RDATA1_ADDR A:0xe61ff9c
y.create.l HWIO_PMIC_ARB_OBS2_CHNL0_RDATA1_ADDR A:0xe62001c
y.create.l HWIO_PMIC_ARB_OBS2_CHNL1_RDATA1_ADDR A:0xe62009c
y.create.l HWIO_PMIC_ARB_OBS2_CHNL2_RDATA1_ADDR A:0xe62011c
y.create.l HWIO_PMIC_ARB_OBS2_CHNL3_RDATA1_ADDR A:0xe62019c
y.create.l HWIO_PMIC_ARB_OBS2_CHNL4_RDATA1_ADDR A:0xe62021c
y.create.l HWIO_PMIC_ARB_OBS2_CHNL5_RDATA1_ADDR A:0xe62029c
y.create.l HWIO_PMIC_ARB_OBS2_CHNL6_RDATA1_ADDR A:0xe62031c
y.create.l HWIO_PMIC_ARB_OBS2_CHNL7_RDATA1_ADDR A:0xe62039c
y.create.l HWIO_PMIC_ARB_OBS2_CHNL8_RDATA1_ADDR A:0xe62041c
y.create.l HWIO_PMIC_ARB_OBS2_CHNL9_RDATA1_ADDR A:0xe62049c
y.create.l HWIO_PMIC_ARB_OBS2_CHNL10_RDATA1_ADDR A:0xe62051c
y.create.l HWIO_PMIC_ARB_OBS2_CHNL11_RDATA1_ADDR A:0xe62059c
y.create.l HWIO_PMIC_ARB_OBS2_CHNL12_RDATA1_ADDR A:0xe62061c
y.create.l HWIO_PMIC_ARB_OBS2_CHNL13_RDATA1_ADDR A:0xe62069c
y.create.l HWIO_PMIC_ARB_OBS2_CHNL14_RDATA1_ADDR A:0xe62071c
y.create.l HWIO_PMIC_ARB_OBS2_CHNL15_RDATA1_ADDR A:0xe62079c
y.create.l HWIO_PMIC_ARB_OBS2_CHNL16_RDATA1_ADDR A:0xe62081c
y.create.l HWIO_PMIC_ARB_OBS2_CHNL17_RDATA1_ADDR A:0xe62089c
y.create.l HWIO_PMIC_ARB_OBS2_CHNL18_RDATA1_ADDR A:0xe62091c
y.create.l HWIO_PMIC_ARB_OBS2_CHNL19_RDATA1_ADDR A:0xe62099c
y.create.l HWIO_PMIC_ARB_OBS2_CHNL20_RDATA1_ADDR A:0xe620a1c
y.create.l HWIO_PMIC_ARB_OBS2_CHNL21_RDATA1_ADDR A:0xe620a9c
y.create.l HWIO_PMIC_ARB_OBS2_CHNL22_RDATA1_ADDR A:0xe620b1c
y.create.l HWIO_PMIC_ARB_OBS2_CHNL23_RDATA1_ADDR A:0xe620b9c
y.create.l HWIO_PMIC_ARB_OBS2_CHNL24_RDATA1_ADDR A:0xe620c1c
y.create.l HWIO_PMIC_ARB_OBS2_CHNL25_RDATA1_ADDR A:0xe620c9c
y.create.l HWIO_PMIC_ARB_OBS2_CHNL26_RDATA1_ADDR A:0xe620d1c
y.create.l HWIO_PMIC_ARB_OBS2_CHNL27_RDATA1_ADDR A:0xe620d9c
y.create.l HWIO_PMIC_ARB_OBS2_CHNL28_RDATA1_ADDR A:0xe620e1c
y.create.l HWIO_PMIC_ARB_OBS2_CHNL29_RDATA1_ADDR A:0xe620e9c
y.create.l HWIO_PMIC_ARB_OBS2_CHNL30_RDATA1_ADDR A:0xe620f1c
y.create.l HWIO_PMIC_ARB_OBS2_CHNL31_RDATA1_ADDR A:0xe620f9c
y.create.l HWIO_PMIC_ARB_OBS2_CHNL32_RDATA1_ADDR A:0xe62101c
y.create.l HWIO_PMIC_ARB_OBS2_CHNL33_RDATA1_ADDR A:0xe62109c
y.create.l HWIO_PMIC_ARB_OBS2_CHNL34_RDATA1_ADDR A:0xe62111c
y.create.l HWIO_PMIC_ARB_OBS2_CHNL35_RDATA1_ADDR A:0xe62119c
y.create.l HWIO_PMIC_ARB_OBS2_CHNL36_RDATA1_ADDR A:0xe62121c
y.create.l HWIO_PMIC_ARB_OBS2_CHNL37_RDATA1_ADDR A:0xe62129c
y.create.l HWIO_PMIC_ARB_OBS2_CHNL38_RDATA1_ADDR A:0xe62131c
y.create.l HWIO_PMIC_ARB_OBS2_CHNL39_RDATA1_ADDR A:0xe62139c
y.create.l HWIO_PMIC_ARB_OBS2_CHNL40_RDATA1_ADDR A:0xe62141c
y.create.l HWIO_PMIC_ARB_OBS2_CHNL41_RDATA1_ADDR A:0xe62149c
y.create.l HWIO_PMIC_ARB_OBS2_CHNL42_RDATA1_ADDR A:0xe62151c
y.create.l HWIO_PMIC_ARB_OBS2_CHNL43_RDATA1_ADDR A:0xe62159c
y.create.l HWIO_PMIC_ARB_OBS2_CHNL44_RDATA1_ADDR A:0xe62161c
y.create.l HWIO_PMIC_ARB_OBS2_CHNL45_RDATA1_ADDR A:0xe62169c
y.create.l HWIO_PMIC_ARB_OBS2_CHNL46_RDATA1_ADDR A:0xe62171c
y.create.l HWIO_PMIC_ARB_OBS2_CHNL47_RDATA1_ADDR A:0xe62179c
y.create.l HWIO_PMIC_ARB_OBS2_CHNL48_RDATA1_ADDR A:0xe62181c
y.create.l HWIO_PMIC_ARB_OBS2_CHNL49_RDATA1_ADDR A:0xe62189c
y.create.l HWIO_PMIC_ARB_OBS2_CHNL50_RDATA1_ADDR A:0xe62191c
y.create.l HWIO_PMIC_ARB_OBS2_CHNL51_RDATA1_ADDR A:0xe62199c
y.create.l HWIO_PMIC_ARB_OBS2_CHNL52_RDATA1_ADDR A:0xe621a1c
y.create.l HWIO_PMIC_ARB_OBS2_CHNL53_RDATA1_ADDR A:0xe621a9c
y.create.l HWIO_PMIC_ARB_OBS2_CHNL54_RDATA1_ADDR A:0xe621b1c
y.create.l HWIO_PMIC_ARB_OBS2_CHNL55_RDATA1_ADDR A:0xe621b9c
y.create.l HWIO_PMIC_ARB_OBS2_CHNL56_RDATA1_ADDR A:0xe621c1c
y.create.l HWIO_PMIC_ARB_OBS2_CHNL57_RDATA1_ADDR A:0xe621c9c
y.create.l HWIO_PMIC_ARB_OBS2_CHNL58_RDATA1_ADDR A:0xe621d1c
y.create.l HWIO_PMIC_ARB_OBS2_CHNL59_RDATA1_ADDR A:0xe621d9c
y.create.l HWIO_PMIC_ARB_OBS2_CHNL60_RDATA1_ADDR A:0xe621e1c
y.create.l HWIO_PMIC_ARB_OBS2_CHNL61_RDATA1_ADDR A:0xe621e9c
y.create.l HWIO_PMIC_ARB_OBS2_CHNL62_RDATA1_ADDR A:0xe621f1c
y.create.l HWIO_PMIC_ARB_OBS2_CHNL63_RDATA1_ADDR A:0xe621f9c
y.create.l HWIO_PMIC_ARB_OBS2_CHNL64_RDATA1_ADDR A:0xe62201c
y.create.l HWIO_PMIC_ARB_OBS2_CHNL65_RDATA1_ADDR A:0xe62209c
y.create.l HWIO_PMIC_ARB_OBS2_CHNL66_RDATA1_ADDR A:0xe62211c
y.create.l HWIO_PMIC_ARB_OBS2_CHNL67_RDATA1_ADDR A:0xe62219c
y.create.l HWIO_PMIC_ARB_OBS2_CHNL68_RDATA1_ADDR A:0xe62221c
y.create.l HWIO_PMIC_ARB_OBS2_CHNL69_RDATA1_ADDR A:0xe62229c
y.create.l HWIO_PMIC_ARB_OBS2_CHNL70_RDATA1_ADDR A:0xe62231c
y.create.l HWIO_PMIC_ARB_OBS2_CHNL71_RDATA1_ADDR A:0xe62239c
y.create.l HWIO_PMIC_ARB_OBS2_CHNL72_RDATA1_ADDR A:0xe62241c
y.create.l HWIO_PMIC_ARB_OBS2_CHNL73_RDATA1_ADDR A:0xe62249c
y.create.l HWIO_PMIC_ARB_OBS2_CHNL74_RDATA1_ADDR A:0xe62251c
y.create.l HWIO_PMIC_ARB_OBS2_CHNL75_RDATA1_ADDR A:0xe62259c
y.create.l HWIO_PMIC_ARB_OBS2_CHNL76_RDATA1_ADDR A:0xe62261c
y.create.l HWIO_PMIC_ARB_OBS2_CHNL77_RDATA1_ADDR A:0xe62269c
y.create.l HWIO_PMIC_ARB_OBS2_CHNL78_RDATA1_ADDR A:0xe62271c
y.create.l HWIO_PMIC_ARB_OBS2_CHNL79_RDATA1_ADDR A:0xe62279c
y.create.l HWIO_PMIC_ARB_OBS2_CHNL80_RDATA1_ADDR A:0xe62281c
y.create.l HWIO_PMIC_ARB_OBS2_CHNL81_RDATA1_ADDR A:0xe62289c
y.create.l HWIO_PMIC_ARB_OBS2_CHNL82_RDATA1_ADDR A:0xe62291c
y.create.l HWIO_PMIC_ARB_OBS2_CHNL83_RDATA1_ADDR A:0xe62299c
y.create.l HWIO_PMIC_ARB_OBS2_CHNL84_RDATA1_ADDR A:0xe622a1c
y.create.l HWIO_PMIC_ARB_OBS2_CHNL85_RDATA1_ADDR A:0xe622a9c
y.create.l HWIO_PMIC_ARB_OBS2_CHNL86_RDATA1_ADDR A:0xe622b1c
y.create.l HWIO_PMIC_ARB_OBS2_CHNL87_RDATA1_ADDR A:0xe622b9c
y.create.l HWIO_PMIC_ARB_OBS2_CHNL88_RDATA1_ADDR A:0xe622c1c
y.create.l HWIO_PMIC_ARB_OBS2_CHNL89_RDATA1_ADDR A:0xe622c9c
y.create.l HWIO_PMIC_ARB_OBS2_CHNL90_RDATA1_ADDR A:0xe622d1c
y.create.l HWIO_PMIC_ARB_OBS2_CHNL91_RDATA1_ADDR A:0xe622d9c
y.create.l HWIO_PMIC_ARB_OBS2_CHNL92_RDATA1_ADDR A:0xe622e1c
y.create.l HWIO_PMIC_ARB_OBS2_CHNL93_RDATA1_ADDR A:0xe622e9c
y.create.l HWIO_PMIC_ARB_OBS2_CHNL94_RDATA1_ADDR A:0xe622f1c
y.create.l HWIO_PMIC_ARB_OBS2_CHNL95_RDATA1_ADDR A:0xe622f9c
y.create.l HWIO_PMIC_ARB_OBS2_CHNL96_RDATA1_ADDR A:0xe62301c
y.create.l HWIO_PMIC_ARB_OBS2_CHNL97_RDATA1_ADDR A:0xe62309c
y.create.l HWIO_PMIC_ARB_OBS2_CHNL98_RDATA1_ADDR A:0xe62311c
y.create.l HWIO_PMIC_ARB_OBS2_CHNL99_RDATA1_ADDR A:0xe62319c
y.create.l HWIO_PMIC_ARB_OBS2_CHNL100_RDATA1_ADDR A:0xe62321c
y.create.l HWIO_PMIC_ARB_OBS2_CHNL101_RDATA1_ADDR A:0xe62329c
y.create.l HWIO_PMIC_ARB_OBS2_CHNL102_RDATA1_ADDR A:0xe62331c
y.create.l HWIO_PMIC_ARB_OBS2_CHNL103_RDATA1_ADDR A:0xe62339c
y.create.l HWIO_PMIC_ARB_OBS2_CHNL104_RDATA1_ADDR A:0xe62341c
y.create.l HWIO_PMIC_ARB_OBS2_CHNL105_RDATA1_ADDR A:0xe62349c
y.create.l HWIO_PMIC_ARB_OBS2_CHNL106_RDATA1_ADDR A:0xe62351c
y.create.l HWIO_PMIC_ARB_OBS2_CHNL107_RDATA1_ADDR A:0xe62359c
y.create.l HWIO_PMIC_ARB_OBS2_CHNL108_RDATA1_ADDR A:0xe62361c
y.create.l HWIO_PMIC_ARB_OBS2_CHNL109_RDATA1_ADDR A:0xe62369c
y.create.l HWIO_PMIC_ARB_OBS2_CHNL110_RDATA1_ADDR A:0xe62371c
y.create.l HWIO_PMIC_ARB_OBS2_CHNL111_RDATA1_ADDR A:0xe62379c
y.create.l HWIO_PMIC_ARB_OBS2_CHNL112_RDATA1_ADDR A:0xe62381c
y.create.l HWIO_PMIC_ARB_OBS2_CHNL113_RDATA1_ADDR A:0xe62389c
y.create.l HWIO_PMIC_ARB_OBS2_CHNL114_RDATA1_ADDR A:0xe62391c
y.create.l HWIO_PMIC_ARB_OBS2_CHNL115_RDATA1_ADDR A:0xe62399c
y.create.l HWIO_PMIC_ARB_OBS2_CHNL116_RDATA1_ADDR A:0xe623a1c
y.create.l HWIO_PMIC_ARB_OBS2_CHNL117_RDATA1_ADDR A:0xe623a9c
y.create.l HWIO_PMIC_ARB_OBS2_CHNL118_RDATA1_ADDR A:0xe623b1c
y.create.l HWIO_PMIC_ARB_OBS2_CHNL119_RDATA1_ADDR A:0xe623b9c
y.create.l HWIO_PMIC_ARB_OBS2_CHNL120_RDATA1_ADDR A:0xe623c1c
y.create.l HWIO_PMIC_ARB_OBS2_CHNL121_RDATA1_ADDR A:0xe623c9c
y.create.l HWIO_PMIC_ARB_OBS2_CHNL122_RDATA1_ADDR A:0xe623d1c
y.create.l HWIO_PMIC_ARB_OBS2_CHNL123_RDATA1_ADDR A:0xe623d9c
y.create.l HWIO_PMIC_ARB_OBS2_CHNL124_RDATA1_ADDR A:0xe623e1c
y.create.l HWIO_PMIC_ARB_OBS2_CHNL125_RDATA1_ADDR A:0xe623e9c
y.create.l HWIO_PMIC_ARB_OBS2_CHNL126_RDATA1_ADDR A:0xe623f1c
y.create.l HWIO_PMIC_ARB_OBS2_CHNL127_RDATA1_ADDR A:0xe623f9c
y.create.l HWIO_PMIC_ARB_OBS2_CHNL128_RDATA1_ADDR A:0xe62401c
y.create.l HWIO_PMIC_ARB_OBS2_CHNL129_RDATA1_ADDR A:0xe62409c
y.create.l HWIO_PMIC_ARB_OBS2_CHNL130_RDATA1_ADDR A:0xe62411c
y.create.l HWIO_PMIC_ARB_OBS2_CHNL131_RDATA1_ADDR A:0xe62419c
y.create.l HWIO_PMIC_ARB_OBS2_CHNL132_RDATA1_ADDR A:0xe62421c
y.create.l HWIO_PMIC_ARB_OBS2_CHNL133_RDATA1_ADDR A:0xe62429c
y.create.l HWIO_PMIC_ARB_OBS2_CHNL134_RDATA1_ADDR A:0xe62431c
y.create.l HWIO_PMIC_ARB_OBS2_CHNL135_RDATA1_ADDR A:0xe62439c
y.create.l HWIO_PMIC_ARB_OBS2_CHNL136_RDATA1_ADDR A:0xe62441c
y.create.l HWIO_PMIC_ARB_OBS2_CHNL137_RDATA1_ADDR A:0xe62449c
y.create.l HWIO_PMIC_ARB_OBS2_CHNL138_RDATA1_ADDR A:0xe62451c
y.create.l HWIO_PMIC_ARB_OBS2_CHNL139_RDATA1_ADDR A:0xe62459c
y.create.l HWIO_PMIC_ARB_OBS2_CHNL140_RDATA1_ADDR A:0xe62461c
y.create.l HWIO_PMIC_ARB_OBS2_CHNL141_RDATA1_ADDR A:0xe62469c
y.create.l HWIO_PMIC_ARB_OBS2_CHNL142_RDATA1_ADDR A:0xe62471c
y.create.l HWIO_PMIC_ARB_OBS2_CHNL143_RDATA1_ADDR A:0xe62479c
y.create.l HWIO_PMIC_ARB_OBS2_CHNL144_RDATA1_ADDR A:0xe62481c
y.create.l HWIO_PMIC_ARB_OBS2_CHNL145_RDATA1_ADDR A:0xe62489c
y.create.l HWIO_PMIC_ARB_OBS2_CHNL146_RDATA1_ADDR A:0xe62491c
y.create.l HWIO_PMIC_ARB_OBS2_CHNL147_RDATA1_ADDR A:0xe62499c
y.create.l HWIO_PMIC_ARB_OBS2_CHNL148_RDATA1_ADDR A:0xe624a1c
y.create.l HWIO_PMIC_ARB_OBS2_CHNL149_RDATA1_ADDR A:0xe624a9c
y.create.l HWIO_PMIC_ARB_OBS2_CHNL150_RDATA1_ADDR A:0xe624b1c
y.create.l HWIO_PMIC_ARB_OBS2_CHNL151_RDATA1_ADDR A:0xe624b9c
y.create.l HWIO_PMIC_ARB_OBS2_CHNL152_RDATA1_ADDR A:0xe624c1c
y.create.l HWIO_PMIC_ARB_OBS2_CHNL153_RDATA1_ADDR A:0xe624c9c
y.create.l HWIO_PMIC_ARB_OBS2_CHNL154_RDATA1_ADDR A:0xe624d1c
y.create.l HWIO_PMIC_ARB_OBS2_CHNL155_RDATA1_ADDR A:0xe624d9c
y.create.l HWIO_PMIC_ARB_OBS2_CHNL156_RDATA1_ADDR A:0xe624e1c
y.create.l HWIO_PMIC_ARB_OBS2_CHNL157_RDATA1_ADDR A:0xe624e9c
y.create.l HWIO_PMIC_ARB_OBS2_CHNL158_RDATA1_ADDR A:0xe624f1c
y.create.l HWIO_PMIC_ARB_OBS2_CHNL159_RDATA1_ADDR A:0xe624f9c
y.create.l HWIO_PMIC_ARB_OBS2_CHNL160_RDATA1_ADDR A:0xe62501c
y.create.l HWIO_PMIC_ARB_OBS2_CHNL161_RDATA1_ADDR A:0xe62509c
y.create.l HWIO_PMIC_ARB_OBS2_CHNL162_RDATA1_ADDR A:0xe62511c
y.create.l HWIO_PMIC_ARB_OBS2_CHNL163_RDATA1_ADDR A:0xe62519c
y.create.l HWIO_PMIC_ARB_OBS2_CHNL164_RDATA1_ADDR A:0xe62521c
y.create.l HWIO_PMIC_ARB_OBS2_CHNL165_RDATA1_ADDR A:0xe62529c
y.create.l HWIO_PMIC_ARB_OBS2_CHNL166_RDATA1_ADDR A:0xe62531c
y.create.l HWIO_PMIC_ARB_OBS2_CHNL167_RDATA1_ADDR A:0xe62539c
y.create.l HWIO_PMIC_ARB_OBS2_CHNL168_RDATA1_ADDR A:0xe62541c
y.create.l HWIO_PMIC_ARB_OBS2_CHNL169_RDATA1_ADDR A:0xe62549c
y.create.l HWIO_PMIC_ARB_OBS2_CHNL170_RDATA1_ADDR A:0xe62551c
y.create.l HWIO_PMIC_ARB_OBS2_CHNL171_RDATA1_ADDR A:0xe62559c
y.create.l HWIO_PMIC_ARB_OBS2_CHNL172_RDATA1_ADDR A:0xe62561c
y.create.l HWIO_PMIC_ARB_OBS2_CHNL173_RDATA1_ADDR A:0xe62569c
y.create.l HWIO_PMIC_ARB_OBS2_CHNL174_RDATA1_ADDR A:0xe62571c
y.create.l HWIO_PMIC_ARB_OBS2_CHNL175_RDATA1_ADDR A:0xe62579c
y.create.l HWIO_PMIC_ARB_OBS2_CHNL176_RDATA1_ADDR A:0xe62581c
y.create.l HWIO_PMIC_ARB_OBS2_CHNL177_RDATA1_ADDR A:0xe62589c
y.create.l HWIO_PMIC_ARB_OBS2_CHNL178_RDATA1_ADDR A:0xe62591c
y.create.l HWIO_PMIC_ARB_OBS2_CHNL179_RDATA1_ADDR A:0xe62599c
y.create.l HWIO_PMIC_ARB_OBS2_CHNL180_RDATA1_ADDR A:0xe625a1c
y.create.l HWIO_PMIC_ARB_OBS2_CHNL181_RDATA1_ADDR A:0xe625a9c
y.create.l HWIO_PMIC_ARB_OBS2_CHNL182_RDATA1_ADDR A:0xe625b1c
y.create.l HWIO_PMIC_ARB_OBS2_CHNL183_RDATA1_ADDR A:0xe625b9c
y.create.l HWIO_PMIC_ARB_OBS2_CHNL184_RDATA1_ADDR A:0xe625c1c
y.create.l HWIO_PMIC_ARB_OBS2_CHNL185_RDATA1_ADDR A:0xe625c9c
y.create.l HWIO_PMIC_ARB_OBS2_CHNL186_RDATA1_ADDR A:0xe625d1c
y.create.l HWIO_PMIC_ARB_OBS2_CHNL187_RDATA1_ADDR A:0xe625d9c
y.create.l HWIO_PMIC_ARB_OBS2_CHNL188_RDATA1_ADDR A:0xe625e1c
y.create.l HWIO_PMIC_ARB_OBS2_CHNL189_RDATA1_ADDR A:0xe625e9c
y.create.l HWIO_PMIC_ARB_OBS2_CHNL190_RDATA1_ADDR A:0xe625f1c
y.create.l HWIO_PMIC_ARB_OBS2_CHNL191_RDATA1_ADDR A:0xe625f9c
y.create.l HWIO_PMIC_ARB_OBS2_CHNL192_RDATA1_ADDR A:0xe62601c
y.create.l HWIO_PMIC_ARB_OBS2_CHNL193_RDATA1_ADDR A:0xe62609c
y.create.l HWIO_PMIC_ARB_OBS2_CHNL194_RDATA1_ADDR A:0xe62611c
y.create.l HWIO_PMIC_ARB_OBS2_CHNL195_RDATA1_ADDR A:0xe62619c
y.create.l HWIO_PMIC_ARB_OBS2_CHNL196_RDATA1_ADDR A:0xe62621c
y.create.l HWIO_PMIC_ARB_OBS2_CHNL197_RDATA1_ADDR A:0xe62629c
y.create.l HWIO_PMIC_ARB_OBS2_CHNL198_RDATA1_ADDR A:0xe62631c
y.create.l HWIO_PMIC_ARB_OBS2_CHNL199_RDATA1_ADDR A:0xe62639c
y.create.l HWIO_PMIC_ARB_OBS2_CHNL200_RDATA1_ADDR A:0xe62641c
y.create.l HWIO_PMIC_ARB_OBS2_CHNL201_RDATA1_ADDR A:0xe62649c
y.create.l HWIO_PMIC_ARB_OBS2_CHNL202_RDATA1_ADDR A:0xe62651c
y.create.l HWIO_PMIC_ARB_OBS2_CHNL203_RDATA1_ADDR A:0xe62659c
y.create.l HWIO_PMIC_ARB_OBS2_CHNL204_RDATA1_ADDR A:0xe62661c
y.create.l HWIO_PMIC_ARB_OBS2_CHNL205_RDATA1_ADDR A:0xe62669c
y.create.l HWIO_PMIC_ARB_OBS2_CHNL206_RDATA1_ADDR A:0xe62671c
y.create.l HWIO_PMIC_ARB_OBS2_CHNL207_RDATA1_ADDR A:0xe62679c
y.create.l HWIO_PMIC_ARB_OBS2_CHNL208_RDATA1_ADDR A:0xe62681c
y.create.l HWIO_PMIC_ARB_OBS2_CHNL209_RDATA1_ADDR A:0xe62689c
y.create.l HWIO_PMIC_ARB_OBS2_CHNL210_RDATA1_ADDR A:0xe62691c
y.create.l HWIO_PMIC_ARB_OBS2_CHNL211_RDATA1_ADDR A:0xe62699c
y.create.l HWIO_PMIC_ARB_OBS2_CHNL212_RDATA1_ADDR A:0xe626a1c
y.create.l HWIO_PMIC_ARB_OBS2_CHNL213_RDATA1_ADDR A:0xe626a9c
y.create.l HWIO_PMIC_ARB_OBS2_CHNL214_RDATA1_ADDR A:0xe626b1c
y.create.l HWIO_PMIC_ARB_OBS2_CHNL215_RDATA1_ADDR A:0xe626b9c
y.create.l HWIO_PMIC_ARB_OBS2_CHNL216_RDATA1_ADDR A:0xe626c1c
y.create.l HWIO_PMIC_ARB_OBS2_CHNL217_RDATA1_ADDR A:0xe626c9c
y.create.l HWIO_PMIC_ARB_OBS2_CHNL218_RDATA1_ADDR A:0xe626d1c
y.create.l HWIO_PMIC_ARB_OBS2_CHNL219_RDATA1_ADDR A:0xe626d9c
y.create.l HWIO_PMIC_ARB_OBS2_CHNL220_RDATA1_ADDR A:0xe626e1c
y.create.l HWIO_PMIC_ARB_OBS2_CHNL221_RDATA1_ADDR A:0xe626e9c
y.create.l HWIO_PMIC_ARB_OBS2_CHNL222_RDATA1_ADDR A:0xe626f1c
y.create.l HWIO_PMIC_ARB_OBS2_CHNL223_RDATA1_ADDR A:0xe626f9c
y.create.l HWIO_PMIC_ARB_OBS2_CHNL224_RDATA1_ADDR A:0xe62701c
y.create.l HWIO_PMIC_ARB_OBS2_CHNL225_RDATA1_ADDR A:0xe62709c
y.create.l HWIO_PMIC_ARB_OBS2_CHNL226_RDATA1_ADDR A:0xe62711c
y.create.l HWIO_PMIC_ARB_OBS2_CHNL227_RDATA1_ADDR A:0xe62719c
y.create.l HWIO_PMIC_ARB_OBS2_CHNL228_RDATA1_ADDR A:0xe62721c
y.create.l HWIO_PMIC_ARB_OBS2_CHNL229_RDATA1_ADDR A:0xe62729c
y.create.l HWIO_PMIC_ARB_OBS2_CHNL230_RDATA1_ADDR A:0xe62731c
y.create.l HWIO_PMIC_ARB_OBS2_CHNL231_RDATA1_ADDR A:0xe62739c
y.create.l HWIO_PMIC_ARB_OBS2_CHNL232_RDATA1_ADDR A:0xe62741c
y.create.l HWIO_PMIC_ARB_OBS2_CHNL233_RDATA1_ADDR A:0xe62749c
y.create.l HWIO_PMIC_ARB_OBS2_CHNL234_RDATA1_ADDR A:0xe62751c
y.create.l HWIO_PMIC_ARB_OBS2_CHNL235_RDATA1_ADDR A:0xe62759c
y.create.l HWIO_PMIC_ARB_OBS2_CHNL236_RDATA1_ADDR A:0xe62761c
y.create.l HWIO_PMIC_ARB_OBS2_CHNL237_RDATA1_ADDR A:0xe62769c
y.create.l HWIO_PMIC_ARB_OBS2_CHNL238_RDATA1_ADDR A:0xe62771c
y.create.l HWIO_PMIC_ARB_OBS2_CHNL239_RDATA1_ADDR A:0xe62779c
y.create.l HWIO_PMIC_ARB_OBS2_CHNL240_RDATA1_ADDR A:0xe62781c
y.create.l HWIO_PMIC_ARB_OBS2_CHNL241_RDATA1_ADDR A:0xe62789c
y.create.l HWIO_PMIC_ARB_OBS2_CHNL242_RDATA1_ADDR A:0xe62791c
y.create.l HWIO_PMIC_ARB_OBS2_CHNL243_RDATA1_ADDR A:0xe62799c
y.create.l HWIO_PMIC_ARB_OBS2_CHNL244_RDATA1_ADDR A:0xe627a1c
y.create.l HWIO_PMIC_ARB_OBS2_CHNL245_RDATA1_ADDR A:0xe627a9c
y.create.l HWIO_PMIC_ARB_OBS2_CHNL246_RDATA1_ADDR A:0xe627b1c
y.create.l HWIO_PMIC_ARB_OBS2_CHNL247_RDATA1_ADDR A:0xe627b9c
y.create.l HWIO_PMIC_ARB_OBS2_CHNL248_RDATA1_ADDR A:0xe627c1c
y.create.l HWIO_PMIC_ARB_OBS2_CHNL249_RDATA1_ADDR A:0xe627c9c
y.create.l HWIO_PMIC_ARB_OBS2_CHNL250_RDATA1_ADDR A:0xe627d1c
y.create.l HWIO_PMIC_ARB_OBS2_CHNL251_RDATA1_ADDR A:0xe627d9c
y.create.l HWIO_PMIC_ARB_OBS2_CHNL252_RDATA1_ADDR A:0xe627e1c
y.create.l HWIO_PMIC_ARB_OBS2_CHNL253_RDATA1_ADDR A:0xe627e9c
y.create.l HWIO_PMIC_ARB_OBS2_CHNL254_RDATA1_ADDR A:0xe627f1c
y.create.l HWIO_PMIC_ARB_OBS2_CHNL255_RDATA1_ADDR A:0xe627f9c
y.create.l HWIO_PMIC_ARB_OBS2_CHNL256_RDATA1_ADDR A:0xe62801c
y.create.l HWIO_PMIC_ARB_OBS2_CHNL257_RDATA1_ADDR A:0xe62809c
y.create.l HWIO_PMIC_ARB_OBS2_CHNL258_RDATA1_ADDR A:0xe62811c
y.create.l HWIO_PMIC_ARB_OBS2_CHNL259_RDATA1_ADDR A:0xe62819c
y.create.l HWIO_PMIC_ARB_OBS2_CHNL260_RDATA1_ADDR A:0xe62821c
y.create.l HWIO_PMIC_ARB_OBS2_CHNL261_RDATA1_ADDR A:0xe62829c
y.create.l HWIO_PMIC_ARB_OBS2_CHNL262_RDATA1_ADDR A:0xe62831c
y.create.l HWIO_PMIC_ARB_OBS2_CHNL263_RDATA1_ADDR A:0xe62839c
y.create.l HWIO_PMIC_ARB_OBS2_CHNL264_RDATA1_ADDR A:0xe62841c
y.create.l HWIO_PMIC_ARB_OBS2_CHNL265_RDATA1_ADDR A:0xe62849c
y.create.l HWIO_PMIC_ARB_OBS2_CHNL266_RDATA1_ADDR A:0xe62851c
y.create.l HWIO_PMIC_ARB_OBS2_CHNL267_RDATA1_ADDR A:0xe62859c
y.create.l HWIO_PMIC_ARB_OBS2_CHNL268_RDATA1_ADDR A:0xe62861c
y.create.l HWIO_PMIC_ARB_OBS2_CHNL269_RDATA1_ADDR A:0xe62869c
y.create.l HWIO_PMIC_ARB_OBS2_CHNL270_RDATA1_ADDR A:0xe62871c
y.create.l HWIO_PMIC_ARB_OBS2_CHNL271_RDATA1_ADDR A:0xe62879c
y.create.l HWIO_PMIC_ARB_OBS2_CHNL272_RDATA1_ADDR A:0xe62881c
y.create.l HWIO_PMIC_ARB_OBS2_CHNL273_RDATA1_ADDR A:0xe62889c
y.create.l HWIO_PMIC_ARB_OBS2_CHNL274_RDATA1_ADDR A:0xe62891c
y.create.l HWIO_PMIC_ARB_OBS2_CHNL275_RDATA1_ADDR A:0xe62899c
y.create.l HWIO_PMIC_ARB_OBS2_CHNL276_RDATA1_ADDR A:0xe628a1c
y.create.l HWIO_PMIC_ARB_OBS2_CHNL277_RDATA1_ADDR A:0xe628a9c
y.create.l HWIO_PMIC_ARB_OBS2_CHNL278_RDATA1_ADDR A:0xe628b1c
y.create.l HWIO_PMIC_ARB_OBS2_CHNL279_RDATA1_ADDR A:0xe628b9c
y.create.l HWIO_PMIC_ARB_OBS2_CHNL280_RDATA1_ADDR A:0xe628c1c
y.create.l HWIO_PMIC_ARB_OBS2_CHNL281_RDATA1_ADDR A:0xe628c9c
y.create.l HWIO_PMIC_ARB_OBS2_CHNL282_RDATA1_ADDR A:0xe628d1c
y.create.l HWIO_PMIC_ARB_OBS2_CHNL283_RDATA1_ADDR A:0xe628d9c
y.create.l HWIO_PMIC_ARB_OBS2_CHNL284_RDATA1_ADDR A:0xe628e1c
y.create.l HWIO_PMIC_ARB_OBS2_CHNL285_RDATA1_ADDR A:0xe628e9c
y.create.l HWIO_PMIC_ARB_OBS2_CHNL286_RDATA1_ADDR A:0xe628f1c
y.create.l HWIO_PMIC_ARB_OBS2_CHNL287_RDATA1_ADDR A:0xe628f9c
y.create.l HWIO_PMIC_ARB_OBS2_CHNL288_RDATA1_ADDR A:0xe62901c
y.create.l HWIO_PMIC_ARB_OBS2_CHNL289_RDATA1_ADDR A:0xe62909c
y.create.l HWIO_PMIC_ARB_OBS2_CHNL290_RDATA1_ADDR A:0xe62911c
y.create.l HWIO_PMIC_ARB_OBS2_CHNL291_RDATA1_ADDR A:0xe62919c
y.create.l HWIO_PMIC_ARB_OBS2_CHNL292_RDATA1_ADDR A:0xe62921c
y.create.l HWIO_PMIC_ARB_OBS2_CHNL293_RDATA1_ADDR A:0xe62929c
y.create.l HWIO_PMIC_ARB_OBS2_CHNL294_RDATA1_ADDR A:0xe62931c
y.create.l HWIO_PMIC_ARB_OBS2_CHNL295_RDATA1_ADDR A:0xe62939c
y.create.l HWIO_PMIC_ARB_OBS2_CHNL296_RDATA1_ADDR A:0xe62941c
y.create.l HWIO_PMIC_ARB_OBS2_CHNL297_RDATA1_ADDR A:0xe62949c
y.create.l HWIO_PMIC_ARB_OBS2_CHNL298_RDATA1_ADDR A:0xe62951c
y.create.l HWIO_PMIC_ARB_OBS2_CHNL299_RDATA1_ADDR A:0xe62959c
y.create.l HWIO_PMIC_ARB_OBS2_CHNL300_RDATA1_ADDR A:0xe62961c
y.create.l HWIO_PMIC_ARB_OBS2_CHNL301_RDATA1_ADDR A:0xe62969c
y.create.l HWIO_PMIC_ARB_OBS2_CHNL302_RDATA1_ADDR A:0xe62971c
y.create.l HWIO_PMIC_ARB_OBS2_CHNL303_RDATA1_ADDR A:0xe62979c
y.create.l HWIO_PMIC_ARB_OBS2_CHNL304_RDATA1_ADDR A:0xe62981c
y.create.l HWIO_PMIC_ARB_OBS2_CHNL305_RDATA1_ADDR A:0xe62989c
y.create.l HWIO_PMIC_ARB_OBS2_CHNL306_RDATA1_ADDR A:0xe62991c
y.create.l HWIO_PMIC_ARB_OBS2_CHNL307_RDATA1_ADDR A:0xe62999c
y.create.l HWIO_PMIC_ARB_OBS2_CHNL308_RDATA1_ADDR A:0xe629a1c
y.create.l HWIO_PMIC_ARB_OBS2_CHNL309_RDATA1_ADDR A:0xe629a9c
y.create.l HWIO_PMIC_ARB_OBS2_CHNL310_RDATA1_ADDR A:0xe629b1c
y.create.l HWIO_PMIC_ARB_OBS2_CHNL311_RDATA1_ADDR A:0xe629b9c
y.create.l HWIO_PMIC_ARB_OBS2_CHNL312_RDATA1_ADDR A:0xe629c1c
y.create.l HWIO_PMIC_ARB_OBS2_CHNL313_RDATA1_ADDR A:0xe629c9c
y.create.l HWIO_PMIC_ARB_OBS2_CHNL314_RDATA1_ADDR A:0xe629d1c
y.create.l HWIO_PMIC_ARB_OBS2_CHNL315_RDATA1_ADDR A:0xe629d9c
y.create.l HWIO_PMIC_ARB_OBS2_CHNL316_RDATA1_ADDR A:0xe629e1c
y.create.l HWIO_PMIC_ARB_OBS2_CHNL317_RDATA1_ADDR A:0xe629e9c
y.create.l HWIO_PMIC_ARB_OBS2_CHNL318_RDATA1_ADDR A:0xe629f1c
y.create.l HWIO_PMIC_ARB_OBS2_CHNL319_RDATA1_ADDR A:0xe629f9c
y.create.l HWIO_PMIC_ARB_OBS2_CHNL320_RDATA1_ADDR A:0xe62a01c
y.create.l HWIO_PMIC_ARB_OBS2_CHNL321_RDATA1_ADDR A:0xe62a09c
y.create.l HWIO_PMIC_ARB_OBS2_CHNL322_RDATA1_ADDR A:0xe62a11c
y.create.l HWIO_PMIC_ARB_OBS2_CHNL323_RDATA1_ADDR A:0xe62a19c
y.create.l HWIO_PMIC_ARB_OBS2_CHNL324_RDATA1_ADDR A:0xe62a21c
y.create.l HWIO_PMIC_ARB_OBS2_CHNL325_RDATA1_ADDR A:0xe62a29c
y.create.l HWIO_PMIC_ARB_OBS2_CHNL326_RDATA1_ADDR A:0xe62a31c
y.create.l HWIO_PMIC_ARB_OBS2_CHNL327_RDATA1_ADDR A:0xe62a39c
y.create.l HWIO_PMIC_ARB_OBS2_CHNL328_RDATA1_ADDR A:0xe62a41c
y.create.l HWIO_PMIC_ARB_OBS2_CHNL329_RDATA1_ADDR A:0xe62a49c
y.create.l HWIO_PMIC_ARB_OBS2_CHNL330_RDATA1_ADDR A:0xe62a51c
y.create.l HWIO_PMIC_ARB_OBS2_CHNL331_RDATA1_ADDR A:0xe62a59c
y.create.l HWIO_PMIC_ARB_OBS2_CHNL332_RDATA1_ADDR A:0xe62a61c
y.create.l HWIO_PMIC_ARB_OBS2_CHNL333_RDATA1_ADDR A:0xe62a69c
y.create.l HWIO_PMIC_ARB_OBS2_CHNL334_RDATA1_ADDR A:0xe62a71c
y.create.l HWIO_PMIC_ARB_OBS2_CHNL335_RDATA1_ADDR A:0xe62a79c
y.create.l HWIO_PMIC_ARB_OBS2_CHNL336_RDATA1_ADDR A:0xe62a81c
y.create.l HWIO_PMIC_ARB_OBS2_CHNL337_RDATA1_ADDR A:0xe62a89c
y.create.l HWIO_PMIC_ARB_OBS2_CHNL338_RDATA1_ADDR A:0xe62a91c
y.create.l HWIO_PMIC_ARB_OBS2_CHNL339_RDATA1_ADDR A:0xe62a99c
y.create.l HWIO_PMIC_ARB_OBS2_CHNL340_RDATA1_ADDR A:0xe62aa1c
y.create.l HWIO_PMIC_ARB_OBS2_CHNL341_RDATA1_ADDR A:0xe62aa9c
y.create.l HWIO_PMIC_ARB_OBS2_CHNL342_RDATA1_ADDR A:0xe62ab1c
y.create.l HWIO_PMIC_ARB_OBS2_CHNL343_RDATA1_ADDR A:0xe62ab9c
y.create.l HWIO_PMIC_ARB_OBS2_CHNL344_RDATA1_ADDR A:0xe62ac1c
y.create.l HWIO_PMIC_ARB_OBS2_CHNL345_RDATA1_ADDR A:0xe62ac9c
y.create.l HWIO_PMIC_ARB_OBS2_CHNL346_RDATA1_ADDR A:0xe62ad1c
y.create.l HWIO_PMIC_ARB_OBS2_CHNL347_RDATA1_ADDR A:0xe62ad9c
y.create.l HWIO_PMIC_ARB_OBS2_CHNL348_RDATA1_ADDR A:0xe62ae1c
y.create.l HWIO_PMIC_ARB_OBS2_CHNL349_RDATA1_ADDR A:0xe62ae9c
y.create.l HWIO_PMIC_ARB_OBS2_CHNL350_RDATA1_ADDR A:0xe62af1c
y.create.l HWIO_PMIC_ARB_OBS2_CHNL351_RDATA1_ADDR A:0xe62af9c
y.create.l HWIO_PMIC_ARB_OBS2_CHNL352_RDATA1_ADDR A:0xe62b01c
y.create.l HWIO_PMIC_ARB_OBS2_CHNL353_RDATA1_ADDR A:0xe62b09c
y.create.l HWIO_PMIC_ARB_OBS2_CHNL354_RDATA1_ADDR A:0xe62b11c
y.create.l HWIO_PMIC_ARB_OBS2_CHNL355_RDATA1_ADDR A:0xe62b19c
y.create.l HWIO_PMIC_ARB_OBS2_CHNL356_RDATA1_ADDR A:0xe62b21c
y.create.l HWIO_PMIC_ARB_OBS2_CHNL357_RDATA1_ADDR A:0xe62b29c
y.create.l HWIO_PMIC_ARB_OBS2_CHNL358_RDATA1_ADDR A:0xe62b31c
y.create.l HWIO_PMIC_ARB_OBS2_CHNL359_RDATA1_ADDR A:0xe62b39c
y.create.l HWIO_PMIC_ARB_OBS2_CHNL360_RDATA1_ADDR A:0xe62b41c
y.create.l HWIO_PMIC_ARB_OBS2_CHNL361_RDATA1_ADDR A:0xe62b49c
y.create.l HWIO_PMIC_ARB_OBS2_CHNL362_RDATA1_ADDR A:0xe62b51c
y.create.l HWIO_PMIC_ARB_OBS2_CHNL363_RDATA1_ADDR A:0xe62b59c
y.create.l HWIO_PMIC_ARB_OBS2_CHNL364_RDATA1_ADDR A:0xe62b61c
y.create.l HWIO_PMIC_ARB_OBS2_CHNL365_RDATA1_ADDR A:0xe62b69c
y.create.l HWIO_PMIC_ARB_OBS2_CHNL366_RDATA1_ADDR A:0xe62b71c
y.create.l HWIO_PMIC_ARB_OBS2_CHNL367_RDATA1_ADDR A:0xe62b79c
y.create.l HWIO_PMIC_ARB_OBS2_CHNL368_RDATA1_ADDR A:0xe62b81c
y.create.l HWIO_PMIC_ARB_OBS2_CHNL369_RDATA1_ADDR A:0xe62b89c
y.create.l HWIO_PMIC_ARB_OBS2_CHNL370_RDATA1_ADDR A:0xe62b91c
y.create.l HWIO_PMIC_ARB_OBS2_CHNL371_RDATA1_ADDR A:0xe62b99c
y.create.l HWIO_PMIC_ARB_OBS2_CHNL372_RDATA1_ADDR A:0xe62ba1c
y.create.l HWIO_PMIC_ARB_OBS2_CHNL373_RDATA1_ADDR A:0xe62ba9c
y.create.l HWIO_PMIC_ARB_OBS2_CHNL374_RDATA1_ADDR A:0xe62bb1c
y.create.l HWIO_PMIC_ARB_OBS2_CHNL375_RDATA1_ADDR A:0xe62bb9c
y.create.l HWIO_PMIC_ARB_OBS2_CHNL376_RDATA1_ADDR A:0xe62bc1c
y.create.l HWIO_PMIC_ARB_OBS2_CHNL377_RDATA1_ADDR A:0xe62bc9c
y.create.l HWIO_PMIC_ARB_OBS2_CHNL378_RDATA1_ADDR A:0xe62bd1c
y.create.l HWIO_PMIC_ARB_OBS2_CHNL379_RDATA1_ADDR A:0xe62bd9c
y.create.l HWIO_PMIC_ARB_OBS2_CHNL380_RDATA1_ADDR A:0xe62be1c
y.create.l HWIO_PMIC_ARB_OBS2_CHNL381_RDATA1_ADDR A:0xe62be9c
y.create.l HWIO_PMIC_ARB_OBS2_CHNL382_RDATA1_ADDR A:0xe62bf1c
y.create.l HWIO_PMIC_ARB_OBS2_CHNL383_RDATA1_ADDR A:0xe62bf9c
y.create.l HWIO_PMIC_ARB_OBS2_CHNL384_RDATA1_ADDR A:0xe62c01c
y.create.l HWIO_PMIC_ARB_OBS2_CHNL385_RDATA1_ADDR A:0xe62c09c
y.create.l HWIO_PMIC_ARB_OBS2_CHNL386_RDATA1_ADDR A:0xe62c11c
y.create.l HWIO_PMIC_ARB_OBS2_CHNL387_RDATA1_ADDR A:0xe62c19c
y.create.l HWIO_PMIC_ARB_OBS2_CHNL388_RDATA1_ADDR A:0xe62c21c
y.create.l HWIO_PMIC_ARB_OBS2_CHNL389_RDATA1_ADDR A:0xe62c29c
y.create.l HWIO_PMIC_ARB_OBS2_CHNL390_RDATA1_ADDR A:0xe62c31c
y.create.l HWIO_PMIC_ARB_OBS2_CHNL391_RDATA1_ADDR A:0xe62c39c
y.create.l HWIO_PMIC_ARB_OBS2_CHNL392_RDATA1_ADDR A:0xe62c41c
y.create.l HWIO_PMIC_ARB_OBS2_CHNL393_RDATA1_ADDR A:0xe62c49c
y.create.l HWIO_PMIC_ARB_OBS2_CHNL394_RDATA1_ADDR A:0xe62c51c
y.create.l HWIO_PMIC_ARB_OBS2_CHNL395_RDATA1_ADDR A:0xe62c59c
y.create.l HWIO_PMIC_ARB_OBS2_CHNL396_RDATA1_ADDR A:0xe62c61c
y.create.l HWIO_PMIC_ARB_OBS2_CHNL397_RDATA1_ADDR A:0xe62c69c
y.create.l HWIO_PMIC_ARB_OBS2_CHNL398_RDATA1_ADDR A:0xe62c71c
y.create.l HWIO_PMIC_ARB_OBS2_CHNL399_RDATA1_ADDR A:0xe62c79c
y.create.l HWIO_PMIC_ARB_OBS2_CHNL400_RDATA1_ADDR A:0xe62c81c
y.create.l HWIO_PMIC_ARB_OBS2_CHNL401_RDATA1_ADDR A:0xe62c89c
y.create.l HWIO_PMIC_ARB_OBS2_CHNL402_RDATA1_ADDR A:0xe62c91c
y.create.l HWIO_PMIC_ARB_OBS2_CHNL403_RDATA1_ADDR A:0xe62c99c
y.create.l HWIO_PMIC_ARB_OBS2_CHNL404_RDATA1_ADDR A:0xe62ca1c
y.create.l HWIO_PMIC_ARB_OBS2_CHNL405_RDATA1_ADDR A:0xe62ca9c
y.create.l HWIO_PMIC_ARB_OBS2_CHNL406_RDATA1_ADDR A:0xe62cb1c
y.create.l HWIO_PMIC_ARB_OBS2_CHNL407_RDATA1_ADDR A:0xe62cb9c
y.create.l HWIO_PMIC_ARB_OBS2_CHNL408_RDATA1_ADDR A:0xe62cc1c
y.create.l HWIO_PMIC_ARB_OBS2_CHNL409_RDATA1_ADDR A:0xe62cc9c
y.create.l HWIO_PMIC_ARB_OBS2_CHNL410_RDATA1_ADDR A:0xe62cd1c
y.create.l HWIO_PMIC_ARB_OBS2_CHNL411_RDATA1_ADDR A:0xe62cd9c
y.create.l HWIO_PMIC_ARB_OBS2_CHNL412_RDATA1_ADDR A:0xe62ce1c
y.create.l HWIO_PMIC_ARB_OBS2_CHNL413_RDATA1_ADDR A:0xe62ce9c
y.create.l HWIO_PMIC_ARB_OBS2_CHNL414_RDATA1_ADDR A:0xe62cf1c
y.create.l HWIO_PMIC_ARB_OBS2_CHNL415_RDATA1_ADDR A:0xe62cf9c
y.create.l HWIO_PMIC_ARB_OBS2_CHNL416_RDATA1_ADDR A:0xe62d01c
y.create.l HWIO_PMIC_ARB_OBS2_CHNL417_RDATA1_ADDR A:0xe62d09c
y.create.l HWIO_PMIC_ARB_OBS2_CHNL418_RDATA1_ADDR A:0xe62d11c
y.create.l HWIO_PMIC_ARB_OBS2_CHNL419_RDATA1_ADDR A:0xe62d19c
y.create.l HWIO_PMIC_ARB_OBS2_CHNL420_RDATA1_ADDR A:0xe62d21c
y.create.l HWIO_PMIC_ARB_OBS2_CHNL421_RDATA1_ADDR A:0xe62d29c
y.create.l HWIO_PMIC_ARB_OBS2_CHNL422_RDATA1_ADDR A:0xe62d31c
y.create.l HWIO_PMIC_ARB_OBS2_CHNL423_RDATA1_ADDR A:0xe62d39c
y.create.l HWIO_PMIC_ARB_OBS2_CHNL424_RDATA1_ADDR A:0xe62d41c
y.create.l HWIO_PMIC_ARB_OBS2_CHNL425_RDATA1_ADDR A:0xe62d49c
y.create.l HWIO_PMIC_ARB_OBS2_CHNL426_RDATA1_ADDR A:0xe62d51c
y.create.l HWIO_PMIC_ARB_OBS2_CHNL427_RDATA1_ADDR A:0xe62d59c
y.create.l HWIO_PMIC_ARB_OBS2_CHNL428_RDATA1_ADDR A:0xe62d61c
y.create.l HWIO_PMIC_ARB_OBS2_CHNL429_RDATA1_ADDR A:0xe62d69c
y.create.l HWIO_PMIC_ARB_OBS2_CHNL430_RDATA1_ADDR A:0xe62d71c
y.create.l HWIO_PMIC_ARB_OBS2_CHNL431_RDATA1_ADDR A:0xe62d79c
y.create.l HWIO_PMIC_ARB_OBS2_CHNL432_RDATA1_ADDR A:0xe62d81c
y.create.l HWIO_PMIC_ARB_OBS2_CHNL433_RDATA1_ADDR A:0xe62d89c
y.create.l HWIO_PMIC_ARB_OBS2_CHNL434_RDATA1_ADDR A:0xe62d91c
y.create.l HWIO_PMIC_ARB_OBS2_CHNL435_RDATA1_ADDR A:0xe62d99c
y.create.l HWIO_PMIC_ARB_OBS2_CHNL436_RDATA1_ADDR A:0xe62da1c
y.create.l HWIO_PMIC_ARB_OBS2_CHNL437_RDATA1_ADDR A:0xe62da9c
y.create.l HWIO_PMIC_ARB_OBS2_CHNL438_RDATA1_ADDR A:0xe62db1c
y.create.l HWIO_PMIC_ARB_OBS2_CHNL439_RDATA1_ADDR A:0xe62db9c
y.create.l HWIO_PMIC_ARB_OBS2_CHNL440_RDATA1_ADDR A:0xe62dc1c
y.create.l HWIO_PMIC_ARB_OBS2_CHNL441_RDATA1_ADDR A:0xe62dc9c
y.create.l HWIO_PMIC_ARB_OBS2_CHNL442_RDATA1_ADDR A:0xe62dd1c
y.create.l HWIO_PMIC_ARB_OBS2_CHNL443_RDATA1_ADDR A:0xe62dd9c
y.create.l HWIO_PMIC_ARB_OBS2_CHNL444_RDATA1_ADDR A:0xe62de1c
y.create.l HWIO_PMIC_ARB_OBS2_CHNL445_RDATA1_ADDR A:0xe62de9c
y.create.l HWIO_PMIC_ARB_OBS2_CHNL446_RDATA1_ADDR A:0xe62df1c
y.create.l HWIO_PMIC_ARB_OBS2_CHNL447_RDATA1_ADDR A:0xe62df9c
y.create.l HWIO_PMIC_ARB_OBS2_CHNL448_RDATA1_ADDR A:0xe62e01c
y.create.l HWIO_PMIC_ARB_OBS2_CHNL449_RDATA1_ADDR A:0xe62e09c
y.create.l HWIO_PMIC_ARB_OBS2_CHNL450_RDATA1_ADDR A:0xe62e11c
y.create.l HWIO_PMIC_ARB_OBS2_CHNL451_RDATA1_ADDR A:0xe62e19c
y.create.l HWIO_PMIC_ARB_OBS2_CHNL452_RDATA1_ADDR A:0xe62e21c
y.create.l HWIO_PMIC_ARB_OBS2_CHNL453_RDATA1_ADDR A:0xe62e29c
y.create.l HWIO_PMIC_ARB_OBS2_CHNL454_RDATA1_ADDR A:0xe62e31c
y.create.l HWIO_PMIC_ARB_OBS2_CHNL455_RDATA1_ADDR A:0xe62e39c
y.create.l HWIO_PMIC_ARB_OBS2_CHNL456_RDATA1_ADDR A:0xe62e41c
y.create.l HWIO_PMIC_ARB_OBS2_CHNL457_RDATA1_ADDR A:0xe62e49c
y.create.l HWIO_PMIC_ARB_OBS2_CHNL458_RDATA1_ADDR A:0xe62e51c
y.create.l HWIO_PMIC_ARB_OBS2_CHNL459_RDATA1_ADDR A:0xe62e59c
y.create.l HWIO_PMIC_ARB_OBS2_CHNL460_RDATA1_ADDR A:0xe62e61c
y.create.l HWIO_PMIC_ARB_OBS2_CHNL461_RDATA1_ADDR A:0xe62e69c
y.create.l HWIO_PMIC_ARB_OBS2_CHNL462_RDATA1_ADDR A:0xe62e71c
y.create.l HWIO_PMIC_ARB_OBS2_CHNL463_RDATA1_ADDR A:0xe62e79c
y.create.l HWIO_PMIC_ARB_OBS2_CHNL464_RDATA1_ADDR A:0xe62e81c
y.create.l HWIO_PMIC_ARB_OBS2_CHNL465_RDATA1_ADDR A:0xe62e89c
y.create.l HWIO_PMIC_ARB_OBS2_CHNL466_RDATA1_ADDR A:0xe62e91c
y.create.l HWIO_PMIC_ARB_OBS2_CHNL467_RDATA1_ADDR A:0xe62e99c
y.create.l HWIO_PMIC_ARB_OBS2_CHNL468_RDATA1_ADDR A:0xe62ea1c
y.create.l HWIO_PMIC_ARB_OBS2_CHNL469_RDATA1_ADDR A:0xe62ea9c
y.create.l HWIO_PMIC_ARB_OBS2_CHNL470_RDATA1_ADDR A:0xe62eb1c
y.create.l HWIO_PMIC_ARB_OBS2_CHNL471_RDATA1_ADDR A:0xe62eb9c
y.create.l HWIO_PMIC_ARB_OBS2_CHNL472_RDATA1_ADDR A:0xe62ec1c
y.create.l HWIO_PMIC_ARB_OBS2_CHNL473_RDATA1_ADDR A:0xe62ec9c
y.create.l HWIO_PMIC_ARB_OBS2_CHNL474_RDATA1_ADDR A:0xe62ed1c
y.create.l HWIO_PMIC_ARB_OBS2_CHNL475_RDATA1_ADDR A:0xe62ed9c
y.create.l HWIO_PMIC_ARB_OBS2_CHNL476_RDATA1_ADDR A:0xe62ee1c
y.create.l HWIO_PMIC_ARB_OBS2_CHNL477_RDATA1_ADDR A:0xe62ee9c
y.create.l HWIO_PMIC_ARB_OBS2_CHNL478_RDATA1_ADDR A:0xe62ef1c
y.create.l HWIO_PMIC_ARB_OBS2_CHNL479_RDATA1_ADDR A:0xe62ef9c
y.create.l HWIO_PMIC_ARB_OBS2_CHNL480_RDATA1_ADDR A:0xe62f01c
y.create.l HWIO_PMIC_ARB_OBS2_CHNL481_RDATA1_ADDR A:0xe62f09c
y.create.l HWIO_PMIC_ARB_OBS2_CHNL482_RDATA1_ADDR A:0xe62f11c
y.create.l HWIO_PMIC_ARB_OBS2_CHNL483_RDATA1_ADDR A:0xe62f19c
y.create.l HWIO_PMIC_ARB_OBS2_CHNL484_RDATA1_ADDR A:0xe62f21c
y.create.l HWIO_PMIC_ARB_OBS2_CHNL485_RDATA1_ADDR A:0xe62f29c
y.create.l HWIO_PMIC_ARB_OBS2_CHNL486_RDATA1_ADDR A:0xe62f31c
y.create.l HWIO_PMIC_ARB_OBS2_CHNL487_RDATA1_ADDR A:0xe62f39c
y.create.l HWIO_PMIC_ARB_OBS2_CHNL488_RDATA1_ADDR A:0xe62f41c
y.create.l HWIO_PMIC_ARB_OBS2_CHNL489_RDATA1_ADDR A:0xe62f49c
y.create.l HWIO_PMIC_ARB_OBS2_CHNL490_RDATA1_ADDR A:0xe62f51c
y.create.l HWIO_PMIC_ARB_OBS2_CHNL491_RDATA1_ADDR A:0xe62f59c
y.create.l HWIO_PMIC_ARB_OBS2_CHNL492_RDATA1_ADDR A:0xe62f61c
y.create.l HWIO_PMIC_ARB_OBS2_CHNL493_RDATA1_ADDR A:0xe62f69c
y.create.l HWIO_PMIC_ARB_OBS2_CHNL494_RDATA1_ADDR A:0xe62f71c
y.create.l HWIO_PMIC_ARB_OBS2_CHNL495_RDATA1_ADDR A:0xe62f79c
y.create.l HWIO_PMIC_ARB_OBS2_CHNL496_RDATA1_ADDR A:0xe62f81c
y.create.l HWIO_PMIC_ARB_OBS2_CHNL497_RDATA1_ADDR A:0xe62f89c
y.create.l HWIO_PMIC_ARB_OBS2_CHNL498_RDATA1_ADDR A:0xe62f91c
y.create.l HWIO_PMIC_ARB_OBS2_CHNL499_RDATA1_ADDR A:0xe62f99c
y.create.l HWIO_PMIC_ARB_OBS2_CHNL500_RDATA1_ADDR A:0xe62fa1c
y.create.l HWIO_PMIC_ARB_OBS2_CHNL501_RDATA1_ADDR A:0xe62fa9c
y.create.l HWIO_PMIC_ARB_OBS2_CHNL502_RDATA1_ADDR A:0xe62fb1c
y.create.l HWIO_PMIC_ARB_OBS2_CHNL503_RDATA1_ADDR A:0xe62fb9c
y.create.l HWIO_PMIC_ARB_OBS2_CHNL504_RDATA1_ADDR A:0xe62fc1c
y.create.l HWIO_PMIC_ARB_OBS2_CHNL505_RDATA1_ADDR A:0xe62fc9c
y.create.l HWIO_PMIC_ARB_OBS2_CHNL506_RDATA1_ADDR A:0xe62fd1c
y.create.l HWIO_PMIC_ARB_OBS2_CHNL507_RDATA1_ADDR A:0xe62fd9c
y.create.l HWIO_PMIC_ARB_OBS2_CHNL508_RDATA1_ADDR A:0xe62fe1c
y.create.l HWIO_PMIC_ARB_OBS2_CHNL509_RDATA1_ADDR A:0xe62fe9c
y.create.l HWIO_PMIC_ARB_OBS2_CHNL510_RDATA1_ADDR A:0xe62ff1c
y.create.l HWIO_PMIC_ARB_OBS2_CHNL511_RDATA1_ADDR A:0xe62ff9c
y.create.l HWIO_PMIC_ARB_OBS3_CHNL0_RDATA1_ADDR A:0xe63001c
y.create.l HWIO_PMIC_ARB_OBS3_CHNL1_RDATA1_ADDR A:0xe63009c
y.create.l HWIO_PMIC_ARB_OBS3_CHNL2_RDATA1_ADDR A:0xe63011c
y.create.l HWIO_PMIC_ARB_OBS3_CHNL3_RDATA1_ADDR A:0xe63019c
y.create.l HWIO_PMIC_ARB_OBS3_CHNL4_RDATA1_ADDR A:0xe63021c
y.create.l HWIO_PMIC_ARB_OBS3_CHNL5_RDATA1_ADDR A:0xe63029c
y.create.l HWIO_PMIC_ARB_OBS3_CHNL6_RDATA1_ADDR A:0xe63031c
y.create.l HWIO_PMIC_ARB_OBS3_CHNL7_RDATA1_ADDR A:0xe63039c
y.create.l HWIO_PMIC_ARB_OBS3_CHNL8_RDATA1_ADDR A:0xe63041c
y.create.l HWIO_PMIC_ARB_OBS3_CHNL9_RDATA1_ADDR A:0xe63049c
y.create.l HWIO_PMIC_ARB_OBS3_CHNL10_RDATA1_ADDR A:0xe63051c
y.create.l HWIO_PMIC_ARB_OBS3_CHNL11_RDATA1_ADDR A:0xe63059c
y.create.l HWIO_PMIC_ARB_OBS3_CHNL12_RDATA1_ADDR A:0xe63061c
y.create.l HWIO_PMIC_ARB_OBS3_CHNL13_RDATA1_ADDR A:0xe63069c
y.create.l HWIO_PMIC_ARB_OBS3_CHNL14_RDATA1_ADDR A:0xe63071c
y.create.l HWIO_PMIC_ARB_OBS3_CHNL15_RDATA1_ADDR A:0xe63079c
y.create.l HWIO_PMIC_ARB_OBS3_CHNL16_RDATA1_ADDR A:0xe63081c
y.create.l HWIO_PMIC_ARB_OBS3_CHNL17_RDATA1_ADDR A:0xe63089c
y.create.l HWIO_PMIC_ARB_OBS3_CHNL18_RDATA1_ADDR A:0xe63091c
y.create.l HWIO_PMIC_ARB_OBS3_CHNL19_RDATA1_ADDR A:0xe63099c
y.create.l HWIO_PMIC_ARB_OBS3_CHNL20_RDATA1_ADDR A:0xe630a1c
y.create.l HWIO_PMIC_ARB_OBS3_CHNL21_RDATA1_ADDR A:0xe630a9c
y.create.l HWIO_PMIC_ARB_OBS3_CHNL22_RDATA1_ADDR A:0xe630b1c
y.create.l HWIO_PMIC_ARB_OBS3_CHNL23_RDATA1_ADDR A:0xe630b9c
y.create.l HWIO_PMIC_ARB_OBS3_CHNL24_RDATA1_ADDR A:0xe630c1c
y.create.l HWIO_PMIC_ARB_OBS3_CHNL25_RDATA1_ADDR A:0xe630c9c
y.create.l HWIO_PMIC_ARB_OBS3_CHNL26_RDATA1_ADDR A:0xe630d1c
y.create.l HWIO_PMIC_ARB_OBS3_CHNL27_RDATA1_ADDR A:0xe630d9c
y.create.l HWIO_PMIC_ARB_OBS3_CHNL28_RDATA1_ADDR A:0xe630e1c
y.create.l HWIO_PMIC_ARB_OBS3_CHNL29_RDATA1_ADDR A:0xe630e9c
y.create.l HWIO_PMIC_ARB_OBS3_CHNL30_RDATA1_ADDR A:0xe630f1c
y.create.l HWIO_PMIC_ARB_OBS3_CHNL31_RDATA1_ADDR A:0xe630f9c
y.create.l HWIO_PMIC_ARB_OBS3_CHNL32_RDATA1_ADDR A:0xe63101c
y.create.l HWIO_PMIC_ARB_OBS3_CHNL33_RDATA1_ADDR A:0xe63109c
y.create.l HWIO_PMIC_ARB_OBS3_CHNL34_RDATA1_ADDR A:0xe63111c
y.create.l HWIO_PMIC_ARB_OBS3_CHNL35_RDATA1_ADDR A:0xe63119c
y.create.l HWIO_PMIC_ARB_OBS3_CHNL36_RDATA1_ADDR A:0xe63121c
y.create.l HWIO_PMIC_ARB_OBS3_CHNL37_RDATA1_ADDR A:0xe63129c
y.create.l HWIO_PMIC_ARB_OBS3_CHNL38_RDATA1_ADDR A:0xe63131c
y.create.l HWIO_PMIC_ARB_OBS3_CHNL39_RDATA1_ADDR A:0xe63139c
y.create.l HWIO_PMIC_ARB_OBS3_CHNL40_RDATA1_ADDR A:0xe63141c
y.create.l HWIO_PMIC_ARB_OBS3_CHNL41_RDATA1_ADDR A:0xe63149c
y.create.l HWIO_PMIC_ARB_OBS3_CHNL42_RDATA1_ADDR A:0xe63151c
y.create.l HWIO_PMIC_ARB_OBS3_CHNL43_RDATA1_ADDR A:0xe63159c
y.create.l HWIO_PMIC_ARB_OBS3_CHNL44_RDATA1_ADDR A:0xe63161c
y.create.l HWIO_PMIC_ARB_OBS3_CHNL45_RDATA1_ADDR A:0xe63169c
y.create.l HWIO_PMIC_ARB_OBS3_CHNL46_RDATA1_ADDR A:0xe63171c
y.create.l HWIO_PMIC_ARB_OBS3_CHNL47_RDATA1_ADDR A:0xe63179c
y.create.l HWIO_PMIC_ARB_OBS3_CHNL48_RDATA1_ADDR A:0xe63181c
y.create.l HWIO_PMIC_ARB_OBS3_CHNL49_RDATA1_ADDR A:0xe63189c
y.create.l HWIO_PMIC_ARB_OBS3_CHNL50_RDATA1_ADDR A:0xe63191c
y.create.l HWIO_PMIC_ARB_OBS3_CHNL51_RDATA1_ADDR A:0xe63199c
y.create.l HWIO_PMIC_ARB_OBS3_CHNL52_RDATA1_ADDR A:0xe631a1c
y.create.l HWIO_PMIC_ARB_OBS3_CHNL53_RDATA1_ADDR A:0xe631a9c
y.create.l HWIO_PMIC_ARB_OBS3_CHNL54_RDATA1_ADDR A:0xe631b1c
y.create.l HWIO_PMIC_ARB_OBS3_CHNL55_RDATA1_ADDR A:0xe631b9c
y.create.l HWIO_PMIC_ARB_OBS3_CHNL56_RDATA1_ADDR A:0xe631c1c
y.create.l HWIO_PMIC_ARB_OBS3_CHNL57_RDATA1_ADDR A:0xe631c9c
y.create.l HWIO_PMIC_ARB_OBS3_CHNL58_RDATA1_ADDR A:0xe631d1c
y.create.l HWIO_PMIC_ARB_OBS3_CHNL59_RDATA1_ADDR A:0xe631d9c
y.create.l HWIO_PMIC_ARB_OBS3_CHNL60_RDATA1_ADDR A:0xe631e1c
y.create.l HWIO_PMIC_ARB_OBS3_CHNL61_RDATA1_ADDR A:0xe631e9c
y.create.l HWIO_PMIC_ARB_OBS3_CHNL62_RDATA1_ADDR A:0xe631f1c
y.create.l HWIO_PMIC_ARB_OBS3_CHNL63_RDATA1_ADDR A:0xe631f9c
y.create.l HWIO_PMIC_ARB_OBS3_CHNL64_RDATA1_ADDR A:0xe63201c
y.create.l HWIO_PMIC_ARB_OBS3_CHNL65_RDATA1_ADDR A:0xe63209c
y.create.l HWIO_PMIC_ARB_OBS3_CHNL66_RDATA1_ADDR A:0xe63211c
y.create.l HWIO_PMIC_ARB_OBS3_CHNL67_RDATA1_ADDR A:0xe63219c
y.create.l HWIO_PMIC_ARB_OBS3_CHNL68_RDATA1_ADDR A:0xe63221c
y.create.l HWIO_PMIC_ARB_OBS3_CHNL69_RDATA1_ADDR A:0xe63229c
y.create.l HWIO_PMIC_ARB_OBS3_CHNL70_RDATA1_ADDR A:0xe63231c
y.create.l HWIO_PMIC_ARB_OBS3_CHNL71_RDATA1_ADDR A:0xe63239c
y.create.l HWIO_PMIC_ARB_OBS3_CHNL72_RDATA1_ADDR A:0xe63241c
y.create.l HWIO_PMIC_ARB_OBS3_CHNL73_RDATA1_ADDR A:0xe63249c
y.create.l HWIO_PMIC_ARB_OBS3_CHNL74_RDATA1_ADDR A:0xe63251c
y.create.l HWIO_PMIC_ARB_OBS3_CHNL75_RDATA1_ADDR A:0xe63259c
y.create.l HWIO_PMIC_ARB_OBS3_CHNL76_RDATA1_ADDR A:0xe63261c
y.create.l HWIO_PMIC_ARB_OBS3_CHNL77_RDATA1_ADDR A:0xe63269c
y.create.l HWIO_PMIC_ARB_OBS3_CHNL78_RDATA1_ADDR A:0xe63271c
y.create.l HWIO_PMIC_ARB_OBS3_CHNL79_RDATA1_ADDR A:0xe63279c
y.create.l HWIO_PMIC_ARB_OBS3_CHNL80_RDATA1_ADDR A:0xe63281c
y.create.l HWIO_PMIC_ARB_OBS3_CHNL81_RDATA1_ADDR A:0xe63289c
y.create.l HWIO_PMIC_ARB_OBS3_CHNL82_RDATA1_ADDR A:0xe63291c
y.create.l HWIO_PMIC_ARB_OBS3_CHNL83_RDATA1_ADDR A:0xe63299c
y.create.l HWIO_PMIC_ARB_OBS3_CHNL84_RDATA1_ADDR A:0xe632a1c
y.create.l HWIO_PMIC_ARB_OBS3_CHNL85_RDATA1_ADDR A:0xe632a9c
y.create.l HWIO_PMIC_ARB_OBS3_CHNL86_RDATA1_ADDR A:0xe632b1c
y.create.l HWIO_PMIC_ARB_OBS3_CHNL87_RDATA1_ADDR A:0xe632b9c
y.create.l HWIO_PMIC_ARB_OBS3_CHNL88_RDATA1_ADDR A:0xe632c1c
y.create.l HWIO_PMIC_ARB_OBS3_CHNL89_RDATA1_ADDR A:0xe632c9c
y.create.l HWIO_PMIC_ARB_OBS3_CHNL90_RDATA1_ADDR A:0xe632d1c
y.create.l HWIO_PMIC_ARB_OBS3_CHNL91_RDATA1_ADDR A:0xe632d9c
y.create.l HWIO_PMIC_ARB_OBS3_CHNL92_RDATA1_ADDR A:0xe632e1c
y.create.l HWIO_PMIC_ARB_OBS3_CHNL93_RDATA1_ADDR A:0xe632e9c
y.create.l HWIO_PMIC_ARB_OBS3_CHNL94_RDATA1_ADDR A:0xe632f1c
y.create.l HWIO_PMIC_ARB_OBS3_CHNL95_RDATA1_ADDR A:0xe632f9c
y.create.l HWIO_PMIC_ARB_OBS3_CHNL96_RDATA1_ADDR A:0xe63301c
y.create.l HWIO_PMIC_ARB_OBS3_CHNL97_RDATA1_ADDR A:0xe63309c
y.create.l HWIO_PMIC_ARB_OBS3_CHNL98_RDATA1_ADDR A:0xe63311c
y.create.l HWIO_PMIC_ARB_OBS3_CHNL99_RDATA1_ADDR A:0xe63319c
y.create.l HWIO_PMIC_ARB_OBS3_CHNL100_RDATA1_ADDR A:0xe63321c
y.create.l HWIO_PMIC_ARB_OBS3_CHNL101_RDATA1_ADDR A:0xe63329c
y.create.l HWIO_PMIC_ARB_OBS3_CHNL102_RDATA1_ADDR A:0xe63331c
y.create.l HWIO_PMIC_ARB_OBS3_CHNL103_RDATA1_ADDR A:0xe63339c
y.create.l HWIO_PMIC_ARB_OBS3_CHNL104_RDATA1_ADDR A:0xe63341c
y.create.l HWIO_PMIC_ARB_OBS3_CHNL105_RDATA1_ADDR A:0xe63349c
y.create.l HWIO_PMIC_ARB_OBS3_CHNL106_RDATA1_ADDR A:0xe63351c
y.create.l HWIO_PMIC_ARB_OBS3_CHNL107_RDATA1_ADDR A:0xe63359c
y.create.l HWIO_PMIC_ARB_OBS3_CHNL108_RDATA1_ADDR A:0xe63361c
y.create.l HWIO_PMIC_ARB_OBS3_CHNL109_RDATA1_ADDR A:0xe63369c
y.create.l HWIO_PMIC_ARB_OBS3_CHNL110_RDATA1_ADDR A:0xe63371c
y.create.l HWIO_PMIC_ARB_OBS3_CHNL111_RDATA1_ADDR A:0xe63379c
y.create.l HWIO_PMIC_ARB_OBS3_CHNL112_RDATA1_ADDR A:0xe63381c
y.create.l HWIO_PMIC_ARB_OBS3_CHNL113_RDATA1_ADDR A:0xe63389c
y.create.l HWIO_PMIC_ARB_OBS3_CHNL114_RDATA1_ADDR A:0xe63391c
y.create.l HWIO_PMIC_ARB_OBS3_CHNL115_RDATA1_ADDR A:0xe63399c
y.create.l HWIO_PMIC_ARB_OBS3_CHNL116_RDATA1_ADDR A:0xe633a1c
y.create.l HWIO_PMIC_ARB_OBS3_CHNL117_RDATA1_ADDR A:0xe633a9c
y.create.l HWIO_PMIC_ARB_OBS3_CHNL118_RDATA1_ADDR A:0xe633b1c
y.create.l HWIO_PMIC_ARB_OBS3_CHNL119_RDATA1_ADDR A:0xe633b9c
y.create.l HWIO_PMIC_ARB_OBS3_CHNL120_RDATA1_ADDR A:0xe633c1c
y.create.l HWIO_PMIC_ARB_OBS3_CHNL121_RDATA1_ADDR A:0xe633c9c
y.create.l HWIO_PMIC_ARB_OBS3_CHNL122_RDATA1_ADDR A:0xe633d1c
y.create.l HWIO_PMIC_ARB_OBS3_CHNL123_RDATA1_ADDR A:0xe633d9c
y.create.l HWIO_PMIC_ARB_OBS3_CHNL124_RDATA1_ADDR A:0xe633e1c
y.create.l HWIO_PMIC_ARB_OBS3_CHNL125_RDATA1_ADDR A:0xe633e9c
y.create.l HWIO_PMIC_ARB_OBS3_CHNL126_RDATA1_ADDR A:0xe633f1c
y.create.l HWIO_PMIC_ARB_OBS3_CHNL127_RDATA1_ADDR A:0xe633f9c
y.create.l HWIO_PMIC_ARB_OBS3_CHNL128_RDATA1_ADDR A:0xe63401c
y.create.l HWIO_PMIC_ARB_OBS3_CHNL129_RDATA1_ADDR A:0xe63409c
y.create.l HWIO_PMIC_ARB_OBS3_CHNL130_RDATA1_ADDR A:0xe63411c
y.create.l HWIO_PMIC_ARB_OBS3_CHNL131_RDATA1_ADDR A:0xe63419c
y.create.l HWIO_PMIC_ARB_OBS3_CHNL132_RDATA1_ADDR A:0xe63421c
y.create.l HWIO_PMIC_ARB_OBS3_CHNL133_RDATA1_ADDR A:0xe63429c
y.create.l HWIO_PMIC_ARB_OBS3_CHNL134_RDATA1_ADDR A:0xe63431c
y.create.l HWIO_PMIC_ARB_OBS3_CHNL135_RDATA1_ADDR A:0xe63439c
y.create.l HWIO_PMIC_ARB_OBS3_CHNL136_RDATA1_ADDR A:0xe63441c
y.create.l HWIO_PMIC_ARB_OBS3_CHNL137_RDATA1_ADDR A:0xe63449c
y.create.l HWIO_PMIC_ARB_OBS3_CHNL138_RDATA1_ADDR A:0xe63451c
y.create.l HWIO_PMIC_ARB_OBS3_CHNL139_RDATA1_ADDR A:0xe63459c
y.create.l HWIO_PMIC_ARB_OBS3_CHNL140_RDATA1_ADDR A:0xe63461c
y.create.l HWIO_PMIC_ARB_OBS3_CHNL141_RDATA1_ADDR A:0xe63469c
y.create.l HWIO_PMIC_ARB_OBS3_CHNL142_RDATA1_ADDR A:0xe63471c
y.create.l HWIO_PMIC_ARB_OBS3_CHNL143_RDATA1_ADDR A:0xe63479c
y.create.l HWIO_PMIC_ARB_OBS3_CHNL144_RDATA1_ADDR A:0xe63481c
y.create.l HWIO_PMIC_ARB_OBS3_CHNL145_RDATA1_ADDR A:0xe63489c
y.create.l HWIO_PMIC_ARB_OBS3_CHNL146_RDATA1_ADDR A:0xe63491c
y.create.l HWIO_PMIC_ARB_OBS3_CHNL147_RDATA1_ADDR A:0xe63499c
y.create.l HWIO_PMIC_ARB_OBS3_CHNL148_RDATA1_ADDR A:0xe634a1c
y.create.l HWIO_PMIC_ARB_OBS3_CHNL149_RDATA1_ADDR A:0xe634a9c
y.create.l HWIO_PMIC_ARB_OBS3_CHNL150_RDATA1_ADDR A:0xe634b1c
y.create.l HWIO_PMIC_ARB_OBS3_CHNL151_RDATA1_ADDR A:0xe634b9c
y.create.l HWIO_PMIC_ARB_OBS3_CHNL152_RDATA1_ADDR A:0xe634c1c
y.create.l HWIO_PMIC_ARB_OBS3_CHNL153_RDATA1_ADDR A:0xe634c9c
y.create.l HWIO_PMIC_ARB_OBS3_CHNL154_RDATA1_ADDR A:0xe634d1c
y.create.l HWIO_PMIC_ARB_OBS3_CHNL155_RDATA1_ADDR A:0xe634d9c
y.create.l HWIO_PMIC_ARB_OBS3_CHNL156_RDATA1_ADDR A:0xe634e1c
y.create.l HWIO_PMIC_ARB_OBS3_CHNL157_RDATA1_ADDR A:0xe634e9c
y.create.l HWIO_PMIC_ARB_OBS3_CHNL158_RDATA1_ADDR A:0xe634f1c
y.create.l HWIO_PMIC_ARB_OBS3_CHNL159_RDATA1_ADDR A:0xe634f9c
y.create.l HWIO_PMIC_ARB_OBS3_CHNL160_RDATA1_ADDR A:0xe63501c
y.create.l HWIO_PMIC_ARB_OBS3_CHNL161_RDATA1_ADDR A:0xe63509c
y.create.l HWIO_PMIC_ARB_OBS3_CHNL162_RDATA1_ADDR A:0xe63511c
y.create.l HWIO_PMIC_ARB_OBS3_CHNL163_RDATA1_ADDR A:0xe63519c
y.create.l HWIO_PMIC_ARB_OBS3_CHNL164_RDATA1_ADDR A:0xe63521c
y.create.l HWIO_PMIC_ARB_OBS3_CHNL165_RDATA1_ADDR A:0xe63529c
y.create.l HWIO_PMIC_ARB_OBS3_CHNL166_RDATA1_ADDR A:0xe63531c
y.create.l HWIO_PMIC_ARB_OBS3_CHNL167_RDATA1_ADDR A:0xe63539c
y.create.l HWIO_PMIC_ARB_OBS3_CHNL168_RDATA1_ADDR A:0xe63541c
y.create.l HWIO_PMIC_ARB_OBS3_CHNL169_RDATA1_ADDR A:0xe63549c
y.create.l HWIO_PMIC_ARB_OBS3_CHNL170_RDATA1_ADDR A:0xe63551c
y.create.l HWIO_PMIC_ARB_OBS3_CHNL171_RDATA1_ADDR A:0xe63559c
y.create.l HWIO_PMIC_ARB_OBS3_CHNL172_RDATA1_ADDR A:0xe63561c
y.create.l HWIO_PMIC_ARB_OBS3_CHNL173_RDATA1_ADDR A:0xe63569c
y.create.l HWIO_PMIC_ARB_OBS3_CHNL174_RDATA1_ADDR A:0xe63571c
y.create.l HWIO_PMIC_ARB_OBS3_CHNL175_RDATA1_ADDR A:0xe63579c
y.create.l HWIO_PMIC_ARB_OBS3_CHNL176_RDATA1_ADDR A:0xe63581c
y.create.l HWIO_PMIC_ARB_OBS3_CHNL177_RDATA1_ADDR A:0xe63589c
y.create.l HWIO_PMIC_ARB_OBS3_CHNL178_RDATA1_ADDR A:0xe63591c
y.create.l HWIO_PMIC_ARB_OBS3_CHNL179_RDATA1_ADDR A:0xe63599c
y.create.l HWIO_PMIC_ARB_OBS3_CHNL180_RDATA1_ADDR A:0xe635a1c
y.create.l HWIO_PMIC_ARB_OBS3_CHNL181_RDATA1_ADDR A:0xe635a9c
y.create.l HWIO_PMIC_ARB_OBS3_CHNL182_RDATA1_ADDR A:0xe635b1c
y.create.l HWIO_PMIC_ARB_OBS3_CHNL183_RDATA1_ADDR A:0xe635b9c
y.create.l HWIO_PMIC_ARB_OBS3_CHNL184_RDATA1_ADDR A:0xe635c1c
y.create.l HWIO_PMIC_ARB_OBS3_CHNL185_RDATA1_ADDR A:0xe635c9c
y.create.l HWIO_PMIC_ARB_OBS3_CHNL186_RDATA1_ADDR A:0xe635d1c
y.create.l HWIO_PMIC_ARB_OBS3_CHNL187_RDATA1_ADDR A:0xe635d9c
y.create.l HWIO_PMIC_ARB_OBS3_CHNL188_RDATA1_ADDR A:0xe635e1c
y.create.l HWIO_PMIC_ARB_OBS3_CHNL189_RDATA1_ADDR A:0xe635e9c
y.create.l HWIO_PMIC_ARB_OBS3_CHNL190_RDATA1_ADDR A:0xe635f1c
y.create.l HWIO_PMIC_ARB_OBS3_CHNL191_RDATA1_ADDR A:0xe635f9c
y.create.l HWIO_PMIC_ARB_OBS3_CHNL192_RDATA1_ADDR A:0xe63601c
y.create.l HWIO_PMIC_ARB_OBS3_CHNL193_RDATA1_ADDR A:0xe63609c
y.create.l HWIO_PMIC_ARB_OBS3_CHNL194_RDATA1_ADDR A:0xe63611c
y.create.l HWIO_PMIC_ARB_OBS3_CHNL195_RDATA1_ADDR A:0xe63619c
y.create.l HWIO_PMIC_ARB_OBS3_CHNL196_RDATA1_ADDR A:0xe63621c
y.create.l HWIO_PMIC_ARB_OBS3_CHNL197_RDATA1_ADDR A:0xe63629c
y.create.l HWIO_PMIC_ARB_OBS3_CHNL198_RDATA1_ADDR A:0xe63631c
y.create.l HWIO_PMIC_ARB_OBS3_CHNL199_RDATA1_ADDR A:0xe63639c
y.create.l HWIO_PMIC_ARB_OBS3_CHNL200_RDATA1_ADDR A:0xe63641c
y.create.l HWIO_PMIC_ARB_OBS3_CHNL201_RDATA1_ADDR A:0xe63649c
y.create.l HWIO_PMIC_ARB_OBS3_CHNL202_RDATA1_ADDR A:0xe63651c
y.create.l HWIO_PMIC_ARB_OBS3_CHNL203_RDATA1_ADDR A:0xe63659c
y.create.l HWIO_PMIC_ARB_OBS3_CHNL204_RDATA1_ADDR A:0xe63661c
y.create.l HWIO_PMIC_ARB_OBS3_CHNL205_RDATA1_ADDR A:0xe63669c
y.create.l HWIO_PMIC_ARB_OBS3_CHNL206_RDATA1_ADDR A:0xe63671c
y.create.l HWIO_PMIC_ARB_OBS3_CHNL207_RDATA1_ADDR A:0xe63679c
y.create.l HWIO_PMIC_ARB_OBS3_CHNL208_RDATA1_ADDR A:0xe63681c
y.create.l HWIO_PMIC_ARB_OBS3_CHNL209_RDATA1_ADDR A:0xe63689c
y.create.l HWIO_PMIC_ARB_OBS3_CHNL210_RDATA1_ADDR A:0xe63691c
y.create.l HWIO_PMIC_ARB_OBS3_CHNL211_RDATA1_ADDR A:0xe63699c
y.create.l HWIO_PMIC_ARB_OBS3_CHNL212_RDATA1_ADDR A:0xe636a1c
y.create.l HWIO_PMIC_ARB_OBS3_CHNL213_RDATA1_ADDR A:0xe636a9c
y.create.l HWIO_PMIC_ARB_OBS3_CHNL214_RDATA1_ADDR A:0xe636b1c
y.create.l HWIO_PMIC_ARB_OBS3_CHNL215_RDATA1_ADDR A:0xe636b9c
y.create.l HWIO_PMIC_ARB_OBS3_CHNL216_RDATA1_ADDR A:0xe636c1c
y.create.l HWIO_PMIC_ARB_OBS3_CHNL217_RDATA1_ADDR A:0xe636c9c
y.create.l HWIO_PMIC_ARB_OBS3_CHNL218_RDATA1_ADDR A:0xe636d1c
y.create.l HWIO_PMIC_ARB_OBS3_CHNL219_RDATA1_ADDR A:0xe636d9c
y.create.l HWIO_PMIC_ARB_OBS3_CHNL220_RDATA1_ADDR A:0xe636e1c
y.create.l HWIO_PMIC_ARB_OBS3_CHNL221_RDATA1_ADDR A:0xe636e9c
y.create.l HWIO_PMIC_ARB_OBS3_CHNL222_RDATA1_ADDR A:0xe636f1c
y.create.l HWIO_PMIC_ARB_OBS3_CHNL223_RDATA1_ADDR A:0xe636f9c
y.create.l HWIO_PMIC_ARB_OBS3_CHNL224_RDATA1_ADDR A:0xe63701c
y.create.l HWIO_PMIC_ARB_OBS3_CHNL225_RDATA1_ADDR A:0xe63709c
y.create.l HWIO_PMIC_ARB_OBS3_CHNL226_RDATA1_ADDR A:0xe63711c
y.create.l HWIO_PMIC_ARB_OBS3_CHNL227_RDATA1_ADDR A:0xe63719c
y.create.l HWIO_PMIC_ARB_OBS3_CHNL228_RDATA1_ADDR A:0xe63721c
y.create.l HWIO_PMIC_ARB_OBS3_CHNL229_RDATA1_ADDR A:0xe63729c
y.create.l HWIO_PMIC_ARB_OBS3_CHNL230_RDATA1_ADDR A:0xe63731c
y.create.l HWIO_PMIC_ARB_OBS3_CHNL231_RDATA1_ADDR A:0xe63739c
y.create.l HWIO_PMIC_ARB_OBS3_CHNL232_RDATA1_ADDR A:0xe63741c
y.create.l HWIO_PMIC_ARB_OBS3_CHNL233_RDATA1_ADDR A:0xe63749c
y.create.l HWIO_PMIC_ARB_OBS3_CHNL234_RDATA1_ADDR A:0xe63751c
y.create.l HWIO_PMIC_ARB_OBS3_CHNL235_RDATA1_ADDR A:0xe63759c
y.create.l HWIO_PMIC_ARB_OBS3_CHNL236_RDATA1_ADDR A:0xe63761c
y.create.l HWIO_PMIC_ARB_OBS3_CHNL237_RDATA1_ADDR A:0xe63769c
y.create.l HWIO_PMIC_ARB_OBS3_CHNL238_RDATA1_ADDR A:0xe63771c
y.create.l HWIO_PMIC_ARB_OBS3_CHNL239_RDATA1_ADDR A:0xe63779c
y.create.l HWIO_PMIC_ARB_OBS3_CHNL240_RDATA1_ADDR A:0xe63781c
y.create.l HWIO_PMIC_ARB_OBS3_CHNL241_RDATA1_ADDR A:0xe63789c
y.create.l HWIO_PMIC_ARB_OBS3_CHNL242_RDATA1_ADDR A:0xe63791c
y.create.l HWIO_PMIC_ARB_OBS3_CHNL243_RDATA1_ADDR A:0xe63799c
y.create.l HWIO_PMIC_ARB_OBS3_CHNL244_RDATA1_ADDR A:0xe637a1c
y.create.l HWIO_PMIC_ARB_OBS3_CHNL245_RDATA1_ADDR A:0xe637a9c
y.create.l HWIO_PMIC_ARB_OBS3_CHNL246_RDATA1_ADDR A:0xe637b1c
y.create.l HWIO_PMIC_ARB_OBS3_CHNL247_RDATA1_ADDR A:0xe637b9c
y.create.l HWIO_PMIC_ARB_OBS3_CHNL248_RDATA1_ADDR A:0xe637c1c
y.create.l HWIO_PMIC_ARB_OBS3_CHNL249_RDATA1_ADDR A:0xe637c9c
y.create.l HWIO_PMIC_ARB_OBS3_CHNL250_RDATA1_ADDR A:0xe637d1c
y.create.l HWIO_PMIC_ARB_OBS3_CHNL251_RDATA1_ADDR A:0xe637d9c
y.create.l HWIO_PMIC_ARB_OBS3_CHNL252_RDATA1_ADDR A:0xe637e1c
y.create.l HWIO_PMIC_ARB_OBS3_CHNL253_RDATA1_ADDR A:0xe637e9c
y.create.l HWIO_PMIC_ARB_OBS3_CHNL254_RDATA1_ADDR A:0xe637f1c
y.create.l HWIO_PMIC_ARB_OBS3_CHNL255_RDATA1_ADDR A:0xe637f9c
y.create.l HWIO_PMIC_ARB_OBS3_CHNL256_RDATA1_ADDR A:0xe63801c
y.create.l HWIO_PMIC_ARB_OBS3_CHNL257_RDATA1_ADDR A:0xe63809c
y.create.l HWIO_PMIC_ARB_OBS3_CHNL258_RDATA1_ADDR A:0xe63811c
y.create.l HWIO_PMIC_ARB_OBS3_CHNL259_RDATA1_ADDR A:0xe63819c
y.create.l HWIO_PMIC_ARB_OBS3_CHNL260_RDATA1_ADDR A:0xe63821c
y.create.l HWIO_PMIC_ARB_OBS3_CHNL261_RDATA1_ADDR A:0xe63829c
y.create.l HWIO_PMIC_ARB_OBS3_CHNL262_RDATA1_ADDR A:0xe63831c
y.create.l HWIO_PMIC_ARB_OBS3_CHNL263_RDATA1_ADDR A:0xe63839c
y.create.l HWIO_PMIC_ARB_OBS3_CHNL264_RDATA1_ADDR A:0xe63841c
y.create.l HWIO_PMIC_ARB_OBS3_CHNL265_RDATA1_ADDR A:0xe63849c
y.create.l HWIO_PMIC_ARB_OBS3_CHNL266_RDATA1_ADDR A:0xe63851c
y.create.l HWIO_PMIC_ARB_OBS3_CHNL267_RDATA1_ADDR A:0xe63859c
y.create.l HWIO_PMIC_ARB_OBS3_CHNL268_RDATA1_ADDR A:0xe63861c
y.create.l HWIO_PMIC_ARB_OBS3_CHNL269_RDATA1_ADDR A:0xe63869c
y.create.l HWIO_PMIC_ARB_OBS3_CHNL270_RDATA1_ADDR A:0xe63871c
y.create.l HWIO_PMIC_ARB_OBS3_CHNL271_RDATA1_ADDR A:0xe63879c
y.create.l HWIO_PMIC_ARB_OBS3_CHNL272_RDATA1_ADDR A:0xe63881c
y.create.l HWIO_PMIC_ARB_OBS3_CHNL273_RDATA1_ADDR A:0xe63889c
y.create.l HWIO_PMIC_ARB_OBS3_CHNL274_RDATA1_ADDR A:0xe63891c
y.create.l HWIO_PMIC_ARB_OBS3_CHNL275_RDATA1_ADDR A:0xe63899c
y.create.l HWIO_PMIC_ARB_OBS3_CHNL276_RDATA1_ADDR A:0xe638a1c
y.create.l HWIO_PMIC_ARB_OBS3_CHNL277_RDATA1_ADDR A:0xe638a9c
y.create.l HWIO_PMIC_ARB_OBS3_CHNL278_RDATA1_ADDR A:0xe638b1c
y.create.l HWIO_PMIC_ARB_OBS3_CHNL279_RDATA1_ADDR A:0xe638b9c
y.create.l HWIO_PMIC_ARB_OBS3_CHNL280_RDATA1_ADDR A:0xe638c1c
y.create.l HWIO_PMIC_ARB_OBS3_CHNL281_RDATA1_ADDR A:0xe638c9c
y.create.l HWIO_PMIC_ARB_OBS3_CHNL282_RDATA1_ADDR A:0xe638d1c
y.create.l HWIO_PMIC_ARB_OBS3_CHNL283_RDATA1_ADDR A:0xe638d9c
y.create.l HWIO_PMIC_ARB_OBS3_CHNL284_RDATA1_ADDR A:0xe638e1c
y.create.l HWIO_PMIC_ARB_OBS3_CHNL285_RDATA1_ADDR A:0xe638e9c
y.create.l HWIO_PMIC_ARB_OBS3_CHNL286_RDATA1_ADDR A:0xe638f1c
y.create.l HWIO_PMIC_ARB_OBS3_CHNL287_RDATA1_ADDR A:0xe638f9c
y.create.l HWIO_PMIC_ARB_OBS3_CHNL288_RDATA1_ADDR A:0xe63901c
y.create.l HWIO_PMIC_ARB_OBS3_CHNL289_RDATA1_ADDR A:0xe63909c
y.create.l HWIO_PMIC_ARB_OBS3_CHNL290_RDATA1_ADDR A:0xe63911c
y.create.l HWIO_PMIC_ARB_OBS3_CHNL291_RDATA1_ADDR A:0xe63919c
y.create.l HWIO_PMIC_ARB_OBS3_CHNL292_RDATA1_ADDR A:0xe63921c
y.create.l HWIO_PMIC_ARB_OBS3_CHNL293_RDATA1_ADDR A:0xe63929c
y.create.l HWIO_PMIC_ARB_OBS3_CHNL294_RDATA1_ADDR A:0xe63931c
y.create.l HWIO_PMIC_ARB_OBS3_CHNL295_RDATA1_ADDR A:0xe63939c
y.create.l HWIO_PMIC_ARB_OBS3_CHNL296_RDATA1_ADDR A:0xe63941c
y.create.l HWIO_PMIC_ARB_OBS3_CHNL297_RDATA1_ADDR A:0xe63949c
y.create.l HWIO_PMIC_ARB_OBS3_CHNL298_RDATA1_ADDR A:0xe63951c
y.create.l HWIO_PMIC_ARB_OBS3_CHNL299_RDATA1_ADDR A:0xe63959c
y.create.l HWIO_PMIC_ARB_OBS3_CHNL300_RDATA1_ADDR A:0xe63961c
y.create.l HWIO_PMIC_ARB_OBS3_CHNL301_RDATA1_ADDR A:0xe63969c
y.create.l HWIO_PMIC_ARB_OBS3_CHNL302_RDATA1_ADDR A:0xe63971c
y.create.l HWIO_PMIC_ARB_OBS3_CHNL303_RDATA1_ADDR A:0xe63979c
y.create.l HWIO_PMIC_ARB_OBS3_CHNL304_RDATA1_ADDR A:0xe63981c
y.create.l HWIO_PMIC_ARB_OBS3_CHNL305_RDATA1_ADDR A:0xe63989c
y.create.l HWIO_PMIC_ARB_OBS3_CHNL306_RDATA1_ADDR A:0xe63991c
y.create.l HWIO_PMIC_ARB_OBS3_CHNL307_RDATA1_ADDR A:0xe63999c
y.create.l HWIO_PMIC_ARB_OBS3_CHNL308_RDATA1_ADDR A:0xe639a1c
y.create.l HWIO_PMIC_ARB_OBS3_CHNL309_RDATA1_ADDR A:0xe639a9c
y.create.l HWIO_PMIC_ARB_OBS3_CHNL310_RDATA1_ADDR A:0xe639b1c
y.create.l HWIO_PMIC_ARB_OBS3_CHNL311_RDATA1_ADDR A:0xe639b9c
y.create.l HWIO_PMIC_ARB_OBS3_CHNL312_RDATA1_ADDR A:0xe639c1c
y.create.l HWIO_PMIC_ARB_OBS3_CHNL313_RDATA1_ADDR A:0xe639c9c
y.create.l HWIO_PMIC_ARB_OBS3_CHNL314_RDATA1_ADDR A:0xe639d1c
y.create.l HWIO_PMIC_ARB_OBS3_CHNL315_RDATA1_ADDR A:0xe639d9c
y.create.l HWIO_PMIC_ARB_OBS3_CHNL316_RDATA1_ADDR A:0xe639e1c
y.create.l HWIO_PMIC_ARB_OBS3_CHNL317_RDATA1_ADDR A:0xe639e9c
y.create.l HWIO_PMIC_ARB_OBS3_CHNL318_RDATA1_ADDR A:0xe639f1c
y.create.l HWIO_PMIC_ARB_OBS3_CHNL319_RDATA1_ADDR A:0xe639f9c
y.create.l HWIO_PMIC_ARB_OBS3_CHNL320_RDATA1_ADDR A:0xe63a01c
y.create.l HWIO_PMIC_ARB_OBS3_CHNL321_RDATA1_ADDR A:0xe63a09c
y.create.l HWIO_PMIC_ARB_OBS3_CHNL322_RDATA1_ADDR A:0xe63a11c
y.create.l HWIO_PMIC_ARB_OBS3_CHNL323_RDATA1_ADDR A:0xe63a19c
y.create.l HWIO_PMIC_ARB_OBS3_CHNL324_RDATA1_ADDR A:0xe63a21c
y.create.l HWIO_PMIC_ARB_OBS3_CHNL325_RDATA1_ADDR A:0xe63a29c
y.create.l HWIO_PMIC_ARB_OBS3_CHNL326_RDATA1_ADDR A:0xe63a31c
y.create.l HWIO_PMIC_ARB_OBS3_CHNL327_RDATA1_ADDR A:0xe63a39c
y.create.l HWIO_PMIC_ARB_OBS3_CHNL328_RDATA1_ADDR A:0xe63a41c
y.create.l HWIO_PMIC_ARB_OBS3_CHNL329_RDATA1_ADDR A:0xe63a49c
y.create.l HWIO_PMIC_ARB_OBS3_CHNL330_RDATA1_ADDR A:0xe63a51c
y.create.l HWIO_PMIC_ARB_OBS3_CHNL331_RDATA1_ADDR A:0xe63a59c
y.create.l HWIO_PMIC_ARB_OBS3_CHNL332_RDATA1_ADDR A:0xe63a61c
y.create.l HWIO_PMIC_ARB_OBS3_CHNL333_RDATA1_ADDR A:0xe63a69c
y.create.l HWIO_PMIC_ARB_OBS3_CHNL334_RDATA1_ADDR A:0xe63a71c
y.create.l HWIO_PMIC_ARB_OBS3_CHNL335_RDATA1_ADDR A:0xe63a79c
y.create.l HWIO_PMIC_ARB_OBS3_CHNL336_RDATA1_ADDR A:0xe63a81c
y.create.l HWIO_PMIC_ARB_OBS3_CHNL337_RDATA1_ADDR A:0xe63a89c
y.create.l HWIO_PMIC_ARB_OBS3_CHNL338_RDATA1_ADDR A:0xe63a91c
y.create.l HWIO_PMIC_ARB_OBS3_CHNL339_RDATA1_ADDR A:0xe63a99c
y.create.l HWIO_PMIC_ARB_OBS3_CHNL340_RDATA1_ADDR A:0xe63aa1c
y.create.l HWIO_PMIC_ARB_OBS3_CHNL341_RDATA1_ADDR A:0xe63aa9c
y.create.l HWIO_PMIC_ARB_OBS3_CHNL342_RDATA1_ADDR A:0xe63ab1c
y.create.l HWIO_PMIC_ARB_OBS3_CHNL343_RDATA1_ADDR A:0xe63ab9c
y.create.l HWIO_PMIC_ARB_OBS3_CHNL344_RDATA1_ADDR A:0xe63ac1c
y.create.l HWIO_PMIC_ARB_OBS3_CHNL345_RDATA1_ADDR A:0xe63ac9c
y.create.l HWIO_PMIC_ARB_OBS3_CHNL346_RDATA1_ADDR A:0xe63ad1c
y.create.l HWIO_PMIC_ARB_OBS3_CHNL347_RDATA1_ADDR A:0xe63ad9c
y.create.l HWIO_PMIC_ARB_OBS3_CHNL348_RDATA1_ADDR A:0xe63ae1c
y.create.l HWIO_PMIC_ARB_OBS3_CHNL349_RDATA1_ADDR A:0xe63ae9c
y.create.l HWIO_PMIC_ARB_OBS3_CHNL350_RDATA1_ADDR A:0xe63af1c
y.create.l HWIO_PMIC_ARB_OBS3_CHNL351_RDATA1_ADDR A:0xe63af9c
y.create.l HWIO_PMIC_ARB_OBS3_CHNL352_RDATA1_ADDR A:0xe63b01c
y.create.l HWIO_PMIC_ARB_OBS3_CHNL353_RDATA1_ADDR A:0xe63b09c
y.create.l HWIO_PMIC_ARB_OBS3_CHNL354_RDATA1_ADDR A:0xe63b11c
y.create.l HWIO_PMIC_ARB_OBS3_CHNL355_RDATA1_ADDR A:0xe63b19c
y.create.l HWIO_PMIC_ARB_OBS3_CHNL356_RDATA1_ADDR A:0xe63b21c
y.create.l HWIO_PMIC_ARB_OBS3_CHNL357_RDATA1_ADDR A:0xe63b29c
y.create.l HWIO_PMIC_ARB_OBS3_CHNL358_RDATA1_ADDR A:0xe63b31c
y.create.l HWIO_PMIC_ARB_OBS3_CHNL359_RDATA1_ADDR A:0xe63b39c
y.create.l HWIO_PMIC_ARB_OBS3_CHNL360_RDATA1_ADDR A:0xe63b41c
y.create.l HWIO_PMIC_ARB_OBS3_CHNL361_RDATA1_ADDR A:0xe63b49c
y.create.l HWIO_PMIC_ARB_OBS3_CHNL362_RDATA1_ADDR A:0xe63b51c
y.create.l HWIO_PMIC_ARB_OBS3_CHNL363_RDATA1_ADDR A:0xe63b59c
y.create.l HWIO_PMIC_ARB_OBS3_CHNL364_RDATA1_ADDR A:0xe63b61c
y.create.l HWIO_PMIC_ARB_OBS3_CHNL365_RDATA1_ADDR A:0xe63b69c
y.create.l HWIO_PMIC_ARB_OBS3_CHNL366_RDATA1_ADDR A:0xe63b71c
y.create.l HWIO_PMIC_ARB_OBS3_CHNL367_RDATA1_ADDR A:0xe63b79c
y.create.l HWIO_PMIC_ARB_OBS3_CHNL368_RDATA1_ADDR A:0xe63b81c
y.create.l HWIO_PMIC_ARB_OBS3_CHNL369_RDATA1_ADDR A:0xe63b89c
y.create.l HWIO_PMIC_ARB_OBS3_CHNL370_RDATA1_ADDR A:0xe63b91c
y.create.l HWIO_PMIC_ARB_OBS3_CHNL371_RDATA1_ADDR A:0xe63b99c
y.create.l HWIO_PMIC_ARB_OBS3_CHNL372_RDATA1_ADDR A:0xe63ba1c
y.create.l HWIO_PMIC_ARB_OBS3_CHNL373_RDATA1_ADDR A:0xe63ba9c
y.create.l HWIO_PMIC_ARB_OBS3_CHNL374_RDATA1_ADDR A:0xe63bb1c
y.create.l HWIO_PMIC_ARB_OBS3_CHNL375_RDATA1_ADDR A:0xe63bb9c
y.create.l HWIO_PMIC_ARB_OBS3_CHNL376_RDATA1_ADDR A:0xe63bc1c
y.create.l HWIO_PMIC_ARB_OBS3_CHNL377_RDATA1_ADDR A:0xe63bc9c
y.create.l HWIO_PMIC_ARB_OBS3_CHNL378_RDATA1_ADDR A:0xe63bd1c
y.create.l HWIO_PMIC_ARB_OBS3_CHNL379_RDATA1_ADDR A:0xe63bd9c
y.create.l HWIO_PMIC_ARB_OBS3_CHNL380_RDATA1_ADDR A:0xe63be1c
y.create.l HWIO_PMIC_ARB_OBS3_CHNL381_RDATA1_ADDR A:0xe63be9c
y.create.l HWIO_PMIC_ARB_OBS3_CHNL382_RDATA1_ADDR A:0xe63bf1c
y.create.l HWIO_PMIC_ARB_OBS3_CHNL383_RDATA1_ADDR A:0xe63bf9c
y.create.l HWIO_PMIC_ARB_OBS3_CHNL384_RDATA1_ADDR A:0xe63c01c
y.create.l HWIO_PMIC_ARB_OBS3_CHNL385_RDATA1_ADDR A:0xe63c09c
y.create.l HWIO_PMIC_ARB_OBS3_CHNL386_RDATA1_ADDR A:0xe63c11c
y.create.l HWIO_PMIC_ARB_OBS3_CHNL387_RDATA1_ADDR A:0xe63c19c
y.create.l HWIO_PMIC_ARB_OBS3_CHNL388_RDATA1_ADDR A:0xe63c21c
y.create.l HWIO_PMIC_ARB_OBS3_CHNL389_RDATA1_ADDR A:0xe63c29c
y.create.l HWIO_PMIC_ARB_OBS3_CHNL390_RDATA1_ADDR A:0xe63c31c
y.create.l HWIO_PMIC_ARB_OBS3_CHNL391_RDATA1_ADDR A:0xe63c39c
y.create.l HWIO_PMIC_ARB_OBS3_CHNL392_RDATA1_ADDR A:0xe63c41c
y.create.l HWIO_PMIC_ARB_OBS3_CHNL393_RDATA1_ADDR A:0xe63c49c
y.create.l HWIO_PMIC_ARB_OBS3_CHNL394_RDATA1_ADDR A:0xe63c51c
y.create.l HWIO_PMIC_ARB_OBS3_CHNL395_RDATA1_ADDR A:0xe63c59c
y.create.l HWIO_PMIC_ARB_OBS3_CHNL396_RDATA1_ADDR A:0xe63c61c
y.create.l HWIO_PMIC_ARB_OBS3_CHNL397_RDATA1_ADDR A:0xe63c69c
y.create.l HWIO_PMIC_ARB_OBS3_CHNL398_RDATA1_ADDR A:0xe63c71c
y.create.l HWIO_PMIC_ARB_OBS3_CHNL399_RDATA1_ADDR A:0xe63c79c
y.create.l HWIO_PMIC_ARB_OBS3_CHNL400_RDATA1_ADDR A:0xe63c81c
y.create.l HWIO_PMIC_ARB_OBS3_CHNL401_RDATA1_ADDR A:0xe63c89c
y.create.l HWIO_PMIC_ARB_OBS3_CHNL402_RDATA1_ADDR A:0xe63c91c
y.create.l HWIO_PMIC_ARB_OBS3_CHNL403_RDATA1_ADDR A:0xe63c99c
y.create.l HWIO_PMIC_ARB_OBS3_CHNL404_RDATA1_ADDR A:0xe63ca1c
y.create.l HWIO_PMIC_ARB_OBS3_CHNL405_RDATA1_ADDR A:0xe63ca9c
y.create.l HWIO_PMIC_ARB_OBS3_CHNL406_RDATA1_ADDR A:0xe63cb1c
y.create.l HWIO_PMIC_ARB_OBS3_CHNL407_RDATA1_ADDR A:0xe63cb9c
y.create.l HWIO_PMIC_ARB_OBS3_CHNL408_RDATA1_ADDR A:0xe63cc1c
y.create.l HWIO_PMIC_ARB_OBS3_CHNL409_RDATA1_ADDR A:0xe63cc9c
y.create.l HWIO_PMIC_ARB_OBS3_CHNL410_RDATA1_ADDR A:0xe63cd1c
y.create.l HWIO_PMIC_ARB_OBS3_CHNL411_RDATA1_ADDR A:0xe63cd9c
y.create.l HWIO_PMIC_ARB_OBS3_CHNL412_RDATA1_ADDR A:0xe63ce1c
y.create.l HWIO_PMIC_ARB_OBS3_CHNL413_RDATA1_ADDR A:0xe63ce9c
y.create.l HWIO_PMIC_ARB_OBS3_CHNL414_RDATA1_ADDR A:0xe63cf1c
y.create.l HWIO_PMIC_ARB_OBS3_CHNL415_RDATA1_ADDR A:0xe63cf9c
y.create.l HWIO_PMIC_ARB_OBS3_CHNL416_RDATA1_ADDR A:0xe63d01c
y.create.l HWIO_PMIC_ARB_OBS3_CHNL417_RDATA1_ADDR A:0xe63d09c
y.create.l HWIO_PMIC_ARB_OBS3_CHNL418_RDATA1_ADDR A:0xe63d11c
y.create.l HWIO_PMIC_ARB_OBS3_CHNL419_RDATA1_ADDR A:0xe63d19c
y.create.l HWIO_PMIC_ARB_OBS3_CHNL420_RDATA1_ADDR A:0xe63d21c
y.create.l HWIO_PMIC_ARB_OBS3_CHNL421_RDATA1_ADDR A:0xe63d29c
y.create.l HWIO_PMIC_ARB_OBS3_CHNL422_RDATA1_ADDR A:0xe63d31c
y.create.l HWIO_PMIC_ARB_OBS3_CHNL423_RDATA1_ADDR A:0xe63d39c
y.create.l HWIO_PMIC_ARB_OBS3_CHNL424_RDATA1_ADDR A:0xe63d41c
y.create.l HWIO_PMIC_ARB_OBS3_CHNL425_RDATA1_ADDR A:0xe63d49c
y.create.l HWIO_PMIC_ARB_OBS3_CHNL426_RDATA1_ADDR A:0xe63d51c
y.create.l HWIO_PMIC_ARB_OBS3_CHNL427_RDATA1_ADDR A:0xe63d59c
y.create.l HWIO_PMIC_ARB_OBS3_CHNL428_RDATA1_ADDR A:0xe63d61c
y.create.l HWIO_PMIC_ARB_OBS3_CHNL429_RDATA1_ADDR A:0xe63d69c
y.create.l HWIO_PMIC_ARB_OBS3_CHNL430_RDATA1_ADDR A:0xe63d71c
y.create.l HWIO_PMIC_ARB_OBS3_CHNL431_RDATA1_ADDR A:0xe63d79c
y.create.l HWIO_PMIC_ARB_OBS3_CHNL432_RDATA1_ADDR A:0xe63d81c
y.create.l HWIO_PMIC_ARB_OBS3_CHNL433_RDATA1_ADDR A:0xe63d89c
y.create.l HWIO_PMIC_ARB_OBS3_CHNL434_RDATA1_ADDR A:0xe63d91c
y.create.l HWIO_PMIC_ARB_OBS3_CHNL435_RDATA1_ADDR A:0xe63d99c
y.create.l HWIO_PMIC_ARB_OBS3_CHNL436_RDATA1_ADDR A:0xe63da1c
y.create.l HWIO_PMIC_ARB_OBS3_CHNL437_RDATA1_ADDR A:0xe63da9c
y.create.l HWIO_PMIC_ARB_OBS3_CHNL438_RDATA1_ADDR A:0xe63db1c
y.create.l HWIO_PMIC_ARB_OBS3_CHNL439_RDATA1_ADDR A:0xe63db9c
y.create.l HWIO_PMIC_ARB_OBS3_CHNL440_RDATA1_ADDR A:0xe63dc1c
y.create.l HWIO_PMIC_ARB_OBS3_CHNL441_RDATA1_ADDR A:0xe63dc9c
y.create.l HWIO_PMIC_ARB_OBS3_CHNL442_RDATA1_ADDR A:0xe63dd1c
y.create.l HWIO_PMIC_ARB_OBS3_CHNL443_RDATA1_ADDR A:0xe63dd9c
y.create.l HWIO_PMIC_ARB_OBS3_CHNL444_RDATA1_ADDR A:0xe63de1c
y.create.l HWIO_PMIC_ARB_OBS3_CHNL445_RDATA1_ADDR A:0xe63de9c
y.create.l HWIO_PMIC_ARB_OBS3_CHNL446_RDATA1_ADDR A:0xe63df1c
y.create.l HWIO_PMIC_ARB_OBS3_CHNL447_RDATA1_ADDR A:0xe63df9c
y.create.l HWIO_PMIC_ARB_OBS3_CHNL448_RDATA1_ADDR A:0xe63e01c
y.create.l HWIO_PMIC_ARB_OBS3_CHNL449_RDATA1_ADDR A:0xe63e09c
y.create.l HWIO_PMIC_ARB_OBS3_CHNL450_RDATA1_ADDR A:0xe63e11c
y.create.l HWIO_PMIC_ARB_OBS3_CHNL451_RDATA1_ADDR A:0xe63e19c
y.create.l HWIO_PMIC_ARB_OBS3_CHNL452_RDATA1_ADDR A:0xe63e21c
y.create.l HWIO_PMIC_ARB_OBS3_CHNL453_RDATA1_ADDR A:0xe63e29c
y.create.l HWIO_PMIC_ARB_OBS3_CHNL454_RDATA1_ADDR A:0xe63e31c
y.create.l HWIO_PMIC_ARB_OBS3_CHNL455_RDATA1_ADDR A:0xe63e39c
y.create.l HWIO_PMIC_ARB_OBS3_CHNL456_RDATA1_ADDR A:0xe63e41c
y.create.l HWIO_PMIC_ARB_OBS3_CHNL457_RDATA1_ADDR A:0xe63e49c
y.create.l HWIO_PMIC_ARB_OBS3_CHNL458_RDATA1_ADDR A:0xe63e51c
y.create.l HWIO_PMIC_ARB_OBS3_CHNL459_RDATA1_ADDR A:0xe63e59c
y.create.l HWIO_PMIC_ARB_OBS3_CHNL460_RDATA1_ADDR A:0xe63e61c
y.create.l HWIO_PMIC_ARB_OBS3_CHNL461_RDATA1_ADDR A:0xe63e69c
y.create.l HWIO_PMIC_ARB_OBS3_CHNL462_RDATA1_ADDR A:0xe63e71c
y.create.l HWIO_PMIC_ARB_OBS3_CHNL463_RDATA1_ADDR A:0xe63e79c
y.create.l HWIO_PMIC_ARB_OBS3_CHNL464_RDATA1_ADDR A:0xe63e81c
y.create.l HWIO_PMIC_ARB_OBS3_CHNL465_RDATA1_ADDR A:0xe63e89c
y.create.l HWIO_PMIC_ARB_OBS3_CHNL466_RDATA1_ADDR A:0xe63e91c
y.create.l HWIO_PMIC_ARB_OBS3_CHNL467_RDATA1_ADDR A:0xe63e99c
y.create.l HWIO_PMIC_ARB_OBS3_CHNL468_RDATA1_ADDR A:0xe63ea1c
y.create.l HWIO_PMIC_ARB_OBS3_CHNL469_RDATA1_ADDR A:0xe63ea9c
y.create.l HWIO_PMIC_ARB_OBS3_CHNL470_RDATA1_ADDR A:0xe63eb1c
y.create.l HWIO_PMIC_ARB_OBS3_CHNL471_RDATA1_ADDR A:0xe63eb9c
y.create.l HWIO_PMIC_ARB_OBS3_CHNL472_RDATA1_ADDR A:0xe63ec1c
y.create.l HWIO_PMIC_ARB_OBS3_CHNL473_RDATA1_ADDR A:0xe63ec9c
y.create.l HWIO_PMIC_ARB_OBS3_CHNL474_RDATA1_ADDR A:0xe63ed1c
y.create.l HWIO_PMIC_ARB_OBS3_CHNL475_RDATA1_ADDR A:0xe63ed9c
y.create.l HWIO_PMIC_ARB_OBS3_CHNL476_RDATA1_ADDR A:0xe63ee1c
y.create.l HWIO_PMIC_ARB_OBS3_CHNL477_RDATA1_ADDR A:0xe63ee9c
y.create.l HWIO_PMIC_ARB_OBS3_CHNL478_RDATA1_ADDR A:0xe63ef1c
y.create.l HWIO_PMIC_ARB_OBS3_CHNL479_RDATA1_ADDR A:0xe63ef9c
y.create.l HWIO_PMIC_ARB_OBS3_CHNL480_RDATA1_ADDR A:0xe63f01c
y.create.l HWIO_PMIC_ARB_OBS3_CHNL481_RDATA1_ADDR A:0xe63f09c
y.create.l HWIO_PMIC_ARB_OBS3_CHNL482_RDATA1_ADDR A:0xe63f11c
y.create.l HWIO_PMIC_ARB_OBS3_CHNL483_RDATA1_ADDR A:0xe63f19c
y.create.l HWIO_PMIC_ARB_OBS3_CHNL484_RDATA1_ADDR A:0xe63f21c
y.create.l HWIO_PMIC_ARB_OBS3_CHNL485_RDATA1_ADDR A:0xe63f29c
y.create.l HWIO_PMIC_ARB_OBS3_CHNL486_RDATA1_ADDR A:0xe63f31c
y.create.l HWIO_PMIC_ARB_OBS3_CHNL487_RDATA1_ADDR A:0xe63f39c
y.create.l HWIO_PMIC_ARB_OBS3_CHNL488_RDATA1_ADDR A:0xe63f41c
y.create.l HWIO_PMIC_ARB_OBS3_CHNL489_RDATA1_ADDR A:0xe63f49c
y.create.l HWIO_PMIC_ARB_OBS3_CHNL490_RDATA1_ADDR A:0xe63f51c
y.create.l HWIO_PMIC_ARB_OBS3_CHNL491_RDATA1_ADDR A:0xe63f59c
y.create.l HWIO_PMIC_ARB_OBS3_CHNL492_RDATA1_ADDR A:0xe63f61c
y.create.l HWIO_PMIC_ARB_OBS3_CHNL493_RDATA1_ADDR A:0xe63f69c
y.create.l HWIO_PMIC_ARB_OBS3_CHNL494_RDATA1_ADDR A:0xe63f71c
y.create.l HWIO_PMIC_ARB_OBS3_CHNL495_RDATA1_ADDR A:0xe63f79c
y.create.l HWIO_PMIC_ARB_OBS3_CHNL496_RDATA1_ADDR A:0xe63f81c
y.create.l HWIO_PMIC_ARB_OBS3_CHNL497_RDATA1_ADDR A:0xe63f89c
y.create.l HWIO_PMIC_ARB_OBS3_CHNL498_RDATA1_ADDR A:0xe63f91c
y.create.l HWIO_PMIC_ARB_OBS3_CHNL499_RDATA1_ADDR A:0xe63f99c
y.create.l HWIO_PMIC_ARB_OBS3_CHNL500_RDATA1_ADDR A:0xe63fa1c
y.create.l HWIO_PMIC_ARB_OBS3_CHNL501_RDATA1_ADDR A:0xe63fa9c
y.create.l HWIO_PMIC_ARB_OBS3_CHNL502_RDATA1_ADDR A:0xe63fb1c
y.create.l HWIO_PMIC_ARB_OBS3_CHNL503_RDATA1_ADDR A:0xe63fb9c
y.create.l HWIO_PMIC_ARB_OBS3_CHNL504_RDATA1_ADDR A:0xe63fc1c
y.create.l HWIO_PMIC_ARB_OBS3_CHNL505_RDATA1_ADDR A:0xe63fc9c
y.create.l HWIO_PMIC_ARB_OBS3_CHNL506_RDATA1_ADDR A:0xe63fd1c
y.create.l HWIO_PMIC_ARB_OBS3_CHNL507_RDATA1_ADDR A:0xe63fd9c
y.create.l HWIO_PMIC_ARB_OBS3_CHNL508_RDATA1_ADDR A:0xe63fe1c
y.create.l HWIO_PMIC_ARB_OBS3_CHNL509_RDATA1_ADDR A:0xe63fe9c
y.create.l HWIO_PMIC_ARB_OBS3_CHNL510_RDATA1_ADDR A:0xe63ff1c
y.create.l HWIO_PMIC_ARB_OBS3_CHNL511_RDATA1_ADDR A:0xe63ff9c
y.create.l HWIO_PMIC_ARB_OBS4_CHNL0_RDATA1_ADDR A:0xe64001c
y.create.l HWIO_PMIC_ARB_OBS4_CHNL1_RDATA1_ADDR A:0xe64009c
y.create.l HWIO_PMIC_ARB_OBS4_CHNL2_RDATA1_ADDR A:0xe64011c
y.create.l HWIO_PMIC_ARB_OBS4_CHNL3_RDATA1_ADDR A:0xe64019c
y.create.l HWIO_PMIC_ARB_OBS4_CHNL4_RDATA1_ADDR A:0xe64021c
y.create.l HWIO_PMIC_ARB_OBS4_CHNL5_RDATA1_ADDR A:0xe64029c
y.create.l HWIO_PMIC_ARB_OBS4_CHNL6_RDATA1_ADDR A:0xe64031c
y.create.l HWIO_PMIC_ARB_OBS4_CHNL7_RDATA1_ADDR A:0xe64039c
y.create.l HWIO_PMIC_ARB_OBS4_CHNL8_RDATA1_ADDR A:0xe64041c
y.create.l HWIO_PMIC_ARB_OBS4_CHNL9_RDATA1_ADDR A:0xe64049c
y.create.l HWIO_PMIC_ARB_OBS4_CHNL10_RDATA1_ADDR A:0xe64051c
y.create.l HWIO_PMIC_ARB_OBS4_CHNL11_RDATA1_ADDR A:0xe64059c
y.create.l HWIO_PMIC_ARB_OBS4_CHNL12_RDATA1_ADDR A:0xe64061c
y.create.l HWIO_PMIC_ARB_OBS4_CHNL13_RDATA1_ADDR A:0xe64069c
y.create.l HWIO_PMIC_ARB_OBS4_CHNL14_RDATA1_ADDR A:0xe64071c
y.create.l HWIO_PMIC_ARB_OBS4_CHNL15_RDATA1_ADDR A:0xe64079c
y.create.l HWIO_PMIC_ARB_OBS4_CHNL16_RDATA1_ADDR A:0xe64081c
y.create.l HWIO_PMIC_ARB_OBS4_CHNL17_RDATA1_ADDR A:0xe64089c
y.create.l HWIO_PMIC_ARB_OBS4_CHNL18_RDATA1_ADDR A:0xe64091c
y.create.l HWIO_PMIC_ARB_OBS4_CHNL19_RDATA1_ADDR A:0xe64099c
y.create.l HWIO_PMIC_ARB_OBS4_CHNL20_RDATA1_ADDR A:0xe640a1c
y.create.l HWIO_PMIC_ARB_OBS4_CHNL21_RDATA1_ADDR A:0xe640a9c
y.create.l HWIO_PMIC_ARB_OBS4_CHNL22_RDATA1_ADDR A:0xe640b1c
y.create.l HWIO_PMIC_ARB_OBS4_CHNL23_RDATA1_ADDR A:0xe640b9c
y.create.l HWIO_PMIC_ARB_OBS4_CHNL24_RDATA1_ADDR A:0xe640c1c
y.create.l HWIO_PMIC_ARB_OBS4_CHNL25_RDATA1_ADDR A:0xe640c9c
y.create.l HWIO_PMIC_ARB_OBS4_CHNL26_RDATA1_ADDR A:0xe640d1c
y.create.l HWIO_PMIC_ARB_OBS4_CHNL27_RDATA1_ADDR A:0xe640d9c
y.create.l HWIO_PMIC_ARB_OBS4_CHNL28_RDATA1_ADDR A:0xe640e1c
y.create.l HWIO_PMIC_ARB_OBS4_CHNL29_RDATA1_ADDR A:0xe640e9c
y.create.l HWIO_PMIC_ARB_OBS4_CHNL30_RDATA1_ADDR A:0xe640f1c
y.create.l HWIO_PMIC_ARB_OBS4_CHNL31_RDATA1_ADDR A:0xe640f9c
y.create.l HWIO_PMIC_ARB_OBS4_CHNL32_RDATA1_ADDR A:0xe64101c
y.create.l HWIO_PMIC_ARB_OBS4_CHNL33_RDATA1_ADDR A:0xe64109c
y.create.l HWIO_PMIC_ARB_OBS4_CHNL34_RDATA1_ADDR A:0xe64111c
y.create.l HWIO_PMIC_ARB_OBS4_CHNL35_RDATA1_ADDR A:0xe64119c
y.create.l HWIO_PMIC_ARB_OBS4_CHNL36_RDATA1_ADDR A:0xe64121c
y.create.l HWIO_PMIC_ARB_OBS4_CHNL37_RDATA1_ADDR A:0xe64129c
y.create.l HWIO_PMIC_ARB_OBS4_CHNL38_RDATA1_ADDR A:0xe64131c
y.create.l HWIO_PMIC_ARB_OBS4_CHNL39_RDATA1_ADDR A:0xe64139c
y.create.l HWIO_PMIC_ARB_OBS4_CHNL40_RDATA1_ADDR A:0xe64141c
y.create.l HWIO_PMIC_ARB_OBS4_CHNL41_RDATA1_ADDR A:0xe64149c
y.create.l HWIO_PMIC_ARB_OBS4_CHNL42_RDATA1_ADDR A:0xe64151c
y.create.l HWIO_PMIC_ARB_OBS4_CHNL43_RDATA1_ADDR A:0xe64159c
y.create.l HWIO_PMIC_ARB_OBS4_CHNL44_RDATA1_ADDR A:0xe64161c
y.create.l HWIO_PMIC_ARB_OBS4_CHNL45_RDATA1_ADDR A:0xe64169c
y.create.l HWIO_PMIC_ARB_OBS4_CHNL46_RDATA1_ADDR A:0xe64171c
y.create.l HWIO_PMIC_ARB_OBS4_CHNL47_RDATA1_ADDR A:0xe64179c
y.create.l HWIO_PMIC_ARB_OBS4_CHNL48_RDATA1_ADDR A:0xe64181c
y.create.l HWIO_PMIC_ARB_OBS4_CHNL49_RDATA1_ADDR A:0xe64189c
y.create.l HWIO_PMIC_ARB_OBS4_CHNL50_RDATA1_ADDR A:0xe64191c
y.create.l HWIO_PMIC_ARB_OBS4_CHNL51_RDATA1_ADDR A:0xe64199c
y.create.l HWIO_PMIC_ARB_OBS4_CHNL52_RDATA1_ADDR A:0xe641a1c
y.create.l HWIO_PMIC_ARB_OBS4_CHNL53_RDATA1_ADDR A:0xe641a9c
y.create.l HWIO_PMIC_ARB_OBS4_CHNL54_RDATA1_ADDR A:0xe641b1c
y.create.l HWIO_PMIC_ARB_OBS4_CHNL55_RDATA1_ADDR A:0xe641b9c
y.create.l HWIO_PMIC_ARB_OBS4_CHNL56_RDATA1_ADDR A:0xe641c1c
y.create.l HWIO_PMIC_ARB_OBS4_CHNL57_RDATA1_ADDR A:0xe641c9c
y.create.l HWIO_PMIC_ARB_OBS4_CHNL58_RDATA1_ADDR A:0xe641d1c
y.create.l HWIO_PMIC_ARB_OBS4_CHNL59_RDATA1_ADDR A:0xe641d9c
y.create.l HWIO_PMIC_ARB_OBS4_CHNL60_RDATA1_ADDR A:0xe641e1c
y.create.l HWIO_PMIC_ARB_OBS4_CHNL61_RDATA1_ADDR A:0xe641e9c
y.create.l HWIO_PMIC_ARB_OBS4_CHNL62_RDATA1_ADDR A:0xe641f1c
y.create.l HWIO_PMIC_ARB_OBS4_CHNL63_RDATA1_ADDR A:0xe641f9c
y.create.l HWIO_PMIC_ARB_OBS4_CHNL64_RDATA1_ADDR A:0xe64201c
y.create.l HWIO_PMIC_ARB_OBS4_CHNL65_RDATA1_ADDR A:0xe64209c
y.create.l HWIO_PMIC_ARB_OBS4_CHNL66_RDATA1_ADDR A:0xe64211c
y.create.l HWIO_PMIC_ARB_OBS4_CHNL67_RDATA1_ADDR A:0xe64219c
y.create.l HWIO_PMIC_ARB_OBS4_CHNL68_RDATA1_ADDR A:0xe64221c
y.create.l HWIO_PMIC_ARB_OBS4_CHNL69_RDATA1_ADDR A:0xe64229c
y.create.l HWIO_PMIC_ARB_OBS4_CHNL70_RDATA1_ADDR A:0xe64231c
y.create.l HWIO_PMIC_ARB_OBS4_CHNL71_RDATA1_ADDR A:0xe64239c
y.create.l HWIO_PMIC_ARB_OBS4_CHNL72_RDATA1_ADDR A:0xe64241c
y.create.l HWIO_PMIC_ARB_OBS4_CHNL73_RDATA1_ADDR A:0xe64249c
y.create.l HWIO_PMIC_ARB_OBS4_CHNL74_RDATA1_ADDR A:0xe64251c
y.create.l HWIO_PMIC_ARB_OBS4_CHNL75_RDATA1_ADDR A:0xe64259c
y.create.l HWIO_PMIC_ARB_OBS4_CHNL76_RDATA1_ADDR A:0xe64261c
y.create.l HWIO_PMIC_ARB_OBS4_CHNL77_RDATA1_ADDR A:0xe64269c
y.create.l HWIO_PMIC_ARB_OBS4_CHNL78_RDATA1_ADDR A:0xe64271c
y.create.l HWIO_PMIC_ARB_OBS4_CHNL79_RDATA1_ADDR A:0xe64279c
y.create.l HWIO_PMIC_ARB_OBS4_CHNL80_RDATA1_ADDR A:0xe64281c
y.create.l HWIO_PMIC_ARB_OBS4_CHNL81_RDATA1_ADDR A:0xe64289c
y.create.l HWIO_PMIC_ARB_OBS4_CHNL82_RDATA1_ADDR A:0xe64291c
y.create.l HWIO_PMIC_ARB_OBS4_CHNL83_RDATA1_ADDR A:0xe64299c
y.create.l HWIO_PMIC_ARB_OBS4_CHNL84_RDATA1_ADDR A:0xe642a1c
y.create.l HWIO_PMIC_ARB_OBS4_CHNL85_RDATA1_ADDR A:0xe642a9c
y.create.l HWIO_PMIC_ARB_OBS4_CHNL86_RDATA1_ADDR A:0xe642b1c
y.create.l HWIO_PMIC_ARB_OBS4_CHNL87_RDATA1_ADDR A:0xe642b9c
y.create.l HWIO_PMIC_ARB_OBS4_CHNL88_RDATA1_ADDR A:0xe642c1c
y.create.l HWIO_PMIC_ARB_OBS4_CHNL89_RDATA1_ADDR A:0xe642c9c
y.create.l HWIO_PMIC_ARB_OBS4_CHNL90_RDATA1_ADDR A:0xe642d1c
y.create.l HWIO_PMIC_ARB_OBS4_CHNL91_RDATA1_ADDR A:0xe642d9c
y.create.l HWIO_PMIC_ARB_OBS4_CHNL92_RDATA1_ADDR A:0xe642e1c
y.create.l HWIO_PMIC_ARB_OBS4_CHNL93_RDATA1_ADDR A:0xe642e9c
y.create.l HWIO_PMIC_ARB_OBS4_CHNL94_RDATA1_ADDR A:0xe642f1c
y.create.l HWIO_PMIC_ARB_OBS4_CHNL95_RDATA1_ADDR A:0xe642f9c
y.create.l HWIO_PMIC_ARB_OBS4_CHNL96_RDATA1_ADDR A:0xe64301c
y.create.l HWIO_PMIC_ARB_OBS4_CHNL97_RDATA1_ADDR A:0xe64309c
y.create.l HWIO_PMIC_ARB_OBS4_CHNL98_RDATA1_ADDR A:0xe64311c
y.create.l HWIO_PMIC_ARB_OBS4_CHNL99_RDATA1_ADDR A:0xe64319c
y.create.l HWIO_PMIC_ARB_OBS4_CHNL100_RDATA1_ADDR A:0xe64321c
y.create.l HWIO_PMIC_ARB_OBS4_CHNL101_RDATA1_ADDR A:0xe64329c
y.create.l HWIO_PMIC_ARB_OBS4_CHNL102_RDATA1_ADDR A:0xe64331c
y.create.l HWIO_PMIC_ARB_OBS4_CHNL103_RDATA1_ADDR A:0xe64339c
y.create.l HWIO_PMIC_ARB_OBS4_CHNL104_RDATA1_ADDR A:0xe64341c
y.create.l HWIO_PMIC_ARB_OBS4_CHNL105_RDATA1_ADDR A:0xe64349c
y.create.l HWIO_PMIC_ARB_OBS4_CHNL106_RDATA1_ADDR A:0xe64351c
y.create.l HWIO_PMIC_ARB_OBS4_CHNL107_RDATA1_ADDR A:0xe64359c
y.create.l HWIO_PMIC_ARB_OBS4_CHNL108_RDATA1_ADDR A:0xe64361c
y.create.l HWIO_PMIC_ARB_OBS4_CHNL109_RDATA1_ADDR A:0xe64369c
y.create.l HWIO_PMIC_ARB_OBS4_CHNL110_RDATA1_ADDR A:0xe64371c
y.create.l HWIO_PMIC_ARB_OBS4_CHNL111_RDATA1_ADDR A:0xe64379c
y.create.l HWIO_PMIC_ARB_OBS4_CHNL112_RDATA1_ADDR A:0xe64381c
y.create.l HWIO_PMIC_ARB_OBS4_CHNL113_RDATA1_ADDR A:0xe64389c
y.create.l HWIO_PMIC_ARB_OBS4_CHNL114_RDATA1_ADDR A:0xe64391c
y.create.l HWIO_PMIC_ARB_OBS4_CHNL115_RDATA1_ADDR A:0xe64399c
y.create.l HWIO_PMIC_ARB_OBS4_CHNL116_RDATA1_ADDR A:0xe643a1c
y.create.l HWIO_PMIC_ARB_OBS4_CHNL117_RDATA1_ADDR A:0xe643a9c
y.create.l HWIO_PMIC_ARB_OBS4_CHNL118_RDATA1_ADDR A:0xe643b1c
y.create.l HWIO_PMIC_ARB_OBS4_CHNL119_RDATA1_ADDR A:0xe643b9c
y.create.l HWIO_PMIC_ARB_OBS4_CHNL120_RDATA1_ADDR A:0xe643c1c
y.create.l HWIO_PMIC_ARB_OBS4_CHNL121_RDATA1_ADDR A:0xe643c9c
y.create.l HWIO_PMIC_ARB_OBS4_CHNL122_RDATA1_ADDR A:0xe643d1c
y.create.l HWIO_PMIC_ARB_OBS4_CHNL123_RDATA1_ADDR A:0xe643d9c
y.create.l HWIO_PMIC_ARB_OBS4_CHNL124_RDATA1_ADDR A:0xe643e1c
y.create.l HWIO_PMIC_ARB_OBS4_CHNL125_RDATA1_ADDR A:0xe643e9c
y.create.l HWIO_PMIC_ARB_OBS4_CHNL126_RDATA1_ADDR A:0xe643f1c
y.create.l HWIO_PMIC_ARB_OBS4_CHNL127_RDATA1_ADDR A:0xe643f9c
y.create.l HWIO_PMIC_ARB_OBS4_CHNL128_RDATA1_ADDR A:0xe64401c
y.create.l HWIO_PMIC_ARB_OBS4_CHNL129_RDATA1_ADDR A:0xe64409c
y.create.l HWIO_PMIC_ARB_OBS4_CHNL130_RDATA1_ADDR A:0xe64411c
y.create.l HWIO_PMIC_ARB_OBS4_CHNL131_RDATA1_ADDR A:0xe64419c
y.create.l HWIO_PMIC_ARB_OBS4_CHNL132_RDATA1_ADDR A:0xe64421c
y.create.l HWIO_PMIC_ARB_OBS4_CHNL133_RDATA1_ADDR A:0xe64429c
y.create.l HWIO_PMIC_ARB_OBS4_CHNL134_RDATA1_ADDR A:0xe64431c
y.create.l HWIO_PMIC_ARB_OBS4_CHNL135_RDATA1_ADDR A:0xe64439c
y.create.l HWIO_PMIC_ARB_OBS4_CHNL136_RDATA1_ADDR A:0xe64441c
y.create.l HWIO_PMIC_ARB_OBS4_CHNL137_RDATA1_ADDR A:0xe64449c
y.create.l HWIO_PMIC_ARB_OBS4_CHNL138_RDATA1_ADDR A:0xe64451c
y.create.l HWIO_PMIC_ARB_OBS4_CHNL139_RDATA1_ADDR A:0xe64459c
y.create.l HWIO_PMIC_ARB_OBS4_CHNL140_RDATA1_ADDR A:0xe64461c
y.create.l HWIO_PMIC_ARB_OBS4_CHNL141_RDATA1_ADDR A:0xe64469c
y.create.l HWIO_PMIC_ARB_OBS4_CHNL142_RDATA1_ADDR A:0xe64471c
y.create.l HWIO_PMIC_ARB_OBS4_CHNL143_RDATA1_ADDR A:0xe64479c
y.create.l HWIO_PMIC_ARB_OBS4_CHNL144_RDATA1_ADDR A:0xe64481c
y.create.l HWIO_PMIC_ARB_OBS4_CHNL145_RDATA1_ADDR A:0xe64489c
y.create.l HWIO_PMIC_ARB_OBS4_CHNL146_RDATA1_ADDR A:0xe64491c
y.create.l HWIO_PMIC_ARB_OBS4_CHNL147_RDATA1_ADDR A:0xe64499c
y.create.l HWIO_PMIC_ARB_OBS4_CHNL148_RDATA1_ADDR A:0xe644a1c
y.create.l HWIO_PMIC_ARB_OBS4_CHNL149_RDATA1_ADDR A:0xe644a9c
y.create.l HWIO_PMIC_ARB_OBS4_CHNL150_RDATA1_ADDR A:0xe644b1c
y.create.l HWIO_PMIC_ARB_OBS4_CHNL151_RDATA1_ADDR A:0xe644b9c
y.create.l HWIO_PMIC_ARB_OBS4_CHNL152_RDATA1_ADDR A:0xe644c1c
y.create.l HWIO_PMIC_ARB_OBS4_CHNL153_RDATA1_ADDR A:0xe644c9c
y.create.l HWIO_PMIC_ARB_OBS4_CHNL154_RDATA1_ADDR A:0xe644d1c
y.create.l HWIO_PMIC_ARB_OBS4_CHNL155_RDATA1_ADDR A:0xe644d9c
y.create.l HWIO_PMIC_ARB_OBS4_CHNL156_RDATA1_ADDR A:0xe644e1c
y.create.l HWIO_PMIC_ARB_OBS4_CHNL157_RDATA1_ADDR A:0xe644e9c
y.create.l HWIO_PMIC_ARB_OBS4_CHNL158_RDATA1_ADDR A:0xe644f1c
y.create.l HWIO_PMIC_ARB_OBS4_CHNL159_RDATA1_ADDR A:0xe644f9c
y.create.l HWIO_PMIC_ARB_OBS4_CHNL160_RDATA1_ADDR A:0xe64501c
y.create.l HWIO_PMIC_ARB_OBS4_CHNL161_RDATA1_ADDR A:0xe64509c
y.create.l HWIO_PMIC_ARB_OBS4_CHNL162_RDATA1_ADDR A:0xe64511c
y.create.l HWIO_PMIC_ARB_OBS4_CHNL163_RDATA1_ADDR A:0xe64519c
y.create.l HWIO_PMIC_ARB_OBS4_CHNL164_RDATA1_ADDR A:0xe64521c
y.create.l HWIO_PMIC_ARB_OBS4_CHNL165_RDATA1_ADDR A:0xe64529c
y.create.l HWIO_PMIC_ARB_OBS4_CHNL166_RDATA1_ADDR A:0xe64531c
y.create.l HWIO_PMIC_ARB_OBS4_CHNL167_RDATA1_ADDR A:0xe64539c
y.create.l HWIO_PMIC_ARB_OBS4_CHNL168_RDATA1_ADDR A:0xe64541c
y.create.l HWIO_PMIC_ARB_OBS4_CHNL169_RDATA1_ADDR A:0xe64549c
y.create.l HWIO_PMIC_ARB_OBS4_CHNL170_RDATA1_ADDR A:0xe64551c
y.create.l HWIO_PMIC_ARB_OBS4_CHNL171_RDATA1_ADDR A:0xe64559c
y.create.l HWIO_PMIC_ARB_OBS4_CHNL172_RDATA1_ADDR A:0xe64561c
y.create.l HWIO_PMIC_ARB_OBS4_CHNL173_RDATA1_ADDR A:0xe64569c
y.create.l HWIO_PMIC_ARB_OBS4_CHNL174_RDATA1_ADDR A:0xe64571c
y.create.l HWIO_PMIC_ARB_OBS4_CHNL175_RDATA1_ADDR A:0xe64579c
y.create.l HWIO_PMIC_ARB_OBS4_CHNL176_RDATA1_ADDR A:0xe64581c
y.create.l HWIO_PMIC_ARB_OBS4_CHNL177_RDATA1_ADDR A:0xe64589c
y.create.l HWIO_PMIC_ARB_OBS4_CHNL178_RDATA1_ADDR A:0xe64591c
y.create.l HWIO_PMIC_ARB_OBS4_CHNL179_RDATA1_ADDR A:0xe64599c
y.create.l HWIO_PMIC_ARB_OBS4_CHNL180_RDATA1_ADDR A:0xe645a1c
y.create.l HWIO_PMIC_ARB_OBS4_CHNL181_RDATA1_ADDR A:0xe645a9c
y.create.l HWIO_PMIC_ARB_OBS4_CHNL182_RDATA1_ADDR A:0xe645b1c
y.create.l HWIO_PMIC_ARB_OBS4_CHNL183_RDATA1_ADDR A:0xe645b9c
y.create.l HWIO_PMIC_ARB_OBS4_CHNL184_RDATA1_ADDR A:0xe645c1c
y.create.l HWIO_PMIC_ARB_OBS4_CHNL185_RDATA1_ADDR A:0xe645c9c
y.create.l HWIO_PMIC_ARB_OBS4_CHNL186_RDATA1_ADDR A:0xe645d1c
y.create.l HWIO_PMIC_ARB_OBS4_CHNL187_RDATA1_ADDR A:0xe645d9c
y.create.l HWIO_PMIC_ARB_OBS4_CHNL188_RDATA1_ADDR A:0xe645e1c
y.create.l HWIO_PMIC_ARB_OBS4_CHNL189_RDATA1_ADDR A:0xe645e9c
y.create.l HWIO_PMIC_ARB_OBS4_CHNL190_RDATA1_ADDR A:0xe645f1c
y.create.l HWIO_PMIC_ARB_OBS4_CHNL191_RDATA1_ADDR A:0xe645f9c
y.create.l HWIO_PMIC_ARB_OBS4_CHNL192_RDATA1_ADDR A:0xe64601c
y.create.l HWIO_PMIC_ARB_OBS4_CHNL193_RDATA1_ADDR A:0xe64609c
y.create.l HWIO_PMIC_ARB_OBS4_CHNL194_RDATA1_ADDR A:0xe64611c
y.create.l HWIO_PMIC_ARB_OBS4_CHNL195_RDATA1_ADDR A:0xe64619c
y.create.l HWIO_PMIC_ARB_OBS4_CHNL196_RDATA1_ADDR A:0xe64621c
y.create.l HWIO_PMIC_ARB_OBS4_CHNL197_RDATA1_ADDR A:0xe64629c
y.create.l HWIO_PMIC_ARB_OBS4_CHNL198_RDATA1_ADDR A:0xe64631c
y.create.l HWIO_PMIC_ARB_OBS4_CHNL199_RDATA1_ADDR A:0xe64639c
y.create.l HWIO_PMIC_ARB_OBS4_CHNL200_RDATA1_ADDR A:0xe64641c
y.create.l HWIO_PMIC_ARB_OBS4_CHNL201_RDATA1_ADDR A:0xe64649c
y.create.l HWIO_PMIC_ARB_OBS4_CHNL202_RDATA1_ADDR A:0xe64651c
y.create.l HWIO_PMIC_ARB_OBS4_CHNL203_RDATA1_ADDR A:0xe64659c
y.create.l HWIO_PMIC_ARB_OBS4_CHNL204_RDATA1_ADDR A:0xe64661c
y.create.l HWIO_PMIC_ARB_OBS4_CHNL205_RDATA1_ADDR A:0xe64669c
y.create.l HWIO_PMIC_ARB_OBS4_CHNL206_RDATA1_ADDR A:0xe64671c
y.create.l HWIO_PMIC_ARB_OBS4_CHNL207_RDATA1_ADDR A:0xe64679c
y.create.l HWIO_PMIC_ARB_OBS4_CHNL208_RDATA1_ADDR A:0xe64681c
y.create.l HWIO_PMIC_ARB_OBS4_CHNL209_RDATA1_ADDR A:0xe64689c
y.create.l HWIO_PMIC_ARB_OBS4_CHNL210_RDATA1_ADDR A:0xe64691c
y.create.l HWIO_PMIC_ARB_OBS4_CHNL211_RDATA1_ADDR A:0xe64699c
y.create.l HWIO_PMIC_ARB_OBS4_CHNL212_RDATA1_ADDR A:0xe646a1c
y.create.l HWIO_PMIC_ARB_OBS4_CHNL213_RDATA1_ADDR A:0xe646a9c
y.create.l HWIO_PMIC_ARB_OBS4_CHNL214_RDATA1_ADDR A:0xe646b1c
y.create.l HWIO_PMIC_ARB_OBS4_CHNL215_RDATA1_ADDR A:0xe646b9c
y.create.l HWIO_PMIC_ARB_OBS4_CHNL216_RDATA1_ADDR A:0xe646c1c
y.create.l HWIO_PMIC_ARB_OBS4_CHNL217_RDATA1_ADDR A:0xe646c9c
y.create.l HWIO_PMIC_ARB_OBS4_CHNL218_RDATA1_ADDR A:0xe646d1c
y.create.l HWIO_PMIC_ARB_OBS4_CHNL219_RDATA1_ADDR A:0xe646d9c
y.create.l HWIO_PMIC_ARB_OBS4_CHNL220_RDATA1_ADDR A:0xe646e1c
y.create.l HWIO_PMIC_ARB_OBS4_CHNL221_RDATA1_ADDR A:0xe646e9c
y.create.l HWIO_PMIC_ARB_OBS4_CHNL222_RDATA1_ADDR A:0xe646f1c
y.create.l HWIO_PMIC_ARB_OBS4_CHNL223_RDATA1_ADDR A:0xe646f9c
y.create.l HWIO_PMIC_ARB_OBS4_CHNL224_RDATA1_ADDR A:0xe64701c
y.create.l HWIO_PMIC_ARB_OBS4_CHNL225_RDATA1_ADDR A:0xe64709c
y.create.l HWIO_PMIC_ARB_OBS4_CHNL226_RDATA1_ADDR A:0xe64711c
y.create.l HWIO_PMIC_ARB_OBS4_CHNL227_RDATA1_ADDR A:0xe64719c
y.create.l HWIO_PMIC_ARB_OBS4_CHNL228_RDATA1_ADDR A:0xe64721c
y.create.l HWIO_PMIC_ARB_OBS4_CHNL229_RDATA1_ADDR A:0xe64729c
y.create.l HWIO_PMIC_ARB_OBS4_CHNL230_RDATA1_ADDR A:0xe64731c
y.create.l HWIO_PMIC_ARB_OBS4_CHNL231_RDATA1_ADDR A:0xe64739c
y.create.l HWIO_PMIC_ARB_OBS4_CHNL232_RDATA1_ADDR A:0xe64741c
y.create.l HWIO_PMIC_ARB_OBS4_CHNL233_RDATA1_ADDR A:0xe64749c
y.create.l HWIO_PMIC_ARB_OBS4_CHNL234_RDATA1_ADDR A:0xe64751c
y.create.l HWIO_PMIC_ARB_OBS4_CHNL235_RDATA1_ADDR A:0xe64759c
y.create.l HWIO_PMIC_ARB_OBS4_CHNL236_RDATA1_ADDR A:0xe64761c
y.create.l HWIO_PMIC_ARB_OBS4_CHNL237_RDATA1_ADDR A:0xe64769c
y.create.l HWIO_PMIC_ARB_OBS4_CHNL238_RDATA1_ADDR A:0xe64771c
y.create.l HWIO_PMIC_ARB_OBS4_CHNL239_RDATA1_ADDR A:0xe64779c
y.create.l HWIO_PMIC_ARB_OBS4_CHNL240_RDATA1_ADDR A:0xe64781c
y.create.l HWIO_PMIC_ARB_OBS4_CHNL241_RDATA1_ADDR A:0xe64789c
y.create.l HWIO_PMIC_ARB_OBS4_CHNL242_RDATA1_ADDR A:0xe64791c
y.create.l HWIO_PMIC_ARB_OBS4_CHNL243_RDATA1_ADDR A:0xe64799c
y.create.l HWIO_PMIC_ARB_OBS4_CHNL244_RDATA1_ADDR A:0xe647a1c
y.create.l HWIO_PMIC_ARB_OBS4_CHNL245_RDATA1_ADDR A:0xe647a9c
y.create.l HWIO_PMIC_ARB_OBS4_CHNL246_RDATA1_ADDR A:0xe647b1c
y.create.l HWIO_PMIC_ARB_OBS4_CHNL247_RDATA1_ADDR A:0xe647b9c
y.create.l HWIO_PMIC_ARB_OBS4_CHNL248_RDATA1_ADDR A:0xe647c1c
y.create.l HWIO_PMIC_ARB_OBS4_CHNL249_RDATA1_ADDR A:0xe647c9c
y.create.l HWIO_PMIC_ARB_OBS4_CHNL250_RDATA1_ADDR A:0xe647d1c
y.create.l HWIO_PMIC_ARB_OBS4_CHNL251_RDATA1_ADDR A:0xe647d9c
y.create.l HWIO_PMIC_ARB_OBS4_CHNL252_RDATA1_ADDR A:0xe647e1c
y.create.l HWIO_PMIC_ARB_OBS4_CHNL253_RDATA1_ADDR A:0xe647e9c
y.create.l HWIO_PMIC_ARB_OBS4_CHNL254_RDATA1_ADDR A:0xe647f1c
y.create.l HWIO_PMIC_ARB_OBS4_CHNL255_RDATA1_ADDR A:0xe647f9c
y.create.l HWIO_PMIC_ARB_OBS4_CHNL256_RDATA1_ADDR A:0xe64801c
y.create.l HWIO_PMIC_ARB_OBS4_CHNL257_RDATA1_ADDR A:0xe64809c
y.create.l HWIO_PMIC_ARB_OBS4_CHNL258_RDATA1_ADDR A:0xe64811c
y.create.l HWIO_PMIC_ARB_OBS4_CHNL259_RDATA1_ADDR A:0xe64819c
y.create.l HWIO_PMIC_ARB_OBS4_CHNL260_RDATA1_ADDR A:0xe64821c
y.create.l HWIO_PMIC_ARB_OBS4_CHNL261_RDATA1_ADDR A:0xe64829c
y.create.l HWIO_PMIC_ARB_OBS4_CHNL262_RDATA1_ADDR A:0xe64831c
y.create.l HWIO_PMIC_ARB_OBS4_CHNL263_RDATA1_ADDR A:0xe64839c
y.create.l HWIO_PMIC_ARB_OBS4_CHNL264_RDATA1_ADDR A:0xe64841c
y.create.l HWIO_PMIC_ARB_OBS4_CHNL265_RDATA1_ADDR A:0xe64849c
y.create.l HWIO_PMIC_ARB_OBS4_CHNL266_RDATA1_ADDR A:0xe64851c
y.create.l HWIO_PMIC_ARB_OBS4_CHNL267_RDATA1_ADDR A:0xe64859c
y.create.l HWIO_PMIC_ARB_OBS4_CHNL268_RDATA1_ADDR A:0xe64861c
y.create.l HWIO_PMIC_ARB_OBS4_CHNL269_RDATA1_ADDR A:0xe64869c
y.create.l HWIO_PMIC_ARB_OBS4_CHNL270_RDATA1_ADDR A:0xe64871c
y.create.l HWIO_PMIC_ARB_OBS4_CHNL271_RDATA1_ADDR A:0xe64879c
y.create.l HWIO_PMIC_ARB_OBS4_CHNL272_RDATA1_ADDR A:0xe64881c
y.create.l HWIO_PMIC_ARB_OBS4_CHNL273_RDATA1_ADDR A:0xe64889c
y.create.l HWIO_PMIC_ARB_OBS4_CHNL274_RDATA1_ADDR A:0xe64891c
y.create.l HWIO_PMIC_ARB_OBS4_CHNL275_RDATA1_ADDR A:0xe64899c
y.create.l HWIO_PMIC_ARB_OBS4_CHNL276_RDATA1_ADDR A:0xe648a1c
y.create.l HWIO_PMIC_ARB_OBS4_CHNL277_RDATA1_ADDR A:0xe648a9c
y.create.l HWIO_PMIC_ARB_OBS4_CHNL278_RDATA1_ADDR A:0xe648b1c
y.create.l HWIO_PMIC_ARB_OBS4_CHNL279_RDATA1_ADDR A:0xe648b9c
y.create.l HWIO_PMIC_ARB_OBS4_CHNL280_RDATA1_ADDR A:0xe648c1c
y.create.l HWIO_PMIC_ARB_OBS4_CHNL281_RDATA1_ADDR A:0xe648c9c
y.create.l HWIO_PMIC_ARB_OBS4_CHNL282_RDATA1_ADDR A:0xe648d1c
y.create.l HWIO_PMIC_ARB_OBS4_CHNL283_RDATA1_ADDR A:0xe648d9c
y.create.l HWIO_PMIC_ARB_OBS4_CHNL284_RDATA1_ADDR A:0xe648e1c
y.create.l HWIO_PMIC_ARB_OBS4_CHNL285_RDATA1_ADDR A:0xe648e9c
y.create.l HWIO_PMIC_ARB_OBS4_CHNL286_RDATA1_ADDR A:0xe648f1c
y.create.l HWIO_PMIC_ARB_OBS4_CHNL287_RDATA1_ADDR A:0xe648f9c
y.create.l HWIO_PMIC_ARB_OBS4_CHNL288_RDATA1_ADDR A:0xe64901c
y.create.l HWIO_PMIC_ARB_OBS4_CHNL289_RDATA1_ADDR A:0xe64909c
y.create.l HWIO_PMIC_ARB_OBS4_CHNL290_RDATA1_ADDR A:0xe64911c
y.create.l HWIO_PMIC_ARB_OBS4_CHNL291_RDATA1_ADDR A:0xe64919c
y.create.l HWIO_PMIC_ARB_OBS4_CHNL292_RDATA1_ADDR A:0xe64921c
y.create.l HWIO_PMIC_ARB_OBS4_CHNL293_RDATA1_ADDR A:0xe64929c
y.create.l HWIO_PMIC_ARB_OBS4_CHNL294_RDATA1_ADDR A:0xe64931c
y.create.l HWIO_PMIC_ARB_OBS4_CHNL295_RDATA1_ADDR A:0xe64939c
y.create.l HWIO_PMIC_ARB_OBS4_CHNL296_RDATA1_ADDR A:0xe64941c
y.create.l HWIO_PMIC_ARB_OBS4_CHNL297_RDATA1_ADDR A:0xe64949c
y.create.l HWIO_PMIC_ARB_OBS4_CHNL298_RDATA1_ADDR A:0xe64951c
y.create.l HWIO_PMIC_ARB_OBS4_CHNL299_RDATA1_ADDR A:0xe64959c
y.create.l HWIO_PMIC_ARB_OBS4_CHNL300_RDATA1_ADDR A:0xe64961c
y.create.l HWIO_PMIC_ARB_OBS4_CHNL301_RDATA1_ADDR A:0xe64969c
y.create.l HWIO_PMIC_ARB_OBS4_CHNL302_RDATA1_ADDR A:0xe64971c
y.create.l HWIO_PMIC_ARB_OBS4_CHNL303_RDATA1_ADDR A:0xe64979c
y.create.l HWIO_PMIC_ARB_OBS4_CHNL304_RDATA1_ADDR A:0xe64981c
y.create.l HWIO_PMIC_ARB_OBS4_CHNL305_RDATA1_ADDR A:0xe64989c
y.create.l HWIO_PMIC_ARB_OBS4_CHNL306_RDATA1_ADDR A:0xe64991c
y.create.l HWIO_PMIC_ARB_OBS4_CHNL307_RDATA1_ADDR A:0xe64999c
y.create.l HWIO_PMIC_ARB_OBS4_CHNL308_RDATA1_ADDR A:0xe649a1c
y.create.l HWIO_PMIC_ARB_OBS4_CHNL309_RDATA1_ADDR A:0xe649a9c
y.create.l HWIO_PMIC_ARB_OBS4_CHNL310_RDATA1_ADDR A:0xe649b1c
y.create.l HWIO_PMIC_ARB_OBS4_CHNL311_RDATA1_ADDR A:0xe649b9c
y.create.l HWIO_PMIC_ARB_OBS4_CHNL312_RDATA1_ADDR A:0xe649c1c
y.create.l HWIO_PMIC_ARB_OBS4_CHNL313_RDATA1_ADDR A:0xe649c9c
y.create.l HWIO_PMIC_ARB_OBS4_CHNL314_RDATA1_ADDR A:0xe649d1c
y.create.l HWIO_PMIC_ARB_OBS4_CHNL315_RDATA1_ADDR A:0xe649d9c
y.create.l HWIO_PMIC_ARB_OBS4_CHNL316_RDATA1_ADDR A:0xe649e1c
y.create.l HWIO_PMIC_ARB_OBS4_CHNL317_RDATA1_ADDR A:0xe649e9c
y.create.l HWIO_PMIC_ARB_OBS4_CHNL318_RDATA1_ADDR A:0xe649f1c
y.create.l HWIO_PMIC_ARB_OBS4_CHNL319_RDATA1_ADDR A:0xe649f9c
y.create.l HWIO_PMIC_ARB_OBS4_CHNL320_RDATA1_ADDR A:0xe64a01c
y.create.l HWIO_PMIC_ARB_OBS4_CHNL321_RDATA1_ADDR A:0xe64a09c
y.create.l HWIO_PMIC_ARB_OBS4_CHNL322_RDATA1_ADDR A:0xe64a11c
y.create.l HWIO_PMIC_ARB_OBS4_CHNL323_RDATA1_ADDR A:0xe64a19c
y.create.l HWIO_PMIC_ARB_OBS4_CHNL324_RDATA1_ADDR A:0xe64a21c
y.create.l HWIO_PMIC_ARB_OBS4_CHNL325_RDATA1_ADDR A:0xe64a29c
y.create.l HWIO_PMIC_ARB_OBS4_CHNL326_RDATA1_ADDR A:0xe64a31c
y.create.l HWIO_PMIC_ARB_OBS4_CHNL327_RDATA1_ADDR A:0xe64a39c
y.create.l HWIO_PMIC_ARB_OBS4_CHNL328_RDATA1_ADDR A:0xe64a41c
y.create.l HWIO_PMIC_ARB_OBS4_CHNL329_RDATA1_ADDR A:0xe64a49c
y.create.l HWIO_PMIC_ARB_OBS4_CHNL330_RDATA1_ADDR A:0xe64a51c
y.create.l HWIO_PMIC_ARB_OBS4_CHNL331_RDATA1_ADDR A:0xe64a59c
y.create.l HWIO_PMIC_ARB_OBS4_CHNL332_RDATA1_ADDR A:0xe64a61c
y.create.l HWIO_PMIC_ARB_OBS4_CHNL333_RDATA1_ADDR A:0xe64a69c
y.create.l HWIO_PMIC_ARB_OBS4_CHNL334_RDATA1_ADDR A:0xe64a71c
y.create.l HWIO_PMIC_ARB_OBS4_CHNL335_RDATA1_ADDR A:0xe64a79c
y.create.l HWIO_PMIC_ARB_OBS4_CHNL336_RDATA1_ADDR A:0xe64a81c
y.create.l HWIO_PMIC_ARB_OBS4_CHNL337_RDATA1_ADDR A:0xe64a89c
y.create.l HWIO_PMIC_ARB_OBS4_CHNL338_RDATA1_ADDR A:0xe64a91c
y.create.l HWIO_PMIC_ARB_OBS4_CHNL339_RDATA1_ADDR A:0xe64a99c
y.create.l HWIO_PMIC_ARB_OBS4_CHNL340_RDATA1_ADDR A:0xe64aa1c
y.create.l HWIO_PMIC_ARB_OBS4_CHNL341_RDATA1_ADDR A:0xe64aa9c
y.create.l HWIO_PMIC_ARB_OBS4_CHNL342_RDATA1_ADDR A:0xe64ab1c
y.create.l HWIO_PMIC_ARB_OBS4_CHNL343_RDATA1_ADDR A:0xe64ab9c
y.create.l HWIO_PMIC_ARB_OBS4_CHNL344_RDATA1_ADDR A:0xe64ac1c
y.create.l HWIO_PMIC_ARB_OBS4_CHNL345_RDATA1_ADDR A:0xe64ac9c
y.create.l HWIO_PMIC_ARB_OBS4_CHNL346_RDATA1_ADDR A:0xe64ad1c
y.create.l HWIO_PMIC_ARB_OBS4_CHNL347_RDATA1_ADDR A:0xe64ad9c
y.create.l HWIO_PMIC_ARB_OBS4_CHNL348_RDATA1_ADDR A:0xe64ae1c
y.create.l HWIO_PMIC_ARB_OBS4_CHNL349_RDATA1_ADDR A:0xe64ae9c
y.create.l HWIO_PMIC_ARB_OBS4_CHNL350_RDATA1_ADDR A:0xe64af1c
y.create.l HWIO_PMIC_ARB_OBS4_CHNL351_RDATA1_ADDR A:0xe64af9c
y.create.l HWIO_PMIC_ARB_OBS4_CHNL352_RDATA1_ADDR A:0xe64b01c
y.create.l HWIO_PMIC_ARB_OBS4_CHNL353_RDATA1_ADDR A:0xe64b09c
y.create.l HWIO_PMIC_ARB_OBS4_CHNL354_RDATA1_ADDR A:0xe64b11c
y.create.l HWIO_PMIC_ARB_OBS4_CHNL355_RDATA1_ADDR A:0xe64b19c
y.create.l HWIO_PMIC_ARB_OBS4_CHNL356_RDATA1_ADDR A:0xe64b21c
y.create.l HWIO_PMIC_ARB_OBS4_CHNL357_RDATA1_ADDR A:0xe64b29c
y.create.l HWIO_PMIC_ARB_OBS4_CHNL358_RDATA1_ADDR A:0xe64b31c
y.create.l HWIO_PMIC_ARB_OBS4_CHNL359_RDATA1_ADDR A:0xe64b39c
y.create.l HWIO_PMIC_ARB_OBS4_CHNL360_RDATA1_ADDR A:0xe64b41c
y.create.l HWIO_PMIC_ARB_OBS4_CHNL361_RDATA1_ADDR A:0xe64b49c
y.create.l HWIO_PMIC_ARB_OBS4_CHNL362_RDATA1_ADDR A:0xe64b51c
y.create.l HWIO_PMIC_ARB_OBS4_CHNL363_RDATA1_ADDR A:0xe64b59c
y.create.l HWIO_PMIC_ARB_OBS4_CHNL364_RDATA1_ADDR A:0xe64b61c
y.create.l HWIO_PMIC_ARB_OBS4_CHNL365_RDATA1_ADDR A:0xe64b69c
y.create.l HWIO_PMIC_ARB_OBS4_CHNL366_RDATA1_ADDR A:0xe64b71c
y.create.l HWIO_PMIC_ARB_OBS4_CHNL367_RDATA1_ADDR A:0xe64b79c
y.create.l HWIO_PMIC_ARB_OBS4_CHNL368_RDATA1_ADDR A:0xe64b81c
y.create.l HWIO_PMIC_ARB_OBS4_CHNL369_RDATA1_ADDR A:0xe64b89c
y.create.l HWIO_PMIC_ARB_OBS4_CHNL370_RDATA1_ADDR A:0xe64b91c
y.create.l HWIO_PMIC_ARB_OBS4_CHNL371_RDATA1_ADDR A:0xe64b99c
y.create.l HWIO_PMIC_ARB_OBS4_CHNL372_RDATA1_ADDR A:0xe64ba1c
y.create.l HWIO_PMIC_ARB_OBS4_CHNL373_RDATA1_ADDR A:0xe64ba9c
y.create.l HWIO_PMIC_ARB_OBS4_CHNL374_RDATA1_ADDR A:0xe64bb1c
y.create.l HWIO_PMIC_ARB_OBS4_CHNL375_RDATA1_ADDR A:0xe64bb9c
y.create.l HWIO_PMIC_ARB_OBS4_CHNL376_RDATA1_ADDR A:0xe64bc1c
y.create.l HWIO_PMIC_ARB_OBS4_CHNL377_RDATA1_ADDR A:0xe64bc9c
y.create.l HWIO_PMIC_ARB_OBS4_CHNL378_RDATA1_ADDR A:0xe64bd1c
y.create.l HWIO_PMIC_ARB_OBS4_CHNL379_RDATA1_ADDR A:0xe64bd9c
y.create.l HWIO_PMIC_ARB_OBS4_CHNL380_RDATA1_ADDR A:0xe64be1c
y.create.l HWIO_PMIC_ARB_OBS4_CHNL381_RDATA1_ADDR A:0xe64be9c
y.create.l HWIO_PMIC_ARB_OBS4_CHNL382_RDATA1_ADDR A:0xe64bf1c
y.create.l HWIO_PMIC_ARB_OBS4_CHNL383_RDATA1_ADDR A:0xe64bf9c
y.create.l HWIO_PMIC_ARB_OBS4_CHNL384_RDATA1_ADDR A:0xe64c01c
y.create.l HWIO_PMIC_ARB_OBS4_CHNL385_RDATA1_ADDR A:0xe64c09c
y.create.l HWIO_PMIC_ARB_OBS4_CHNL386_RDATA1_ADDR A:0xe64c11c
y.create.l HWIO_PMIC_ARB_OBS4_CHNL387_RDATA1_ADDR A:0xe64c19c
y.create.l HWIO_PMIC_ARB_OBS4_CHNL388_RDATA1_ADDR A:0xe64c21c
y.create.l HWIO_PMIC_ARB_OBS4_CHNL389_RDATA1_ADDR A:0xe64c29c
y.create.l HWIO_PMIC_ARB_OBS4_CHNL390_RDATA1_ADDR A:0xe64c31c
y.create.l HWIO_PMIC_ARB_OBS4_CHNL391_RDATA1_ADDR A:0xe64c39c
y.create.l HWIO_PMIC_ARB_OBS4_CHNL392_RDATA1_ADDR A:0xe64c41c
y.create.l HWIO_PMIC_ARB_OBS4_CHNL393_RDATA1_ADDR A:0xe64c49c
y.create.l HWIO_PMIC_ARB_OBS4_CHNL394_RDATA1_ADDR A:0xe64c51c
y.create.l HWIO_PMIC_ARB_OBS4_CHNL395_RDATA1_ADDR A:0xe64c59c
y.create.l HWIO_PMIC_ARB_OBS4_CHNL396_RDATA1_ADDR A:0xe64c61c
y.create.l HWIO_PMIC_ARB_OBS4_CHNL397_RDATA1_ADDR A:0xe64c69c
y.create.l HWIO_PMIC_ARB_OBS4_CHNL398_RDATA1_ADDR A:0xe64c71c
y.create.l HWIO_PMIC_ARB_OBS4_CHNL399_RDATA1_ADDR A:0xe64c79c
y.create.l HWIO_PMIC_ARB_OBS4_CHNL400_RDATA1_ADDR A:0xe64c81c
y.create.l HWIO_PMIC_ARB_OBS4_CHNL401_RDATA1_ADDR A:0xe64c89c
y.create.l HWIO_PMIC_ARB_OBS4_CHNL402_RDATA1_ADDR A:0xe64c91c
y.create.l HWIO_PMIC_ARB_OBS4_CHNL403_RDATA1_ADDR A:0xe64c99c
y.create.l HWIO_PMIC_ARB_OBS4_CHNL404_RDATA1_ADDR A:0xe64ca1c
y.create.l HWIO_PMIC_ARB_OBS4_CHNL405_RDATA1_ADDR A:0xe64ca9c
y.create.l HWIO_PMIC_ARB_OBS4_CHNL406_RDATA1_ADDR A:0xe64cb1c
y.create.l HWIO_PMIC_ARB_OBS4_CHNL407_RDATA1_ADDR A:0xe64cb9c
y.create.l HWIO_PMIC_ARB_OBS4_CHNL408_RDATA1_ADDR A:0xe64cc1c
y.create.l HWIO_PMIC_ARB_OBS4_CHNL409_RDATA1_ADDR A:0xe64cc9c
y.create.l HWIO_PMIC_ARB_OBS4_CHNL410_RDATA1_ADDR A:0xe64cd1c
y.create.l HWIO_PMIC_ARB_OBS4_CHNL411_RDATA1_ADDR A:0xe64cd9c
y.create.l HWIO_PMIC_ARB_OBS4_CHNL412_RDATA1_ADDR A:0xe64ce1c
y.create.l HWIO_PMIC_ARB_OBS4_CHNL413_RDATA1_ADDR A:0xe64ce9c
y.create.l HWIO_PMIC_ARB_OBS4_CHNL414_RDATA1_ADDR A:0xe64cf1c
y.create.l HWIO_PMIC_ARB_OBS4_CHNL415_RDATA1_ADDR A:0xe64cf9c
y.create.l HWIO_PMIC_ARB_OBS4_CHNL416_RDATA1_ADDR A:0xe64d01c
y.create.l HWIO_PMIC_ARB_OBS4_CHNL417_RDATA1_ADDR A:0xe64d09c
y.create.l HWIO_PMIC_ARB_OBS4_CHNL418_RDATA1_ADDR A:0xe64d11c
y.create.l HWIO_PMIC_ARB_OBS4_CHNL419_RDATA1_ADDR A:0xe64d19c
y.create.l HWIO_PMIC_ARB_OBS4_CHNL420_RDATA1_ADDR A:0xe64d21c
y.create.l HWIO_PMIC_ARB_OBS4_CHNL421_RDATA1_ADDR A:0xe64d29c
y.create.l HWIO_PMIC_ARB_OBS4_CHNL422_RDATA1_ADDR A:0xe64d31c
y.create.l HWIO_PMIC_ARB_OBS4_CHNL423_RDATA1_ADDR A:0xe64d39c
y.create.l HWIO_PMIC_ARB_OBS4_CHNL424_RDATA1_ADDR A:0xe64d41c
y.create.l HWIO_PMIC_ARB_OBS4_CHNL425_RDATA1_ADDR A:0xe64d49c
y.create.l HWIO_PMIC_ARB_OBS4_CHNL426_RDATA1_ADDR A:0xe64d51c
y.create.l HWIO_PMIC_ARB_OBS4_CHNL427_RDATA1_ADDR A:0xe64d59c
y.create.l HWIO_PMIC_ARB_OBS4_CHNL428_RDATA1_ADDR A:0xe64d61c
y.create.l HWIO_PMIC_ARB_OBS4_CHNL429_RDATA1_ADDR A:0xe64d69c
y.create.l HWIO_PMIC_ARB_OBS4_CHNL430_RDATA1_ADDR A:0xe64d71c
y.create.l HWIO_PMIC_ARB_OBS4_CHNL431_RDATA1_ADDR A:0xe64d79c
y.create.l HWIO_PMIC_ARB_OBS4_CHNL432_RDATA1_ADDR A:0xe64d81c
y.create.l HWIO_PMIC_ARB_OBS4_CHNL433_RDATA1_ADDR A:0xe64d89c
y.create.l HWIO_PMIC_ARB_OBS4_CHNL434_RDATA1_ADDR A:0xe64d91c
y.create.l HWIO_PMIC_ARB_OBS4_CHNL435_RDATA1_ADDR A:0xe64d99c
y.create.l HWIO_PMIC_ARB_OBS4_CHNL436_RDATA1_ADDR A:0xe64da1c
y.create.l HWIO_PMIC_ARB_OBS4_CHNL437_RDATA1_ADDR A:0xe64da9c
y.create.l HWIO_PMIC_ARB_OBS4_CHNL438_RDATA1_ADDR A:0xe64db1c
y.create.l HWIO_PMIC_ARB_OBS4_CHNL439_RDATA1_ADDR A:0xe64db9c
y.create.l HWIO_PMIC_ARB_OBS4_CHNL440_RDATA1_ADDR A:0xe64dc1c
y.create.l HWIO_PMIC_ARB_OBS4_CHNL441_RDATA1_ADDR A:0xe64dc9c
y.create.l HWIO_PMIC_ARB_OBS4_CHNL442_RDATA1_ADDR A:0xe64dd1c
y.create.l HWIO_PMIC_ARB_OBS4_CHNL443_RDATA1_ADDR A:0xe64dd9c
y.create.l HWIO_PMIC_ARB_OBS4_CHNL444_RDATA1_ADDR A:0xe64de1c
y.create.l HWIO_PMIC_ARB_OBS4_CHNL445_RDATA1_ADDR A:0xe64de9c
y.create.l HWIO_PMIC_ARB_OBS4_CHNL446_RDATA1_ADDR A:0xe64df1c
y.create.l HWIO_PMIC_ARB_OBS4_CHNL447_RDATA1_ADDR A:0xe64df9c
y.create.l HWIO_PMIC_ARB_OBS4_CHNL448_RDATA1_ADDR A:0xe64e01c
y.create.l HWIO_PMIC_ARB_OBS4_CHNL449_RDATA1_ADDR A:0xe64e09c
y.create.l HWIO_PMIC_ARB_OBS4_CHNL450_RDATA1_ADDR A:0xe64e11c
y.create.l HWIO_PMIC_ARB_OBS4_CHNL451_RDATA1_ADDR A:0xe64e19c
y.create.l HWIO_PMIC_ARB_OBS4_CHNL452_RDATA1_ADDR A:0xe64e21c
y.create.l HWIO_PMIC_ARB_OBS4_CHNL453_RDATA1_ADDR A:0xe64e29c
y.create.l HWIO_PMIC_ARB_OBS4_CHNL454_RDATA1_ADDR A:0xe64e31c
y.create.l HWIO_PMIC_ARB_OBS4_CHNL455_RDATA1_ADDR A:0xe64e39c
y.create.l HWIO_PMIC_ARB_OBS4_CHNL456_RDATA1_ADDR A:0xe64e41c
y.create.l HWIO_PMIC_ARB_OBS4_CHNL457_RDATA1_ADDR A:0xe64e49c
y.create.l HWIO_PMIC_ARB_OBS4_CHNL458_RDATA1_ADDR A:0xe64e51c
y.create.l HWIO_PMIC_ARB_OBS4_CHNL459_RDATA1_ADDR A:0xe64e59c
y.create.l HWIO_PMIC_ARB_OBS4_CHNL460_RDATA1_ADDR A:0xe64e61c
y.create.l HWIO_PMIC_ARB_OBS4_CHNL461_RDATA1_ADDR A:0xe64e69c
y.create.l HWIO_PMIC_ARB_OBS4_CHNL462_RDATA1_ADDR A:0xe64e71c
y.create.l HWIO_PMIC_ARB_OBS4_CHNL463_RDATA1_ADDR A:0xe64e79c
y.create.l HWIO_PMIC_ARB_OBS4_CHNL464_RDATA1_ADDR A:0xe64e81c
y.create.l HWIO_PMIC_ARB_OBS4_CHNL465_RDATA1_ADDR A:0xe64e89c
y.create.l HWIO_PMIC_ARB_OBS4_CHNL466_RDATA1_ADDR A:0xe64e91c
y.create.l HWIO_PMIC_ARB_OBS4_CHNL467_RDATA1_ADDR A:0xe64e99c
y.create.l HWIO_PMIC_ARB_OBS4_CHNL468_RDATA1_ADDR A:0xe64ea1c
y.create.l HWIO_PMIC_ARB_OBS4_CHNL469_RDATA1_ADDR A:0xe64ea9c
y.create.l HWIO_PMIC_ARB_OBS4_CHNL470_RDATA1_ADDR A:0xe64eb1c
y.create.l HWIO_PMIC_ARB_OBS4_CHNL471_RDATA1_ADDR A:0xe64eb9c
y.create.l HWIO_PMIC_ARB_OBS4_CHNL472_RDATA1_ADDR A:0xe64ec1c
y.create.l HWIO_PMIC_ARB_OBS4_CHNL473_RDATA1_ADDR A:0xe64ec9c
y.create.l HWIO_PMIC_ARB_OBS4_CHNL474_RDATA1_ADDR A:0xe64ed1c
y.create.l HWIO_PMIC_ARB_OBS4_CHNL475_RDATA1_ADDR A:0xe64ed9c
y.create.l HWIO_PMIC_ARB_OBS4_CHNL476_RDATA1_ADDR A:0xe64ee1c
y.create.l HWIO_PMIC_ARB_OBS4_CHNL477_RDATA1_ADDR A:0xe64ee9c
y.create.l HWIO_PMIC_ARB_OBS4_CHNL478_RDATA1_ADDR A:0xe64ef1c
y.create.l HWIO_PMIC_ARB_OBS4_CHNL479_RDATA1_ADDR A:0xe64ef9c
y.create.l HWIO_PMIC_ARB_OBS4_CHNL480_RDATA1_ADDR A:0xe64f01c
y.create.l HWIO_PMIC_ARB_OBS4_CHNL481_RDATA1_ADDR A:0xe64f09c
y.create.l HWIO_PMIC_ARB_OBS4_CHNL482_RDATA1_ADDR A:0xe64f11c
y.create.l HWIO_PMIC_ARB_OBS4_CHNL483_RDATA1_ADDR A:0xe64f19c
y.create.l HWIO_PMIC_ARB_OBS4_CHNL484_RDATA1_ADDR A:0xe64f21c
y.create.l HWIO_PMIC_ARB_OBS4_CHNL485_RDATA1_ADDR A:0xe64f29c
y.create.l HWIO_PMIC_ARB_OBS4_CHNL486_RDATA1_ADDR A:0xe64f31c
y.create.l HWIO_PMIC_ARB_OBS4_CHNL487_RDATA1_ADDR A:0xe64f39c
y.create.l HWIO_PMIC_ARB_OBS4_CHNL488_RDATA1_ADDR A:0xe64f41c
y.create.l HWIO_PMIC_ARB_OBS4_CHNL489_RDATA1_ADDR A:0xe64f49c
y.create.l HWIO_PMIC_ARB_OBS4_CHNL490_RDATA1_ADDR A:0xe64f51c
y.create.l HWIO_PMIC_ARB_OBS4_CHNL491_RDATA1_ADDR A:0xe64f59c
y.create.l HWIO_PMIC_ARB_OBS4_CHNL492_RDATA1_ADDR A:0xe64f61c
y.create.l HWIO_PMIC_ARB_OBS4_CHNL493_RDATA1_ADDR A:0xe64f69c
y.create.l HWIO_PMIC_ARB_OBS4_CHNL494_RDATA1_ADDR A:0xe64f71c
y.create.l HWIO_PMIC_ARB_OBS4_CHNL495_RDATA1_ADDR A:0xe64f79c
y.create.l HWIO_PMIC_ARB_OBS4_CHNL496_RDATA1_ADDR A:0xe64f81c
y.create.l HWIO_PMIC_ARB_OBS4_CHNL497_RDATA1_ADDR A:0xe64f89c
y.create.l HWIO_PMIC_ARB_OBS4_CHNL498_RDATA1_ADDR A:0xe64f91c
y.create.l HWIO_PMIC_ARB_OBS4_CHNL499_RDATA1_ADDR A:0xe64f99c
y.create.l HWIO_PMIC_ARB_OBS4_CHNL500_RDATA1_ADDR A:0xe64fa1c
y.create.l HWIO_PMIC_ARB_OBS4_CHNL501_RDATA1_ADDR A:0xe64fa9c
y.create.l HWIO_PMIC_ARB_OBS4_CHNL502_RDATA1_ADDR A:0xe64fb1c
y.create.l HWIO_PMIC_ARB_OBS4_CHNL503_RDATA1_ADDR A:0xe64fb9c
y.create.l HWIO_PMIC_ARB_OBS4_CHNL504_RDATA1_ADDR A:0xe64fc1c
y.create.l HWIO_PMIC_ARB_OBS4_CHNL505_RDATA1_ADDR A:0xe64fc9c
y.create.l HWIO_PMIC_ARB_OBS4_CHNL506_RDATA1_ADDR A:0xe64fd1c
y.create.l HWIO_PMIC_ARB_OBS4_CHNL507_RDATA1_ADDR A:0xe64fd9c
y.create.l HWIO_PMIC_ARB_OBS4_CHNL508_RDATA1_ADDR A:0xe64fe1c
y.create.l HWIO_PMIC_ARB_OBS4_CHNL509_RDATA1_ADDR A:0xe64fe9c
y.create.l HWIO_PMIC_ARB_OBS4_CHNL510_RDATA1_ADDR A:0xe64ff1c
y.create.l HWIO_PMIC_ARB_OBS4_CHNL511_RDATA1_ADDR A:0xe64ff9c
y.create.l HWIO_PMIC_ARB_OBS5_CHNL0_RDATA1_ADDR A:0xe65001c
y.create.l HWIO_PMIC_ARB_OBS5_CHNL1_RDATA1_ADDR A:0xe65009c
y.create.l HWIO_PMIC_ARB_OBS5_CHNL2_RDATA1_ADDR A:0xe65011c
y.create.l HWIO_PMIC_ARB_OBS5_CHNL3_RDATA1_ADDR A:0xe65019c
y.create.l HWIO_PMIC_ARB_OBS5_CHNL4_RDATA1_ADDR A:0xe65021c
y.create.l HWIO_PMIC_ARB_OBS5_CHNL5_RDATA1_ADDR A:0xe65029c
y.create.l HWIO_PMIC_ARB_OBS5_CHNL6_RDATA1_ADDR A:0xe65031c
y.create.l HWIO_PMIC_ARB_OBS5_CHNL7_RDATA1_ADDR A:0xe65039c
y.create.l HWIO_PMIC_ARB_OBS5_CHNL8_RDATA1_ADDR A:0xe65041c
y.create.l HWIO_PMIC_ARB_OBS5_CHNL9_RDATA1_ADDR A:0xe65049c
y.create.l HWIO_PMIC_ARB_OBS5_CHNL10_RDATA1_ADDR A:0xe65051c
y.create.l HWIO_PMIC_ARB_OBS5_CHNL11_RDATA1_ADDR A:0xe65059c
y.create.l HWIO_PMIC_ARB_OBS5_CHNL12_RDATA1_ADDR A:0xe65061c
y.create.l HWIO_PMIC_ARB_OBS5_CHNL13_RDATA1_ADDR A:0xe65069c
y.create.l HWIO_PMIC_ARB_OBS5_CHNL14_RDATA1_ADDR A:0xe65071c
y.create.l HWIO_PMIC_ARB_OBS5_CHNL15_RDATA1_ADDR A:0xe65079c
y.create.l HWIO_PMIC_ARB_OBS5_CHNL16_RDATA1_ADDR A:0xe65081c
y.create.l HWIO_PMIC_ARB_OBS5_CHNL17_RDATA1_ADDR A:0xe65089c
y.create.l HWIO_PMIC_ARB_OBS5_CHNL18_RDATA1_ADDR A:0xe65091c
y.create.l HWIO_PMIC_ARB_OBS5_CHNL19_RDATA1_ADDR A:0xe65099c
y.create.l HWIO_PMIC_ARB_OBS5_CHNL20_RDATA1_ADDR A:0xe650a1c
y.create.l HWIO_PMIC_ARB_OBS5_CHNL21_RDATA1_ADDR A:0xe650a9c
y.create.l HWIO_PMIC_ARB_OBS5_CHNL22_RDATA1_ADDR A:0xe650b1c
y.create.l HWIO_PMIC_ARB_OBS5_CHNL23_RDATA1_ADDR A:0xe650b9c
y.create.l HWIO_PMIC_ARB_OBS5_CHNL24_RDATA1_ADDR A:0xe650c1c
y.create.l HWIO_PMIC_ARB_OBS5_CHNL25_RDATA1_ADDR A:0xe650c9c
y.create.l HWIO_PMIC_ARB_OBS5_CHNL26_RDATA1_ADDR A:0xe650d1c
y.create.l HWIO_PMIC_ARB_OBS5_CHNL27_RDATA1_ADDR A:0xe650d9c
y.create.l HWIO_PMIC_ARB_OBS5_CHNL28_RDATA1_ADDR A:0xe650e1c
y.create.l HWIO_PMIC_ARB_OBS5_CHNL29_RDATA1_ADDR A:0xe650e9c
y.create.l HWIO_PMIC_ARB_OBS5_CHNL30_RDATA1_ADDR A:0xe650f1c
y.create.l HWIO_PMIC_ARB_OBS5_CHNL31_RDATA1_ADDR A:0xe650f9c
y.create.l HWIO_PMIC_ARB_OBS5_CHNL32_RDATA1_ADDR A:0xe65101c
y.create.l HWIO_PMIC_ARB_OBS5_CHNL33_RDATA1_ADDR A:0xe65109c
y.create.l HWIO_PMIC_ARB_OBS5_CHNL34_RDATA1_ADDR A:0xe65111c
y.create.l HWIO_PMIC_ARB_OBS5_CHNL35_RDATA1_ADDR A:0xe65119c
y.create.l HWIO_PMIC_ARB_OBS5_CHNL36_RDATA1_ADDR A:0xe65121c
y.create.l HWIO_PMIC_ARB_OBS5_CHNL37_RDATA1_ADDR A:0xe65129c
y.create.l HWIO_PMIC_ARB_OBS5_CHNL38_RDATA1_ADDR A:0xe65131c
y.create.l HWIO_PMIC_ARB_OBS5_CHNL39_RDATA1_ADDR A:0xe65139c
y.create.l HWIO_PMIC_ARB_OBS5_CHNL40_RDATA1_ADDR A:0xe65141c
y.create.l HWIO_PMIC_ARB_OBS5_CHNL41_RDATA1_ADDR A:0xe65149c
y.create.l HWIO_PMIC_ARB_OBS5_CHNL42_RDATA1_ADDR A:0xe65151c
y.create.l HWIO_PMIC_ARB_OBS5_CHNL43_RDATA1_ADDR A:0xe65159c
y.create.l HWIO_PMIC_ARB_OBS5_CHNL44_RDATA1_ADDR A:0xe65161c
y.create.l HWIO_PMIC_ARB_OBS5_CHNL45_RDATA1_ADDR A:0xe65169c
y.create.l HWIO_PMIC_ARB_OBS5_CHNL46_RDATA1_ADDR A:0xe65171c
y.create.l HWIO_PMIC_ARB_OBS5_CHNL47_RDATA1_ADDR A:0xe65179c
y.create.l HWIO_PMIC_ARB_OBS5_CHNL48_RDATA1_ADDR A:0xe65181c
y.create.l HWIO_PMIC_ARB_OBS5_CHNL49_RDATA1_ADDR A:0xe65189c
y.create.l HWIO_PMIC_ARB_OBS5_CHNL50_RDATA1_ADDR A:0xe65191c
y.create.l HWIO_PMIC_ARB_OBS5_CHNL51_RDATA1_ADDR A:0xe65199c
y.create.l HWIO_PMIC_ARB_OBS5_CHNL52_RDATA1_ADDR A:0xe651a1c
y.create.l HWIO_PMIC_ARB_OBS5_CHNL53_RDATA1_ADDR A:0xe651a9c
y.create.l HWIO_PMIC_ARB_OBS5_CHNL54_RDATA1_ADDR A:0xe651b1c
y.create.l HWIO_PMIC_ARB_OBS5_CHNL55_RDATA1_ADDR A:0xe651b9c
y.create.l HWIO_PMIC_ARB_OBS5_CHNL56_RDATA1_ADDR A:0xe651c1c
y.create.l HWIO_PMIC_ARB_OBS5_CHNL57_RDATA1_ADDR A:0xe651c9c
y.create.l HWIO_PMIC_ARB_OBS5_CHNL58_RDATA1_ADDR A:0xe651d1c
y.create.l HWIO_PMIC_ARB_OBS5_CHNL59_RDATA1_ADDR A:0xe651d9c
y.create.l HWIO_PMIC_ARB_OBS5_CHNL60_RDATA1_ADDR A:0xe651e1c
y.create.l HWIO_PMIC_ARB_OBS5_CHNL61_RDATA1_ADDR A:0xe651e9c
y.create.l HWIO_PMIC_ARB_OBS5_CHNL62_RDATA1_ADDR A:0xe651f1c
y.create.l HWIO_PMIC_ARB_OBS5_CHNL63_RDATA1_ADDR A:0xe651f9c
y.create.l HWIO_PMIC_ARB_OBS5_CHNL64_RDATA1_ADDR A:0xe65201c
y.create.l HWIO_PMIC_ARB_OBS5_CHNL65_RDATA1_ADDR A:0xe65209c
y.create.l HWIO_PMIC_ARB_OBS5_CHNL66_RDATA1_ADDR A:0xe65211c
y.create.l HWIO_PMIC_ARB_OBS5_CHNL67_RDATA1_ADDR A:0xe65219c
y.create.l HWIO_PMIC_ARB_OBS5_CHNL68_RDATA1_ADDR A:0xe65221c
y.create.l HWIO_PMIC_ARB_OBS5_CHNL69_RDATA1_ADDR A:0xe65229c
y.create.l HWIO_PMIC_ARB_OBS5_CHNL70_RDATA1_ADDR A:0xe65231c
y.create.l HWIO_PMIC_ARB_OBS5_CHNL71_RDATA1_ADDR A:0xe65239c
y.create.l HWIO_PMIC_ARB_OBS5_CHNL72_RDATA1_ADDR A:0xe65241c
y.create.l HWIO_PMIC_ARB_OBS5_CHNL73_RDATA1_ADDR A:0xe65249c
y.create.l HWIO_PMIC_ARB_OBS5_CHNL74_RDATA1_ADDR A:0xe65251c
y.create.l HWIO_PMIC_ARB_OBS5_CHNL75_RDATA1_ADDR A:0xe65259c
y.create.l HWIO_PMIC_ARB_OBS5_CHNL76_RDATA1_ADDR A:0xe65261c
y.create.l HWIO_PMIC_ARB_OBS5_CHNL77_RDATA1_ADDR A:0xe65269c
y.create.l HWIO_PMIC_ARB_OBS5_CHNL78_RDATA1_ADDR A:0xe65271c
y.create.l HWIO_PMIC_ARB_OBS5_CHNL79_RDATA1_ADDR A:0xe65279c
y.create.l HWIO_PMIC_ARB_OBS5_CHNL80_RDATA1_ADDR A:0xe65281c
y.create.l HWIO_PMIC_ARB_OBS5_CHNL81_RDATA1_ADDR A:0xe65289c
y.create.l HWIO_PMIC_ARB_OBS5_CHNL82_RDATA1_ADDR A:0xe65291c
y.create.l HWIO_PMIC_ARB_OBS5_CHNL83_RDATA1_ADDR A:0xe65299c
y.create.l HWIO_PMIC_ARB_OBS5_CHNL84_RDATA1_ADDR A:0xe652a1c
y.create.l HWIO_PMIC_ARB_OBS5_CHNL85_RDATA1_ADDR A:0xe652a9c
y.create.l HWIO_PMIC_ARB_OBS5_CHNL86_RDATA1_ADDR A:0xe652b1c
y.create.l HWIO_PMIC_ARB_OBS5_CHNL87_RDATA1_ADDR A:0xe652b9c
y.create.l HWIO_PMIC_ARB_OBS5_CHNL88_RDATA1_ADDR A:0xe652c1c
y.create.l HWIO_PMIC_ARB_OBS5_CHNL89_RDATA1_ADDR A:0xe652c9c
y.create.l HWIO_PMIC_ARB_OBS5_CHNL90_RDATA1_ADDR A:0xe652d1c
y.create.l HWIO_PMIC_ARB_OBS5_CHNL91_RDATA1_ADDR A:0xe652d9c
y.create.l HWIO_PMIC_ARB_OBS5_CHNL92_RDATA1_ADDR A:0xe652e1c
y.create.l HWIO_PMIC_ARB_OBS5_CHNL93_RDATA1_ADDR A:0xe652e9c
y.create.l HWIO_PMIC_ARB_OBS5_CHNL94_RDATA1_ADDR A:0xe652f1c
y.create.l HWIO_PMIC_ARB_OBS5_CHNL95_RDATA1_ADDR A:0xe652f9c
y.create.l HWIO_PMIC_ARB_OBS5_CHNL96_RDATA1_ADDR A:0xe65301c
y.create.l HWIO_PMIC_ARB_OBS5_CHNL97_RDATA1_ADDR A:0xe65309c
y.create.l HWIO_PMIC_ARB_OBS5_CHNL98_RDATA1_ADDR A:0xe65311c
y.create.l HWIO_PMIC_ARB_OBS5_CHNL99_RDATA1_ADDR A:0xe65319c
y.create.l HWIO_PMIC_ARB_OBS5_CHNL100_RDATA1_ADDR A:0xe65321c
y.create.l HWIO_PMIC_ARB_OBS5_CHNL101_RDATA1_ADDR A:0xe65329c
y.create.l HWIO_PMIC_ARB_OBS5_CHNL102_RDATA1_ADDR A:0xe65331c
y.create.l HWIO_PMIC_ARB_OBS5_CHNL103_RDATA1_ADDR A:0xe65339c
y.create.l HWIO_PMIC_ARB_OBS5_CHNL104_RDATA1_ADDR A:0xe65341c
y.create.l HWIO_PMIC_ARB_OBS5_CHNL105_RDATA1_ADDR A:0xe65349c
y.create.l HWIO_PMIC_ARB_OBS5_CHNL106_RDATA1_ADDR A:0xe65351c
y.create.l HWIO_PMIC_ARB_OBS5_CHNL107_RDATA1_ADDR A:0xe65359c
y.create.l HWIO_PMIC_ARB_OBS5_CHNL108_RDATA1_ADDR A:0xe65361c
y.create.l HWIO_PMIC_ARB_OBS5_CHNL109_RDATA1_ADDR A:0xe65369c
y.create.l HWIO_PMIC_ARB_OBS5_CHNL110_RDATA1_ADDR A:0xe65371c
y.create.l HWIO_PMIC_ARB_OBS5_CHNL111_RDATA1_ADDR A:0xe65379c
y.create.l HWIO_PMIC_ARB_OBS5_CHNL112_RDATA1_ADDR A:0xe65381c
y.create.l HWIO_PMIC_ARB_OBS5_CHNL113_RDATA1_ADDR A:0xe65389c
y.create.l HWIO_PMIC_ARB_OBS5_CHNL114_RDATA1_ADDR A:0xe65391c
y.create.l HWIO_PMIC_ARB_OBS5_CHNL115_RDATA1_ADDR A:0xe65399c
y.create.l HWIO_PMIC_ARB_OBS5_CHNL116_RDATA1_ADDR A:0xe653a1c
y.create.l HWIO_PMIC_ARB_OBS5_CHNL117_RDATA1_ADDR A:0xe653a9c
y.create.l HWIO_PMIC_ARB_OBS5_CHNL118_RDATA1_ADDR A:0xe653b1c
y.create.l HWIO_PMIC_ARB_OBS5_CHNL119_RDATA1_ADDR A:0xe653b9c
y.create.l HWIO_PMIC_ARB_OBS5_CHNL120_RDATA1_ADDR A:0xe653c1c
y.create.l HWIO_PMIC_ARB_OBS5_CHNL121_RDATA1_ADDR A:0xe653c9c
y.create.l HWIO_PMIC_ARB_OBS5_CHNL122_RDATA1_ADDR A:0xe653d1c
y.create.l HWIO_PMIC_ARB_OBS5_CHNL123_RDATA1_ADDR A:0xe653d9c
y.create.l HWIO_PMIC_ARB_OBS5_CHNL124_RDATA1_ADDR A:0xe653e1c
y.create.l HWIO_PMIC_ARB_OBS5_CHNL125_RDATA1_ADDR A:0xe653e9c
y.create.l HWIO_PMIC_ARB_OBS5_CHNL126_RDATA1_ADDR A:0xe653f1c
y.create.l HWIO_PMIC_ARB_OBS5_CHNL127_RDATA1_ADDR A:0xe653f9c
y.create.l HWIO_PMIC_ARB_OBS5_CHNL128_RDATA1_ADDR A:0xe65401c
y.create.l HWIO_PMIC_ARB_OBS5_CHNL129_RDATA1_ADDR A:0xe65409c
y.create.l HWIO_PMIC_ARB_OBS5_CHNL130_RDATA1_ADDR A:0xe65411c
y.create.l HWIO_PMIC_ARB_OBS5_CHNL131_RDATA1_ADDR A:0xe65419c
y.create.l HWIO_PMIC_ARB_OBS5_CHNL132_RDATA1_ADDR A:0xe65421c
y.create.l HWIO_PMIC_ARB_OBS5_CHNL133_RDATA1_ADDR A:0xe65429c
y.create.l HWIO_PMIC_ARB_OBS5_CHNL134_RDATA1_ADDR A:0xe65431c
y.create.l HWIO_PMIC_ARB_OBS5_CHNL135_RDATA1_ADDR A:0xe65439c
y.create.l HWIO_PMIC_ARB_OBS5_CHNL136_RDATA1_ADDR A:0xe65441c
y.create.l HWIO_PMIC_ARB_OBS5_CHNL137_RDATA1_ADDR A:0xe65449c
y.create.l HWIO_PMIC_ARB_OBS5_CHNL138_RDATA1_ADDR A:0xe65451c
y.create.l HWIO_PMIC_ARB_OBS5_CHNL139_RDATA1_ADDR A:0xe65459c
y.create.l HWIO_PMIC_ARB_OBS5_CHNL140_RDATA1_ADDR A:0xe65461c
y.create.l HWIO_PMIC_ARB_OBS5_CHNL141_RDATA1_ADDR A:0xe65469c
y.create.l HWIO_PMIC_ARB_OBS5_CHNL142_RDATA1_ADDR A:0xe65471c
y.create.l HWIO_PMIC_ARB_OBS5_CHNL143_RDATA1_ADDR A:0xe65479c
y.create.l HWIO_PMIC_ARB_OBS5_CHNL144_RDATA1_ADDR A:0xe65481c
y.create.l HWIO_PMIC_ARB_OBS5_CHNL145_RDATA1_ADDR A:0xe65489c
y.create.l HWIO_PMIC_ARB_OBS5_CHNL146_RDATA1_ADDR A:0xe65491c
y.create.l HWIO_PMIC_ARB_OBS5_CHNL147_RDATA1_ADDR A:0xe65499c
y.create.l HWIO_PMIC_ARB_OBS5_CHNL148_RDATA1_ADDR A:0xe654a1c
y.create.l HWIO_PMIC_ARB_OBS5_CHNL149_RDATA1_ADDR A:0xe654a9c
y.create.l HWIO_PMIC_ARB_OBS5_CHNL150_RDATA1_ADDR A:0xe654b1c
y.create.l HWIO_PMIC_ARB_OBS5_CHNL151_RDATA1_ADDR A:0xe654b9c
y.create.l HWIO_PMIC_ARB_OBS5_CHNL152_RDATA1_ADDR A:0xe654c1c
y.create.l HWIO_PMIC_ARB_OBS5_CHNL153_RDATA1_ADDR A:0xe654c9c
y.create.l HWIO_PMIC_ARB_OBS5_CHNL154_RDATA1_ADDR A:0xe654d1c
y.create.l HWIO_PMIC_ARB_OBS5_CHNL155_RDATA1_ADDR A:0xe654d9c
y.create.l HWIO_PMIC_ARB_OBS5_CHNL156_RDATA1_ADDR A:0xe654e1c
y.create.l HWIO_PMIC_ARB_OBS5_CHNL157_RDATA1_ADDR A:0xe654e9c
y.create.l HWIO_PMIC_ARB_OBS5_CHNL158_RDATA1_ADDR A:0xe654f1c
y.create.l HWIO_PMIC_ARB_OBS5_CHNL159_RDATA1_ADDR A:0xe654f9c
y.create.l HWIO_PMIC_ARB_OBS5_CHNL160_RDATA1_ADDR A:0xe65501c
y.create.l HWIO_PMIC_ARB_OBS5_CHNL161_RDATA1_ADDR A:0xe65509c
y.create.l HWIO_PMIC_ARB_OBS5_CHNL162_RDATA1_ADDR A:0xe65511c
y.create.l HWIO_PMIC_ARB_OBS5_CHNL163_RDATA1_ADDR A:0xe65519c
y.create.l HWIO_PMIC_ARB_OBS5_CHNL164_RDATA1_ADDR A:0xe65521c
y.create.l HWIO_PMIC_ARB_OBS5_CHNL165_RDATA1_ADDR A:0xe65529c
y.create.l HWIO_PMIC_ARB_OBS5_CHNL166_RDATA1_ADDR A:0xe65531c
y.create.l HWIO_PMIC_ARB_OBS5_CHNL167_RDATA1_ADDR A:0xe65539c
y.create.l HWIO_PMIC_ARB_OBS5_CHNL168_RDATA1_ADDR A:0xe65541c
y.create.l HWIO_PMIC_ARB_OBS5_CHNL169_RDATA1_ADDR A:0xe65549c
y.create.l HWIO_PMIC_ARB_OBS5_CHNL170_RDATA1_ADDR A:0xe65551c
y.create.l HWIO_PMIC_ARB_OBS5_CHNL171_RDATA1_ADDR A:0xe65559c
y.create.l HWIO_PMIC_ARB_OBS5_CHNL172_RDATA1_ADDR A:0xe65561c
y.create.l HWIO_PMIC_ARB_OBS5_CHNL173_RDATA1_ADDR A:0xe65569c
y.create.l HWIO_PMIC_ARB_OBS5_CHNL174_RDATA1_ADDR A:0xe65571c
y.create.l HWIO_PMIC_ARB_OBS5_CHNL175_RDATA1_ADDR A:0xe65579c
y.create.l HWIO_PMIC_ARB_OBS5_CHNL176_RDATA1_ADDR A:0xe65581c
y.create.l HWIO_PMIC_ARB_OBS5_CHNL177_RDATA1_ADDR A:0xe65589c
y.create.l HWIO_PMIC_ARB_OBS5_CHNL178_RDATA1_ADDR A:0xe65591c
y.create.l HWIO_PMIC_ARB_OBS5_CHNL179_RDATA1_ADDR A:0xe65599c
y.create.l HWIO_PMIC_ARB_OBS5_CHNL180_RDATA1_ADDR A:0xe655a1c
y.create.l HWIO_PMIC_ARB_OBS5_CHNL181_RDATA1_ADDR A:0xe655a9c
y.create.l HWIO_PMIC_ARB_OBS5_CHNL182_RDATA1_ADDR A:0xe655b1c
y.create.l HWIO_PMIC_ARB_OBS5_CHNL183_RDATA1_ADDR A:0xe655b9c
y.create.l HWIO_PMIC_ARB_OBS5_CHNL184_RDATA1_ADDR A:0xe655c1c
y.create.l HWIO_PMIC_ARB_OBS5_CHNL185_RDATA1_ADDR A:0xe655c9c
y.create.l HWIO_PMIC_ARB_OBS5_CHNL186_RDATA1_ADDR A:0xe655d1c
y.create.l HWIO_PMIC_ARB_OBS5_CHNL187_RDATA1_ADDR A:0xe655d9c
y.create.l HWIO_PMIC_ARB_OBS5_CHNL188_RDATA1_ADDR A:0xe655e1c
y.create.l HWIO_PMIC_ARB_OBS5_CHNL189_RDATA1_ADDR A:0xe655e9c
y.create.l HWIO_PMIC_ARB_OBS5_CHNL190_RDATA1_ADDR A:0xe655f1c
y.create.l HWIO_PMIC_ARB_OBS5_CHNL191_RDATA1_ADDR A:0xe655f9c
y.create.l HWIO_PMIC_ARB_OBS5_CHNL192_RDATA1_ADDR A:0xe65601c
y.create.l HWIO_PMIC_ARB_OBS5_CHNL193_RDATA1_ADDR A:0xe65609c
y.create.l HWIO_PMIC_ARB_OBS5_CHNL194_RDATA1_ADDR A:0xe65611c
y.create.l HWIO_PMIC_ARB_OBS5_CHNL195_RDATA1_ADDR A:0xe65619c
y.create.l HWIO_PMIC_ARB_OBS5_CHNL196_RDATA1_ADDR A:0xe65621c
y.create.l HWIO_PMIC_ARB_OBS5_CHNL197_RDATA1_ADDR A:0xe65629c
y.create.l HWIO_PMIC_ARB_OBS5_CHNL198_RDATA1_ADDR A:0xe65631c
y.create.l HWIO_PMIC_ARB_OBS5_CHNL199_RDATA1_ADDR A:0xe65639c
y.create.l HWIO_PMIC_ARB_OBS5_CHNL200_RDATA1_ADDR A:0xe65641c
y.create.l HWIO_PMIC_ARB_OBS5_CHNL201_RDATA1_ADDR A:0xe65649c
y.create.l HWIO_PMIC_ARB_OBS5_CHNL202_RDATA1_ADDR A:0xe65651c
y.create.l HWIO_PMIC_ARB_OBS5_CHNL203_RDATA1_ADDR A:0xe65659c
y.create.l HWIO_PMIC_ARB_OBS5_CHNL204_RDATA1_ADDR A:0xe65661c
y.create.l HWIO_PMIC_ARB_OBS5_CHNL205_RDATA1_ADDR A:0xe65669c
y.create.l HWIO_PMIC_ARB_OBS5_CHNL206_RDATA1_ADDR A:0xe65671c
y.create.l HWIO_PMIC_ARB_OBS5_CHNL207_RDATA1_ADDR A:0xe65679c
y.create.l HWIO_PMIC_ARB_OBS5_CHNL208_RDATA1_ADDR A:0xe65681c
y.create.l HWIO_PMIC_ARB_OBS5_CHNL209_RDATA1_ADDR A:0xe65689c
y.create.l HWIO_PMIC_ARB_OBS5_CHNL210_RDATA1_ADDR A:0xe65691c
y.create.l HWIO_PMIC_ARB_OBS5_CHNL211_RDATA1_ADDR A:0xe65699c
y.create.l HWIO_PMIC_ARB_OBS5_CHNL212_RDATA1_ADDR A:0xe656a1c
y.create.l HWIO_PMIC_ARB_OBS5_CHNL213_RDATA1_ADDR A:0xe656a9c
y.create.l HWIO_PMIC_ARB_OBS5_CHNL214_RDATA1_ADDR A:0xe656b1c
y.create.l HWIO_PMIC_ARB_OBS5_CHNL215_RDATA1_ADDR A:0xe656b9c
y.create.l HWIO_PMIC_ARB_OBS5_CHNL216_RDATA1_ADDR A:0xe656c1c
y.create.l HWIO_PMIC_ARB_OBS5_CHNL217_RDATA1_ADDR A:0xe656c9c
y.create.l HWIO_PMIC_ARB_OBS5_CHNL218_RDATA1_ADDR A:0xe656d1c
y.create.l HWIO_PMIC_ARB_OBS5_CHNL219_RDATA1_ADDR A:0xe656d9c
y.create.l HWIO_PMIC_ARB_OBS5_CHNL220_RDATA1_ADDR A:0xe656e1c
y.create.l HWIO_PMIC_ARB_OBS5_CHNL221_RDATA1_ADDR A:0xe656e9c
y.create.l HWIO_PMIC_ARB_OBS5_CHNL222_RDATA1_ADDR A:0xe656f1c
y.create.l HWIO_PMIC_ARB_OBS5_CHNL223_RDATA1_ADDR A:0xe656f9c
y.create.l HWIO_PMIC_ARB_OBS5_CHNL224_RDATA1_ADDR A:0xe65701c
y.create.l HWIO_PMIC_ARB_OBS5_CHNL225_RDATA1_ADDR A:0xe65709c
y.create.l HWIO_PMIC_ARB_OBS5_CHNL226_RDATA1_ADDR A:0xe65711c
y.create.l HWIO_PMIC_ARB_OBS5_CHNL227_RDATA1_ADDR A:0xe65719c
y.create.l HWIO_PMIC_ARB_OBS5_CHNL228_RDATA1_ADDR A:0xe65721c
y.create.l HWIO_PMIC_ARB_OBS5_CHNL229_RDATA1_ADDR A:0xe65729c
y.create.l HWIO_PMIC_ARB_OBS5_CHNL230_RDATA1_ADDR A:0xe65731c
y.create.l HWIO_PMIC_ARB_OBS5_CHNL231_RDATA1_ADDR A:0xe65739c
y.create.l HWIO_PMIC_ARB_OBS5_CHNL232_RDATA1_ADDR A:0xe65741c
y.create.l HWIO_PMIC_ARB_OBS5_CHNL233_RDATA1_ADDR A:0xe65749c
y.create.l HWIO_PMIC_ARB_OBS5_CHNL234_RDATA1_ADDR A:0xe65751c
y.create.l HWIO_PMIC_ARB_OBS5_CHNL235_RDATA1_ADDR A:0xe65759c
y.create.l HWIO_PMIC_ARB_OBS5_CHNL236_RDATA1_ADDR A:0xe65761c
y.create.l HWIO_PMIC_ARB_OBS5_CHNL237_RDATA1_ADDR A:0xe65769c
y.create.l HWIO_PMIC_ARB_OBS5_CHNL238_RDATA1_ADDR A:0xe65771c
y.create.l HWIO_PMIC_ARB_OBS5_CHNL239_RDATA1_ADDR A:0xe65779c
y.create.l HWIO_PMIC_ARB_OBS5_CHNL240_RDATA1_ADDR A:0xe65781c
y.create.l HWIO_PMIC_ARB_OBS5_CHNL241_RDATA1_ADDR A:0xe65789c
y.create.l HWIO_PMIC_ARB_OBS5_CHNL242_RDATA1_ADDR A:0xe65791c
y.create.l HWIO_PMIC_ARB_OBS5_CHNL243_RDATA1_ADDR A:0xe65799c
y.create.l HWIO_PMIC_ARB_OBS5_CHNL244_RDATA1_ADDR A:0xe657a1c
y.create.l HWIO_PMIC_ARB_OBS5_CHNL245_RDATA1_ADDR A:0xe657a9c
y.create.l HWIO_PMIC_ARB_OBS5_CHNL246_RDATA1_ADDR A:0xe657b1c
y.create.l HWIO_PMIC_ARB_OBS5_CHNL247_RDATA1_ADDR A:0xe657b9c
y.create.l HWIO_PMIC_ARB_OBS5_CHNL248_RDATA1_ADDR A:0xe657c1c
y.create.l HWIO_PMIC_ARB_OBS5_CHNL249_RDATA1_ADDR A:0xe657c9c
y.create.l HWIO_PMIC_ARB_OBS5_CHNL250_RDATA1_ADDR A:0xe657d1c
y.create.l HWIO_PMIC_ARB_OBS5_CHNL251_RDATA1_ADDR A:0xe657d9c
y.create.l HWIO_PMIC_ARB_OBS5_CHNL252_RDATA1_ADDR A:0xe657e1c
y.create.l HWIO_PMIC_ARB_OBS5_CHNL253_RDATA1_ADDR A:0xe657e9c
y.create.l HWIO_PMIC_ARB_OBS5_CHNL254_RDATA1_ADDR A:0xe657f1c
y.create.l HWIO_PMIC_ARB_OBS5_CHNL255_RDATA1_ADDR A:0xe657f9c
y.create.l HWIO_PMIC_ARB_OBS5_CHNL256_RDATA1_ADDR A:0xe65801c
y.create.l HWIO_PMIC_ARB_OBS5_CHNL257_RDATA1_ADDR A:0xe65809c
y.create.l HWIO_PMIC_ARB_OBS5_CHNL258_RDATA1_ADDR A:0xe65811c
y.create.l HWIO_PMIC_ARB_OBS5_CHNL259_RDATA1_ADDR A:0xe65819c
y.create.l HWIO_PMIC_ARB_OBS5_CHNL260_RDATA1_ADDR A:0xe65821c
y.create.l HWIO_PMIC_ARB_OBS5_CHNL261_RDATA1_ADDR A:0xe65829c
y.create.l HWIO_PMIC_ARB_OBS5_CHNL262_RDATA1_ADDR A:0xe65831c
y.create.l HWIO_PMIC_ARB_OBS5_CHNL263_RDATA1_ADDR A:0xe65839c
y.create.l HWIO_PMIC_ARB_OBS5_CHNL264_RDATA1_ADDR A:0xe65841c
y.create.l HWIO_PMIC_ARB_OBS5_CHNL265_RDATA1_ADDR A:0xe65849c
y.create.l HWIO_PMIC_ARB_OBS5_CHNL266_RDATA1_ADDR A:0xe65851c
y.create.l HWIO_PMIC_ARB_OBS5_CHNL267_RDATA1_ADDR A:0xe65859c
y.create.l HWIO_PMIC_ARB_OBS5_CHNL268_RDATA1_ADDR A:0xe65861c
y.create.l HWIO_PMIC_ARB_OBS5_CHNL269_RDATA1_ADDR A:0xe65869c
y.create.l HWIO_PMIC_ARB_OBS5_CHNL270_RDATA1_ADDR A:0xe65871c
y.create.l HWIO_PMIC_ARB_OBS5_CHNL271_RDATA1_ADDR A:0xe65879c
y.create.l HWIO_PMIC_ARB_OBS5_CHNL272_RDATA1_ADDR A:0xe65881c
y.create.l HWIO_PMIC_ARB_OBS5_CHNL273_RDATA1_ADDR A:0xe65889c
y.create.l HWIO_PMIC_ARB_OBS5_CHNL274_RDATA1_ADDR A:0xe65891c
y.create.l HWIO_PMIC_ARB_OBS5_CHNL275_RDATA1_ADDR A:0xe65899c
y.create.l HWIO_PMIC_ARB_OBS5_CHNL276_RDATA1_ADDR A:0xe658a1c
y.create.l HWIO_PMIC_ARB_OBS5_CHNL277_RDATA1_ADDR A:0xe658a9c
y.create.l HWIO_PMIC_ARB_OBS5_CHNL278_RDATA1_ADDR A:0xe658b1c
y.create.l HWIO_PMIC_ARB_OBS5_CHNL279_RDATA1_ADDR A:0xe658b9c
y.create.l HWIO_PMIC_ARB_OBS5_CHNL280_RDATA1_ADDR A:0xe658c1c
y.create.l HWIO_PMIC_ARB_OBS5_CHNL281_RDATA1_ADDR A:0xe658c9c
y.create.l HWIO_PMIC_ARB_OBS5_CHNL282_RDATA1_ADDR A:0xe658d1c
y.create.l HWIO_PMIC_ARB_OBS5_CHNL283_RDATA1_ADDR A:0xe658d9c
y.create.l HWIO_PMIC_ARB_OBS5_CHNL284_RDATA1_ADDR A:0xe658e1c
y.create.l HWIO_PMIC_ARB_OBS5_CHNL285_RDATA1_ADDR A:0xe658e9c
y.create.l HWIO_PMIC_ARB_OBS5_CHNL286_RDATA1_ADDR A:0xe658f1c
y.create.l HWIO_PMIC_ARB_OBS5_CHNL287_RDATA1_ADDR A:0xe658f9c
y.create.l HWIO_PMIC_ARB_OBS5_CHNL288_RDATA1_ADDR A:0xe65901c
y.create.l HWIO_PMIC_ARB_OBS5_CHNL289_RDATA1_ADDR A:0xe65909c
y.create.l HWIO_PMIC_ARB_OBS5_CHNL290_RDATA1_ADDR A:0xe65911c
y.create.l HWIO_PMIC_ARB_OBS5_CHNL291_RDATA1_ADDR A:0xe65919c
y.create.l HWIO_PMIC_ARB_OBS5_CHNL292_RDATA1_ADDR A:0xe65921c
y.create.l HWIO_PMIC_ARB_OBS5_CHNL293_RDATA1_ADDR A:0xe65929c
y.create.l HWIO_PMIC_ARB_OBS5_CHNL294_RDATA1_ADDR A:0xe65931c
y.create.l HWIO_PMIC_ARB_OBS5_CHNL295_RDATA1_ADDR A:0xe65939c
y.create.l HWIO_PMIC_ARB_OBS5_CHNL296_RDATA1_ADDR A:0xe65941c
y.create.l HWIO_PMIC_ARB_OBS5_CHNL297_RDATA1_ADDR A:0xe65949c
y.create.l HWIO_PMIC_ARB_OBS5_CHNL298_RDATA1_ADDR A:0xe65951c
y.create.l HWIO_PMIC_ARB_OBS5_CHNL299_RDATA1_ADDR A:0xe65959c
y.create.l HWIO_PMIC_ARB_OBS5_CHNL300_RDATA1_ADDR A:0xe65961c
y.create.l HWIO_PMIC_ARB_OBS5_CHNL301_RDATA1_ADDR A:0xe65969c
y.create.l HWIO_PMIC_ARB_OBS5_CHNL302_RDATA1_ADDR A:0xe65971c
y.create.l HWIO_PMIC_ARB_OBS5_CHNL303_RDATA1_ADDR A:0xe65979c
y.create.l HWIO_PMIC_ARB_OBS5_CHNL304_RDATA1_ADDR A:0xe65981c
y.create.l HWIO_PMIC_ARB_OBS5_CHNL305_RDATA1_ADDR A:0xe65989c
y.create.l HWIO_PMIC_ARB_OBS5_CHNL306_RDATA1_ADDR A:0xe65991c
y.create.l HWIO_PMIC_ARB_OBS5_CHNL307_RDATA1_ADDR A:0xe65999c
y.create.l HWIO_PMIC_ARB_OBS5_CHNL308_RDATA1_ADDR A:0xe659a1c
y.create.l HWIO_PMIC_ARB_OBS5_CHNL309_RDATA1_ADDR A:0xe659a9c
y.create.l HWIO_PMIC_ARB_OBS5_CHNL310_RDATA1_ADDR A:0xe659b1c
y.create.l HWIO_PMIC_ARB_OBS5_CHNL311_RDATA1_ADDR A:0xe659b9c
y.create.l HWIO_PMIC_ARB_OBS5_CHNL312_RDATA1_ADDR A:0xe659c1c
y.create.l HWIO_PMIC_ARB_OBS5_CHNL313_RDATA1_ADDR A:0xe659c9c
y.create.l HWIO_PMIC_ARB_OBS5_CHNL314_RDATA1_ADDR A:0xe659d1c
y.create.l HWIO_PMIC_ARB_OBS5_CHNL315_RDATA1_ADDR A:0xe659d9c
y.create.l HWIO_PMIC_ARB_OBS5_CHNL316_RDATA1_ADDR A:0xe659e1c
y.create.l HWIO_PMIC_ARB_OBS5_CHNL317_RDATA1_ADDR A:0xe659e9c
y.create.l HWIO_PMIC_ARB_OBS5_CHNL318_RDATA1_ADDR A:0xe659f1c
y.create.l HWIO_PMIC_ARB_OBS5_CHNL319_RDATA1_ADDR A:0xe659f9c
y.create.l HWIO_PMIC_ARB_OBS5_CHNL320_RDATA1_ADDR A:0xe65a01c
y.create.l HWIO_PMIC_ARB_OBS5_CHNL321_RDATA1_ADDR A:0xe65a09c
y.create.l HWIO_PMIC_ARB_OBS5_CHNL322_RDATA1_ADDR A:0xe65a11c
y.create.l HWIO_PMIC_ARB_OBS5_CHNL323_RDATA1_ADDR A:0xe65a19c
y.create.l HWIO_PMIC_ARB_OBS5_CHNL324_RDATA1_ADDR A:0xe65a21c
y.create.l HWIO_PMIC_ARB_OBS5_CHNL325_RDATA1_ADDR A:0xe65a29c
y.create.l HWIO_PMIC_ARB_OBS5_CHNL326_RDATA1_ADDR A:0xe65a31c
y.create.l HWIO_PMIC_ARB_OBS5_CHNL327_RDATA1_ADDR A:0xe65a39c
y.create.l HWIO_PMIC_ARB_OBS5_CHNL328_RDATA1_ADDR A:0xe65a41c
y.create.l HWIO_PMIC_ARB_OBS5_CHNL329_RDATA1_ADDR A:0xe65a49c
y.create.l HWIO_PMIC_ARB_OBS5_CHNL330_RDATA1_ADDR A:0xe65a51c
y.create.l HWIO_PMIC_ARB_OBS5_CHNL331_RDATA1_ADDR A:0xe65a59c
y.create.l HWIO_PMIC_ARB_OBS5_CHNL332_RDATA1_ADDR A:0xe65a61c
y.create.l HWIO_PMIC_ARB_OBS5_CHNL333_RDATA1_ADDR A:0xe65a69c
y.create.l HWIO_PMIC_ARB_OBS5_CHNL334_RDATA1_ADDR A:0xe65a71c
y.create.l HWIO_PMIC_ARB_OBS5_CHNL335_RDATA1_ADDR A:0xe65a79c
y.create.l HWIO_PMIC_ARB_OBS5_CHNL336_RDATA1_ADDR A:0xe65a81c
y.create.l HWIO_PMIC_ARB_OBS5_CHNL337_RDATA1_ADDR A:0xe65a89c
y.create.l HWIO_PMIC_ARB_OBS5_CHNL338_RDATA1_ADDR A:0xe65a91c
y.create.l HWIO_PMIC_ARB_OBS5_CHNL339_RDATA1_ADDR A:0xe65a99c
y.create.l HWIO_PMIC_ARB_OBS5_CHNL340_RDATA1_ADDR A:0xe65aa1c
y.create.l HWIO_PMIC_ARB_OBS5_CHNL341_RDATA1_ADDR A:0xe65aa9c
y.create.l HWIO_PMIC_ARB_OBS5_CHNL342_RDATA1_ADDR A:0xe65ab1c
y.create.l HWIO_PMIC_ARB_OBS5_CHNL343_RDATA1_ADDR A:0xe65ab9c
y.create.l HWIO_PMIC_ARB_OBS5_CHNL344_RDATA1_ADDR A:0xe65ac1c
y.create.l HWIO_PMIC_ARB_OBS5_CHNL345_RDATA1_ADDR A:0xe65ac9c
y.create.l HWIO_PMIC_ARB_OBS5_CHNL346_RDATA1_ADDR A:0xe65ad1c
y.create.l HWIO_PMIC_ARB_OBS5_CHNL347_RDATA1_ADDR A:0xe65ad9c
y.create.l HWIO_PMIC_ARB_OBS5_CHNL348_RDATA1_ADDR A:0xe65ae1c
y.create.l HWIO_PMIC_ARB_OBS5_CHNL349_RDATA1_ADDR A:0xe65ae9c
y.create.l HWIO_PMIC_ARB_OBS5_CHNL350_RDATA1_ADDR A:0xe65af1c
y.create.l HWIO_PMIC_ARB_OBS5_CHNL351_RDATA1_ADDR A:0xe65af9c
y.create.l HWIO_PMIC_ARB_OBS5_CHNL352_RDATA1_ADDR A:0xe65b01c
y.create.l HWIO_PMIC_ARB_OBS5_CHNL353_RDATA1_ADDR A:0xe65b09c
y.create.l HWIO_PMIC_ARB_OBS5_CHNL354_RDATA1_ADDR A:0xe65b11c
y.create.l HWIO_PMIC_ARB_OBS5_CHNL355_RDATA1_ADDR A:0xe65b19c
y.create.l HWIO_PMIC_ARB_OBS5_CHNL356_RDATA1_ADDR A:0xe65b21c
y.create.l HWIO_PMIC_ARB_OBS5_CHNL357_RDATA1_ADDR A:0xe65b29c
y.create.l HWIO_PMIC_ARB_OBS5_CHNL358_RDATA1_ADDR A:0xe65b31c
y.create.l HWIO_PMIC_ARB_OBS5_CHNL359_RDATA1_ADDR A:0xe65b39c
y.create.l HWIO_PMIC_ARB_OBS5_CHNL360_RDATA1_ADDR A:0xe65b41c
y.create.l HWIO_PMIC_ARB_OBS5_CHNL361_RDATA1_ADDR A:0xe65b49c
y.create.l HWIO_PMIC_ARB_OBS5_CHNL362_RDATA1_ADDR A:0xe65b51c
y.create.l HWIO_PMIC_ARB_OBS5_CHNL363_RDATA1_ADDR A:0xe65b59c
y.create.l HWIO_PMIC_ARB_OBS5_CHNL364_RDATA1_ADDR A:0xe65b61c
y.create.l HWIO_PMIC_ARB_OBS5_CHNL365_RDATA1_ADDR A:0xe65b69c
y.create.l HWIO_PMIC_ARB_OBS5_CHNL366_RDATA1_ADDR A:0xe65b71c
y.create.l HWIO_PMIC_ARB_OBS5_CHNL367_RDATA1_ADDR A:0xe65b79c
y.create.l HWIO_PMIC_ARB_OBS5_CHNL368_RDATA1_ADDR A:0xe65b81c
y.create.l HWIO_PMIC_ARB_OBS5_CHNL369_RDATA1_ADDR A:0xe65b89c
y.create.l HWIO_PMIC_ARB_OBS5_CHNL370_RDATA1_ADDR A:0xe65b91c
y.create.l HWIO_PMIC_ARB_OBS5_CHNL371_RDATA1_ADDR A:0xe65b99c
y.create.l HWIO_PMIC_ARB_OBS5_CHNL372_RDATA1_ADDR A:0xe65ba1c
y.create.l HWIO_PMIC_ARB_OBS5_CHNL373_RDATA1_ADDR A:0xe65ba9c
y.create.l HWIO_PMIC_ARB_OBS5_CHNL374_RDATA1_ADDR A:0xe65bb1c
y.create.l HWIO_PMIC_ARB_OBS5_CHNL375_RDATA1_ADDR A:0xe65bb9c
y.create.l HWIO_PMIC_ARB_OBS5_CHNL376_RDATA1_ADDR A:0xe65bc1c
y.create.l HWIO_PMIC_ARB_OBS5_CHNL377_RDATA1_ADDR A:0xe65bc9c
y.create.l HWIO_PMIC_ARB_OBS5_CHNL378_RDATA1_ADDR A:0xe65bd1c
y.create.l HWIO_PMIC_ARB_OBS5_CHNL379_RDATA1_ADDR A:0xe65bd9c
y.create.l HWIO_PMIC_ARB_OBS5_CHNL380_RDATA1_ADDR A:0xe65be1c
y.create.l HWIO_PMIC_ARB_OBS5_CHNL381_RDATA1_ADDR A:0xe65be9c
y.create.l HWIO_PMIC_ARB_OBS5_CHNL382_RDATA1_ADDR A:0xe65bf1c
y.create.l HWIO_PMIC_ARB_OBS5_CHNL383_RDATA1_ADDR A:0xe65bf9c
y.create.l HWIO_PMIC_ARB_OBS5_CHNL384_RDATA1_ADDR A:0xe65c01c
y.create.l HWIO_PMIC_ARB_OBS5_CHNL385_RDATA1_ADDR A:0xe65c09c
y.create.l HWIO_PMIC_ARB_OBS5_CHNL386_RDATA1_ADDR A:0xe65c11c
y.create.l HWIO_PMIC_ARB_OBS5_CHNL387_RDATA1_ADDR A:0xe65c19c
y.create.l HWIO_PMIC_ARB_OBS5_CHNL388_RDATA1_ADDR A:0xe65c21c
y.create.l HWIO_PMIC_ARB_OBS5_CHNL389_RDATA1_ADDR A:0xe65c29c
y.create.l HWIO_PMIC_ARB_OBS5_CHNL390_RDATA1_ADDR A:0xe65c31c
y.create.l HWIO_PMIC_ARB_OBS5_CHNL391_RDATA1_ADDR A:0xe65c39c
y.create.l HWIO_PMIC_ARB_OBS5_CHNL392_RDATA1_ADDR A:0xe65c41c
y.create.l HWIO_PMIC_ARB_OBS5_CHNL393_RDATA1_ADDR A:0xe65c49c
y.create.l HWIO_PMIC_ARB_OBS5_CHNL394_RDATA1_ADDR A:0xe65c51c
y.create.l HWIO_PMIC_ARB_OBS5_CHNL395_RDATA1_ADDR A:0xe65c59c
y.create.l HWIO_PMIC_ARB_OBS5_CHNL396_RDATA1_ADDR A:0xe65c61c
y.create.l HWIO_PMIC_ARB_OBS5_CHNL397_RDATA1_ADDR A:0xe65c69c
y.create.l HWIO_PMIC_ARB_OBS5_CHNL398_RDATA1_ADDR A:0xe65c71c
y.create.l HWIO_PMIC_ARB_OBS5_CHNL399_RDATA1_ADDR A:0xe65c79c
y.create.l HWIO_PMIC_ARB_OBS5_CHNL400_RDATA1_ADDR A:0xe65c81c
y.create.l HWIO_PMIC_ARB_OBS5_CHNL401_RDATA1_ADDR A:0xe65c89c
y.create.l HWIO_PMIC_ARB_OBS5_CHNL402_RDATA1_ADDR A:0xe65c91c
y.create.l HWIO_PMIC_ARB_OBS5_CHNL403_RDATA1_ADDR A:0xe65c99c
y.create.l HWIO_PMIC_ARB_OBS5_CHNL404_RDATA1_ADDR A:0xe65ca1c
y.create.l HWIO_PMIC_ARB_OBS5_CHNL405_RDATA1_ADDR A:0xe65ca9c
y.create.l HWIO_PMIC_ARB_OBS5_CHNL406_RDATA1_ADDR A:0xe65cb1c
y.create.l HWIO_PMIC_ARB_OBS5_CHNL407_RDATA1_ADDR A:0xe65cb9c
y.create.l HWIO_PMIC_ARB_OBS5_CHNL408_RDATA1_ADDR A:0xe65cc1c
y.create.l HWIO_PMIC_ARB_OBS5_CHNL409_RDATA1_ADDR A:0xe65cc9c
y.create.l HWIO_PMIC_ARB_OBS5_CHNL410_RDATA1_ADDR A:0xe65cd1c
y.create.l HWIO_PMIC_ARB_OBS5_CHNL411_RDATA1_ADDR A:0xe65cd9c
y.create.l HWIO_PMIC_ARB_OBS5_CHNL412_RDATA1_ADDR A:0xe65ce1c
y.create.l HWIO_PMIC_ARB_OBS5_CHNL413_RDATA1_ADDR A:0xe65ce9c
y.create.l HWIO_PMIC_ARB_OBS5_CHNL414_RDATA1_ADDR A:0xe65cf1c
y.create.l HWIO_PMIC_ARB_OBS5_CHNL415_RDATA1_ADDR A:0xe65cf9c
y.create.l HWIO_PMIC_ARB_OBS5_CHNL416_RDATA1_ADDR A:0xe65d01c
y.create.l HWIO_PMIC_ARB_OBS5_CHNL417_RDATA1_ADDR A:0xe65d09c
y.create.l HWIO_PMIC_ARB_OBS5_CHNL418_RDATA1_ADDR A:0xe65d11c
y.create.l HWIO_PMIC_ARB_OBS5_CHNL419_RDATA1_ADDR A:0xe65d19c
y.create.l HWIO_PMIC_ARB_OBS5_CHNL420_RDATA1_ADDR A:0xe65d21c
y.create.l HWIO_PMIC_ARB_OBS5_CHNL421_RDATA1_ADDR A:0xe65d29c
y.create.l HWIO_PMIC_ARB_OBS5_CHNL422_RDATA1_ADDR A:0xe65d31c
y.create.l HWIO_PMIC_ARB_OBS5_CHNL423_RDATA1_ADDR A:0xe65d39c
y.create.l HWIO_PMIC_ARB_OBS5_CHNL424_RDATA1_ADDR A:0xe65d41c
y.create.l HWIO_PMIC_ARB_OBS5_CHNL425_RDATA1_ADDR A:0xe65d49c
y.create.l HWIO_PMIC_ARB_OBS5_CHNL426_RDATA1_ADDR A:0xe65d51c
y.create.l HWIO_PMIC_ARB_OBS5_CHNL427_RDATA1_ADDR A:0xe65d59c
y.create.l HWIO_PMIC_ARB_OBS5_CHNL428_RDATA1_ADDR A:0xe65d61c
y.create.l HWIO_PMIC_ARB_OBS5_CHNL429_RDATA1_ADDR A:0xe65d69c
y.create.l HWIO_PMIC_ARB_OBS5_CHNL430_RDATA1_ADDR A:0xe65d71c
y.create.l HWIO_PMIC_ARB_OBS5_CHNL431_RDATA1_ADDR A:0xe65d79c
y.create.l HWIO_PMIC_ARB_OBS5_CHNL432_RDATA1_ADDR A:0xe65d81c
y.create.l HWIO_PMIC_ARB_OBS5_CHNL433_RDATA1_ADDR A:0xe65d89c
y.create.l HWIO_PMIC_ARB_OBS5_CHNL434_RDATA1_ADDR A:0xe65d91c
y.create.l HWIO_PMIC_ARB_OBS5_CHNL435_RDATA1_ADDR A:0xe65d99c
y.create.l HWIO_PMIC_ARB_OBS5_CHNL436_RDATA1_ADDR A:0xe65da1c
y.create.l HWIO_PMIC_ARB_OBS5_CHNL437_RDATA1_ADDR A:0xe65da9c
y.create.l HWIO_PMIC_ARB_OBS5_CHNL438_RDATA1_ADDR A:0xe65db1c
y.create.l HWIO_PMIC_ARB_OBS5_CHNL439_RDATA1_ADDR A:0xe65db9c
y.create.l HWIO_PMIC_ARB_OBS5_CHNL440_RDATA1_ADDR A:0xe65dc1c
y.create.l HWIO_PMIC_ARB_OBS5_CHNL441_RDATA1_ADDR A:0xe65dc9c
y.create.l HWIO_PMIC_ARB_OBS5_CHNL442_RDATA1_ADDR A:0xe65dd1c
y.create.l HWIO_PMIC_ARB_OBS5_CHNL443_RDATA1_ADDR A:0xe65dd9c
y.create.l HWIO_PMIC_ARB_OBS5_CHNL444_RDATA1_ADDR A:0xe65de1c
y.create.l HWIO_PMIC_ARB_OBS5_CHNL445_RDATA1_ADDR A:0xe65de9c
y.create.l HWIO_PMIC_ARB_OBS5_CHNL446_RDATA1_ADDR A:0xe65df1c
y.create.l HWIO_PMIC_ARB_OBS5_CHNL447_RDATA1_ADDR A:0xe65df9c
y.create.l HWIO_PMIC_ARB_OBS5_CHNL448_RDATA1_ADDR A:0xe65e01c
y.create.l HWIO_PMIC_ARB_OBS5_CHNL449_RDATA1_ADDR A:0xe65e09c
y.create.l HWIO_PMIC_ARB_OBS5_CHNL450_RDATA1_ADDR A:0xe65e11c
y.create.l HWIO_PMIC_ARB_OBS5_CHNL451_RDATA1_ADDR A:0xe65e19c
y.create.l HWIO_PMIC_ARB_OBS5_CHNL452_RDATA1_ADDR A:0xe65e21c
y.create.l HWIO_PMIC_ARB_OBS5_CHNL453_RDATA1_ADDR A:0xe65e29c
y.create.l HWIO_PMIC_ARB_OBS5_CHNL454_RDATA1_ADDR A:0xe65e31c
y.create.l HWIO_PMIC_ARB_OBS5_CHNL455_RDATA1_ADDR A:0xe65e39c
y.create.l HWIO_PMIC_ARB_OBS5_CHNL456_RDATA1_ADDR A:0xe65e41c
y.create.l HWIO_PMIC_ARB_OBS5_CHNL457_RDATA1_ADDR A:0xe65e49c
y.create.l HWIO_PMIC_ARB_OBS5_CHNL458_RDATA1_ADDR A:0xe65e51c
y.create.l HWIO_PMIC_ARB_OBS5_CHNL459_RDATA1_ADDR A:0xe65e59c
y.create.l HWIO_PMIC_ARB_OBS5_CHNL460_RDATA1_ADDR A:0xe65e61c
y.create.l HWIO_PMIC_ARB_OBS5_CHNL461_RDATA1_ADDR A:0xe65e69c
y.create.l HWIO_PMIC_ARB_OBS5_CHNL462_RDATA1_ADDR A:0xe65e71c
y.create.l HWIO_PMIC_ARB_OBS5_CHNL463_RDATA1_ADDR A:0xe65e79c
y.create.l HWIO_PMIC_ARB_OBS5_CHNL464_RDATA1_ADDR A:0xe65e81c
y.create.l HWIO_PMIC_ARB_OBS5_CHNL465_RDATA1_ADDR A:0xe65e89c
y.create.l HWIO_PMIC_ARB_OBS5_CHNL466_RDATA1_ADDR A:0xe65e91c
y.create.l HWIO_PMIC_ARB_OBS5_CHNL467_RDATA1_ADDR A:0xe65e99c
y.create.l HWIO_PMIC_ARB_OBS5_CHNL468_RDATA1_ADDR A:0xe65ea1c
y.create.l HWIO_PMIC_ARB_OBS5_CHNL469_RDATA1_ADDR A:0xe65ea9c
y.create.l HWIO_PMIC_ARB_OBS5_CHNL470_RDATA1_ADDR A:0xe65eb1c
y.create.l HWIO_PMIC_ARB_OBS5_CHNL471_RDATA1_ADDR A:0xe65eb9c
y.create.l HWIO_PMIC_ARB_OBS5_CHNL472_RDATA1_ADDR A:0xe65ec1c
y.create.l HWIO_PMIC_ARB_OBS5_CHNL473_RDATA1_ADDR A:0xe65ec9c
y.create.l HWIO_PMIC_ARB_OBS5_CHNL474_RDATA1_ADDR A:0xe65ed1c
y.create.l HWIO_PMIC_ARB_OBS5_CHNL475_RDATA1_ADDR A:0xe65ed9c
y.create.l HWIO_PMIC_ARB_OBS5_CHNL476_RDATA1_ADDR A:0xe65ee1c
y.create.l HWIO_PMIC_ARB_OBS5_CHNL477_RDATA1_ADDR A:0xe65ee9c
y.create.l HWIO_PMIC_ARB_OBS5_CHNL478_RDATA1_ADDR A:0xe65ef1c
y.create.l HWIO_PMIC_ARB_OBS5_CHNL479_RDATA1_ADDR A:0xe65ef9c
y.create.l HWIO_PMIC_ARB_OBS5_CHNL480_RDATA1_ADDR A:0xe65f01c
y.create.l HWIO_PMIC_ARB_OBS5_CHNL481_RDATA1_ADDR A:0xe65f09c
y.create.l HWIO_PMIC_ARB_OBS5_CHNL482_RDATA1_ADDR A:0xe65f11c
y.create.l HWIO_PMIC_ARB_OBS5_CHNL483_RDATA1_ADDR A:0xe65f19c
y.create.l HWIO_PMIC_ARB_OBS5_CHNL484_RDATA1_ADDR A:0xe65f21c
y.create.l HWIO_PMIC_ARB_OBS5_CHNL485_RDATA1_ADDR A:0xe65f29c
y.create.l HWIO_PMIC_ARB_OBS5_CHNL486_RDATA1_ADDR A:0xe65f31c
y.create.l HWIO_PMIC_ARB_OBS5_CHNL487_RDATA1_ADDR A:0xe65f39c
y.create.l HWIO_PMIC_ARB_OBS5_CHNL488_RDATA1_ADDR A:0xe65f41c
y.create.l HWIO_PMIC_ARB_OBS5_CHNL489_RDATA1_ADDR A:0xe65f49c
y.create.l HWIO_PMIC_ARB_OBS5_CHNL490_RDATA1_ADDR A:0xe65f51c
y.create.l HWIO_PMIC_ARB_OBS5_CHNL491_RDATA1_ADDR A:0xe65f59c
y.create.l HWIO_PMIC_ARB_OBS5_CHNL492_RDATA1_ADDR A:0xe65f61c
y.create.l HWIO_PMIC_ARB_OBS5_CHNL493_RDATA1_ADDR A:0xe65f69c
y.create.l HWIO_PMIC_ARB_OBS5_CHNL494_RDATA1_ADDR A:0xe65f71c
y.create.l HWIO_PMIC_ARB_OBS5_CHNL495_RDATA1_ADDR A:0xe65f79c
y.create.l HWIO_PMIC_ARB_OBS5_CHNL496_RDATA1_ADDR A:0xe65f81c
y.create.l HWIO_PMIC_ARB_OBS5_CHNL497_RDATA1_ADDR A:0xe65f89c
y.create.l HWIO_PMIC_ARB_OBS5_CHNL498_RDATA1_ADDR A:0xe65f91c
y.create.l HWIO_PMIC_ARB_OBS5_CHNL499_RDATA1_ADDR A:0xe65f99c
y.create.l HWIO_PMIC_ARB_OBS5_CHNL500_RDATA1_ADDR A:0xe65fa1c
y.create.l HWIO_PMIC_ARB_OBS5_CHNL501_RDATA1_ADDR A:0xe65fa9c
y.create.l HWIO_PMIC_ARB_OBS5_CHNL502_RDATA1_ADDR A:0xe65fb1c
y.create.l HWIO_PMIC_ARB_OBS5_CHNL503_RDATA1_ADDR A:0xe65fb9c
y.create.l HWIO_PMIC_ARB_OBS5_CHNL504_RDATA1_ADDR A:0xe65fc1c
y.create.l HWIO_PMIC_ARB_OBS5_CHNL505_RDATA1_ADDR A:0xe65fc9c
y.create.l HWIO_PMIC_ARB_OBS5_CHNL506_RDATA1_ADDR A:0xe65fd1c
y.create.l HWIO_PMIC_ARB_OBS5_CHNL507_RDATA1_ADDR A:0xe65fd9c
y.create.l HWIO_PMIC_ARB_OBS5_CHNL508_RDATA1_ADDR A:0xe65fe1c
y.create.l HWIO_PMIC_ARB_OBS5_CHNL509_RDATA1_ADDR A:0xe65fe9c
y.create.l HWIO_PMIC_ARB_OBS5_CHNL510_RDATA1_ADDR A:0xe65ff1c
y.create.l HWIO_PMIC_ARB_OBS5_CHNL511_RDATA1_ADDR A:0xe65ff9c
y.create.l HWIO_PMIC_ARB_OBS6_CHNL0_RDATA1_ADDR A:0xe66001c
y.create.l HWIO_PMIC_ARB_OBS6_CHNL1_RDATA1_ADDR A:0xe66009c
y.create.l HWIO_PMIC_ARB_OBS6_CHNL2_RDATA1_ADDR A:0xe66011c
y.create.l HWIO_PMIC_ARB_OBS6_CHNL3_RDATA1_ADDR A:0xe66019c
y.create.l HWIO_PMIC_ARB_OBS6_CHNL4_RDATA1_ADDR A:0xe66021c
y.create.l HWIO_PMIC_ARB_OBS6_CHNL5_RDATA1_ADDR A:0xe66029c
y.create.l HWIO_PMIC_ARB_OBS6_CHNL6_RDATA1_ADDR A:0xe66031c
y.create.l HWIO_PMIC_ARB_OBS6_CHNL7_RDATA1_ADDR A:0xe66039c
y.create.l HWIO_PMIC_ARB_OBS6_CHNL8_RDATA1_ADDR A:0xe66041c
y.create.l HWIO_PMIC_ARB_OBS6_CHNL9_RDATA1_ADDR A:0xe66049c
y.create.l HWIO_PMIC_ARB_OBS6_CHNL10_RDATA1_ADDR A:0xe66051c
y.create.l HWIO_PMIC_ARB_OBS6_CHNL11_RDATA1_ADDR A:0xe66059c
y.create.l HWIO_PMIC_ARB_OBS6_CHNL12_RDATA1_ADDR A:0xe66061c
y.create.l HWIO_PMIC_ARB_OBS6_CHNL13_RDATA1_ADDR A:0xe66069c
y.create.l HWIO_PMIC_ARB_OBS6_CHNL14_RDATA1_ADDR A:0xe66071c
y.create.l HWIO_PMIC_ARB_OBS6_CHNL15_RDATA1_ADDR A:0xe66079c
y.create.l HWIO_PMIC_ARB_OBS6_CHNL16_RDATA1_ADDR A:0xe66081c
y.create.l HWIO_PMIC_ARB_OBS6_CHNL17_RDATA1_ADDR A:0xe66089c
y.create.l HWIO_PMIC_ARB_OBS6_CHNL18_RDATA1_ADDR A:0xe66091c
y.create.l HWIO_PMIC_ARB_OBS6_CHNL19_RDATA1_ADDR A:0xe66099c
y.create.l HWIO_PMIC_ARB_OBS6_CHNL20_RDATA1_ADDR A:0xe660a1c
y.create.l HWIO_PMIC_ARB_OBS6_CHNL21_RDATA1_ADDR A:0xe660a9c
y.create.l HWIO_PMIC_ARB_OBS6_CHNL22_RDATA1_ADDR A:0xe660b1c
y.create.l HWIO_PMIC_ARB_OBS6_CHNL23_RDATA1_ADDR A:0xe660b9c
y.create.l HWIO_PMIC_ARB_OBS6_CHNL24_RDATA1_ADDR A:0xe660c1c
y.create.l HWIO_PMIC_ARB_OBS6_CHNL25_RDATA1_ADDR A:0xe660c9c
y.create.l HWIO_PMIC_ARB_OBS6_CHNL26_RDATA1_ADDR A:0xe660d1c
y.create.l HWIO_PMIC_ARB_OBS6_CHNL27_RDATA1_ADDR A:0xe660d9c
y.create.l HWIO_PMIC_ARB_OBS6_CHNL28_RDATA1_ADDR A:0xe660e1c
y.create.l HWIO_PMIC_ARB_OBS6_CHNL29_RDATA1_ADDR A:0xe660e9c
y.create.l HWIO_PMIC_ARB_OBS6_CHNL30_RDATA1_ADDR A:0xe660f1c
y.create.l HWIO_PMIC_ARB_OBS6_CHNL31_RDATA1_ADDR A:0xe660f9c
y.create.l HWIO_PMIC_ARB_OBS6_CHNL32_RDATA1_ADDR A:0xe66101c
y.create.l HWIO_PMIC_ARB_OBS6_CHNL33_RDATA1_ADDR A:0xe66109c
y.create.l HWIO_PMIC_ARB_OBS6_CHNL34_RDATA1_ADDR A:0xe66111c
y.create.l HWIO_PMIC_ARB_OBS6_CHNL35_RDATA1_ADDR A:0xe66119c
y.create.l HWIO_PMIC_ARB_OBS6_CHNL36_RDATA1_ADDR A:0xe66121c
y.create.l HWIO_PMIC_ARB_OBS6_CHNL37_RDATA1_ADDR A:0xe66129c
y.create.l HWIO_PMIC_ARB_OBS6_CHNL38_RDATA1_ADDR A:0xe66131c
y.create.l HWIO_PMIC_ARB_OBS6_CHNL39_RDATA1_ADDR A:0xe66139c
y.create.l HWIO_PMIC_ARB_OBS6_CHNL40_RDATA1_ADDR A:0xe66141c
y.create.l HWIO_PMIC_ARB_OBS6_CHNL41_RDATA1_ADDR A:0xe66149c
y.create.l HWIO_PMIC_ARB_OBS6_CHNL42_RDATA1_ADDR A:0xe66151c
y.create.l HWIO_PMIC_ARB_OBS6_CHNL43_RDATA1_ADDR A:0xe66159c
y.create.l HWIO_PMIC_ARB_OBS6_CHNL44_RDATA1_ADDR A:0xe66161c
y.create.l HWIO_PMIC_ARB_OBS6_CHNL45_RDATA1_ADDR A:0xe66169c
y.create.l HWIO_PMIC_ARB_OBS6_CHNL46_RDATA1_ADDR A:0xe66171c
y.create.l HWIO_PMIC_ARB_OBS6_CHNL47_RDATA1_ADDR A:0xe66179c
y.create.l HWIO_PMIC_ARB_OBS6_CHNL48_RDATA1_ADDR A:0xe66181c
y.create.l HWIO_PMIC_ARB_OBS6_CHNL49_RDATA1_ADDR A:0xe66189c
y.create.l HWIO_PMIC_ARB_OBS6_CHNL50_RDATA1_ADDR A:0xe66191c
y.create.l HWIO_PMIC_ARB_OBS6_CHNL51_RDATA1_ADDR A:0xe66199c
y.create.l HWIO_PMIC_ARB_OBS6_CHNL52_RDATA1_ADDR A:0xe661a1c
y.create.l HWIO_PMIC_ARB_OBS6_CHNL53_RDATA1_ADDR A:0xe661a9c
y.create.l HWIO_PMIC_ARB_OBS6_CHNL54_RDATA1_ADDR A:0xe661b1c
y.create.l HWIO_PMIC_ARB_OBS6_CHNL55_RDATA1_ADDR A:0xe661b9c
y.create.l HWIO_PMIC_ARB_OBS6_CHNL56_RDATA1_ADDR A:0xe661c1c
y.create.l HWIO_PMIC_ARB_OBS6_CHNL57_RDATA1_ADDR A:0xe661c9c
y.create.l HWIO_PMIC_ARB_OBS6_CHNL58_RDATA1_ADDR A:0xe661d1c
y.create.l HWIO_PMIC_ARB_OBS6_CHNL59_RDATA1_ADDR A:0xe661d9c
y.create.l HWIO_PMIC_ARB_OBS6_CHNL60_RDATA1_ADDR A:0xe661e1c
y.create.l HWIO_PMIC_ARB_OBS6_CHNL61_RDATA1_ADDR A:0xe661e9c
y.create.l HWIO_PMIC_ARB_OBS6_CHNL62_RDATA1_ADDR A:0xe661f1c
y.create.l HWIO_PMIC_ARB_OBS6_CHNL63_RDATA1_ADDR A:0xe661f9c
y.create.l HWIO_PMIC_ARB_OBS6_CHNL64_RDATA1_ADDR A:0xe66201c
y.create.l HWIO_PMIC_ARB_OBS6_CHNL65_RDATA1_ADDR A:0xe66209c
y.create.l HWIO_PMIC_ARB_OBS6_CHNL66_RDATA1_ADDR A:0xe66211c
y.create.l HWIO_PMIC_ARB_OBS6_CHNL67_RDATA1_ADDR A:0xe66219c
y.create.l HWIO_PMIC_ARB_OBS6_CHNL68_RDATA1_ADDR A:0xe66221c
y.create.l HWIO_PMIC_ARB_OBS6_CHNL69_RDATA1_ADDR A:0xe66229c
y.create.l HWIO_PMIC_ARB_OBS6_CHNL70_RDATA1_ADDR A:0xe66231c
y.create.l HWIO_PMIC_ARB_OBS6_CHNL71_RDATA1_ADDR A:0xe66239c
y.create.l HWIO_PMIC_ARB_OBS6_CHNL72_RDATA1_ADDR A:0xe66241c
y.create.l HWIO_PMIC_ARB_OBS6_CHNL73_RDATA1_ADDR A:0xe66249c
y.create.l HWIO_PMIC_ARB_OBS6_CHNL74_RDATA1_ADDR A:0xe66251c
y.create.l HWIO_PMIC_ARB_OBS6_CHNL75_RDATA1_ADDR A:0xe66259c
y.create.l HWIO_PMIC_ARB_OBS6_CHNL76_RDATA1_ADDR A:0xe66261c
y.create.l HWIO_PMIC_ARB_OBS6_CHNL77_RDATA1_ADDR A:0xe66269c
y.create.l HWIO_PMIC_ARB_OBS6_CHNL78_RDATA1_ADDR A:0xe66271c
y.create.l HWIO_PMIC_ARB_OBS6_CHNL79_RDATA1_ADDR A:0xe66279c
y.create.l HWIO_PMIC_ARB_OBS6_CHNL80_RDATA1_ADDR A:0xe66281c
y.create.l HWIO_PMIC_ARB_OBS6_CHNL81_RDATA1_ADDR A:0xe66289c
y.create.l HWIO_PMIC_ARB_OBS6_CHNL82_RDATA1_ADDR A:0xe66291c
y.create.l HWIO_PMIC_ARB_OBS6_CHNL83_RDATA1_ADDR A:0xe66299c
y.create.l HWIO_PMIC_ARB_OBS6_CHNL84_RDATA1_ADDR A:0xe662a1c
y.create.l HWIO_PMIC_ARB_OBS6_CHNL85_RDATA1_ADDR A:0xe662a9c
y.create.l HWIO_PMIC_ARB_OBS6_CHNL86_RDATA1_ADDR A:0xe662b1c
y.create.l HWIO_PMIC_ARB_OBS6_CHNL87_RDATA1_ADDR A:0xe662b9c
y.create.l HWIO_PMIC_ARB_OBS6_CHNL88_RDATA1_ADDR A:0xe662c1c
y.create.l HWIO_PMIC_ARB_OBS6_CHNL89_RDATA1_ADDR A:0xe662c9c
y.create.l HWIO_PMIC_ARB_OBS6_CHNL90_RDATA1_ADDR A:0xe662d1c
y.create.l HWIO_PMIC_ARB_OBS6_CHNL91_RDATA1_ADDR A:0xe662d9c
y.create.l HWIO_PMIC_ARB_OBS6_CHNL92_RDATA1_ADDR A:0xe662e1c
y.create.l HWIO_PMIC_ARB_OBS6_CHNL93_RDATA1_ADDR A:0xe662e9c
y.create.l HWIO_PMIC_ARB_OBS6_CHNL94_RDATA1_ADDR A:0xe662f1c
y.create.l HWIO_PMIC_ARB_OBS6_CHNL95_RDATA1_ADDR A:0xe662f9c
y.create.l HWIO_PMIC_ARB_OBS6_CHNL96_RDATA1_ADDR A:0xe66301c
y.create.l HWIO_PMIC_ARB_OBS6_CHNL97_RDATA1_ADDR A:0xe66309c
y.create.l HWIO_PMIC_ARB_OBS6_CHNL98_RDATA1_ADDR A:0xe66311c
y.create.l HWIO_PMIC_ARB_OBS6_CHNL99_RDATA1_ADDR A:0xe66319c
y.create.l HWIO_PMIC_ARB_OBS6_CHNL100_RDATA1_ADDR A:0xe66321c
y.create.l HWIO_PMIC_ARB_OBS6_CHNL101_RDATA1_ADDR A:0xe66329c
y.create.l HWIO_PMIC_ARB_OBS6_CHNL102_RDATA1_ADDR A:0xe66331c
y.create.l HWIO_PMIC_ARB_OBS6_CHNL103_RDATA1_ADDR A:0xe66339c
y.create.l HWIO_PMIC_ARB_OBS6_CHNL104_RDATA1_ADDR A:0xe66341c
y.create.l HWIO_PMIC_ARB_OBS6_CHNL105_RDATA1_ADDR A:0xe66349c
y.create.l HWIO_PMIC_ARB_OBS6_CHNL106_RDATA1_ADDR A:0xe66351c
y.create.l HWIO_PMIC_ARB_OBS6_CHNL107_RDATA1_ADDR A:0xe66359c
y.create.l HWIO_PMIC_ARB_OBS6_CHNL108_RDATA1_ADDR A:0xe66361c
y.create.l HWIO_PMIC_ARB_OBS6_CHNL109_RDATA1_ADDR A:0xe66369c
y.create.l HWIO_PMIC_ARB_OBS6_CHNL110_RDATA1_ADDR A:0xe66371c
y.create.l HWIO_PMIC_ARB_OBS6_CHNL111_RDATA1_ADDR A:0xe66379c
y.create.l HWIO_PMIC_ARB_OBS6_CHNL112_RDATA1_ADDR A:0xe66381c
y.create.l HWIO_PMIC_ARB_OBS6_CHNL113_RDATA1_ADDR A:0xe66389c
y.create.l HWIO_PMIC_ARB_OBS6_CHNL114_RDATA1_ADDR A:0xe66391c
y.create.l HWIO_PMIC_ARB_OBS6_CHNL115_RDATA1_ADDR A:0xe66399c
y.create.l HWIO_PMIC_ARB_OBS6_CHNL116_RDATA1_ADDR A:0xe663a1c
y.create.l HWIO_PMIC_ARB_OBS6_CHNL117_RDATA1_ADDR A:0xe663a9c
y.create.l HWIO_PMIC_ARB_OBS6_CHNL118_RDATA1_ADDR A:0xe663b1c
y.create.l HWIO_PMIC_ARB_OBS6_CHNL119_RDATA1_ADDR A:0xe663b9c
y.create.l HWIO_PMIC_ARB_OBS6_CHNL120_RDATA1_ADDR A:0xe663c1c
y.create.l HWIO_PMIC_ARB_OBS6_CHNL121_RDATA1_ADDR A:0xe663c9c
y.create.l HWIO_PMIC_ARB_OBS6_CHNL122_RDATA1_ADDR A:0xe663d1c
y.create.l HWIO_PMIC_ARB_OBS6_CHNL123_RDATA1_ADDR A:0xe663d9c
y.create.l HWIO_PMIC_ARB_OBS6_CHNL124_RDATA1_ADDR A:0xe663e1c
y.create.l HWIO_PMIC_ARB_OBS6_CHNL125_RDATA1_ADDR A:0xe663e9c
y.create.l HWIO_PMIC_ARB_OBS6_CHNL126_RDATA1_ADDR A:0xe663f1c
y.create.l HWIO_PMIC_ARB_OBS6_CHNL127_RDATA1_ADDR A:0xe663f9c
y.create.l HWIO_PMIC_ARB_OBS6_CHNL128_RDATA1_ADDR A:0xe66401c
y.create.l HWIO_PMIC_ARB_OBS6_CHNL129_RDATA1_ADDR A:0xe66409c
y.create.l HWIO_PMIC_ARB_OBS6_CHNL130_RDATA1_ADDR A:0xe66411c
y.create.l HWIO_PMIC_ARB_OBS6_CHNL131_RDATA1_ADDR A:0xe66419c
y.create.l HWIO_PMIC_ARB_OBS6_CHNL132_RDATA1_ADDR A:0xe66421c
y.create.l HWIO_PMIC_ARB_OBS6_CHNL133_RDATA1_ADDR A:0xe66429c
y.create.l HWIO_PMIC_ARB_OBS6_CHNL134_RDATA1_ADDR A:0xe66431c
y.create.l HWIO_PMIC_ARB_OBS6_CHNL135_RDATA1_ADDR A:0xe66439c
y.create.l HWIO_PMIC_ARB_OBS6_CHNL136_RDATA1_ADDR A:0xe66441c
y.create.l HWIO_PMIC_ARB_OBS6_CHNL137_RDATA1_ADDR A:0xe66449c
y.create.l HWIO_PMIC_ARB_OBS6_CHNL138_RDATA1_ADDR A:0xe66451c
y.create.l HWIO_PMIC_ARB_OBS6_CHNL139_RDATA1_ADDR A:0xe66459c
y.create.l HWIO_PMIC_ARB_OBS6_CHNL140_RDATA1_ADDR A:0xe66461c
y.create.l HWIO_PMIC_ARB_OBS6_CHNL141_RDATA1_ADDR A:0xe66469c
y.create.l HWIO_PMIC_ARB_OBS6_CHNL142_RDATA1_ADDR A:0xe66471c
y.create.l HWIO_PMIC_ARB_OBS6_CHNL143_RDATA1_ADDR A:0xe66479c
y.create.l HWIO_PMIC_ARB_OBS6_CHNL144_RDATA1_ADDR A:0xe66481c
y.create.l HWIO_PMIC_ARB_OBS6_CHNL145_RDATA1_ADDR A:0xe66489c
y.create.l HWIO_PMIC_ARB_OBS6_CHNL146_RDATA1_ADDR A:0xe66491c
y.create.l HWIO_PMIC_ARB_OBS6_CHNL147_RDATA1_ADDR A:0xe66499c
y.create.l HWIO_PMIC_ARB_OBS6_CHNL148_RDATA1_ADDR A:0xe664a1c
y.create.l HWIO_PMIC_ARB_OBS6_CHNL149_RDATA1_ADDR A:0xe664a9c
y.create.l HWIO_PMIC_ARB_OBS6_CHNL150_RDATA1_ADDR A:0xe664b1c
y.create.l HWIO_PMIC_ARB_OBS6_CHNL151_RDATA1_ADDR A:0xe664b9c
y.create.l HWIO_PMIC_ARB_OBS6_CHNL152_RDATA1_ADDR A:0xe664c1c
y.create.l HWIO_PMIC_ARB_OBS6_CHNL153_RDATA1_ADDR A:0xe664c9c
y.create.l HWIO_PMIC_ARB_OBS6_CHNL154_RDATA1_ADDR A:0xe664d1c
y.create.l HWIO_PMIC_ARB_OBS6_CHNL155_RDATA1_ADDR A:0xe664d9c
y.create.l HWIO_PMIC_ARB_OBS6_CHNL156_RDATA1_ADDR A:0xe664e1c
y.create.l HWIO_PMIC_ARB_OBS6_CHNL157_RDATA1_ADDR A:0xe664e9c
y.create.l HWIO_PMIC_ARB_OBS6_CHNL158_RDATA1_ADDR A:0xe664f1c
y.create.l HWIO_PMIC_ARB_OBS6_CHNL159_RDATA1_ADDR A:0xe664f9c
y.create.l HWIO_PMIC_ARB_OBS6_CHNL160_RDATA1_ADDR A:0xe66501c
y.create.l HWIO_PMIC_ARB_OBS6_CHNL161_RDATA1_ADDR A:0xe66509c
y.create.l HWIO_PMIC_ARB_OBS6_CHNL162_RDATA1_ADDR A:0xe66511c
y.create.l HWIO_PMIC_ARB_OBS6_CHNL163_RDATA1_ADDR A:0xe66519c
y.create.l HWIO_PMIC_ARB_OBS6_CHNL164_RDATA1_ADDR A:0xe66521c
y.create.l HWIO_PMIC_ARB_OBS6_CHNL165_RDATA1_ADDR A:0xe66529c
y.create.l HWIO_PMIC_ARB_OBS6_CHNL166_RDATA1_ADDR A:0xe66531c
y.create.l HWIO_PMIC_ARB_OBS6_CHNL167_RDATA1_ADDR A:0xe66539c
y.create.l HWIO_PMIC_ARB_OBS6_CHNL168_RDATA1_ADDR A:0xe66541c
y.create.l HWIO_PMIC_ARB_OBS6_CHNL169_RDATA1_ADDR A:0xe66549c
y.create.l HWIO_PMIC_ARB_OBS6_CHNL170_RDATA1_ADDR A:0xe66551c
y.create.l HWIO_PMIC_ARB_OBS6_CHNL171_RDATA1_ADDR A:0xe66559c
y.create.l HWIO_PMIC_ARB_OBS6_CHNL172_RDATA1_ADDR A:0xe66561c
y.create.l HWIO_PMIC_ARB_OBS6_CHNL173_RDATA1_ADDR A:0xe66569c
y.create.l HWIO_PMIC_ARB_OBS6_CHNL174_RDATA1_ADDR A:0xe66571c
y.create.l HWIO_PMIC_ARB_OBS6_CHNL175_RDATA1_ADDR A:0xe66579c
y.create.l HWIO_PMIC_ARB_OBS6_CHNL176_RDATA1_ADDR A:0xe66581c
y.create.l HWIO_PMIC_ARB_OBS6_CHNL177_RDATA1_ADDR A:0xe66589c
y.create.l HWIO_PMIC_ARB_OBS6_CHNL178_RDATA1_ADDR A:0xe66591c
y.create.l HWIO_PMIC_ARB_OBS6_CHNL179_RDATA1_ADDR A:0xe66599c
y.create.l HWIO_PMIC_ARB_OBS6_CHNL180_RDATA1_ADDR A:0xe665a1c
y.create.l HWIO_PMIC_ARB_OBS6_CHNL181_RDATA1_ADDR A:0xe665a9c
y.create.l HWIO_PMIC_ARB_OBS6_CHNL182_RDATA1_ADDR A:0xe665b1c
y.create.l HWIO_PMIC_ARB_OBS6_CHNL183_RDATA1_ADDR A:0xe665b9c
y.create.l HWIO_PMIC_ARB_OBS6_CHNL184_RDATA1_ADDR A:0xe665c1c
y.create.l HWIO_PMIC_ARB_OBS6_CHNL185_RDATA1_ADDR A:0xe665c9c
y.create.l HWIO_PMIC_ARB_OBS6_CHNL186_RDATA1_ADDR A:0xe665d1c
y.create.l HWIO_PMIC_ARB_OBS6_CHNL187_RDATA1_ADDR A:0xe665d9c
y.create.l HWIO_PMIC_ARB_OBS6_CHNL188_RDATA1_ADDR A:0xe665e1c
y.create.l HWIO_PMIC_ARB_OBS6_CHNL189_RDATA1_ADDR A:0xe665e9c
y.create.l HWIO_PMIC_ARB_OBS6_CHNL190_RDATA1_ADDR A:0xe665f1c
y.create.l HWIO_PMIC_ARB_OBS6_CHNL191_RDATA1_ADDR A:0xe665f9c
y.create.l HWIO_PMIC_ARB_OBS6_CHNL192_RDATA1_ADDR A:0xe66601c
y.create.l HWIO_PMIC_ARB_OBS6_CHNL193_RDATA1_ADDR A:0xe66609c
y.create.l HWIO_PMIC_ARB_OBS6_CHNL194_RDATA1_ADDR A:0xe66611c
y.create.l HWIO_PMIC_ARB_OBS6_CHNL195_RDATA1_ADDR A:0xe66619c
y.create.l HWIO_PMIC_ARB_OBS6_CHNL196_RDATA1_ADDR A:0xe66621c
y.create.l HWIO_PMIC_ARB_OBS6_CHNL197_RDATA1_ADDR A:0xe66629c
y.create.l HWIO_PMIC_ARB_OBS6_CHNL198_RDATA1_ADDR A:0xe66631c
y.create.l HWIO_PMIC_ARB_OBS6_CHNL199_RDATA1_ADDR A:0xe66639c
y.create.l HWIO_PMIC_ARB_OBS6_CHNL200_RDATA1_ADDR A:0xe66641c
y.create.l HWIO_PMIC_ARB_OBS6_CHNL201_RDATA1_ADDR A:0xe66649c
y.create.l HWIO_PMIC_ARB_OBS6_CHNL202_RDATA1_ADDR A:0xe66651c
y.create.l HWIO_PMIC_ARB_OBS6_CHNL203_RDATA1_ADDR A:0xe66659c
y.create.l HWIO_PMIC_ARB_OBS6_CHNL204_RDATA1_ADDR A:0xe66661c
y.create.l HWIO_PMIC_ARB_OBS6_CHNL205_RDATA1_ADDR A:0xe66669c
y.create.l HWIO_PMIC_ARB_OBS6_CHNL206_RDATA1_ADDR A:0xe66671c
y.create.l HWIO_PMIC_ARB_OBS6_CHNL207_RDATA1_ADDR A:0xe66679c
y.create.l HWIO_PMIC_ARB_OBS6_CHNL208_RDATA1_ADDR A:0xe66681c
y.create.l HWIO_PMIC_ARB_OBS6_CHNL209_RDATA1_ADDR A:0xe66689c
y.create.l HWIO_PMIC_ARB_OBS6_CHNL210_RDATA1_ADDR A:0xe66691c
y.create.l HWIO_PMIC_ARB_OBS6_CHNL211_RDATA1_ADDR A:0xe66699c
y.create.l HWIO_PMIC_ARB_OBS6_CHNL212_RDATA1_ADDR A:0xe666a1c
y.create.l HWIO_PMIC_ARB_OBS6_CHNL213_RDATA1_ADDR A:0xe666a9c
y.create.l HWIO_PMIC_ARB_OBS6_CHNL214_RDATA1_ADDR A:0xe666b1c
y.create.l HWIO_PMIC_ARB_OBS6_CHNL215_RDATA1_ADDR A:0xe666b9c
y.create.l HWIO_PMIC_ARB_OBS6_CHNL216_RDATA1_ADDR A:0xe666c1c
y.create.l HWIO_PMIC_ARB_OBS6_CHNL217_RDATA1_ADDR A:0xe666c9c
y.create.l HWIO_PMIC_ARB_OBS6_CHNL218_RDATA1_ADDR A:0xe666d1c
y.create.l HWIO_PMIC_ARB_OBS6_CHNL219_RDATA1_ADDR A:0xe666d9c
y.create.l HWIO_PMIC_ARB_OBS6_CHNL220_RDATA1_ADDR A:0xe666e1c
y.create.l HWIO_PMIC_ARB_OBS6_CHNL221_RDATA1_ADDR A:0xe666e9c
y.create.l HWIO_PMIC_ARB_OBS6_CHNL222_RDATA1_ADDR A:0xe666f1c
y.create.l HWIO_PMIC_ARB_OBS6_CHNL223_RDATA1_ADDR A:0xe666f9c
y.create.l HWIO_PMIC_ARB_OBS6_CHNL224_RDATA1_ADDR A:0xe66701c
y.create.l HWIO_PMIC_ARB_OBS6_CHNL225_RDATA1_ADDR A:0xe66709c
y.create.l HWIO_PMIC_ARB_OBS6_CHNL226_RDATA1_ADDR A:0xe66711c
y.create.l HWIO_PMIC_ARB_OBS6_CHNL227_RDATA1_ADDR A:0xe66719c
y.create.l HWIO_PMIC_ARB_OBS6_CHNL228_RDATA1_ADDR A:0xe66721c
y.create.l HWIO_PMIC_ARB_OBS6_CHNL229_RDATA1_ADDR A:0xe66729c
y.create.l HWIO_PMIC_ARB_OBS6_CHNL230_RDATA1_ADDR A:0xe66731c
y.create.l HWIO_PMIC_ARB_OBS6_CHNL231_RDATA1_ADDR A:0xe66739c
y.create.l HWIO_PMIC_ARB_OBS6_CHNL232_RDATA1_ADDR A:0xe66741c
y.create.l HWIO_PMIC_ARB_OBS6_CHNL233_RDATA1_ADDR A:0xe66749c
y.create.l HWIO_PMIC_ARB_OBS6_CHNL234_RDATA1_ADDR A:0xe66751c
y.create.l HWIO_PMIC_ARB_OBS6_CHNL235_RDATA1_ADDR A:0xe66759c
y.create.l HWIO_PMIC_ARB_OBS6_CHNL236_RDATA1_ADDR A:0xe66761c
y.create.l HWIO_PMIC_ARB_OBS6_CHNL237_RDATA1_ADDR A:0xe66769c
y.create.l HWIO_PMIC_ARB_OBS6_CHNL238_RDATA1_ADDR A:0xe66771c
y.create.l HWIO_PMIC_ARB_OBS6_CHNL239_RDATA1_ADDR A:0xe66779c
y.create.l HWIO_PMIC_ARB_OBS6_CHNL240_RDATA1_ADDR A:0xe66781c
y.create.l HWIO_PMIC_ARB_OBS6_CHNL241_RDATA1_ADDR A:0xe66789c
y.create.l HWIO_PMIC_ARB_OBS6_CHNL242_RDATA1_ADDR A:0xe66791c
y.create.l HWIO_PMIC_ARB_OBS6_CHNL243_RDATA1_ADDR A:0xe66799c
y.create.l HWIO_PMIC_ARB_OBS6_CHNL244_RDATA1_ADDR A:0xe667a1c
y.create.l HWIO_PMIC_ARB_OBS6_CHNL245_RDATA1_ADDR A:0xe667a9c
y.create.l HWIO_PMIC_ARB_OBS6_CHNL246_RDATA1_ADDR A:0xe667b1c
y.create.l HWIO_PMIC_ARB_OBS6_CHNL247_RDATA1_ADDR A:0xe667b9c
y.create.l HWIO_PMIC_ARB_OBS6_CHNL248_RDATA1_ADDR A:0xe667c1c
y.create.l HWIO_PMIC_ARB_OBS6_CHNL249_RDATA1_ADDR A:0xe667c9c
y.create.l HWIO_PMIC_ARB_OBS6_CHNL250_RDATA1_ADDR A:0xe667d1c
y.create.l HWIO_PMIC_ARB_OBS6_CHNL251_RDATA1_ADDR A:0xe667d9c
y.create.l HWIO_PMIC_ARB_OBS6_CHNL252_RDATA1_ADDR A:0xe667e1c
y.create.l HWIO_PMIC_ARB_OBS6_CHNL253_RDATA1_ADDR A:0xe667e9c
y.create.l HWIO_PMIC_ARB_OBS6_CHNL254_RDATA1_ADDR A:0xe667f1c
y.create.l HWIO_PMIC_ARB_OBS6_CHNL255_RDATA1_ADDR A:0xe667f9c
y.create.l HWIO_PMIC_ARB_OBS6_CHNL256_RDATA1_ADDR A:0xe66801c
y.create.l HWIO_PMIC_ARB_OBS6_CHNL257_RDATA1_ADDR A:0xe66809c
y.create.l HWIO_PMIC_ARB_OBS6_CHNL258_RDATA1_ADDR A:0xe66811c
y.create.l HWIO_PMIC_ARB_OBS6_CHNL259_RDATA1_ADDR A:0xe66819c
y.create.l HWIO_PMIC_ARB_OBS6_CHNL260_RDATA1_ADDR A:0xe66821c
y.create.l HWIO_PMIC_ARB_OBS6_CHNL261_RDATA1_ADDR A:0xe66829c
y.create.l HWIO_PMIC_ARB_OBS6_CHNL262_RDATA1_ADDR A:0xe66831c
y.create.l HWIO_PMIC_ARB_OBS6_CHNL263_RDATA1_ADDR A:0xe66839c
y.create.l HWIO_PMIC_ARB_OBS6_CHNL264_RDATA1_ADDR A:0xe66841c
y.create.l HWIO_PMIC_ARB_OBS6_CHNL265_RDATA1_ADDR A:0xe66849c
y.create.l HWIO_PMIC_ARB_OBS6_CHNL266_RDATA1_ADDR A:0xe66851c
y.create.l HWIO_PMIC_ARB_OBS6_CHNL267_RDATA1_ADDR A:0xe66859c
y.create.l HWIO_PMIC_ARB_OBS6_CHNL268_RDATA1_ADDR A:0xe66861c
y.create.l HWIO_PMIC_ARB_OBS6_CHNL269_RDATA1_ADDR A:0xe66869c
y.create.l HWIO_PMIC_ARB_OBS6_CHNL270_RDATA1_ADDR A:0xe66871c
y.create.l HWIO_PMIC_ARB_OBS6_CHNL271_RDATA1_ADDR A:0xe66879c
y.create.l HWIO_PMIC_ARB_OBS6_CHNL272_RDATA1_ADDR A:0xe66881c
y.create.l HWIO_PMIC_ARB_OBS6_CHNL273_RDATA1_ADDR A:0xe66889c
y.create.l HWIO_PMIC_ARB_OBS6_CHNL274_RDATA1_ADDR A:0xe66891c
y.create.l HWIO_PMIC_ARB_OBS6_CHNL275_RDATA1_ADDR A:0xe66899c
y.create.l HWIO_PMIC_ARB_OBS6_CHNL276_RDATA1_ADDR A:0xe668a1c
y.create.l HWIO_PMIC_ARB_OBS6_CHNL277_RDATA1_ADDR A:0xe668a9c
y.create.l HWIO_PMIC_ARB_OBS6_CHNL278_RDATA1_ADDR A:0xe668b1c
y.create.l HWIO_PMIC_ARB_OBS6_CHNL279_RDATA1_ADDR A:0xe668b9c
y.create.l HWIO_PMIC_ARB_OBS6_CHNL280_RDATA1_ADDR A:0xe668c1c
y.create.l HWIO_PMIC_ARB_OBS6_CHNL281_RDATA1_ADDR A:0xe668c9c
y.create.l HWIO_PMIC_ARB_OBS6_CHNL282_RDATA1_ADDR A:0xe668d1c
y.create.l HWIO_PMIC_ARB_OBS6_CHNL283_RDATA1_ADDR A:0xe668d9c
y.create.l HWIO_PMIC_ARB_OBS6_CHNL284_RDATA1_ADDR A:0xe668e1c
y.create.l HWIO_PMIC_ARB_OBS6_CHNL285_RDATA1_ADDR A:0xe668e9c
y.create.l HWIO_PMIC_ARB_OBS6_CHNL286_RDATA1_ADDR A:0xe668f1c
y.create.l HWIO_PMIC_ARB_OBS6_CHNL287_RDATA1_ADDR A:0xe668f9c
y.create.l HWIO_PMIC_ARB_OBS6_CHNL288_RDATA1_ADDR A:0xe66901c
y.create.l HWIO_PMIC_ARB_OBS6_CHNL289_RDATA1_ADDR A:0xe66909c
y.create.l HWIO_PMIC_ARB_OBS6_CHNL290_RDATA1_ADDR A:0xe66911c
y.create.l HWIO_PMIC_ARB_OBS6_CHNL291_RDATA1_ADDR A:0xe66919c
y.create.l HWIO_PMIC_ARB_OBS6_CHNL292_RDATA1_ADDR A:0xe66921c
y.create.l HWIO_PMIC_ARB_OBS6_CHNL293_RDATA1_ADDR A:0xe66929c
y.create.l HWIO_PMIC_ARB_OBS6_CHNL294_RDATA1_ADDR A:0xe66931c
y.create.l HWIO_PMIC_ARB_OBS6_CHNL295_RDATA1_ADDR A:0xe66939c
y.create.l HWIO_PMIC_ARB_OBS6_CHNL296_RDATA1_ADDR A:0xe66941c
y.create.l HWIO_PMIC_ARB_OBS6_CHNL297_RDATA1_ADDR A:0xe66949c
y.create.l HWIO_PMIC_ARB_OBS6_CHNL298_RDATA1_ADDR A:0xe66951c
y.create.l HWIO_PMIC_ARB_OBS6_CHNL299_RDATA1_ADDR A:0xe66959c
y.create.l HWIO_PMIC_ARB_OBS6_CHNL300_RDATA1_ADDR A:0xe66961c
y.create.l HWIO_PMIC_ARB_OBS6_CHNL301_RDATA1_ADDR A:0xe66969c
y.create.l HWIO_PMIC_ARB_OBS6_CHNL302_RDATA1_ADDR A:0xe66971c
y.create.l HWIO_PMIC_ARB_OBS6_CHNL303_RDATA1_ADDR A:0xe66979c
y.create.l HWIO_PMIC_ARB_OBS6_CHNL304_RDATA1_ADDR A:0xe66981c
y.create.l HWIO_PMIC_ARB_OBS6_CHNL305_RDATA1_ADDR A:0xe66989c
y.create.l HWIO_PMIC_ARB_OBS6_CHNL306_RDATA1_ADDR A:0xe66991c
y.create.l HWIO_PMIC_ARB_OBS6_CHNL307_RDATA1_ADDR A:0xe66999c
y.create.l HWIO_PMIC_ARB_OBS6_CHNL308_RDATA1_ADDR A:0xe669a1c
y.create.l HWIO_PMIC_ARB_OBS6_CHNL309_RDATA1_ADDR A:0xe669a9c
y.create.l HWIO_PMIC_ARB_OBS6_CHNL310_RDATA1_ADDR A:0xe669b1c
y.create.l HWIO_PMIC_ARB_OBS6_CHNL311_RDATA1_ADDR A:0xe669b9c
y.create.l HWIO_PMIC_ARB_OBS6_CHNL312_RDATA1_ADDR A:0xe669c1c
y.create.l HWIO_PMIC_ARB_OBS6_CHNL313_RDATA1_ADDR A:0xe669c9c
y.create.l HWIO_PMIC_ARB_OBS6_CHNL314_RDATA1_ADDR A:0xe669d1c
y.create.l HWIO_PMIC_ARB_OBS6_CHNL315_RDATA1_ADDR A:0xe669d9c
y.create.l HWIO_PMIC_ARB_OBS6_CHNL316_RDATA1_ADDR A:0xe669e1c
y.create.l HWIO_PMIC_ARB_OBS6_CHNL317_RDATA1_ADDR A:0xe669e9c
y.create.l HWIO_PMIC_ARB_OBS6_CHNL318_RDATA1_ADDR A:0xe669f1c
y.create.l HWIO_PMIC_ARB_OBS6_CHNL319_RDATA1_ADDR A:0xe669f9c
y.create.l HWIO_PMIC_ARB_OBS6_CHNL320_RDATA1_ADDR A:0xe66a01c
y.create.l HWIO_PMIC_ARB_OBS6_CHNL321_RDATA1_ADDR A:0xe66a09c
y.create.l HWIO_PMIC_ARB_OBS6_CHNL322_RDATA1_ADDR A:0xe66a11c
y.create.l HWIO_PMIC_ARB_OBS6_CHNL323_RDATA1_ADDR A:0xe66a19c
y.create.l HWIO_PMIC_ARB_OBS6_CHNL324_RDATA1_ADDR A:0xe66a21c
y.create.l HWIO_PMIC_ARB_OBS6_CHNL325_RDATA1_ADDR A:0xe66a29c
y.create.l HWIO_PMIC_ARB_OBS6_CHNL326_RDATA1_ADDR A:0xe66a31c
y.create.l HWIO_PMIC_ARB_OBS6_CHNL327_RDATA1_ADDR A:0xe66a39c
y.create.l HWIO_PMIC_ARB_OBS6_CHNL328_RDATA1_ADDR A:0xe66a41c
y.create.l HWIO_PMIC_ARB_OBS6_CHNL329_RDATA1_ADDR A:0xe66a49c
y.create.l HWIO_PMIC_ARB_OBS6_CHNL330_RDATA1_ADDR A:0xe66a51c
y.create.l HWIO_PMIC_ARB_OBS6_CHNL331_RDATA1_ADDR A:0xe66a59c
y.create.l HWIO_PMIC_ARB_OBS6_CHNL332_RDATA1_ADDR A:0xe66a61c
y.create.l HWIO_PMIC_ARB_OBS6_CHNL333_RDATA1_ADDR A:0xe66a69c
y.create.l HWIO_PMIC_ARB_OBS6_CHNL334_RDATA1_ADDR A:0xe66a71c
y.create.l HWIO_PMIC_ARB_OBS6_CHNL335_RDATA1_ADDR A:0xe66a79c
y.create.l HWIO_PMIC_ARB_OBS6_CHNL336_RDATA1_ADDR A:0xe66a81c
y.create.l HWIO_PMIC_ARB_OBS6_CHNL337_RDATA1_ADDR A:0xe66a89c
y.create.l HWIO_PMIC_ARB_OBS6_CHNL338_RDATA1_ADDR A:0xe66a91c
y.create.l HWIO_PMIC_ARB_OBS6_CHNL339_RDATA1_ADDR A:0xe66a99c
y.create.l HWIO_PMIC_ARB_OBS6_CHNL340_RDATA1_ADDR A:0xe66aa1c
y.create.l HWIO_PMIC_ARB_OBS6_CHNL341_RDATA1_ADDR A:0xe66aa9c
y.create.l HWIO_PMIC_ARB_OBS6_CHNL342_RDATA1_ADDR A:0xe66ab1c
y.create.l HWIO_PMIC_ARB_OBS6_CHNL343_RDATA1_ADDR A:0xe66ab9c
y.create.l HWIO_PMIC_ARB_OBS6_CHNL344_RDATA1_ADDR A:0xe66ac1c
y.create.l HWIO_PMIC_ARB_OBS6_CHNL345_RDATA1_ADDR A:0xe66ac9c
y.create.l HWIO_PMIC_ARB_OBS6_CHNL346_RDATA1_ADDR A:0xe66ad1c
y.create.l HWIO_PMIC_ARB_OBS6_CHNL347_RDATA1_ADDR A:0xe66ad9c
y.create.l HWIO_PMIC_ARB_OBS6_CHNL348_RDATA1_ADDR A:0xe66ae1c
y.create.l HWIO_PMIC_ARB_OBS6_CHNL349_RDATA1_ADDR A:0xe66ae9c
y.create.l HWIO_PMIC_ARB_OBS6_CHNL350_RDATA1_ADDR A:0xe66af1c
y.create.l HWIO_PMIC_ARB_OBS6_CHNL351_RDATA1_ADDR A:0xe66af9c
y.create.l HWIO_PMIC_ARB_OBS6_CHNL352_RDATA1_ADDR A:0xe66b01c
y.create.l HWIO_PMIC_ARB_OBS6_CHNL353_RDATA1_ADDR A:0xe66b09c
y.create.l HWIO_PMIC_ARB_OBS6_CHNL354_RDATA1_ADDR A:0xe66b11c
y.create.l HWIO_PMIC_ARB_OBS6_CHNL355_RDATA1_ADDR A:0xe66b19c
y.create.l HWIO_PMIC_ARB_OBS6_CHNL356_RDATA1_ADDR A:0xe66b21c
y.create.l HWIO_PMIC_ARB_OBS6_CHNL357_RDATA1_ADDR A:0xe66b29c
y.create.l HWIO_PMIC_ARB_OBS6_CHNL358_RDATA1_ADDR A:0xe66b31c
y.create.l HWIO_PMIC_ARB_OBS6_CHNL359_RDATA1_ADDR A:0xe66b39c
y.create.l HWIO_PMIC_ARB_OBS6_CHNL360_RDATA1_ADDR A:0xe66b41c
y.create.l HWIO_PMIC_ARB_OBS6_CHNL361_RDATA1_ADDR A:0xe66b49c
y.create.l HWIO_PMIC_ARB_OBS6_CHNL362_RDATA1_ADDR A:0xe66b51c
y.create.l HWIO_PMIC_ARB_OBS6_CHNL363_RDATA1_ADDR A:0xe66b59c
y.create.l HWIO_PMIC_ARB_OBS6_CHNL364_RDATA1_ADDR A:0xe66b61c
y.create.l HWIO_PMIC_ARB_OBS6_CHNL365_RDATA1_ADDR A:0xe66b69c
y.create.l HWIO_PMIC_ARB_OBS6_CHNL366_RDATA1_ADDR A:0xe66b71c
y.create.l HWIO_PMIC_ARB_OBS6_CHNL367_RDATA1_ADDR A:0xe66b79c
y.create.l HWIO_PMIC_ARB_OBS6_CHNL368_RDATA1_ADDR A:0xe66b81c
y.create.l HWIO_PMIC_ARB_OBS6_CHNL369_RDATA1_ADDR A:0xe66b89c
y.create.l HWIO_PMIC_ARB_OBS6_CHNL370_RDATA1_ADDR A:0xe66b91c
y.create.l HWIO_PMIC_ARB_OBS6_CHNL371_RDATA1_ADDR A:0xe66b99c
y.create.l HWIO_PMIC_ARB_OBS6_CHNL372_RDATA1_ADDR A:0xe66ba1c
y.create.l HWIO_PMIC_ARB_OBS6_CHNL373_RDATA1_ADDR A:0xe66ba9c
y.create.l HWIO_PMIC_ARB_OBS6_CHNL374_RDATA1_ADDR A:0xe66bb1c
y.create.l HWIO_PMIC_ARB_OBS6_CHNL375_RDATA1_ADDR A:0xe66bb9c
y.create.l HWIO_PMIC_ARB_OBS6_CHNL376_RDATA1_ADDR A:0xe66bc1c
y.create.l HWIO_PMIC_ARB_OBS6_CHNL377_RDATA1_ADDR A:0xe66bc9c
y.create.l HWIO_PMIC_ARB_OBS6_CHNL378_RDATA1_ADDR A:0xe66bd1c
y.create.l HWIO_PMIC_ARB_OBS6_CHNL379_RDATA1_ADDR A:0xe66bd9c
y.create.l HWIO_PMIC_ARB_OBS6_CHNL380_RDATA1_ADDR A:0xe66be1c
y.create.l HWIO_PMIC_ARB_OBS6_CHNL381_RDATA1_ADDR A:0xe66be9c
y.create.l HWIO_PMIC_ARB_OBS6_CHNL382_RDATA1_ADDR A:0xe66bf1c
y.create.l HWIO_PMIC_ARB_OBS6_CHNL383_RDATA1_ADDR A:0xe66bf9c
y.create.l HWIO_PMIC_ARB_OBS6_CHNL384_RDATA1_ADDR A:0xe66c01c
y.create.l HWIO_PMIC_ARB_OBS6_CHNL385_RDATA1_ADDR A:0xe66c09c
y.create.l HWIO_PMIC_ARB_OBS6_CHNL386_RDATA1_ADDR A:0xe66c11c
y.create.l HWIO_PMIC_ARB_OBS6_CHNL387_RDATA1_ADDR A:0xe66c19c
y.create.l HWIO_PMIC_ARB_OBS6_CHNL388_RDATA1_ADDR A:0xe66c21c
y.create.l HWIO_PMIC_ARB_OBS6_CHNL389_RDATA1_ADDR A:0xe66c29c
y.create.l HWIO_PMIC_ARB_OBS6_CHNL390_RDATA1_ADDR A:0xe66c31c
y.create.l HWIO_PMIC_ARB_OBS6_CHNL391_RDATA1_ADDR A:0xe66c39c
y.create.l HWIO_PMIC_ARB_OBS6_CHNL392_RDATA1_ADDR A:0xe66c41c
y.create.l HWIO_PMIC_ARB_OBS6_CHNL393_RDATA1_ADDR A:0xe66c49c
y.create.l HWIO_PMIC_ARB_OBS6_CHNL394_RDATA1_ADDR A:0xe66c51c
y.create.l HWIO_PMIC_ARB_OBS6_CHNL395_RDATA1_ADDR A:0xe66c59c
y.create.l HWIO_PMIC_ARB_OBS6_CHNL396_RDATA1_ADDR A:0xe66c61c
y.create.l HWIO_PMIC_ARB_OBS6_CHNL397_RDATA1_ADDR A:0xe66c69c
y.create.l HWIO_PMIC_ARB_OBS6_CHNL398_RDATA1_ADDR A:0xe66c71c
y.create.l HWIO_PMIC_ARB_OBS6_CHNL399_RDATA1_ADDR A:0xe66c79c
y.create.l HWIO_PMIC_ARB_OBS6_CHNL400_RDATA1_ADDR A:0xe66c81c
y.create.l HWIO_PMIC_ARB_OBS6_CHNL401_RDATA1_ADDR A:0xe66c89c
y.create.l HWIO_PMIC_ARB_OBS6_CHNL402_RDATA1_ADDR A:0xe66c91c
y.create.l HWIO_PMIC_ARB_OBS6_CHNL403_RDATA1_ADDR A:0xe66c99c
y.create.l HWIO_PMIC_ARB_OBS6_CHNL404_RDATA1_ADDR A:0xe66ca1c
y.create.l HWIO_PMIC_ARB_OBS6_CHNL405_RDATA1_ADDR A:0xe66ca9c
y.create.l HWIO_PMIC_ARB_OBS6_CHNL406_RDATA1_ADDR A:0xe66cb1c
y.create.l HWIO_PMIC_ARB_OBS6_CHNL407_RDATA1_ADDR A:0xe66cb9c
y.create.l HWIO_PMIC_ARB_OBS6_CHNL408_RDATA1_ADDR A:0xe66cc1c
y.create.l HWIO_PMIC_ARB_OBS6_CHNL409_RDATA1_ADDR A:0xe66cc9c
y.create.l HWIO_PMIC_ARB_OBS6_CHNL410_RDATA1_ADDR A:0xe66cd1c
y.create.l HWIO_PMIC_ARB_OBS6_CHNL411_RDATA1_ADDR A:0xe66cd9c
y.create.l HWIO_PMIC_ARB_OBS6_CHNL412_RDATA1_ADDR A:0xe66ce1c
y.create.l HWIO_PMIC_ARB_OBS6_CHNL413_RDATA1_ADDR A:0xe66ce9c
y.create.l HWIO_PMIC_ARB_OBS6_CHNL414_RDATA1_ADDR A:0xe66cf1c
y.create.l HWIO_PMIC_ARB_OBS6_CHNL415_RDATA1_ADDR A:0xe66cf9c
y.create.l HWIO_PMIC_ARB_OBS6_CHNL416_RDATA1_ADDR A:0xe66d01c
y.create.l HWIO_PMIC_ARB_OBS6_CHNL417_RDATA1_ADDR A:0xe66d09c
y.create.l HWIO_PMIC_ARB_OBS6_CHNL418_RDATA1_ADDR A:0xe66d11c
y.create.l HWIO_PMIC_ARB_OBS6_CHNL419_RDATA1_ADDR A:0xe66d19c
y.create.l HWIO_PMIC_ARB_OBS6_CHNL420_RDATA1_ADDR A:0xe66d21c
y.create.l HWIO_PMIC_ARB_OBS6_CHNL421_RDATA1_ADDR A:0xe66d29c
y.create.l HWIO_PMIC_ARB_OBS6_CHNL422_RDATA1_ADDR A:0xe66d31c
y.create.l HWIO_PMIC_ARB_OBS6_CHNL423_RDATA1_ADDR A:0xe66d39c
y.create.l HWIO_PMIC_ARB_OBS6_CHNL424_RDATA1_ADDR A:0xe66d41c
y.create.l HWIO_PMIC_ARB_OBS6_CHNL425_RDATA1_ADDR A:0xe66d49c
y.create.l HWIO_PMIC_ARB_OBS6_CHNL426_RDATA1_ADDR A:0xe66d51c
y.create.l HWIO_PMIC_ARB_OBS6_CHNL427_RDATA1_ADDR A:0xe66d59c
y.create.l HWIO_PMIC_ARB_OBS6_CHNL428_RDATA1_ADDR A:0xe66d61c
y.create.l HWIO_PMIC_ARB_OBS6_CHNL429_RDATA1_ADDR A:0xe66d69c
y.create.l HWIO_PMIC_ARB_OBS6_CHNL430_RDATA1_ADDR A:0xe66d71c
y.create.l HWIO_PMIC_ARB_OBS6_CHNL431_RDATA1_ADDR A:0xe66d79c
y.create.l HWIO_PMIC_ARB_OBS6_CHNL432_RDATA1_ADDR A:0xe66d81c
y.create.l HWIO_PMIC_ARB_OBS6_CHNL433_RDATA1_ADDR A:0xe66d89c
y.create.l HWIO_PMIC_ARB_OBS6_CHNL434_RDATA1_ADDR A:0xe66d91c
y.create.l HWIO_PMIC_ARB_OBS6_CHNL435_RDATA1_ADDR A:0xe66d99c
y.create.l HWIO_PMIC_ARB_OBS6_CHNL436_RDATA1_ADDR A:0xe66da1c
y.create.l HWIO_PMIC_ARB_OBS6_CHNL437_RDATA1_ADDR A:0xe66da9c
y.create.l HWIO_PMIC_ARB_OBS6_CHNL438_RDATA1_ADDR A:0xe66db1c
y.create.l HWIO_PMIC_ARB_OBS6_CHNL439_RDATA1_ADDR A:0xe66db9c
y.create.l HWIO_PMIC_ARB_OBS6_CHNL440_RDATA1_ADDR A:0xe66dc1c
y.create.l HWIO_PMIC_ARB_OBS6_CHNL441_RDATA1_ADDR A:0xe66dc9c
y.create.l HWIO_PMIC_ARB_OBS6_CHNL442_RDATA1_ADDR A:0xe66dd1c
y.create.l HWIO_PMIC_ARB_OBS6_CHNL443_RDATA1_ADDR A:0xe66dd9c
y.create.l HWIO_PMIC_ARB_OBS6_CHNL444_RDATA1_ADDR A:0xe66de1c
y.create.l HWIO_PMIC_ARB_OBS6_CHNL445_RDATA1_ADDR A:0xe66de9c
y.create.l HWIO_PMIC_ARB_OBS6_CHNL446_RDATA1_ADDR A:0xe66df1c
y.create.l HWIO_PMIC_ARB_OBS6_CHNL447_RDATA1_ADDR A:0xe66df9c
y.create.l HWIO_PMIC_ARB_OBS6_CHNL448_RDATA1_ADDR A:0xe66e01c
y.create.l HWIO_PMIC_ARB_OBS6_CHNL449_RDATA1_ADDR A:0xe66e09c
y.create.l HWIO_PMIC_ARB_OBS6_CHNL450_RDATA1_ADDR A:0xe66e11c
y.create.l HWIO_PMIC_ARB_OBS6_CHNL451_RDATA1_ADDR A:0xe66e19c
y.create.l HWIO_PMIC_ARB_OBS6_CHNL452_RDATA1_ADDR A:0xe66e21c
y.create.l HWIO_PMIC_ARB_OBS6_CHNL453_RDATA1_ADDR A:0xe66e29c
y.create.l HWIO_PMIC_ARB_OBS6_CHNL454_RDATA1_ADDR A:0xe66e31c
y.create.l HWIO_PMIC_ARB_OBS6_CHNL455_RDATA1_ADDR A:0xe66e39c
y.create.l HWIO_PMIC_ARB_OBS6_CHNL456_RDATA1_ADDR A:0xe66e41c
y.create.l HWIO_PMIC_ARB_OBS6_CHNL457_RDATA1_ADDR A:0xe66e49c
y.create.l HWIO_PMIC_ARB_OBS6_CHNL458_RDATA1_ADDR A:0xe66e51c
y.create.l HWIO_PMIC_ARB_OBS6_CHNL459_RDATA1_ADDR A:0xe66e59c
y.create.l HWIO_PMIC_ARB_OBS6_CHNL460_RDATA1_ADDR A:0xe66e61c
y.create.l HWIO_PMIC_ARB_OBS6_CHNL461_RDATA1_ADDR A:0xe66e69c
y.create.l HWIO_PMIC_ARB_OBS6_CHNL462_RDATA1_ADDR A:0xe66e71c
y.create.l HWIO_PMIC_ARB_OBS6_CHNL463_RDATA1_ADDR A:0xe66e79c
y.create.l HWIO_PMIC_ARB_OBS6_CHNL464_RDATA1_ADDR A:0xe66e81c
y.create.l HWIO_PMIC_ARB_OBS6_CHNL465_RDATA1_ADDR A:0xe66e89c
y.create.l HWIO_PMIC_ARB_OBS6_CHNL466_RDATA1_ADDR A:0xe66e91c
y.create.l HWIO_PMIC_ARB_OBS6_CHNL467_RDATA1_ADDR A:0xe66e99c
y.create.l HWIO_PMIC_ARB_OBS6_CHNL468_RDATA1_ADDR A:0xe66ea1c
y.create.l HWIO_PMIC_ARB_OBS6_CHNL469_RDATA1_ADDR A:0xe66ea9c
y.create.l HWIO_PMIC_ARB_OBS6_CHNL470_RDATA1_ADDR A:0xe66eb1c
y.create.l HWIO_PMIC_ARB_OBS6_CHNL471_RDATA1_ADDR A:0xe66eb9c
y.create.l HWIO_PMIC_ARB_OBS6_CHNL472_RDATA1_ADDR A:0xe66ec1c
y.create.l HWIO_PMIC_ARB_OBS6_CHNL473_RDATA1_ADDR A:0xe66ec9c
y.create.l HWIO_PMIC_ARB_OBS6_CHNL474_RDATA1_ADDR A:0xe66ed1c
y.create.l HWIO_PMIC_ARB_OBS6_CHNL475_RDATA1_ADDR A:0xe66ed9c
y.create.l HWIO_PMIC_ARB_OBS6_CHNL476_RDATA1_ADDR A:0xe66ee1c
y.create.l HWIO_PMIC_ARB_OBS6_CHNL477_RDATA1_ADDR A:0xe66ee9c
y.create.l HWIO_PMIC_ARB_OBS6_CHNL478_RDATA1_ADDR A:0xe66ef1c
y.create.l HWIO_PMIC_ARB_OBS6_CHNL479_RDATA1_ADDR A:0xe66ef9c
y.create.l HWIO_PMIC_ARB_OBS6_CHNL480_RDATA1_ADDR A:0xe66f01c
y.create.l HWIO_PMIC_ARB_OBS6_CHNL481_RDATA1_ADDR A:0xe66f09c
y.create.l HWIO_PMIC_ARB_OBS6_CHNL482_RDATA1_ADDR A:0xe66f11c
y.create.l HWIO_PMIC_ARB_OBS6_CHNL483_RDATA1_ADDR A:0xe66f19c
y.create.l HWIO_PMIC_ARB_OBS6_CHNL484_RDATA1_ADDR A:0xe66f21c
y.create.l HWIO_PMIC_ARB_OBS6_CHNL485_RDATA1_ADDR A:0xe66f29c
y.create.l HWIO_PMIC_ARB_OBS6_CHNL486_RDATA1_ADDR A:0xe66f31c
y.create.l HWIO_PMIC_ARB_OBS6_CHNL487_RDATA1_ADDR A:0xe66f39c
y.create.l HWIO_PMIC_ARB_OBS6_CHNL488_RDATA1_ADDR A:0xe66f41c
y.create.l HWIO_PMIC_ARB_OBS6_CHNL489_RDATA1_ADDR A:0xe66f49c
y.create.l HWIO_PMIC_ARB_OBS6_CHNL490_RDATA1_ADDR A:0xe66f51c
y.create.l HWIO_PMIC_ARB_OBS6_CHNL491_RDATA1_ADDR A:0xe66f59c
y.create.l HWIO_PMIC_ARB_OBS6_CHNL492_RDATA1_ADDR A:0xe66f61c
y.create.l HWIO_PMIC_ARB_OBS6_CHNL493_RDATA1_ADDR A:0xe66f69c
y.create.l HWIO_PMIC_ARB_OBS6_CHNL494_RDATA1_ADDR A:0xe66f71c
y.create.l HWIO_PMIC_ARB_OBS6_CHNL495_RDATA1_ADDR A:0xe66f79c
y.create.l HWIO_PMIC_ARB_OBS6_CHNL496_RDATA1_ADDR A:0xe66f81c
y.create.l HWIO_PMIC_ARB_OBS6_CHNL497_RDATA1_ADDR A:0xe66f89c
y.create.l HWIO_PMIC_ARB_OBS6_CHNL498_RDATA1_ADDR A:0xe66f91c
y.create.l HWIO_PMIC_ARB_OBS6_CHNL499_RDATA1_ADDR A:0xe66f99c
y.create.l HWIO_PMIC_ARB_OBS6_CHNL500_RDATA1_ADDR A:0xe66fa1c
y.create.l HWIO_PMIC_ARB_OBS6_CHNL501_RDATA1_ADDR A:0xe66fa9c
y.create.l HWIO_PMIC_ARB_OBS6_CHNL502_RDATA1_ADDR A:0xe66fb1c
y.create.l HWIO_PMIC_ARB_OBS6_CHNL503_RDATA1_ADDR A:0xe66fb9c
y.create.l HWIO_PMIC_ARB_OBS6_CHNL504_RDATA1_ADDR A:0xe66fc1c
y.create.l HWIO_PMIC_ARB_OBS6_CHNL505_RDATA1_ADDR A:0xe66fc9c
y.create.l HWIO_PMIC_ARB_OBS6_CHNL506_RDATA1_ADDR A:0xe66fd1c
y.create.l HWIO_PMIC_ARB_OBS6_CHNL507_RDATA1_ADDR A:0xe66fd9c
y.create.l HWIO_PMIC_ARB_OBS6_CHNL508_RDATA1_ADDR A:0xe66fe1c
y.create.l HWIO_PMIC_ARB_OBS6_CHNL509_RDATA1_ADDR A:0xe66fe9c
y.create.l HWIO_PMIC_ARB_OBS6_CHNL510_RDATA1_ADDR A:0xe66ff1c
y.create.l HWIO_PMIC_ARB_OBS6_CHNL511_RDATA1_ADDR A:0xe66ff9c
y.create.l HWIO_PMIC_ARB_OBS0_ACCESS0_ADDR A:0xc450000
y.create.l HWIO_PMIC_ARB_OBS0_ACCESS1_ADDR A:0xc450004
y.create.l HWIO_PMIC_ARB_OBS0_ACCESS2_ADDR A:0xc450008
y.create.l HWIO_PMIC_ARB_OBS0_ACCESS3_ADDR A:0xc45000c
y.create.l HWIO_PMIC_ARB_OBS0_ACCESS4_ADDR A:0xc450010
y.create.l HWIO_PMIC_ARB_OBS0_ACCESS5_ADDR A:0xc450014
y.create.l HWIO_PMIC_ARB_OBS0_ACCESS6_ADDR A:0xc450018
y.create.l HWIO_PMIC_ARB_OBS0_ACCESS7_ADDR A:0xc45001c
y.create.l HWIO_PMIC_ARB_OBS0_ACCESS8_ADDR A:0xc450020
y.create.l HWIO_PMIC_ARB_OBS0_ACCESS9_ADDR A:0xc450024
y.create.l HWIO_PMIC_ARB_OBS0_ACCESS10_ADDR A:0xc450028
y.create.l HWIO_PMIC_ARB_OBS0_ACCESS11_ADDR A:0xc45002c
y.create.l HWIO_PMIC_ARB_OBS0_ACCESS12_ADDR A:0xc450030
y.create.l HWIO_PMIC_ARB_OBS0_ACCESS13_ADDR A:0xc450034
y.create.l HWIO_PMIC_ARB_OBS0_ACCESS14_ADDR A:0xc450038
y.create.l HWIO_PMIC_ARB_OBS0_ACCESS15_ADDR A:0xc45003c
y.create.l HWIO_PMIC_ARB_OBS1_ACCESS0_ADDR A:0xc450040
y.create.l HWIO_PMIC_ARB_OBS1_ACCESS1_ADDR A:0xc450044
y.create.l HWIO_PMIC_ARB_OBS1_ACCESS2_ADDR A:0xc450048
y.create.l HWIO_PMIC_ARB_OBS1_ACCESS3_ADDR A:0xc45004c
y.create.l HWIO_PMIC_ARB_OBS1_ACCESS4_ADDR A:0xc450050
y.create.l HWIO_PMIC_ARB_OBS1_ACCESS5_ADDR A:0xc450054
y.create.l HWIO_PMIC_ARB_OBS1_ACCESS6_ADDR A:0xc450058
y.create.l HWIO_PMIC_ARB_OBS1_ACCESS7_ADDR A:0xc45005c
y.create.l HWIO_PMIC_ARB_OBS1_ACCESS8_ADDR A:0xc450060
y.create.l HWIO_PMIC_ARB_OBS1_ACCESS9_ADDR A:0xc450064
y.create.l HWIO_PMIC_ARB_OBS1_ACCESS10_ADDR A:0xc450068
y.create.l HWIO_PMIC_ARB_OBS1_ACCESS11_ADDR A:0xc45006c
y.create.l HWIO_PMIC_ARB_OBS1_ACCESS12_ADDR A:0xc450070
y.create.l HWIO_PMIC_ARB_OBS1_ACCESS13_ADDR A:0xc450074
y.create.l HWIO_PMIC_ARB_OBS1_ACCESS14_ADDR A:0xc450078
y.create.l HWIO_PMIC_ARB_OBS1_ACCESS15_ADDR A:0xc45007c
y.create.l HWIO_PMIC_ARB_OBS2_ACCESS0_ADDR A:0xc450080
y.create.l HWIO_PMIC_ARB_OBS2_ACCESS1_ADDR A:0xc450084
y.create.l HWIO_PMIC_ARB_OBS2_ACCESS2_ADDR A:0xc450088
y.create.l HWIO_PMIC_ARB_OBS2_ACCESS3_ADDR A:0xc45008c
y.create.l HWIO_PMIC_ARB_OBS2_ACCESS4_ADDR A:0xc450090
y.create.l HWIO_PMIC_ARB_OBS2_ACCESS5_ADDR A:0xc450094
y.create.l HWIO_PMIC_ARB_OBS2_ACCESS6_ADDR A:0xc450098
y.create.l HWIO_PMIC_ARB_OBS2_ACCESS7_ADDR A:0xc45009c
y.create.l HWIO_PMIC_ARB_OBS2_ACCESS8_ADDR A:0xc4500a0
y.create.l HWIO_PMIC_ARB_OBS2_ACCESS9_ADDR A:0xc4500a4
y.create.l HWIO_PMIC_ARB_OBS2_ACCESS10_ADDR A:0xc4500a8
y.create.l HWIO_PMIC_ARB_OBS2_ACCESS11_ADDR A:0xc4500ac
y.create.l HWIO_PMIC_ARB_OBS2_ACCESS12_ADDR A:0xc4500b0
y.create.l HWIO_PMIC_ARB_OBS2_ACCESS13_ADDR A:0xc4500b4
y.create.l HWIO_PMIC_ARB_OBS2_ACCESS14_ADDR A:0xc4500b8
y.create.l HWIO_PMIC_ARB_OBS2_ACCESS15_ADDR A:0xc4500bc
y.create.l HWIO_PMIC_ARB_OBS3_ACCESS0_ADDR A:0xc4500c0
y.create.l HWIO_PMIC_ARB_OBS3_ACCESS1_ADDR A:0xc4500c4
y.create.l HWIO_PMIC_ARB_OBS3_ACCESS2_ADDR A:0xc4500c8
y.create.l HWIO_PMIC_ARB_OBS3_ACCESS3_ADDR A:0xc4500cc
y.create.l HWIO_PMIC_ARB_OBS3_ACCESS4_ADDR A:0xc4500d0
y.create.l HWIO_PMIC_ARB_OBS3_ACCESS5_ADDR A:0xc4500d4
y.create.l HWIO_PMIC_ARB_OBS3_ACCESS6_ADDR A:0xc4500d8
y.create.l HWIO_PMIC_ARB_OBS3_ACCESS7_ADDR A:0xc4500dc
y.create.l HWIO_PMIC_ARB_OBS3_ACCESS8_ADDR A:0xc4500e0
y.create.l HWIO_PMIC_ARB_OBS3_ACCESS9_ADDR A:0xc4500e4
y.create.l HWIO_PMIC_ARB_OBS3_ACCESS10_ADDR A:0xc4500e8
y.create.l HWIO_PMIC_ARB_OBS3_ACCESS11_ADDR A:0xc4500ec
y.create.l HWIO_PMIC_ARB_OBS3_ACCESS12_ADDR A:0xc4500f0
y.create.l HWIO_PMIC_ARB_OBS3_ACCESS13_ADDR A:0xc4500f4
y.create.l HWIO_PMIC_ARB_OBS3_ACCESS14_ADDR A:0xc4500f8
y.create.l HWIO_PMIC_ARB_OBS3_ACCESS15_ADDR A:0xc4500fc
y.create.l HWIO_PMIC_ARB_OBS4_ACCESS0_ADDR A:0xc450100
y.create.l HWIO_PMIC_ARB_OBS4_ACCESS1_ADDR A:0xc450104
y.create.l HWIO_PMIC_ARB_OBS4_ACCESS2_ADDR A:0xc450108
y.create.l HWIO_PMIC_ARB_OBS4_ACCESS3_ADDR A:0xc45010c
y.create.l HWIO_PMIC_ARB_OBS4_ACCESS4_ADDR A:0xc450110
y.create.l HWIO_PMIC_ARB_OBS4_ACCESS5_ADDR A:0xc450114
y.create.l HWIO_PMIC_ARB_OBS4_ACCESS6_ADDR A:0xc450118
y.create.l HWIO_PMIC_ARB_OBS4_ACCESS7_ADDR A:0xc45011c
y.create.l HWIO_PMIC_ARB_OBS4_ACCESS8_ADDR A:0xc450120
y.create.l HWIO_PMIC_ARB_OBS4_ACCESS9_ADDR A:0xc450124
y.create.l HWIO_PMIC_ARB_OBS4_ACCESS10_ADDR A:0xc450128
y.create.l HWIO_PMIC_ARB_OBS4_ACCESS11_ADDR A:0xc45012c
y.create.l HWIO_PMIC_ARB_OBS4_ACCESS12_ADDR A:0xc450130
y.create.l HWIO_PMIC_ARB_OBS4_ACCESS13_ADDR A:0xc450134
y.create.l HWIO_PMIC_ARB_OBS4_ACCESS14_ADDR A:0xc450138
y.create.l HWIO_PMIC_ARB_OBS4_ACCESS15_ADDR A:0xc45013c
y.create.l HWIO_PMIC_ARB_OBS5_ACCESS0_ADDR A:0xc450140
y.create.l HWIO_PMIC_ARB_OBS5_ACCESS1_ADDR A:0xc450144
y.create.l HWIO_PMIC_ARB_OBS5_ACCESS2_ADDR A:0xc450148
y.create.l HWIO_PMIC_ARB_OBS5_ACCESS3_ADDR A:0xc45014c
y.create.l HWIO_PMIC_ARB_OBS5_ACCESS4_ADDR A:0xc450150
y.create.l HWIO_PMIC_ARB_OBS5_ACCESS5_ADDR A:0xc450154
y.create.l HWIO_PMIC_ARB_OBS5_ACCESS6_ADDR A:0xc450158
y.create.l HWIO_PMIC_ARB_OBS5_ACCESS7_ADDR A:0xc45015c
y.create.l HWIO_PMIC_ARB_OBS5_ACCESS8_ADDR A:0xc450160
y.create.l HWIO_PMIC_ARB_OBS5_ACCESS9_ADDR A:0xc450164
y.create.l HWIO_PMIC_ARB_OBS5_ACCESS10_ADDR A:0xc450168
y.create.l HWIO_PMIC_ARB_OBS5_ACCESS11_ADDR A:0xc45016c
y.create.l HWIO_PMIC_ARB_OBS5_ACCESS12_ADDR A:0xc450170
y.create.l HWIO_PMIC_ARB_OBS5_ACCESS13_ADDR A:0xc450174
y.create.l HWIO_PMIC_ARB_OBS5_ACCESS14_ADDR A:0xc450178
y.create.l HWIO_PMIC_ARB_OBS5_ACCESS15_ADDR A:0xc45017c
y.create.l HWIO_PMIC_ARB_OBS6_ACCESS0_ADDR A:0xc450180
y.create.l HWIO_PMIC_ARB_OBS6_ACCESS1_ADDR A:0xc450184
y.create.l HWIO_PMIC_ARB_OBS6_ACCESS2_ADDR A:0xc450188
y.create.l HWIO_PMIC_ARB_OBS6_ACCESS3_ADDR A:0xc45018c
y.create.l HWIO_PMIC_ARB_OBS6_ACCESS4_ADDR A:0xc450190
y.create.l HWIO_PMIC_ARB_OBS6_ACCESS5_ADDR A:0xc450194
y.create.l HWIO_PMIC_ARB_OBS6_ACCESS6_ADDR A:0xc450198
y.create.l HWIO_PMIC_ARB_OBS6_ACCESS7_ADDR A:0xc45019c
y.create.l HWIO_PMIC_ARB_OBS6_ACCESS8_ADDR A:0xc4501a0
y.create.l HWIO_PMIC_ARB_OBS6_ACCESS9_ADDR A:0xc4501a4
y.create.l HWIO_PMIC_ARB_OBS6_ACCESS10_ADDR A:0xc4501a8
y.create.l HWIO_PMIC_ARB_OBS6_ACCESS11_ADDR A:0xc4501ac
y.create.l HWIO_PMIC_ARB_OBS6_ACCESS12_ADDR A:0xc4501b0
y.create.l HWIO_PMIC_ARB_OBS6_ACCESS13_ADDR A:0xc4501b4
y.create.l HWIO_PMIC_ARB_OBS6_ACCESS14_ADDR A:0xc4501b8
y.create.l HWIO_PMIC_ARB_OBS6_ACCESS15_ADDR A:0xc4501bc
y.create.l HWIO_QDSS_PMIC_ARB_PMIC_ARB_DEBUG_SPMI_CHNL_CMD0_ADDR A:0x6b22000
y.create.l HWIO_QDSS_PMIC_ARB_PMIC_ARB_DEBUG_SPMI_CHNL_CMD1_ADDR A:0x6b22004
y.create.l HWIO_QDSS_PMIC_ARB_PMIC_ARB_DEBUG_SPMI_CHNL_CMD2_ADDR A:0x6b22008
y.create.l HWIO_QDSS_PMIC_ARB_PMIC_ARB_DEBUG_SPMI_CHNL_CMD3_ADDR A:0x6b2200c
y.create.l HWIO_QDSS_PMIC_ARB_PMIC_ARB_DEBUG_SPMI_CHNL_CONFIG_ADDR A:0x6b22010
y.create.l HWIO_QDSS_PMIC_ARB_PMIC_ARB_DEBUG_SPMI_CHNL_STATUS_ADDR A:0x6b22014
y.create.l HWIO_QDSS_PMIC_ARB_PMIC_ARB_DEBUG_SPMI_CHNL_WDATA0_ADDR A:0x6b22018
y.create.l HWIO_QDSS_PMIC_ARB_PMIC_ARB_DEBUG_SPMI_CHNL_WDATA1_ADDR A:0x6b2201c
y.create.l HWIO_QDSS_PMIC_ARB_PMIC_ARB_DEBUG_SPMI_CHNL_WDATA2_ADDR A:0x6b22020
y.create.l HWIO_QDSS_PMIC_ARB_PMIC_ARB_DEBUG_SPMI_CHNL_WDATA3_ADDR A:0x6b22024
y.create.l HWIO_QDSS_PMIC_ARB_PMIC_ARB_DEBUG_SPMI_CHNL_WDATA4_ADDR A:0x6b22028
y.create.l HWIO_QDSS_PMIC_ARB_PMIC_ARB_DEBUG_SPMI_CHNL_WDATA5_ADDR A:0x6b2202c
y.create.l HWIO_QDSS_PMIC_ARB_PMIC_ARB_DEBUG_SPMI_CHNL_WDATA6_ADDR A:0x6b22030
y.create.l HWIO_QDSS_PMIC_ARB_PMIC_ARB_DEBUG_SPMI_CHNL_WDATA7_ADDR A:0x6b22034
y.create.l HWIO_QDSS_PMIC_ARB_PMIC_ARB_DEBUG_SPMI_CHNL_RDATA0_ADDR A:0x6b22038
y.create.l HWIO_QDSS_PMIC_ARB_PMIC_ARB_DEBUG_SPMI_CHNL_RDATA1_ADDR A:0x6b2203c
y.create.l HWIO_QDSS_PMIC_ARB_PMIC_ARB_DEBUG_SPMI_CHNL_RDATA2_ADDR A:0x6b22040
y.create.l HWIO_QDSS_PMIC_ARB_PMIC_ARB_DEBUG_SPMI_CHNL_RDATA3_ADDR A:0x6b22044
y.create.l HWIO_QDSS_PMIC_ARB_PMIC_ARB_DEBUG_SPMI_CHNL_RDATA4_ADDR A:0x6b22048
y.create.l HWIO_QDSS_PMIC_ARB_PMIC_ARB_DEBUG_SPMI_CHNL_RDATA5_ADDR A:0x6b2204c
y.create.l HWIO_QDSS_PMIC_ARB_PMIC_ARB_DEBUG_SPMI_CHNL_RDATA6_ADDR A:0x6b22050
y.create.l HWIO_QDSS_PMIC_ARB_PMIC_ARB_DEBUG_SPMI_CHNL_RDATA7_ADDR A:0x6b22054
y.create.l HWIO_QDSS_PMIC_ARB_PMIC_ARB_DEBUG_SPMI_CHNL_RDATA8_ADDR A:0x6b22058
y.create.l HWIO_QDSS_PMIC_ARB_PMIC_ARB_DEBUG_SPMI_CHNL_RDATA9_ADDR A:0x6b2205c
y.create.done

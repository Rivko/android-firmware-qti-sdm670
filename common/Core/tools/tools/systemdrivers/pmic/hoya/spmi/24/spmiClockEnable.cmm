; ============================================================================
;
;  spmiCfg.cmm
;
; Script to configure SPMI
;
;  Execution:
;    do spmiClockEnable.cmm
;
;  This script will configure SPMI clocks
;
;  ====================================================================
;
;  Copyright (c) 2016 QUALCOMM Technologies Incorporated. All Rights Reserved.
;  QUALCOMM Proprietary and Confidential.
;
;  ====================================================================
;
;  $Header: //components/rel/core.glue/1.2/tools/tools/systemdrivers/pmic/hoya/spmi/24/spmiClockEnable.cmm#1 $
;  $DateTime: 2017/11/07 09:39:02 $
;  $Author: pwbldsvc $
;
; ============================================================================
;

PRINT " "
PRINT " "
PRINT " "
PRINT "SPMI CLOCK STATUS"
PRINT " "

local &spmi_access_mode
&spmi_access_mode="ezaxi"

local &AOSS_CC_SPMI_CFG_AHB_CBCR &AOSS_CC_SPMI_SER_CBCR 
local &AOSS_CC_SPMI_AOD_SER_CBCR  &AOSS_CC_SPMI_AOD_SER_CMD_RCGR
&AOSS_CC_SPMI_CFG_AHB_CBCR=0xc2a2204
&AOSS_CC_SPMI_SER_CBCR=0xc2a2208
&AOSS_CC_SPMI_AOD_SER_CBCR=0xc2a220c
&AOSS_CC_SPMI_AOD_SER_CMD_RCGR=0xc2a2210

local &ahb_cbcr

&ahb_cbcr=DATA.LONG(&spmi_access_mode:&AOSS_CC_SPMI_CFG_AHB_CBCR)
IF ((&ahb_cbcr&0x1)==0x0)
(
  &ahb_cbcr=&ahb_cbcr|0x1
  DATA.SET &spmi_access_mode:&AOSS_CC_SPMI_CFG_AHB_CBCR %LONG &ahb_cbcr
)

&ahb_cbcr=DATA.LONG(&spmi_access_mode:&AOSS_CC_SPMI_CFG_AHB_CBCR)
IF ((&ahb_cbcr&0x1)==0x1)
(
  PRINT "SPMI_AHB_CLK ENABLED"
)
ELSE
(
  PRINT "SPMI_AHB_CLK NOT ENABLED"
)

local &ser_cbcr

&ser_cbcr=DATA.LONG(&spmi_access_mode:&AOSS_CC_SPMI_SER_CBCR)
IF ((&ser_cbcr&0x1)==0x0)
(
  &ser_cbcr=&ser_cbcr|0x1
  DATA.SET &spmi_access_mode:&AOSS_CC_SPMI_SER_CBCR %LONG &ser_cbcr
)

&ser_cbcr=DATA.LONG(&spmi_access_mode:&AOSS_CC_SPMI_SER_CBCR)
IF ((&ser_cbcr&0x1)==0x1)
(
  PRINT "SPMI_SER_CLK ENABLED"
)
ELSE
(
  PRINT "SPMI_SER_CLK NOT ENABLED"
)
PRINT " "
PRINT " "






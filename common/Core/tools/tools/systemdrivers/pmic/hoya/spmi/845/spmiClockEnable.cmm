; ============================================================================
;
;  spmiCfg.cmm
;
; Script to configure SPMI
;
;  Execution:
;    do spmiClockEnable.cmm
;
;  This script will configure SPMI clocks
;
;  ====================================================================
;
;  Copyright (c) 2016 QUALCOMM Technologies Incorporated. All Rights Reserved.
;  QUALCOMM Proprietary and Confidential.
;
;  ====================================================================
;
;  $Header: //components/rel/core.glue/1.2/tools/tools/systemdrivers/pmic/hoya/spmi/845/spmiClockEnable.cmm#1 $
;  $DateTime: 2017/02/17 13:50:58 $
;  $Author: pwbldsvc $
;
; ============================================================================
;

PRINT " "
PRINT " "
PRINT " "
PRINT "SPMI CLOCK STATUS"
PRINT " "

local &spmi_access_mode
&spmi_access_mode="ezaxi"

local &GCC_SPMI_AHB_CMD_RCGR &AOSS_CC_SPMI_CFG_AHB_CBCR
&GCC_SPMI_AHB_CMD_RCGR=0x0013F028
&AOSS_CC_SPMI_CFG_AHB_CBCR=0x0C2A21F8

local &GCC_SPMI_SER_CMD_RCGR &AOSS_CC_SPMI_SER_CBCR
&GCC_SPMI_SER_CMD_RCGR=0x0013F010
&AOSS_CC_SPMI_SER_CBCR=0x0C2A21FC

local &ahb_cmd_rcgr_value &ahb_cbcr_value

&ahb_cmd_rcgr_value=0;DATA.LONG(&spmi_access_mode:&GCC_SPMI_AHB_CMD_RCGR)
IF ((&ahb_cmd_rcgr_value&0x80000000)==0x80000000)
(
  ;DATA.SET &spmi_access_mode:&GCC_SPMI_AHB_CMD_RCGR %LONG 0x2
  ;DATA.SET &spmi_access_mode:&GCC_SPMI_AHB_CMD_RCGR %LONG 0x1
)

&ahb_cmd_rcgr_value=0;DATA.LONG(&spmi_access_mode:&GCC_SPMI_AHB_CMD_RCGR)
IF ((&ahb_cmd_rcgr_value&0x80000000)==0x0)
(
  ;PRINT "SPMI_AHB_CLK_ROOT ENABLED"
)
ELSE
(
  ;PRINT "SPMI_AHB_CLK_ROOT NOT ENABLED"
)

&ahb_cbcr_value=DATA.LONG(&spmi_access_mode:&AOSS_CC_SPMI_CFG_AHB_CBCR)
IF ((&ahb_cbcr_value&0x1)==0x0)
(
  &ahb_cbcr_value=&ahb_cbcr_value|0x1
  DATA.SET &spmi_access_mode:&AOSS_CC_SPMI_CFG_AHB_CBCR %LONG &ahb_cbcr_value
)

&ahb_cbcr_value=DATA.LONG(&spmi_access_mode:&AOSS_CC_SPMI_CFG_AHB_CBCR)
IF ((&ahb_cbcr_value&0x1)==0x1)
(
  PRINT "SPMI_AHB_CLK ENABLED"
)
ELSE
(
  PRINT "SPMI_AHB_CLK NOT ENABLED"
)

local &ser_cmd_rcgr_value &ser_cbcr_value

&ser_cmd_rcgr_value=0;DATA.LONG(&spmi_access_mode:&GCC_SPMI_SER_CMD_RCGR)
IF ((&ser_cmd_rcgr_value&0x80000000)==0x80000000)
(
  ;DATA.SET &spmi_access_mode:&GCC_SPMI_SER_CMD_RCGR %LONG 0x2
  ;DATA.SET &spmi_access_mode:&GCC_SPMI_SER_CMD_RCGR %LONG 0x1
)

&ser_cmd_rcgr_value=0;DATA.LONG(&spmi_access_mode:&GCC_SPMI_SER_CMD_RCGR)
IF ((&ser_cmd_rcgr_value&0x80000000)==0x0)
(
  ;PRINT "SPMI_SER_CLK_ROOT ENABLED"
)
ELSE
(
  ;PRINT "SPMI_SER_CLK_ROOT NOT ENABLED"
)

&ser_cbcr_value=DATA.LONG(&spmi_access_mode:&AOSS_CC_SPMI_SER_CBCR)
IF ((&ser_cbcr_value&0x1)==0x0)
(
  &ser_cbcr_value=&ser_cbcr_value|0x1
  DATA.SET &spmi_access_mode:&AOSS_CC_SPMI_SER_CBCR %LONG &ser_cbcr_value
)

&ser_cbcr_value=DATA.LONG(&spmi_access_mode:&AOSS_CC_SPMI_SER_CBCR)
IF ((&ser_cbcr_value&0x1)==0x1)
(
  PRINT "SPMI_SER_CLK ENABLED"
)
ELSE
(
  PRINT "SPMI_SER_CLK NOT ENABLED"
)
PRINT " "
PRINT " "






; ============================================================================
;
;  vrm_dump.cmm
;
;  Script to collect VRM register dump
;
;  Execution:
;  do vrm_dump.cmm <target> <register_filter> file=<dump_file>
;
;  <target>: Target on which the script is executed
;  <register_filter>: Optional register name filter for debugging
;  <dump_file>: Optional dump file name with location
;
;  Example:
;  
;  do vrm_dump.cmm 845                 -> Collects full VRM register dump and copies to file
;  do vrm_dump.cmm 845 reg10           -> Collects regulator 10 dump and prints
;  do vrm_dump.cmm 845 vote_drv10_xob5 -> Collects vote table dump for drv 10, xob 5 and prints
;  do vrm_dump.cmm 845 * file=default  -> Collects full VRM dump, prints and copies to default file
;  do vrm_dump.cmm 845 * file=\\<user>\dropbox\demo.txt -> Collects full VRM dump, prints and copies to demo.txt
;  do vrm_dump.cmm 845 * access=a  -> Use access=a in sleep on AOP T32 if CX is collapsed or in retention
;
;  ====================================================================
;
;  Copyright (c) 2017 QUALCOMM Technologies Incorporated.  All Rights Reserved.
;  QUALCOMM Proprietary and Confidential.
;
;  ====================================================================
;
;  $Header: //components/rel/core.glue/1.2/tools/tools/systemdrivers/pmic/hoya/vrm_dump.cmm#3 $
;  $DateTime: 2017/05/05 14:32:45 $
;  $Author: pwbldsvc $
;
; ============================================================================
;

entry &target &register_filter &vrm_config

;-----------------------------------------------------------------------------
; Default bus access mode and owner
;-----------------------------------------------------------------------------

local &bus_access_mode
&bus_access_mode="EZAXI"

local &temp_access_mode
&temp_access_mode=""

local &aoss_base_addr
&aoss_base_addr=0xb000000

if ("&vrm_config"!="")
(
  &temp_access_mode=string.scanandextract("&vrm_config","access=","")
)

if ("&temp_access_mode"!="")
(
  &bus_access_mode="&temp_access_mode"
)

if (string.lower("&bus_access_mode")=="a")
(
  &aoss_base_addr=0
)

;-----------------------------------------------------------------------------
; Determine the file name to save to.
;-----------------------------------------------------------------------------

local &vrm_date
&vrm_date=FORMAT.DECIMAL(0,DATE.DAY())+FORMAT.DECIMAL(0,DATE.MONTH())+FORMAT.DECIMAL(0,DATE.YEAR())+"_"+FORMAT.DECIMAL(0,DATE.SECONDS())

local &save_to_file
&save_to_file=0

local &dump_file
&dump_file=""

if ("&vrm_config"!="")
(
  &dump_file=string.scanandextract("&vrm_config","file=","")
)

if (("&dump_file"=="")||(string.compare(string.lower("&dump_file"),"default")==TRUE()))
(
  if (string.compare(string.lower("&dump_file"),"default")==TRUE())
  (
    &save_to_file=1
  )
  &dump_file="c:\temp\vrmdump_"+"&vrm_date"+".txt"
)
else
(
  &save_to_file=1
)
if !win.exist(vrm_dump)
(
  WinPOS ,,,,,,vrm_dump
  area.create vrm_dump 200 500
)
area.view vrm_dump
area.select vrm_dump

local &astr_str
&astr_str="****************************************************"

print "&astr_str&astr_str"

;-----------------------------------------------------------------------------
; Check for non-interactive mode.
;-----------------------------------------------------------------------------

if ("&target"=="") 
(
  print %color.red "Specify target folder (i.e. 845)"
  print " "
  gosub Usage
  print "&astr_str&astr_str"
  enddo "Specify target folder (i.e. 845)"
)

if (file.exist(vrm/&target/hwio.cmm))
(
  do vrm/&target/hwio.cmm &aoss_base_addr
)
else
(
  print %color.red "Target not supported!"
  print "&astr_str&astr_str"
  enddo "Target not supported!"
)

if ("&register_filter"!="")
(
  &register_filter=string.trim("&register_filter")
  &register_filter=string.upper("&register_filter")
  &register_filter="*"+"&register_filter"+"*"
)
else
(
  &save_to_file=1
)

//*****************************************************************************
// HW Settings
//*****************************************************************************

if (&save_to_file==1)
(
  if file.exist(&dump_file)==TRUE()
  (
    OPEN #1 &dump_file /Append
  )
  else
  (
    OPEN #1 &dump_file /Create
  )
)


local &vrm_addr &vrm_data &tmp1 &tmp2

OPEN #2 vrm/&target/hwio.cmm /Read

REPEAT
(
  READ #2 &tmp1 &vrm_addr &tmp2
    
  if (("&vrm_addr"!="")&&(string.compare("&tmp1","y.create.l")==TRUE()))
  (
    gosub write_to_file &vrm_addr &vrm_addr
  )
)
WHILE !EOF()

if (&save_to_file==1)
(
  CLOSE #1
)
CLOSE #2

if (&save_to_file==1)
(
  PRINT " "
  PRINT %color.blue "VRM Dump copied to"
  PRINT %color.blue "&dump_file"
)
print "&astr_str&astr_str"

enddo

;=============================================================================
; SUB: Usage
;=============================================================================
Usage:
  print %color.blue "Usage examples"
  print " "
  print %color.blue "do vrm_dump.cmm <target> <register_filter> file=<dump_file>"
  print " "
  print "do vrm_dump.cmm 845                 -> Collects full VRM register dump and copies to file"
  print "do vrm_dump.cmm 845 reg10           -> Collects regulator 10 dump and prints"
  print "do vrm_dump.cmm 845 vote_drv10_xob5 -> Collects vote table dump for drv 10, xob 5 and prints"
  print "do vrm_dump.cmm 845 * file=default  -> Collects full VRM dump, prints and copies to default file"
  print "do vrm_dump.cmm 845 * file=\\<user>\dropbox\demo.txt -> Collects full VRM dump, prints and copies to demo.txt"
  print "do vrm_dump.cmm 845 * access=a -> Use access=a in sleep on AOP T32 if CX is collapsed or in retention"
  return

;=============================================================================
; sub: write_to_file
;=============================================================================
write_to_file:
  local &reg_addr &reg_str &reg_data
  entry &reg_addr &reg_str

  if ("&register_filter"!="")
  (
    if (string.compare("&reg_str","&register_filter")==TRUE())
    (
      &reg_data=data.long(&bus_access_mode:&reg_addr)
      print %color.maroon "&reg_str : &reg_data = "+FORMAT.DECIMAL(0,&reg_data)

      if (&save_to_file==1)
      (
        WRITE #1 "&reg_str : &reg_data = "+FORMAT.DECIMAL(0,&reg_data)
      )
    )
  )
  else
  (
    &reg_data=data.long(&bus_access_mode:&reg_addr)

    if (&save_to_file==1)
    (
      WRITE #1 "&reg_str : &reg_data = "+FORMAT.DECIMAL(0,&reg_data)
    )
  )

  return



//============================================================================
//  Name:                                                                     
//    symbolmanager.cmm 
//
//  Description:                                                              
//    Wraps symbol load functionality of different cores
//                                                                            
// Copyright (c) 2012 - 2016 by Qualcomm Technologies, Incorporated.  All Rights Reserved.        
//
//
//
//
//                      EDIT HISTORY FOR FILE
//  This section contains comments describing changes made to the module.
//  Notice that changes are listed in reverse chronological order.
//
// when       who           what, where, why
// --------   ---           ---------------------------------------------------------
// 04/15/2016 JBILLING      Changes for more arguments passed
// 03/28/2016 JBILLING      Initial creation
//
//  Usage:
//      do symbolmanager <Subroutine>
//
//  Where Subroutines is one of the following:
//      ATTACH 
//      BREAK  
//
//  Dependencies
//  This script is expected to be run from within context of metabuild scripts.
//  It needs the following scripts in support 
//      to be filled..
//
//####################Declarations#######################

//###################Arguments passed #####################
LOCAL &ArgumentLine &SUBROUTINE &remainder
ENTRY %LINE &ArgumentLine
ENTRY &SUBROUTINE %LINE &remainder

//##################Defaults##########################
do std_memorymap

//#################Other misc variables#############################///
LOCAL &targetprocessor &string_length


//##################Get configurations for this target###############//

LOCAL &IMAGE

        
//#####################Select Subroutine###################
// Name of the utility we are calling
// Any subroutine specific options
// Default exists for each subroutine
    AREA.SELECT
    // Input Argument 0 is the name of the utility
    IF !(("&SUBROUTINE"=="LOADSYMS")||("&SUBROUTINE"=="HELP")||("&SUBROUTINE"=="help"))
    (
        GOSUB MAIN &ArgumentLine
    )
    ELSE
    (
        GOSUB &SUBROUTINE &remainder
    )
    ENTRY %LINE &rvalue

    //Remove error handler if it was set
    ON ERROR
    
    GOSUB EXIT &rvalue

////////////////////////////////////////
//
//          MAIN
//
//          Load symbols
//          
//          
///////////////////////////////////////// 
MAIN:
LOADSYMS:
    LOCAL &given_subsystem &imagelist
    ENTRY &given_subsystem %LINE &imagelist
    LOCAL &argumentline
    ENTRY %LINE &argumentline
    
    
    IF ("&given_subsystem"=="")
    (
        PRINT "Warning! no subsystem or image specified for symbol load. Will attempt to load all symbols for &CURRENT_HW_BLOCK_NAME"
        &given_subsystem="&CURRENT_HW_BLOCK_NAME"
    )
    &imagelist=STR.UPR(STR.TRIM("&imagelist"))
    //If no image list given or is specified as 'all', give the whole list of images for this subsystem
    IF ("&imagelist"=="ALL")||("&imagelist"=="")
    (
            do std_debug_&CHIPSET GET_IMAGE_BY_SUBSYSTEM &given_subsystem
            ENTRY &imagelist
            &imagelist=STR.LWR("&imagelist")
    )
    
    
    &imagelist=STRING.REPLACE("&imagelist"," ",",",0)
    
    
    //Cycle through images
    
    LOCAL &count &maxcount &current_image &size_of_master &string_length &string_size &value_to_cut &current_slave &size_of_slave
    //parse out masters
    &current_string="&imagelist"
    &count=0
    &maxcount=20
    while (&count<&maxcount)
    (
        &string_length=String.Length("&current_string")
        &string_size=string.scan("&current_string",",",0)
        
        IF (&string_size!=-1)
        (
            &value_to_cut=&string_size-&string_length    
            //separate the first master from the rest of the string
            &current_image=string.cut("&current_string",&value_to_cut)
            &size_of_master=STRING.LENGTH("&current_image")
            &current_string=STRING.CUT("&current_string",&size_of_master+1) //remove comma
        )
        ELSE //if no "," found
        (
            &current_image="&current_string"
            &count=&maxcount
        )
        
        GOSUB LOADSYMS_BY_IMAGE &given_subsystem &current_image
            ENTRY %LINE &rvalue
            
            
        &count=&count+1
    )
    
LOADSYMS_BY_IMAGE:

    LOCAL &given_subsystem &given_image
    ENTRY &given_subsystem &given_image
    
    
    GOSUB GETSANITIZEDIMAGE &given_subsystem &given_image
    ENTRY &given_image
    IF ("&given_image"=="NULL")
    (
        RETURN IMAGE_NOT_APPLICABLE_TO_CORE
    )
    
    LOCAL &image &targetprocessor &targetprocessorport &bootprocessor &bootprocessorport &peripheral_processor &processortimeoutvalue &debugscript &symbolloadscript &imagebuildroot &entry_bkpt &error_bkpts &lpm_option &sleep_disable_command &cti_enable &multi_elf_option &alternateelf &extraoption
    &image="&given_image"
    do std_debug_&CHIPSET GETDEBUGDEFAULTS NONE &image &lpm_option &cti_enable &alternateelf &extraoption
        ENTRY &image &targetprocessor &targetprocessorport &bootprocessor &bootprocessorport &peripheral_processor &processortimeoutvalue &debugscript &symbolloadscript &imagebuildroot &entry_bkpt &error_bkpts &lpm_option &sleep_disable_command &cti_enable &multi_elf_option &alternateelf &extraoption

    IF (STRING.SCAN("&peripheral_processor","mproc",0)!=-1)
    (
        do listparser &symbolloadscript
        ENTRY &other &symbolloadscript

        do listparser &imagebuildroot
        ENTRY  &other &imagebuildroot
        
    )
    //Special cases - images that are mapped to same hardware block.
    //Come up with more elegant solution.
    LOCAL &imageissecondPD
    &imageissecondPD="FALSE"
    IF (STRING.SCAN("&symbolloadscript","&image",0)==-1)&&(STRING.SCAN("&image","apps",0)==-1)
    (
        &imageissecondPD="TRUE"
    )
    
    
    LOCAL &loadflags
    IF (Y.EXIST(PrimarySymbolsLoadedFlag))&&(Y.EXIST(PrimarySymbolsLoadedFlag_&image))
    (
        IF ("&multi_elf_option"=="true")||("&imageissecondPD"=="TRUE")
        (
            IF (Y.EXIST(SecondarySymbolsLoadedFlag))&&(Y.EXIST(SecondarySymbolsLoadedFlag_&image))
            (
                RETURN SUCCESS
            )
            ELSE
            (
                &loadflags="LOADSECONDARY"
            )
        )
        ELSE
        (
            RETURN SUCCESS
        )
    )
    ELSE
    (
        //May get here if secondPD image is requested but first PD image is already loaded
        //In this case, only load second PD image. e.g. WLAN on 8998
        IF Y.EXIST(PrimarySymbolsLoadedFlag)&&("&imageissecondPD"=="TRUE")
        (
            &loadflags="LOADSECONDARY"
            Y.CREATE.L PrimarySymbolsLoadedFlag_&image 1
            Y.CREATE.DONE
        )
        ELSE
        (
            &loadflags="LOADALL"
        )
    )
    
    
    
    
    IF "&loadflags"=="LOADALL"
    (
        IF STRING.SCAN("&CURRENT_HW_BLOCK_NAME","Q6",0)!=-1
        (
            do &symbolloadscript &imagebuildroot locally notliveattach loadsecondelf NULL NULL
        )
        ELSE IF STRING.SCAN("&CURRENT_HW_BLOCK_NAME","APPS",0)!=-1
        (
            IF "&given_image"=="tz"
            (
                do &symbolloadscript &imagebuildroot locally notliveattach loadsecondelf NULL NULL
            )
            IF "&given_image"=="appsboot"
            (
                do &symbolloadscript &imagebuildroot locally notliveattach NULL NULL NULL
            )
            IF "&given_image"=="xbl"
            (
                do &symbolloadscript &imagebuildroot locally notliveattach NULL NULL NULL
            )
            IF "&given_image"=="sbl1"
            (
                do &symbolloadscript &imagebuildroot locally notliveattach NULL NULL NULL
            )
        )
        ELSE IF "&given_image"=="rpm"
        (
            do &symbolloadscript &imagebuildroot locally notliveattach NULL NULL NULL
        )
    )

    IF "&loadflags"=="LOADSECONDARY"
    (
        IF STRING.SCAN("&CURRENT_HW_BLOCK_NAME","Q6",0)!=-1
        (
            LOCAL &secondPDsymbolscript
            &secondPDsymbolscript="&symbolloadscript"+"_secondPD"
            //do &secondPDsymbolscript&buildroot &RemoteOption &LiveAttach NULL MPSSSecondPDElf=&MPSS_STORED_SECONDPD_ELF NULL
            do &secondPDsymbolscript&buildroot &RemoteOption &LiveAttach NULL SecondPDElf=&STORED_SECONDPD_ELF NULL
        )
        ELSE IF STRING.SCAN("&CURRENT_HW_BLOCK_NAME","APPS",0)!=-1
        (
            IF "&given_image"=="tz"
            (
                LOCAL &secondPDsymbolscript
                &secondPDsymbolscript="&symbolloadscript"+"_secondary_elfs"
                do &secondPDsymbolscript &buildroot &RemoteOption &LiveAttach NULL MonitorElf=&MonitorElf,HypervisorElf=&HypervisorElf NULL
            )

        )
    )
    



    
    //IF (Y.EXIST(PrimarySymbolsLoadedFlag))&&(Y.EXIST(SecondarySymbolsLoadedFlag))
    IF (Y.EXIST(PrimarySymbolsLoadedFlag))
    (
        PRINT "Symbols loaded successfully"
        &rvalue="SUCCESS"
    )
    ELSE
    (
        &rvalue="FAILURE - some error ocurred during symbol load"
    )
    RETURN &rvalue
    

    
    
    
GETSANITIZEDIMAGE:
    LOCAL &given_subsystem &given_image
    ENTRY &given_subsystem &given_image
    
    
    LOCAL &image 
    &given_image=STR.LWR("&given_image")

    //Check if it's in allowed images
    do std_debug_&CHIPSET GET_IMAGE_BY_SUBSYSTEM &given_subsystem
    ENTRY &imagelist
    &imagelist=STR.LWR("&imagelist")
    
    IF STRING.SCAN("&imagelist","&given_image",0)!=-1
    (
        
        RETURN &given_image
    )
    ELSE IF ("&given_image"=="")
    (
        RETURN &imagelist
    )
    ELSE 
    (
        RETURN NULL
    )
    //ELSE
    //(
    //    
    //    //else return an approximate map
    //    IF "&CURRENT_HW_BLOCK_NAME"=="LPASS-Q6"
    //    (
    //        &image="adsp"
    //    )
    //    ELSE IF "&CURRENT_HW_BLOCK_NAME"=="MSS-Q6"
    //    (
    //        &image="mpss"
    //    )
    //    ELSE IF "&CURRENT_HW_BLOCK_NAME"=="SSC-Q6"
    //    (
    //        &image="slpi"
    //    )
    //    ELSE IF "&CURRENT_HW_BLOCK_NAME"=="RPM-CORTEXM3"
    //    (
    //        &image="rpm"
    //    )
    //    ELSE IF "&CURRENT_HW_BLOCK_NAME"=="APPS-HYDRA"
    //    (
    //        &image="appsboot"
    //    )
    //    ELSE IF "&CURRENT_HW_BLOCK_NAME"=="APPS-ARMV8"
    //    (
    //        &image="appsboot"
    //    )
    //    ELSE IF "&CURRENT_HW_BLOCK_NAME"=="APPS-CORTEXA7"
    //    (
    //        &image="appsboot"
    //    )
    //    ELSE
    //    (
    //        &image="appsboot"
    //    )
    //)
    //
    //RETURN &image
        
        
        
////////////////////////////////////////
//
//          BREAK
//
//          Just sends a CTI pulse to Q6. 
//          Software on target should busywait for 10 seconds
//
///////////////////////////////////////// 
BREAK:

    LOCAL &rvalue
    
    do std_utils MAKE_SURE_BOOT_PROCESSOR_ATTACHED
    
    IF STRING.SCAN("&CURRENT_HW_BLOCK_NAME","Q6",0)!=-1
    (
        do std_cti_&IMAGE WAKEPROCESSOR
        sys.m.a
        BREAK
    )

    ELSE IF STRING.SCAN("&CURRENT_HW_BLOCK_NAME","APPS",0)!=-1
    (
        do hwio
        SYS.M.A
        SYS.OPTION.ENRESET ON
        DO std_utils HWIO_OUTF APCS_APC0_CPU0_SAW3_SPM_CTL SPM_CTL_WAKEUP 0x1 EDAP
        
        wait.1ms
        
        BREAK
    )
    ELSE IF "&IMAGE"=="RPM"
    (
        SYS.M.A
        BREAK
    )
    
    //Test result
    LOCAL &T32_attachstate &T32_stopstate
    &T32_stopstate=STATE.RUN()
    &T32_attachstate=SYSTEM.MODE()
    IF ((0==&T32_stopstate)&&(&T32_attachstate==0x0B))
    (
        print "attached successfully"
        &rvalue="SUCCESS"
    )
    ELSE
    (
        &rvalue="FAILURE"
    )
    
    RETURN &rvalue
    
    

////////////////////////////////////////
//
//      FAILED_TO_BREAK
//          
//      Print error on failed to break.
//
///////////////////////////////////////// 
FAILED_TO_BREAK:
    //remove Error handler
    ON ERROR

    WINPOS 5. 39. 90. 5.
    AREA
    PRINT %ERROR "Error! std_cti_&targetprocessor - Could not break processor. "
    PRINT %ERROR " This could be a Trace32 version issue "
    PRINT %ERROR "  (please ensure your T32 installation is up to date)"
    PRINT %ERROR " Or this could be a software issue "
    PRINT %ERROR " (e.g. QuRT or CTI driver on target has malfunctioned)"
    
    ENDDO &FAILURE //fail




////////////////////////////////////////
//
//          ATTACH_TO_PROCESSOR
//
//          Attempts to attach to target processor.
//          Tries twice as on Q6 sometimes debug registers
//              need to be asserted then one can attach
//
///////////////////////////////////////// 
ATTACH_TO_PROCESSOR:

        ON ERROR GOTO SECONDATTACH
        sys.m.a
        ON ERROR

        RETURN


////////////////////////////////////////
//
//      SECONDATTACH
//          
//      Usually necessary for Q6 as the first attach
//      asserts debug registers, and then the second will 
//      be successful. Should eventually be fixed by JTag provider
//
///////////////////////////////////////// 
SECONDATTACH:
        ON ERROR

        ON ERROR GOTO CONTINUE
        sys.m.a
CONTINUE:
        ON ERROR

        IF (SYSTEM.MODE()==0x0B)
        (
            print "attached successfully"
        )
        ELSE
        (
            winclear
            WINPOS 0. 0. 60. 15. 0. 0. 
            area.reset
            area
            PRINT %ERROR " std_cti_&targetprocessor - could not attach"
            PRINT %ERROR " Please ensure the following:"  
            PRINT %ERROR "     - Device is not in XO Shutdown"
            PRINT %ERROR "     - &targetprocessor has booted up"
            PRINT %ERROR "     - T32 installation is up to date."
            PRINT %ERROR "     - &targetprocessor build is CTI compliant."
            PRINT %ERROR " "
            
            ENDDO &FAILURE
            
        )
    
    
    IF "&break"=="break"
    (
        RETURN
    )
    ELSE
    (
        GOTO EXIT
    )
        
        
////////////////////////////////////////
//
//          MAKE_SURE_BOOT_PROCESSOR_ATTACHED
//          
//          Makes sure boot processor is attached
//          Otherwise attaching on subsystem processor not possible
//
///////////////////////////////////////// 
MAKE_SURE_BOOT_PROCESSOR_ATTACHED:



    LOCAL &Rvalue
    do std_intercom_init CHECKSESSION 1 &bootprocessor
        ENTRY &Rvalue
    IF (&Rvalue!=1.)&&("&bootprocessor"=="APPS0")
    (
        do std_intercom_init CHECKSESSION 1 APPSC0
        ENTRY &Rvalue
    )
    IF (&Rvalue!=1.)
    (
        PRINT %ERROR "&bootprocessor T32 window not open. Please open and try again"
        GOTO FATALEXIT
    )


    //Run HWIO if needed
    LOCAL &hwio_ran

    do std_intercom_do &bootprocessorport hwio

    //if boot processor t32 not attached, attach.
    INTERCOM.EVALUATE &bootprocessorport SYSTEM.MODE()
        &BOOT_PROCESSOR_STATE=EVAL()
    IF ("&BOOT_PROCESSOR_STATE"!="0x0B")
    (
        INTERCOM.EXECUTE &bootprocessorport sys.m.a
    )
    INTERCOM.EVALUATE &bootprocessorport SYSTEM.MODE()
        &BOOT_PROCESSOR_STATE=EVAL()
    IF ("&BOOT_PROCESSOR_STATE"!="0x0B")
    (
            winclear
            WINPOS 0. 0. 60. 15. 0. 0. 
            area.reset
            area
            PRINT %ERROR " std_cti_&targetprocessor - &bootprocessor not able to attach"
            PRINT %ERROR " Please ensure the following:"    
            PRINT %ERROR "     JTAG is physically attached"
            PRINT %ERROR "     T32 installation is up to date."
            PRINT %ERROR "     Device is booted."
            PRINT %ERROR " "
            
            ENDDO &FAILURE
    )
    
    RETURN
    
        
    
help:
HELP:    

    AREA.RESET
    AREA.CREATE attachmanager_help 125. 23.
    AREA.SELECT attachmanager_help
    WINPOS 5. 39. 125. 23.
    AREA.VIEW attachmanager_help
    
    PRINT " Usage:"
    PRINT "     do attachmanager <Subroutine>"
    PRINT " "
    PRINT " Where Subroutines is one of the following:"
    PRINT "     ATTACH  //executes wake an attach instruction for the particular core that is open"
    PRINT "     BREAK   //executes the wake and break instruction for the particular core that is open"
    PRINT " "
    PRINT " Dependencies"
    PRINT " This script is expected to be run from within context of metabuild scripts."
    PRINT " "

    ENDDO &FAILURE
    
EXIT:
    LOCAL &rvalue
    ENTRY %LINE &rvalue
    ENDDO &rvalue
    


FATALEXIT:
    LOCAL &rvalue
    ENTRY %LINE &rvalue
    IF STRING.SCAN("&FAILUREKEYWORD","FAILUREKEYWORD",0)==-1
    (
        GOSUB EXIT &FAILUREKEYWORD - &rvalue
    )
    ELSE
    (
        GOSUB EXIT &rvalue
    )

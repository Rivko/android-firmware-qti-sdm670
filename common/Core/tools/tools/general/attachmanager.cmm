//============================================================================
//  Name:                                                                     
//    attachmanager.cmm 
//
//  Description:                                                              
//    Wraps attach functionality for different cores
//                                                                            
// Copyright (c) 2012 - 2016 by Qualcomm Technologies, Incorporated.  All Rights Reserved.        
//
//
//
//
//                      EDIT HISTORY FOR FILE
//  This section contains comments describing changes made to the module.
//  Notice that changes are listed in reverse chronological order.
//
// when       who           what, where, why
// --------   ---           ---------------------------------------------------------
// 03/28/2016 JBILLING      Initial creation
//
//  Usage:
//      do attachmanager <Subroutine>
//
//  Where Subroutines is one of the following:
//      ATTACH 
//      BREAK  
//
//  Dependencies
//  This script is expected to be run from within context of metabuild scripts.
//  It needs the following scripts in support 
//      to be filled..
//
//####################Declarations#######################

//###################Arguments passed #####################
ENTRY %LINE &ArgumentLine
ENTRY &UTILITY &OPTION &IARG0 &IARG1 &IARG2 &IARG3 &IARG4 &IARG5 &IARG6 &IARG7 &IARG8 &IARG9 &IARG10 &IARG11

//##################Defaults##########################
do std_memorymap
//Don't attach if simulator
GLOBAL &T32PROP
IF STR.UPR("&T32PROP")=="SIM"
(
    ENDDO SUCCESS
)
//#################Other misc variables#############################///
LOCAL &targetprocessor &string_length

//##################Get configurations for this target###############//

LOCAL &IMAGE

IF "&CURRENT_HW_BLOCK_NAME"=="LPASS-Q6"
(
    &IMAGE="adsp"
)
ELSE IF "&CURRENT_HW_BLOCK_NAME"=="MSS-Q6"
(
    &IMAGE="mpss"
)
ELSE IF "&CURRENT_HW_BLOCK_NAME"=="SSC-Q6"
(
    &IMAGE="slpi"
)
ELSE IF "&CURRENT_HW_BLOCK_NAME"=="RPM-CORTEXM3"
(
    &IMAGE="rpm"
)
ELSE IF "&CURRENT_HW_BLOCK_NAME"=="APPS-HYDRA"
(
    &IMAGE="appsboot"
)
ELSE IF "&CURRENT_HW_BLOCK_NAME"=="APPS-ARMV8"
(
    &IMAGE="appsboot"
)
ELSE IF "&CURRENT_HW_BLOCK_NAME"=="APPS-CORTEXA7"
(
    &IMAGE="appsboot"
)
ELSE
(
    &IMAGE="appsboot"
)

    LOCAL &image &targetprocessor &targetprocessorport &bootprocessor &bootprocessorport &peripheral_processor &processortimeoutvalue &debugscript &symbolloadscript &imagebuildroot &entry_bkpt &error_bkpts &lpm_option &sleep_disable_command &cti_enable &multi_elf_option &alternateelf &extraoption
    &image="&IMAGE"
    do std_debug_&CHIPSET GETDEBUGDEFAULTS NONE &image &lpm_option &cti_enable &alternateelf &extraoption
        ENTRY &image &targetprocessor &targetprocessorport &bootprocessor &bootprocessorport &peripheral_processor &processortimeoutvalue &debugscript &symbolloadscript &imagebuildroot &entry_bkpt &error_bkpts &lpm_option &sleep_disable_command &cti_enable &multi_elf_option &alternateelf &extraoption

        
//#####################Select Subroutine###################
// Name of the utility we are calling
LOCAL &SUBROUTINE
// Any subroutine specific options
// Default exists for each subroutine
LOCAL &OPTION

// Input Argument 0 is the name of the utility
&SUBROUTINE=STR.UPR("&UTILITY")
IF !(("&SUBROUTINE"=="ATTACH")||("&SUBROUTINE"=="BREAK")||("&SUBROUTINE"=="HELP")||("&SUBROUTINE"=="help"))
(
    &SUBROUTINE="HELP"
    PRINT %ERROR "attachmanager: Subroutine not found! Printing Help Window"
)

    // This should be created by some top level script. The setupenv for each proc would
    // set this up
    AREA.SELECT
    // Call the required utility
    GOSUB &SUBROUTINE &OPTION &IARG0 &IARG1 &IARG2 &IARG3 &IARG4 &IARG5 &IARG6 &IARG7 &IARG8 &IARG9 &IARG10 &IARG11
    ENTRY %LINE &rvalue

    //Remove error handler if it was set
    ON ERROR
    
    GOSUB EXIT &rvalue

////////////////////////////////////////
//
//          ATTACH
//
//          Depending on core, attach in the best way
//
///////////////////////////////////////// 
ATTACH:

    LOCAL &rvalue
    IF (SYSTEM.MODE()==0x0B)
    (
        //If already attached, return
        RETURN SUCCESS
    )
    
    
    do std_utils MAKE_SURE_BOOT_PROCESSOR_ATTACHED
    
    IF STRING.SCAN("&CURRENT_HW_BLOCK_NAME","Q6",0)!=-1
    (
        do std_cti_&IMAGE WAKEPROCESSOR
        sys.m.a
    )

    ELSE IF STRING.SCAN("&CURRENT_HW_BLOCK_NAME","APPS",0)!=-1
    (
        SYS.M.A
    )
    ELSE IF "&IMAGE"=="RPM"
    (
        SYS.M.A
    )
    ELSE IF "&IMAGE"=="AOP"
    (
        SYS.M.A
    )
    
    IF (SYSTEM.MODE()==0x0B)
    (
        print "attached successfully"
        &rvalue="SUCCESS"
    )
    ELSE
    (
        &rvalue="FAILURE"
    )
    
    RETURN &rvalue
    

////////////////////////////////////////
//
//          PREPARE
//
//          Depending on core, attach in the best way
//
///////////////////////////////////////// 
PREPARE:

    do std_utils MAKE_SURE_BOOT_PROCESSOR_ATTACHED prepare
    
    do std_utils EVALUATE_INTERCOM_ATTACH_STATE &targetprocessorport
    LOCAL &attachstate
    ENTRY &attachstate
    
    IF !(("&attachstate"=="ATTACHED")||("&attachstate"=="PREPARED"))
    (
        INTERCOM.EXECUTE &targetprocessorport SYS.OPTION.ENRESET OFF
        INTERCOM.EXECUTE &targetprocessorport SYS.M.PREPARE
    )
    
    do std_utils EVALUATE_INTERCOM_ATTACH_STATE &targetprocessorport
    LOCAL &attachstate
    ENTRY &attachstate
    
    IF !(("&attachstate"=="ATTACHED")||("&attachstate"=="PREPARED"))
    (
        RETURN FAILURE
    )
    ELSE
    (
        RETURN SUCCESS
    )
    //Should never get here
    RETURN FAILURE
////////////////////////////////////////
//
//          BREAK
//
//          Just sends a CTI pulse to Q6. 
//          Software on target should busywait for 10 seconds
//
///////////////////////////////////////// 
BREAK:

    LOCAL &rvalue
    
    do std_utils MAKE_SURE_BOOT_PROCESSOR_ATTACHED
    
    
    //if already stopped and attached, exit
    LOCAL &T32_attachstate &T32_stopstate
    &T32_stopstate=STATE.RUN()
    &T32_attachstate=SYSTEM.MODE()
    IF ((TRUE()!=&T32_stopstate)&&(&T32_attachstate==0x0B))
    (
        RETURN SUCCESS
    )
    
    
    
    IF STRING.SCAN("&CURRENT_HW_BLOCK_NAME","Q6",0)!=-1
    (
        do std_cti_&IMAGE WAKEPROCESSOR
        sys.m.a
        do std_utils BREAKPROC
    )

    ELSE IF STRING.SCAN("&CURRENT_HW_BLOCK_NAME","APPS",0)!=-1
    (
        do hwio
        SYS.M.A
        SYS.OPTION.ENRESET ON
        DO std_utils HWIO_OUTF APCS_APC0_CPU0_SAW3_SPM_CTL SPM_CTL_WAKEUP 0x1 EDAP
        
        wait.1ms
        PRINT "Attempting to break processor"
        do std_utils BREAKPROC
    )
    ELSE IF "&IMAGE"=="RPM"
    (
        SYS.M.A
        BREAK
    )
    
    //Test result
    LOCAL &T32_attachstate &T32_stopstate
    &T32_stopstate=STATE.RUN()
    &T32_attachstate=SYSTEM.MODE()
    IF ((TRUE()==&T32_stopstate)&&(&T32_attachstate==0x0B))
    (
        print "attached and broken successfully"
        &rvalue="SUCCESS"
    )
    ELSE
    (
        PRINT "Error! Could not attach/break processor"
        &rvalue="FAILURE"
    )
    
    RETURN &rvalue
    
    

////////////////////////////////////////
//
//      FAILED_TO_BREAK
//          
//      Print error on failed to break.
//
///////////////////////////////////////// 
FAILED_TO_BREAK:
    //remove Error handler
    ON ERROR

    WINPOS 5. 39. 90. 5.
    AREA
    PRINT %ERROR "Error! std_cti_&targetprocessor - Could not break processor. "
    PRINT %ERROR " This could be a Trace32 version issue "
    PRINT %ERROR "  (please ensure your T32 installation is up to date)"
    PRINT %ERROR " Or this could be a software issue "
    PRINT %ERROR " (e.g. QuRT or CTI driver on target has malfunctioned)"
    
    ENDDO &FAILURE //fail




////////////////////////////////////////
//
//          ATTACH_TO_PROCESSOR
//
//          Attempts to attach to target processor.
//          Tries twice as on Q6 sometimes debug registers
//              need to be asserted then one can attach
//
///////////////////////////////////////// 
ATTACH_TO_PROCESSOR:

        ON ERROR GOTO SECONDATTACH
        sys.m.a
        ON ERROR

        RETURN


////////////////////////////////////////
//
//      SECONDATTACH
//          
//      Usually necessary for Q6 as the first attach
//      asserts debug registers, and then the second will 
//      be successful. Should eventually be fixed by JTag provider
//
///////////////////////////////////////// 
SECONDATTACH:
        ON ERROR

        ON ERROR GOTO CONTINUE
        sys.m.a
CONTINUE:
        ON ERROR

        IF (SYSTEM.MODE()==0x0B)
        (
            print "attached successfully"
        )
        ELSE
        (
            winclear
            WINPOS 0. 0. 60. 15. 0. 0. 
            area.reset
            area
            PRINT %ERROR " std_cti_&targetprocessor - could not attach"
            PRINT %ERROR " Please ensure the following:"  
            PRINT %ERROR "     - Device is not in XO Shutdown"
            PRINT %ERROR "     - &targetprocessor has booted up"
            PRINT %ERROR "     - T32 installation is up to date."
            PRINT %ERROR "     - &targetprocessor build is CTI compliant."
            PRINT %ERROR " "
            
            ENDDO &FAILURE
            
        )
    
    
    IF "&break"=="break"
    (
        RETURN
    )
    ELSE
    (
        GOTO EXIT
    )
        
        
////////////////////////////////////////
//
//          MAKE_SURE_BOOT_PROCESSOR_ATTACHED
//          
//          Makes sure boot processor is attached
//          Otherwise attaching on subsystem processor not possible
//
///////////////////////////////////////// 
MAKE_SURE_BOOT_PROCESSOR_ATTACHED:



    LOCAL &Rvalue
    do std_intercom_init CHECKSESSION 1 &bootprocessor
        ENTRY &Rvalue
    IF (&Rvalue!=1.)&&("&bootprocessor"=="APPS0")
    (
        do std_intercom_init CHECKSESSION 1 APPSC0
        ENTRY &Rvalue
    )
    IF (&Rvalue!=1.)
    (
        PRINT %ERROR "&bootprocessor T32 window not open. Please open and try again"
        GOTO FATALEXIT
    )


    //Run HWIO if needed
    LOCAL &hwio_ran

    do std_intercom_do &bootprocessorport hwio

    //if boot processor t32 not attached, attach.
    INTERCOM.EVALUATE &bootprocessorport SYSTEM.MODE()
        &BOOT_PROCESSOR_STATE=EVAL()
    IF ("&BOOT_PROCESSOR_STATE"!="0x0B")
    (
        INTERCOM.EXECUTE &bootprocessorport sys.m.a
    )
    INTERCOM.EVALUATE &bootprocessorport SYSTEM.MODE()
        &BOOT_PROCESSOR_STATE=EVAL()
    IF ("&BOOT_PROCESSOR_STATE"!="0x0B")
    (
            winclear
            WINPOS 0. 0. 60. 15. 0. 0. 
            area.reset
            area
            PRINT %ERROR " std_cti_&targetprocessor - &bootprocessor not able to attach"
            PRINT %ERROR " Please ensure the following:"    
            PRINT %ERROR "     JTAG is physically attached"
            PRINT %ERROR "     T32 installation is up to date."
            PRINT %ERROR "     Device is booted."
            PRINT %ERROR " "
            
            ENDDO &FAILURE
    )
    
    RETURN
    
        
    
help:
HELP:    

    AREA.RESET
    AREA.CREATE attachmanager_help 125. 23.
    AREA.SELECT attachmanager_help
    WINPOS 5. 39. 125. 23.
    AREA.VIEW attachmanager_help
    
    PRINT " Usage:"
    PRINT "     do attachmanager <Subroutine>"
    PRINT " "
    PRINT " Where Subroutines is one of the following:"
    PRINT "     ATTACH  //executes wake an attach instruction for the particular core that is open"
    PRINT "     BREAK   //executes the wake and break instruction for the particular core that is open"
    PRINT " "
    PRINT " Dependencies"
    PRINT " This script is expected to be run from within context of metabuild scripts."
    PRINT " "

    ENDDO &FAILURE
    
EXIT:
    LOCAL &rvalue
    ENTRY %LINE &rvalue
    ENDDO &rvalue
    


FATALEXIT:
    LOCAL &rvalue
    ENTRY %LINE &rvalue
    IF STRING.SCAN("&FAILUREKEYWORD","FAILUREKEYWORD",0)==-1
    (
        GOSUB EXIT &FAILUREKEYWORD - &rvalue
    )
    ELSE
    (
        GOSUB EXIT &rvalue
    )

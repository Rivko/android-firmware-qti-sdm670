////////////////////////////////////////////////////////////////////
//                                                                //
//  File: std_rootcmm_menu_CDSP-Q6_external.cmm     
//  Contains T32 script set-up for CDSP-Q6 subsystem      
//  Autogenerated - Do not edit!                                  //
//  Created: 18-02-2021,00.51.54                                  //
//                                                                //
////////////////////////////////////////////////////////////////////

//###################Arguments passed #####################            
LOCAL &ArgumentLine                                                    
ENTRY %LINE &ArgumentLine                                              
LOCAL &UTILITY &therest                                                
ENTRY &UTILITY %LINE &therest                                          
                                                                       
                                                                       
//#####################Select Subroutine###################            
// Name of the utility we are calling                                  
// Input Argument 0 is the name of the utility                         
LOCAL &SUBROUTINE                                                      
&SUBROUTINE="&UTILITY"                                                 
IF !(("&SUBROUTINE"=="CREATEMENU")||("&SUBROUTINE"=="ADDMENUBUTTONS")||("&SUBROUTINE"=="HELP")||("&SUBROUTINE"=="help")) 
(                                                                      
    &SUBROUTINE="MAIN"                                                 
    GOSUB MAIN &ArgumentLine                                           
)                                                                      
ELSE                                                                   
(                                                                      
    // Call the required utility                                       
    GOSUB &SUBROUTINE &therest                                         
)                                                                      
                                                                       
    LOCAL &rvalue                                                      
    ENTRY %LINE &rvalue                                                
                                                                       
    //Remove error handler if it was set                               
    ON ERROR                                                           
                                                                       
    GOSUB EXIT &rvalue                                                 
                                                                       
////////////////////////////////////////                               
//                                                                     
//            MAIN                                                     
//            Main std_rootcmm_menu_CDSP-Q6_external.cmm logic                                  
//                                                                     
/////////////////////////////////////////                              
MAIN:                                                                  
     LOCAL &arg0 &therest                                               
     ENTRY &arg0 %LINE &therest                                       
                                                                       
     ON ERROR GOSUB HELP                                                
     GOSUB &arg0 &therest                                                
     ON ERROR                                                          
     LOCAL &rvalue                                                     
     ENTRY &rvalue                                                      
     IF ("&rvalue"=="")                                             
     (                                                                  
         &rvalue="SUCCESS"                                           
     )                                                                 
     RETURN &rvalue                                                    
                                                                       
 
 
////////////////////////////////////////                               
//                                                                     
//            CREATEMENU                                                     
//            Creates dropdown menu for Qualcomm Scripts                  
//                                                                     
/////////////////////////////////////////                              
CREATEMENU:                                                            
 
		MENU.REPROGRAM
		(
			ADD 
			MENU 
			( 
				POPUP "[:CORRELATE]&Qualcomm Scripts" 
				( 
					POPUP "[:PSTEP]&aop" 
					( 
						POPUP "[:PSTEP]&aop" 
						( 
							MENUITEM "[:FLASH]&AOP Attach Actions " 
							( 
AOPATTACHACTIONS:
								LOCAL &invocationtype
								ENTRY &invocationtype
								do std_utils EXECUTESCRIPT ERRORHANDLE &METATOOLSDIR/../cmm/rpm/SDM670/aop_attach_actions.cmm 

								IF ("&invocationtype"=="BUTTONPROMPT")
								(
									RETURN
								)

							)
							MENUITEM "[:FLASH]&AOP Attach Actions " 
							( 
AOPDEATTACHACTIONS:
								LOCAL &invocationtype
								ENTRY &invocationtype
								do std_utils EXECUTESCRIPT ERRORHANDLE &METATOOLSDIR/../cmm/rpm/SDM670/aop_deattach_actions.cmm 

								IF ("&invocationtype"=="BUTTONPROMPT")
								(
									RETURN
								)

							)
							MENUITEM "[:FLASH]&Load Symbols " 
							( 
SYMBOLMANAGER-LOADSYMS:
								LOCAL &invocationtype
								ENTRY &invocationtype
								do std_utils EXECUTESCRIPT ERRORHANDLE &METATOOLSDIR/general/symbolmanager.cmm CDSP-Q6 all 

								IF ("&invocationtype"=="BUTTONPROMPT")
								(
									RETURN
								)

							)
							MENUITEM "[:FLASH]&Attach And Break Processor " 
							( 
ATTACHMANAGER-BREAK:
								LOCAL &invocationtype
								ENTRY &invocationtype
								do std_utils EXECUTESCRIPT ERRORHANDLE &METATOOLSDIR/general/attachmanager.cmm break SDM670 

								IF ("&invocationtype"=="BUTTONPROMPT")
								(
									RETURN
								)

							)
							MENUITEM "[:FLASH]&Load HWIO Symbols " 
							( 
MAINHWIOSCRIPT:
								LOCAL &invocationtype
								ENTRY &invocationtype
								do std_utils EXECUTESCRIPT ERRORHANDLE &METATOOLSDIR/../cmm/common/SDM670/hwio.cmm 

								IF ("&invocationtype"=="BUTTONPROMPT")
								(
									RETURN
								)

							)
							MENUITEM "[:FLASH]&Build Options " 
							( 
STDLOADBUILD:
								LOCAL &invocationtype
								ENTRY &invocationtype
								do std_utils EXECUTESCRIPT ERRORHANDLE &METATOOLSDIR/../cmm/common/SDM670/std_buildoptions.cmm 

								IF ("&invocationtype"=="BUTTONPROMPT")
								(
									RETURN
								)

							)
						) 
					) 
					POPUP "[:PSTEP]&general" 
					( 
						POPUP "[:PSTEP]&general" 
						( 
							MENUITEM "[:FLASH]&Attach And Break Processor " 
							( 
ATTACHMANAGER-BREAK:
								LOCAL &invocationtype
								ENTRY &invocationtype
								do std_utils EXECUTESCRIPT ERRORHANDLE &METATOOLSDIR/general/attachmanager.cmm break SDM670 

								IF ("&invocationtype"=="BUTTONPROMPT")
								(
									RETURN
								)

							)
							MENUITEM "[:FLASH]&Load Symbols " 
							( 
SYMBOLMANAGER-LOADSYMS:
								LOCAL &invocationtype
								ENTRY &invocationtype
								do std_utils EXECUTESCRIPT ERRORHANDLE &METATOOLSDIR/general/symbolmanager.cmm CDSP-Q6 all 

								IF ("&invocationtype"=="BUTTONPROMPT")
								(
									RETURN
								)

							)
							MENUITEM "[:FLASH]&Attach to bus (sys.m.prepare). " 
							( 
PREPARE:
								LOCAL &invocationtype
								ENTRY &invocationtype
								do std_utils EXECUTESCRIPT ERRORHANDLE &METATOOLSDIR/general/attachmanager.cmm prepare SDM670 

								IF ("&invocationtype"=="BUTTONPROMPT")
								(
									RETURN
								)

							)
							MENUITEM "[:FLASH]&Load HWIO Symbols " 
							( 
MAINHWIOSCRIPT:
								LOCAL &invocationtype
								ENTRY &invocationtype
								do std_utils EXECUTESCRIPT ERRORHANDLE &METATOOLSDIR/../cmm/common/SDM670/hwio.cmm 

								IF ("&invocationtype"=="BUTTONPROMPT")
								(
									RETURN
								)

							)
							MENUITEM "[:FLASH]&Build Options " 
							( 
STDLOADBUILD:
								LOCAL &invocationtype
								ENTRY &invocationtype
								do std_utils EXECUTESCRIPT ERRORHANDLE &METATOOLSDIR/../cmm/common/SDM670/std_buildoptions.cmm 

								IF ("&invocationtype"=="BUTTONPROMPT")
								(
									RETURN
								)

							)
							MENUITEM "[:FLASH]&Attach to Processor " 
							( 
ATTACHMANAGER-ATTACH:
								LOCAL &invocationtype
								ENTRY &invocationtype
								do std_utils EXECUTESCRIPT ERRORHANDLE &METATOOLSDIR/general/attachmanager.cmm attach SDM670 

								IF ("&invocationtype"=="BUTTONPROMPT")
								(
									RETURN
								)

							)
						) 
					) 
					POPUP "[:PSTEP]&qdss" 
					( 
						POPUP "[:PSTEP]&qdss" 
						( 
							MENUITEM "[:FLASH]&Dump ETB " 
							( 
DUMP_ETB:
								LOCAL &invocationtype
								ENTRY &invocationtype
								do std_utils EXECUTESCRIPT ERRORHANDLE &METATOOLSDIR/general/attachmanager.cmm attach SDM670 
								do std_utils EXECUTESCRIPT ERRORHANDLE &METATOOLSDIR/qdss/SDM670/dump_etb.cmm &TEMP/etb_dump.bin 

								IF ("&invocationtype"=="BUTTONPROMPT")
								(
									RETURN
								)

							)
						) 
					) 
					POPUP "[:PSTEP]&systemdrivers" 
					( 
						POPUP "[:PSTEP]&pmic" 
						( 
							MENUITEM "[:FLASH]&PMIC Dump " 
							( 
PMIC_DUMP:
								LOCAL &invocationtype
								ENTRY &invocationtype
								do std_utils EXECUTESCRIPT ERRORHANDLE &METATOOLSDIR/general/attachmanager.cmm attach SDM670 
								do std_utils EXECUTESCRIPT ERRORHANDLE &METATOOLSDIR/systemdrivers/pmic/hoya/PMICDump.cmm 

								IF ("&invocationtype"=="BUTTONPROMPT")
								(
									RETURN
								)

							)
							MENUITEM "[:FLASH]&PMIC Dashboard " 
							( 
PMIC_DASHBOARD:
								LOCAL &invocationtype
								ENTRY &invocationtype
								do std_utils EXECUTESCRIPT ERRORHANDLE &METATOOLSDIR/general/attachmanager.cmm attach SDM670 
								do std_utils EXECUTESCRIPT ERRORHANDLE &METATOOLSDIR/systemdrivers/pmic/hoya/PMICDashBoard.cmm 

								IF ("&invocationtype"=="BUTTONPROMPT")
								(
									RETURN
								)

							)
							MENUITEM "[:FLASH]&PMIC Warm Reset " 
							( 
PMIC_WARM_RESET:
								LOCAL &invocationtype
								ENTRY &invocationtype
								do std_utils EXECUTESCRIPT ERRORHANDLE &METATOOLSDIR/general/attachmanager.cmm attach SDM670 
								do std_utils EXECUTESCRIPT ERRORHANDLE &METATOOLSDIR/systemdrivers/pmic/PMICReset.cmm WARMRESET 

								IF ("&invocationtype"=="BUTTONPROMPT")
								(
									RETURN
								)

							)
							MENUITEM "[:FLASH]&PMIC Peek " 
							( 
PMIC_PEEK:
								LOCAL &invocationtype
								ENTRY &invocationtype
								do std_utils EXECUTESCRIPT ERRORHANDLE &METATOOLSDIR/general/attachmanager.cmm attach SDM670 
								do std_utils EXECUTESCRIPT ERRORHANDLE &METATOOLSDIR/systemdrivers/pmic/hoya/PMICPeek.cmm 

								IF ("&invocationtype"=="BUTTONPROMPT")
								(
									RETURN
								)

							)
							MENUITEM "[:FLASH]&PBUS Logger " 
							( 
PBUS_LOGGER:
								LOCAL &invocationtype
								ENTRY &invocationtype
								do std_utils EXECUTESCRIPT ERRORHANDLE &METATOOLSDIR/general/attachmanager.cmm attach SDM670 
								do std_utils EXECUTESCRIPT ERRORHANDLE &METATOOLSDIR/systemdrivers/pmic/hoya/PBUSLogger.cmm 

								IF ("&invocationtype"=="BUTTONPROMPT")
								(
									RETURN
								)

							)
							MENUITEM "[:FLASH]&PMIC Hard Reset " 
							( 
PMIC_HARD_RESET:
								LOCAL &invocationtype
								ENTRY &invocationtype
								do std_utils EXECUTESCRIPT ERRORHANDLE &METATOOLSDIR/general/attachmanager.cmm attach SDM670 
								do std_utils EXECUTESCRIPT ERRORHANDLE &METATOOLSDIR/systemdrivers/pmic/hoya/PMICReset.cmm HARDRESET 

								IF ("&invocationtype"=="BUTTONPROMPT")
								(
									RETURN
								)

							)
						) 
						POPUP "[:PSTEP]&vcs" 
						( 
							MENUITEM "[:FLASH]&VCS " 
							( 
VCS:
								LOCAL &invocationtype
								ENTRY &invocationtype
								do std_utils EXECUTESCRIPT ERRORHANDLE &METATOOLSDIR/systemdrivers/vcs/vcs.cmm 

								IF ("&invocationtype"=="BUTTONPROMPT")
								(
									RETURN
								)

							)
						) 
					) 
				) 
			) 
		) 
	
	RETURN SUCCESS


 
 
////////////////////////////////////////                               
//                                                                     
//            ADDMENUBUTTONS                                                     
//            Creates dropdown menu for Qualcomm Scripts                  
//                                                                     
/////////////////////////////////////////                              
ADDMENUBUTTONS:                                                            
	 
		 
			MENU.ADDTOOL "Assert AOP attach/detach options" "_,X,:on" "DO std_utils EXECUTESCRIPT ERRORHANDLE &METATOOLSDIR/SDM670/std_rootcmm_menu_CDSP-Q6_external.cmm ASSERTAOPGLOBALON BUTTONPROMPT"

			
			RETURN                                                            
 



 
 
////////////////////////////////////////                               
//                                                                     
//            HELP                                                     
//            Displays available tools for Qualcomm Scripts                  
//                                                                     
/////////////////////////////////////////                              
HELP:                                                            
 
		 
		AREA.CREATE QualcommScripts 107. 30.                        
		AREA.SELECT QualcommScripts                                             
		WINPOS 60% 29. 107. 30.                               
		AREA.VIEW QualcommScripts                                               
		                                                                 
		//HEADER "Qualcomm Scripts Help window"                         
		                                                                 
		                                                                 
		PRINT " ///////////////////////////////////////////////////////////////////"
		PRINT " /////////////////// Qualcomm Scripts Help //////////////////////////"
		PRINT " ///////////////////////////////////////////////////////////////////"
		PRINT " //" 
		PRINT " // The following are the available tools. " 
		PRINT " // Use the dropdown menu labeled Qualcomm Scripts " 
		PRINT " // To navigate to your desired script " 
		PRINT " //" 
		PRINT " ///////////////////////////////////////////////////////////////////"
		PRINT " //" 
		PRINT " //  AOPAttachActions       : Assert AOSSWPRUREQ" 
		PRINT " //  AOPDeAttachActions     : Detach and deassert AOSSWPRUREQ" 
		PRINT " //  AssertAOPGlobalOn      : Configures AOP window to assert AOSSWPRUREQ on attach" 
		PRINT " //  AttachManager-Attach   : Attach to a runningSDM670 CDSP-Q6" 
		PRINT " //  AttachManager-Break    : Attach and break on a SDM670 CDSP-Q6" 
		PRINT " //  Dump ETB               : Dump ETB" 
		PRINT " //  MainHWIOScript         : Load HWIO Symbols" 
		PRINT " //  PBUS Logger            : Logs and displays the SPMI/PBS transactions" 
		PRINT " //  PMIC Dashboard         : Displays PMIC power rails, clocks and GPIOs status" 
		PRINT " //  PMIC Dump              : Collects PMIC register dump" 
		PRINT " //  PMIC HARD RESET        : Does a PMIC Hard Reset" 
		PRINT " //  PMIC Peek              : Peek/poke PMIC registers" 
		PRINT " //  PMIC WARM RESET        : Does a PMIC Warm Reset" 
		PRINT " //  PostScriptPrompt       : None" 
		PRINT " //  SymbolManager-Loadsyms : Load symbols for CDSP-Q6" 
		PRINT " //  VCS                    : VCS Configuration" 
		PRINT " //  prepare                : Attach only to bus on a SDM670 CDSP-Q6" 
		PRINT " //  stdloadbuild           : Main build loading routine for cleaning and loading a build onto device" 
		PRINT " //" 
		PRINT " ///////////////////////////////////////////////////////////////////"


		RETURN                                                            
 



//In case a return was missed from above                                    
    RETURN                                                                  
                                                                            
EXIT:                                                                       
    LOCAL &rvalue                                                           
    ENTRY %LINE &rvalue                                                     
                                                                            
    //Clear any persistent variables needed                                 
    do std_cti_&CHIPSET CLEARSENTINELS                                      
                                                                            
    ENDDO &rvalue                                                           
                                                                            
                                                                            
//Should never get here.                                                    
FATALEXIT:                                                                  
    LOCAL &rvalue                                                           
    ENTRY %LINE &rvalue                                                     
    IF STRING.SCAN("&FAILUREKEYWORD","FAILUREKEYWORD",0)==-1                
    (                                                                       
        GOSUB EXIT &FAILUREKEYWORD - &rvalue                                
    )                                                                       
    ELSE                                                                    
    (                                                                       
        GOSUB EXIT &rvalue                                                  
    )                                                                       
                                                                            
//Should never get here                                                     
    END                                                                     

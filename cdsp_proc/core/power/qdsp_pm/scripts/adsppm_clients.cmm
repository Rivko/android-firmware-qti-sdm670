
;AREA.SELECT A000
;AREA.VIEW
LOCAL &Clients
&Clients="adsppm_clients_outputs"

;AREA.RESet

WINPOS 0. 0. 50% 100% , , , Clients
AREA.CREATE &Clients 256. 1024.
AREA.CLEAR &Clients
AREA.VIEW &Clients
AREA.SELECT &Clients

LOCAL &clientNode &clientName &clientId &coreId &clientType &client &clientClass
LOCAL &index &numClients &numClientsPrint

PRINT ""
PRINT "ADSPPM client list"
PRINT "------------------"
&clientNode=V.VALUE(gAdsppmClientManager.clients.link.pNext)
&numClients=V.VALUE(gAdsppmClientManager.clients.nCnt)
&numClientsPrint=FORMAT.DECIMAL(0,&numClients)
PRINT "Number of clients = &numClientsPrint"
&index=1
WHILE &index<=&numClients
(
    &client=&clientNode+8
    &clientId=FORMAT.DECIMAL(0,V.VALUE((*((AdsppmClientType *)&client)).clientId))
	PRINT "_______________________________________________________________"
    PRINT "clientId = &clientId"
    PRINT "  client = (AdsppmClientType)&client"
    &clientName=DATA.STRING(D:V.VALUE((*((AdsppmClientType *)&client)).clientName))
    PRINT "  clientName    = &clientName"
    &coreId=FORMAT.DECIMAL(0,V.VALUE((*((AdsppmClientType *)&client)).coreId))
    PRINT "  coreId        = &coreId"
    &clientType=FORMAT.DECIMAL(0,V.VALUE((*((AdsppmClientType *)&client)).periodicityType))
    PRINT "  clientType    = &clientType"
    &clientClass=FORMAT.DECIMAL(0,V.VALUE((*((AdsppmClientType *)&client)).clientClass))
    PRINT "  clientClass    = &clientClass"
    &useCaseActive=FORMAT.DECIMAL(0,V.VALUE((*((AdsppmClientType *)&client)).useCaseActiveFlag))
    PRINT "  useCaseActive    = &useCaseActive"
	&dcvsParticipation=FORMAT.DECIMAL(0,V.VALUE((*((AdsppmClientType *)&client)).dcvsParticipation.enable))
    PRINT "  DCVS Participation    = &dcvsParticipation"
	&streamIdMask=FORMAT.DECIMAL(0,V.VALUE((*((AdsppmClientType *)&client)).streamIdMask))
    PRINT "  Stream ID Mask    = &streamIdMask"
	
	
	
    &clientNode=V.VALUE((*((coreUtils_Q_LinkType *)&clientNode)).pNext)
    &index=&index+1
)


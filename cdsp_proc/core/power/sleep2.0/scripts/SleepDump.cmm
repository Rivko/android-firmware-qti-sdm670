;---------------------------------------------------------------------------
;  File: SleepDump.cmm
;  
;  Description: Dumps Sleep related data structures, optionally dumps sleep 
;               ulogs and merge them
;  
;               Copyright (c) 2016-2017 Qualcomm Technologies, Inc. (QTI).
;               All Rights Reserved.
;               Qualcomm Confidential and Proprietary.
;               Export of this technology or software is regulated by the U.S. Government.
;               Diversion contrary to U.S. law prohibited.
;---------------------------------------------------------------------------

;Path to the output file.
;The three options are for nolog, and/or nomerge. any ordering is fine
ENTRY &logPath &opt1 &opt2 &opt3 &opt4

;ULog time stamp
GLOBAL &output &curr_dir &resourceStr 
GLOBAL &str &op_path

;Local variables
LOCAL &temp &lprmName &ulogcall &uSleepulogcall &clprListPtr
LOCAL &fTable &fCnt &numElem &eCnt &elem
LOCAL &numMLUT &scriptDir
LOCAL &numFLUT &tmpCnt
LOCAL &logCnt &logName &numLogs

&curr_dir=os.pwd()

if "&logPath"==""
(
  ;Print a help message for srcipt
  AREA.Create SleepDumpHelp
  AREA.Select SleepDumpHelp
  AREA SleepDumpHelp

  ; no path to output provided.
  PRINT "Use: SleepDump.cmm <output_path> [config] [nolog] [nomerge] [npa] [rpmh] [all]"
  PRINT "  Optional arguments, 
  PRINT "  config  - default (for default directory structure)"
  PRINT "  nolog   - Sleep Ulogs will not be dumped"
  PRINT "            (Will set nomerge implicitly)"
  PRINT "  rpmh    - Dump RPMh log"
  PRINT "  nomerge - Sleep logs will not be merged"
  PRINT "  npa     - Also dump NPA state"
  PRINT "  all     - Dumps all ulogs"

  ENDDO
)

; fix any path issues for linux
GOSUB fix_filename &logPath
&op_path=PRACTICE.ARG(0.)

;---------------------------------------------------------------------------
; op_path is the path to output the file, 
; We will see if that directory already exist if not we try to create
; If it fails, we abort the script
;---------------------------------------------------------------------------
if !OS.DIR(&op_path)
(
  PRINT "Output path does not exist. Trying to create..."
  mkdir &op_path

  ; Error while creating output path
  if !OS.DIR(&op_path)
  (
    PRINT "Error: Failed to locate/create &(op_path). Exiting..."
    ENDDO
  )
)

; Opening a file for sleep dump at given output path
cd &op_path
&op_path=os.pwd()
cd &curr_dir

;-------------------------------------------------------------------------
; Processing the optional arguments
;
; Currently we are comparing all combination of last 4 arguments in order 
; to provide flexibility to specify option in any order. But try to find
; out if there is a way for command line arguments with varying numbers.
;-------------------------------------------------------------------------
&buildConfig="default"
&merge="true"
&log="true"
&npastate="false"
&rpmhdump="false"
&allDump="false"

if "&opt1"=="all"||"&opt2"=="all"||"&opt3"=="all"||"&opt4"=="all"
(
  &allDump="true"
  &log="true"
)

;if nomerge is passed as either option param
if "&opt1"=="nomerge"||"&opt2"=="nomerge"||"&opt3"=="nomerge"||"&opt4"=="nomerge"
(
  &merge="false"
)

;if npa is passed as either option param
if "&opt1"=="npa"||"&opt2"=="npa"||"&opt3"=="npa"||"&opt4"=="npa"
(
  &npastate="true"
)

if "&opt1"=="rpmh"||"&opt2"=="rpmh"||"&opt3"=="rpmh"||"&opt4"=="rpmh"
(
  &rpmhdump="true"
)

;if nolog is passed as either option param
;merge is implicitly declared as false when log is false, 
;because then theres only 1 or 0 logs, and there's nothing to merge
if "&opt1"=="nolog"||"&opt2"=="nolog"||"&opt3"=="nolog"||"&opt4"=="nolog"
(
  &log="false"
  &merge="false"
)

;-----------------------------------------------------------------------
; Constructing log call string and calling ulog dump on it based on
; build configuration
;-----------------------------------------------------------------------
;String to call ulog dump
&ulogcall="&(curr_dir)/../../../services/diag/diagbuffer/scripts/ULogDump.cmm"
&uSleepulogcall="&(curr_dir)/../../../services/diag/micro_diagbuffer/scripts/micro_ULogDump.cmm"

&resourceStr=""
;switching to appropriate directory to get sleep logs

IF symbol.exist(g_SleepNumOfFreqs)
  &numMLUT=V.VALUE(g_SleepNumOfFreqs)
ELSE
  &numMLUT=1

;Don't run if we passed the nolog param
if "&log"=="true"
(
  ; We may need a function that takes argument as build configuration
  ; (modem, apps) and number of cores sleep is running. Based on those
  ; two args, it calls ulog script for all sleep logs before actual 
  ; dumping starts
  if "&buildConfig"=="default"
  (
    &scriptDir="&(curr_dir)"

    if "&allDump"=="true"
    (
      DO &uSleepulogcall &op_path
      DO &ulogcall &op_path
    )
    else
    (
    
      ; Call micro ulog to dump logs from island section
      if V.VALUE(g_sleepEnabledFeatures & 0x0020)!=0
      (
        ; Call micro ulog to dump logs from island section
        &logCnt=0
        &numLogs=VAR.SIZEOF(g_uSleepLogs)/VAR.SIZEOF(g_uSleepLogs[0])
        while &logCnt<&numLogs
        (      
          &logName=DATA.STRING(D:V.VALUE(g_uSleepLogs[&logCnt].name))
          ;print "Dumping Log: &logName"
          DO &uSleepulogcall &op_path "&logName"
          &logCnt=&logCnt+1
        )

        ; Call ulog to dump logs from normal section
        &logCnt=0
        &numLogs=VAR.SIZEOF(g_uSleepDDRLogs)/VAR.SIZEOF(g_uSleepDDRLogs[0])
        while &logCnt<&numLogs
        (      
          &logName=DATA.STRING(D:V.VALUE(g_uSleepDDRLogs[&logCnt].name))
          ;print "Dumping Log: &logName"
          DO &ulogcall &op_path "&logName"
          &logCnt=&logCnt+1
        )
      )    

      ;calling ulog script to dump all sleep logs
      &logCnt=0
      while &logCnt<V.VALUE(g_sleepNumberOfLogs)
      (      
        &logName=DATA.STRING(D:V.VALUE(g_sleepLogNameArray[&logCnt]))
        ;print "Dumping Log: &logName"
        DO &ulogcall &op_path "&logName"
        &logCnt=&logCnt+1
      )
      
      ;Dump the PDC log as well
      DO &ulogcall &op_path "PDC Log"
    )
  )

  ; different configuration can go here like LPASS, sensors if they
  ; have different ulog call or logs than what we have for default
  
  if "&merge"=="true"
  (
    do &(scriptDir)/mergeLogs.cmm &(scriptDir) &op_path MergedSleepLogs.ulog
  )
)

;;
;; Dump all the internal sleep data
;;
cd &op_path
OPEN #1 "SleepDump.ulog" /Create
&output="WRITE #1"

GOSUB DumpSleepFeatures

GOSUB print_section_header "Observed Frequency List"

&numFLUT=0
&str=""
&fTable=V.VALUE((sleep_fLUT_node *)g_sleepFLUT)
while V.VALUE((sleep_fLUT_node *)&fTable)!=0
(             
  &temp=FORMAT.DECIMAL(0, V.VALUE(((sleep_fLUT_node *)&fTable)->frequency))
  &str="&(str) &(temp)"
  
  if V.VALUE(g_sleepEnabledFeatures & 0x0008)!=0
  (
    &tmpCnt=0
    while &tmpCnt<&numMLUT
    (
      &temp=V.VALUE(((sleep_fLUT_node *)&fTable)->frequency)
      if &temp==V.VALUE(SleepLPR_static_freq_list[&tmpCnt])
      (
        &str="&(str)*"
        &tmpCnt=&numMLUT
      )
      &tmpCnt=&tmpCnt+1
    )
  )
  
  &fTable=V.VALUE(((sleep_fLUT_node *)&fTable)->next)
  &numFLUT=&numFLUT+1
)
&output "&(str)"

&clprListPtr=V.VALUE(&g_LPRRegistry)
GOSUB DumpCLpr &clprListPtr

&resourceStr=""

GOSUB DumpSleepStats

GOSUB print_section_header "Lookup table element statistics"

&fCnt=0
while &fCnt<&numMLUT
( 
  if V.VALUE(g_sleepEnabledFeatures & 0x0008)!=0
  (
    &elem=FORMAT.DECIMAL(0, V.VALUE(SleepLPR_static_freq_list[&fCnt]))
  )
  else
  (
    &elem=0
  )

  &output "Table &fCnt, frequency &(elem)"

  &elem=V.VALUE((sleep_mLUT *)SleepLPR_power_lookup_table[&fCnt])
  &numElem=V.VALUE(((sleep_mLUT *)&elem)->num_elements)
  &eCnt=0
  while &eCnt<&numElem
  (
    &temp=V.VALUE(((sleep_mLUT *)&elem)->element)
    &temp=V.VALUE(&((sleep_mLUT_elem *)&temp)[&eCnt])
    GOSUB DumpLTElemStats &temp
    &output "&(str)"
    &eCnt=&eCnt+1
  )
  &output " "
  &fCnt=&fCnt+1
)

GOSUB print_section_header "Island statistics"
GOSUB print_island_data


;End Dump
CLOSE #1
PRINT "Sleep dump completed..."

;Dump the NPA state if option was given
if "&npastate"=="true"
(
  PRINT "Dumping NPA state..."
  &npacall="&(curr_dir)/../../npa/scripts/NPADump.cmm"
  DO &npacall &op_path state
)

if "&rpmhdump"=="true"
(
  PRINT "Dumping RPMh log..."  
  DO &ulogcall &op_path "RPMhDriverLog"
)


cd &(curr_dir)

ENDDO



;=================================================================
;                          Functions
;=================================================================

;-----------------------------------------------------------------
; Dumping a synthesized LPR. This function will gets called
; while dumping list of Syn LPRs.
;-----------------------------------------------------------------
DumpCLpr:
  ENTRY &clpr
  LOCAL &ptrSynthMode &ptrLpr &lprName &temp
  LOCAL &numSynthMode &numCacheComp &numUncacheComp
  LOCAL &it &jt

  &output " "
  GOSUB print_section_header "Known LPRs"
  
  if V.VALUE(((synthRegistry *)&clpr)->LPR)!=0
  (
    &numSynthMode=V.VALUE(((synthRegistry *)&clpr)->LPR->mode_count)

    &it=0
    while &it<&numSynthMode
    (
      &ptrSynthMode=V.VALUE(((synthRegistry *)&clpr)->LPR->modes + &it)
      
      ; Num of expected modes of ptrSynthMode
      &numCacheComp=V.VALUE(((sleep_synth_lprm *)&ptrSynthMode)->cacheable.num_component_modes)
      &numUncacheComp=V.VALUE(((sleep_synth_lprm *)&ptrSynthMode)->uncacheable.num_component_modes)
      
      &jt=0
      while &jt<&numCacheComp
      (
        &temp=V.VALUE(((sleep_synth_lprm *)&ptrSynthMode)->cacheable.component_modes + &jt)
        &temp=V.VALUE((sleep_lprm *)(*(sleep_lprm **)&temp))
        &ptrLpr=V.VALUE(((sleep_lprm *)&temp)->parent_LPR)
        IF &ptrLpr!=0 
        (
          &lprName=DATA.STRING(D:V.VALUE(((sleep_lpr *)&ptrLpr)->resource_name))
    
          if STRING.SCAN("&(resourceStr)", "$&(lprName)$", 0)==-1
          (
            GOSUB DumpSleepLpr &ptrLpr
            &resourceStr="&(resourceStr) $&(lprName)$"
          )
        )
        &jt=&jt+1
      )

      &jt=0
      while &jt<&numUncacheComp
      (
        &temp=V.VALUE(((sleep_synth_lprm *)&ptrSynthMode)->uncacheable.component_modes + &jt)
        &temp=V.VALUE((sleep_lprm *)(*(sleep_lprm **)&temp))
        &ptrLpr=V.VALUE(((sleep_lprm *)&temp)->parent_LPR)
        IF &ptrLpr!=0 
        (
          &lprName=DATA.STRING(D:V.VALUE(((sleep_lpr *)&ptrLpr)->resource_name))
    
          if STRING.SCAN("&(resourceStr)", "$&(lprName)$", 0)==-1
          (
            GOSUB DumpSleepLpr &ptrLpr
            &resourceStr="&(resourceStr) $&(lprName)$"
          )
        )
        &jt=&jt+1
      )
      &it=&it+1
    )
  )
  else
  (
    &output "!! NONE !!"
  )

  GOSUB print_section_header "Known LPIs"
  
  if V.VALUE(((synthRegistry *)&clpr)->LPI)!=0
  (
    &numSynthMode=V.VALUE(((synthRegistry *)&clpr)->LPI->mode_count)

    &it=0
    while &it<&numSynthMode
    (
      &ptrSynthMode=V.VALUE(((synthRegistry *)&clpr)->LPI->modes + &it)
      
      ; Num of expected modes of ptrSynthMode
      &numCacheComp=V.VALUE(((sleep_synth_lprm *)&ptrSynthMode)->cacheable.num_component_modes)
      
      ;uncacheable islands should be zero - just ignore this for now
      &numUncacheComp=V.VALUE(((sleep_synth_lprm *)&ptrSynthMode)->uncacheable.num_component_modes)
      
      &jt=0
      while &jt<&numCacheComp
      (
        &temp=V.VALUE(((sleep_synth_lprm *)&ptrSynthMode)->cacheable.component_modes + &jt)
        &temp=V.VALUE((sleep_lprm *)(*(sleep_lprm **)&temp))
        &ptrLpr=V.VALUE(((sleep_lprm *)&temp)->parent_LPR)
        IF &ptrLpr!=0 
        (
          &lprName=DATA.STRING(D:V.VALUE(((sleep_lpr *)&ptrLpr)->resource_name))
    
          if STRING.SCAN("&(resourceStr)", "$&(lprName)$", 0)==-1
          (
            GOSUB DumpSleepLpr &ptrLpr
            &resourceStr="&(resourceStr) $&(lprName)$"
          )
        )
        &jt=&jt+1
      )
      &it=&it+1
    )
  )
  else
  (
    &output "!! NONE !!"
  )

  GOSUB print_section_header "Synthesized modes"

  &numSynthMode=V.VALUE(((synthRegistry *)&clpr)->LPR->mode_count)
  &it=0
  while &it<&numSynthMode
  (
    &ptrSynthMode=V.VALUE(((synthRegistry *)&clpr)->LPR->modes + &it)
    
    GOSUB DumpSythMode &ptrSynthMode
    &it=&it+1
  )

  RETURN

;-----------------------------------------------------------------
; Dumping individual SynthModes
;-----------------------------------------------------------------
DumpSythMode:
  ENTRY &synthMode
  LOCAL &lprmName &componentLprms &status_val &status_string
  LOCAL &avg &totalTime &cycles &temp &seconds &start &end &tmpstr

  &lprmName=DATA.STRING(D:V.VALUE(((sleep_synth_lprm *)&synthMode)->name))
  &status_val=V.VALUE(((sleep_synth_lprm *)&synthMode)->mode_status)

  IF &status_val==0
    &status_string="Enabled"
  ELSE
    &status_string="Disabled"
  
  IF symbol.exist(g_solverAllowCacheable)
  (
    IF V.VALUE(g_solverAllowCacheable)==0
    (
      &status_string="&(status_string) (and disabled via cacheable allowed flag)"
    )
  )

  &output "                Mode: ""&(lprmName)"""
  &output "              Status: &(status_string)"
  
  &cycles=V.VALUE(((sleep_synth_lprm *)&synthMode)->synth_stats.cycles)
  &temp=FORMAT.DECIMALU(0, &cycles)
  &output "         Cycle Count: &(temp)"
  
  &start=V.VALUE(((sleep_synth_lprm *)&synthMode)->synth_stats.last_enter_timestamp)
  &end=V.VALUE(((sleep_synth_lprm *)&synthMode)->synth_stats.last_exit_timestamp)
  &output "Last Enter Timestamp: &(start)"
  &output " Last Exit Timestamp: &(end)"
  
  &temp=&end-&start
  &seconds=FORMAT.FLOAT(0, 3, (&temp/19200.0))
  &temp=FORMAT.DECIMALU(0, &temp)
  
  &output "        Last time in: &(temp)  (&(seconds) mS)"
  
  &totalTime=V.VALUE(((sleep_synth_lprm *)&synthMode)->synth_stats.in_mode_time)
  &seconds=FORMAT.FLOAT(0, 3, (&totalTime/19200000.0))
  &temp=FORMAT.DECIMALU(0, &totalTime)
  
  &output "       Total time in: &(temp)  (&(seconds) S)"
  
  if (0!=&cycles)
    &avg=&totalTime/&cycles
  else
    &avg=0
  
  &seconds=FORMAT.FLOAT(0, 3, (&avg/19200.0))
  &avg=FORMAT.DECIMALU(0, &avg)
  &output "         Avg time in: &(avg)  (&(seconds) mS)"
  
  &output " "
  
  RETURN


;---------------------------------------------------------------------------
; Dumps the sleep_lpr structure
;---------------------------------------------------------------------------
DumpSleepLpr:
  ENTRY &lprPtr
  LOCAL &aMode &modeAddress &index &tempStr &modeName

  &index=0
 
  &aMode=V.VALUE(((sleep_lpr *)&lprPtr)->modes + 1 )
  &lprName=DATA.STRING(D:V.VALUE(((sleep_lpr *)&lprPtr)->resource_name))
  &modeCount=V.VALUE(((sleep_lpr *)&lprPtr)->mode_count)
  &output "  Resource Name: &(lprName)"

  while &index<&modeCount
  (
    &aMode=V.VALUE(((sleep_lpr *)&lprPtr)->modes + &index )
    &modeName=DATA.STRING(D:V.VALUE(((sleep_lpr *)&aMode)->resource_name))
    PRINT "&(aMode) : &(lprName).&(modeName)"
    GOSUB DumpSleepLprm &aMode &index
    &index=&index+1
  )
  PRINT " "
  &output " "

  RETURN


;---------------------------------------------------------------------------
; Dumps sleep_lprm structure
;---------------------------------------------------------------------------
DumpSleepLprm:
  ENTRY &lprm &index
  LOCAL &modeName &temp
  LOCAL &modeStatus &intime &attrs &statusStr &registered

  &modeName=DATA.STRING(D:V.VALUE(((sleep_lprm *)&lprm)->mode_name))

  &modeStatus=V.VALUE(((sleep_lprm *)&lprm)->mode_enabled)
  IF &modeStatus==0
    &statusStr="Disabled"
  ELSE
    &statusStr="Enabled "

  &temp=FORMAT.DECIMAL(0, &index)
  &str="    Mode #&temp : (Name: "
  &temp=FORMAT.STRING("&(modeName)", 20., ' ')
  &str="&(str)&temp) (status: "
  
  &registered=V.VALUE( ((sleep_lpr *)(((sleep_lprm *)&lprm)->parent_LPR))->registered )
  if &registered==0
    &temp=FORMAT.STRING("NOT REG", 8., ' ')
  else    
    &temp=FORMAT.STRING("&(statusStr)", 8., ' ')
  
  &str="&(str)&temp)"

  &attrs=FORMAT.HEX(2, V.VALUE(((sleep_lprm *)&lprm)->attributes))
  &str="&(str) (Attribute: 0x&(attrs))"

  &output "&(str)"

  RETURN

;---------------------------------------------------------------------------
; Dumps lookup table stats
;---------------------------------------------------------------------------
DumpLTElemStats:
  ENTRY &ltelem
  LOCAL &dur &stats &min &max &temp
  
  &stats=V.VALUE( (sleepStats_generic *)&(((sleep_mLUT_elem *)&ltelem)->element_stats) )
  &dur=V.VALUE(((sleep_mLUT_elem *)&ltelem)->duration_thresh)
  &dur=FORMAT.DECIMAL(0, &dur);
  &str="  (Element: "
  &temp=FORMAT.STRING("&(dur))", -10., ' ')
  &str="&(str)&temp"
  
  &min=V.VALUE( ((sleepStats_generic *)&stats)->min )
  &min=FORMAT.DECIMAL(0, &min)
  &max=V.VALUE( ((sleepStats_generic *)&stats)->max )
  &max=FORMAT.DECIMAL(0, &max)
  &str="&(str)(Hit Range: "
  &temp=FORMAT.STRING("&(min) <-> &(max))", -27., ' ')
  &str="&(str)&temp"
    
  &tmp=V.VALUE( ((sleepStats_generic *)&stats)->count )
  &tmp=FORMAT.DECIMAL(0, &tmp)
  &str="&(str) (Count: &(tmp))"
  
  RETURN

;---------------------------------------------------------------------------
; Dumps sleep feature status
;---------------------------------------------------------------------------  
DumpSleepFeatures:
  
  GOSUB print_section_header "Sleep Features"
  
  &str="                 QDSS :"
  if V.VALUE(g_sleepEnabledFeatures & 0x0001)!=0
    &str="&(str) Enabled"
  else
    &str="&(str) Disabled"
  &output "&(str)"
  
  &str="         RSVD FEATURE :"
  if V.VALUE(g_sleepEnabledFeatures & 0x0002)!=0
    &str="&(str) Enabled"
  else
    &str="&(str) Disabled"
  &output "&(str)"
  
  &str=" Synth Backoff Adjust :"
  if V.VALUE(g_sleepEnabledFeatures & 0x0004)!=0
    &str="&(str) Enabled"
  else
    &str="&(str) Disabled"
  &output "&(str)"
  
  &str="    Frequency Scaling :"
  if V.VALUE(g_sleepEnabledFeatures & 0x0008)!=0
    &str="&(str) Enabled"
  else
    &str="&(str) Disabled"
  &output "&(str)"
  
  ;Flag is actually "disable modes" when set
  &str="    Sleep allow modes :"
  if V.VALUE(g_sleepEnabledFeatures & 0x0010)!=0
    &str="&(str) Disable by default"
  else
    &str="&(str) Enabled by default"
  &output "&(str) (Runtime changeable)"
  
  &str="               uSleep :"
  if V.VALUE(g_sleepEnabledFeatures & 0x0020)!=0
    &str="&(str) Enabled"
  else
    &str="&(str) Disabled"
  &output "&(str)"

  &str="         RSVD FEATURE :"
  if V.VALUE(g_sleepEnabledFeatures & 0x0040)!=0
    &str="&(str) Enabled"
  else
    &str="&(str) Disabled"
  &output "&(str)"

  &output " "
  
  RETURN
  
;---------------------------------------------------------------------------
; Dumps LPRM stats
;---------------------------------------------------------------------------
DumpSleepStats:
  LOCAL &SLT &num &numLPRM &i &j &lpr 
  LOCAL &fCnt &stats &temp &elem &str2
  LOCAL &count &total &idx &dynData

  LOCAL &nameSpace &latpad
  
  &nameSpace=28.
  &latpad=11.
 
  GOSUB print_section_header "Component Mode Statistics"

  &temp=FORMAT.STRING("     ", &nameSpace, ' ')
  &str="  &temp"
  &temp=FORMAT.STRING("CACHEABLE", -28., ' ')
  &str="&(str)&temp"
  &temp=FORMAT.STRING("UNCACHEABLE / ALT", -31., ' ')
  &str="&(str)&temp"
  &output "&(str)"
  
  
  &temp=FORMAT.STRING("MODE", &nameSpace, ' ')
  &str="  &temp"
  
  &temp=FORMAT.STRING("ENTER", -19., ' ')
  &str="&(str)&temp"
  
  &temp=FORMAT.STRING("EXIT", -13., ' ')
  &str="&(str)&temp"
  
  &temp=FORMAT.STRING("ENTER", -14., ' ')
  &str="&(str)&temp"
  
  &temp=FORMAT.STRING("EXIT", -14., ' ')
  &str="&(str)&temp"
  
  &temp=FORMAT.STRING("Profiler", -13., ' ')
  &str="&(str)&temp"
  
  &output "&(str)"
  
  &num=Var.SIZEOF(SleepLPR_LookupTable)/Var.SIZEOF(SleepLPR_LookupTable[0])
  &i=0
  while &i<&num
  ( 
    &SLT=V.VALUE((sleep_lpr *)SleepLPR_LookupTable[&i])
    
    &j=0
    &numLPRM=V.VALUE(((sleep_lpr *)&SLT)->mode_count)
    
    while &j<&numLPRM
    (
      &modeName=DATA.STRING(D:V.VALUE(((sleep_lpr *)&SLT)->resource_name))
      
      &lpr=V.VALUE((sleep_lpr *)&SLT)
      &elem=V.VALUE((sleep_lprm *)(((sleep_lpr *)&lpr)->modes) + &j)
      &temp=DATA.STRING(D:V.VALUE(((sleep_lprm *)&elem)->mode_name))
          
      &enterLat=V.VALUE(&((sleep_lprm *)&elem)->mode_statistics.enter_lat)
      &exitLat=V.VALUE(&((sleep_lprm *)&elem)->mode_statistics.exit_lat)

      &cacheEnterLat=V.VALUE(&((sleep_lprm *)&elem)->cacheable_mode_statistics.enter_lat)
      &cacheExitLat=V.VALUE(&((sleep_lprm *)&elem)->cacheable_mode_statistics.exit_lat)
      
      &modeName=FORMAT.STRING(" &(modeName).&(temp)", &nameSpace, ' ')
      &str=" &modeName"
      
      ;;Print MAX
      &temp=FORMAT.DECIMALU(&latpad, V.VALUE(((sleepStats_generic32 *)&cacheEnterLat)->max))
      &str="&(str)    Max: &temp "
      &temp=FORMAT.DECIMALU(&latpad, V.VALUE(((sleepStats_generic32 *)&cacheExitLat)->max))
      &str="&(str) &temp "

      &temp=FORMAT.DECIMALU(&latpad+1, V.VALUE(((sleepStats_generic32 *)&enterLat)->max))
      &str="&(str) &temp "
      &temp=FORMAT.DECIMALU(&latpad+1, V.VALUE(((sleepStats_generic32 *)&exitLat)->max))
      &str="&(str) &temp     "

      ;;Print profiled settings
      if (0==V.VALUE(((sleep_lprm *)&elem)->enter_profile_func))
        &str2="A / "
      else
        &str2="M / "
      
      if (0==V.VALUE(((sleep_lprm *)&elem)->exit_profile_func))
        &str2="&(str2)A"
      else
        &str2="&(str2)M"
        
      &str="&(str)&(str2)  "
      
      &output "&(str)"

      ;;Print MIN
      &str=" "
      &temp=FORMAT.STRING("  ", &nameSpace, ' ')
      &str="&(str)&temp"
      
      if (0xFFFFFFFF==V.VALUE(((sleepStats_generic32 *)&cacheEnterLat)->min))
      (
        &temp=FORMAT.DECIMAL(&latpad, V.VALUE(0))
      ) 
      else 
      (
        &temp=FORMAT.DECIMALU(&latpad, V.VALUE(((sleepStats_generic32 *)&cacheEnterLat)->min))
      )

      &str="&(str)    Min: &temp "
      
      if (0xFFFFFFFF==V.VALUE(((sleepStats_generic32 *)&cacheExitLat)->min))
      (
        &temp=FORMAT.DECIMALU(&latpad, V.VALUE(0))
      )
      else 
      (
        &temp=FORMAT.DECIMALU(&latpad, V.VALUE(((sleepStats_generic32 *)&cacheExitLat)->min))
      )      
      
      &str="&(str) &temp "
      
      if (0xFFFFFFFF==V.VALUE(((sleepStats_generic32 *)&enterLat)->min))
      (
        &temp=FORMAT.DECIMAL(&latpad+1, V.VALUE(0))
      ) 
      else 
      (
        &temp=FORMAT.DECIMALU(&latpad+1, V.VALUE(((sleepStats_generic32 *)&enterLat)->min))
      )

      &str="&(str) &temp "
      
      if (0xFFFFFFFF==V.VALUE(((sleepStats_generic32 *)&exitLat)->min))
      (
        &temp=FORMAT.DECIMALU(&latpad+1, V.VALUE(0))
      )
      else 
      (
        &temp=FORMAT.DECIMALU(&latpad+1, V.VALUE(((sleepStats_generic32 *)&exitLat)->min))
      )
      
      &str="&(str) &temp "
      &output "&(str)"
      
      ;;Print Average
      &str=" "
      &temp=FORMAT.STRING("  ", &nameSpace, ' ')
      &str="&(str)&temp"
      &count=V.VALUE(((sleepStats_generic32 *)&cacheEnterLat)->count)
      &total=V.VALUE(((sleepStats_generic32 *)&cacheEnterLat)->total)
      if &count!=0
        &avg=FORMAT.DECIMALU(&latpad, &total/&count)
      else
        &avg=FORMAT.DECIMALU(&latpad, 0)
      &str="&(str)    Avg: &avg "
      
      &count=V.VALUE(((sleepStats_generic32 *)&cacheExitLat)->count)
      &total=V.VALUE(((sleepStats_generic32 *)&cacheExitLat)->total)
      if &count!=0
        &avg=FORMAT.DECIMALU(&latpad, &total/&count)
      else
        &avg=FORMAT.DECIMALU(&latpad, 0)
      &str="&(str) &avg "
      
      &count=V.VALUE(((sleepStats_generic32 *)&enterLat)->count)
      &total=V.VALUE(((sleepStats_generic32 *)&enterLat)->total)
      if &count!=0
        &avg=FORMAT.DECIMALU(&latpad+1, &total/&count)
      else
        &avg=FORMAT.DECIMALU(&latpad+1, 0)
      &str="&(str) &avg "
      
      &count=V.VALUE(((sleepStats_generic32 *)&exitLat)->count)
      &total=V.VALUE(((sleepStats_generic32 *)&exitLat)->total)
      if &count!=0
        &avg=FORMAT.DECIMALU(&latpad+1, &total/&count)
      else
        &avg=FORMAT.DECIMALU(&latpad+1, 0)
      &str="&(str) &avg "
      
      &output "&(str)"
      
      ;;Print Total
      &str=" "
      &temp=FORMAT.STRING("  ", &nameSpace, ' ')
      &str="&(str)&temp"
      &temp=FORMAT.DECIMALU(&latpad, V.VALUE(((sleepStats_generic32 *)&cacheEnterLat)->total))
      &str="&(str)  Total: &temp "
      &temp=FORMAT.DECIMALU(&latpad, V.VALUE(((sleepStats_generic32 *)&cacheExitLat)->total))
      &str="&(str) &temp "
      &temp=FORMAT.DECIMALU(&latpad+1, V.VALUE(((sleepStats_generic32 *)&enterLat)->total))
      &str="&(str) &temp "
      &temp=FORMAT.DECIMALU(&latpad+1, V.VALUE(((sleepStats_generic32 *)&exitLat)->total))
      &str="&(str) &temp "
      &output "&(str)"
      
      ;;Print Count
      &str=" "
      &temp=FORMAT.STRING("  ", &nameSpace, ' ')
      &str="&(str)&temp"
      &temp=FORMAT.DECIMALU(&latpad, V.VALUE(((sleepStats_generic32 *)&cacheEnterLat)->count))
      &str="&(str)  Count: &temp "
      &temp=FORMAT.DECIMALU(&latpad, V.VALUE(((sleepStats_generic32 *)&cacheExitLat)->count))
      &str="&(str) &temp "
      &temp=FORMAT.DECIMALU(&latpad+1, V.VALUE(((sleepStats_generic32 *)&enterLat)->count))
      &str="&(str) &temp "
      &temp=FORMAT.DECIMALU(&latpad+1, V.VALUE(((sleepStats_generic32 *)&exitLat)->count))
      &str="&(str) &temp "
      &output "&(str)"
      
      ;;Print timestamps
      &str=" "
      &output "&(str)"
      &temp=FORMAT.STRING("  ", &nameSpace-9, ' ')
      &str="&(str)&temp"
      &temp=FORMAT.HEX(16., V.VALUE(((sleep_lprm *)&elem)->cacheable_mode_statistics.last_enter_start))
      &str="&(str)Last enter start:       0x&temp"
      &temp=FORMAT.HEX(16., V.VALUE(((sleep_lprm *)&elem)->mode_statistics.last_enter_start))
      &str="&(str)          0x&temp"
      &output "&(str)"
      
      &str=" "
      &temp=FORMAT.STRING("  ", &nameSpace-8, ' ')
      &str="&(str)&temp"
      &temp=FORMAT.HEX(16., V.VALUE(((sleep_lprm *)&elem)->cacheable_mode_statistics.last_enter_end))
      &str="&(str) Last enter end:       0x&temp"
      &temp=FORMAT.HEX(16., V.VALUE(((sleep_lprm *)&elem)->mode_statistics.last_enter_end))
      &str="&(str)          0x&temp"
      &output "&(str)"
      
      &str=" "
      &temp=FORMAT.STRING("  ", &nameSpace-8, ' ')
      &str="&(str)&temp"
      &temp=FORMAT.HEX(16., V.VALUE(((sleep_lprm *)&elem)->cacheable_mode_statistics.last_exit_start))
      &str="&(str)Last exit start:       0x&temp"
      &temp=FORMAT.HEX(16., V.VALUE(((sleep_lprm *)&elem)->mode_statistics.last_exit_start))
      &str="&(str)          0x&temp"
      &output "&(str)"
      
      &str=" "
      &temp=FORMAT.STRING("  ", &nameSpace-8, ' ')
      &str="&(str)&temp"
      &temp=FORMAT.HEX(16., V.VALUE(((sleep_lprm *)&elem)->cacheable_mode_statistics.last_exit_end))
      &str="&(str)  Last exit end:       0x&temp"
      &temp=FORMAT.HEX(16., V.VALUE(((sleep_lprm *)&elem)->mode_statistics.last_exit_end))
      &str="&(str)          0x&temp"
      &output "&(str)"

      &j=&j+1
      &output " "
    )
    &str=FORMAT.STRING("  ", &nameSpace+9, '=')
    &output "&str"
    &i=&i+1
  )
  &output " "

  RETURN  

fix_filename:
   PRIVATE &name
   &name=PRACTICE.ARG(0.)   ;get the file name string passed by GOSUB
                            ;create an array with 'illegal' characters
                            
   Var.NEWLOCAL char[16] \replace_these = "\\"
   Var.NEWLOCAL int \i = 0;
   
   Var.WHILE \replace_these[\i]!=0
   (
      PRIVATE &search_str
      &search_str=""+CONVert.CHAR(Var.VALUE(\replace_these[\i++]))
      &name=STRing.Replace("&name", "&search_str", "/", 0.)
   )   
   
   RETURN "&name"  ;return the cleaned file name to the caller
   
print_section_header:
  ENTRY &hdrTxt
  LOCAL &strHdr &hdr
  
  &strHdr=STRING.TRIM(FORMAT.STRING(&hdrTxt,40, ' '))
  &hdr=FORMAT.STRING("*", 40., '*')
  &output "&(hdr)"
  &output "* &(strHdr)"
  &output "&(hdr)"

  RETURN
  
print_island_data:
  LOCAL &dur &stats &min &max &temp &count &total &transStats &avg
  LOCAL &maxseconds &minseconds &lasttimeseconds &totalseconds &avgseconds &ltmax &ltmin
  LOCAL &lifetime
  IF symbol.exist(g_uSleepData)
  (
    &temp=V.VALUE(g_uSleepData.state)
    &transStats=V.VALUE(&g_uSleepData.transition_data)
    
    &output "        Current state: &(temp)"
    &temp=FORMAT.DECIMALU(0.,V.VALUE(((uSleep_transition_profiling*)&transStats)->entry_latency))
    &output "Current enter latency: &(temp)"
    &temp=FORMAT.DECIMALU(0.,V.VALUE(((uSleep_transition_profiling*)&transStats)->exit_latency))
    &output " Current exit latency: &(temp)"
    &output " "
    
    &stats=V.VALUE(&((uSleep_transition_profiling*)&transStats)->time_in_island)
    if (0xFFFFFFFFFFFFFFFF==V.VALUE(((sleepStats_generic*)&stats)->min))
      &min=FORMAT.DECIMAL(0., V.VALUE(0))
    else
      &min=FORMAT.DECIMALU(0., V.VALUE(((sleepStats_generic*)&stats)->min))
    
    &minseconds=FORMAT.FLOAT(0, 3, (V.VALUE(((sleepStats_generic*)&stats)->min)/19200.0))
    
    &max=FORMAT.DECIMALU(0., V.VALUE(((sleepStats_generic*)&stats)->max))
    &maxseconds=FORMAT.FLOAT(0, 3, (V.VALUE(((sleepStats_generic*)&stats)->max)/19200.0))
    
    &count=FORMAT.DECIMALU(0., V.VALUE(((sleepStats_generic*)&stats)->count))
    &total=FORMAT.DECIMALU(0., V.VALUE(((sleepStats_generic*)&stats)->total))
    &totalseconds=FORMAT.FLOAT(0, 4, (V.VALUE(((sleepStats_generic*)&stats)->total)/19200000.0))
    
    &temp=FORMAT.DECIMALU(0., V.VALUE(((uSleep_transition_profiling*)&transStats)->last_time_in_island))
    &lasttimeseconds=FORMAT.FLOAT(0, 3, (V.VALUE(((uSleep_transition_profiling*)&transStats)->last_time_in_island)/19200.0))
    
    if &count!=0
      &avg=&total/&count
    else
      &avg=0
    &avgseconds=FORMAT.FLOAT(0, 4, &avg/19200.0)
    &avg=FORMAT.DECIMALU(0, &avg)
    
    &output "Time spent in island"
    &output "     Last cycle time: &(temp) (&(lasttimeseconds) mS)"
    &output "            Min time: &(min) (&(minseconds) mS)"
    &output "            Max time: &(max) (&(maxseconds) mS)"
    &output "               Total: &(total) (&(totalseconds) S)"
    &output "               Count: &(count)"
    &output "            Avg time: &(avg) (&(avgseconds) mS)"
    
    &output " "
    
    &stats=V.VALUE(&((uSleep_transition_profiling*)&transStats)->entry_stats)
    &lifetime=V.VALUE(&((uSleep_transition_profiling*)&transStats)->lifetime_enter)
    &min=FORMAT.DECIMALU(0., V.VALUE(((sleepStats_generic*)&stats)->min))
    &max=FORMAT.DECIMALU(0., V.VALUE(((sleepStats_generic*)&stats)->max))
    &count=FORMAT.DECIMALU(0., V.VALUE(((sleepStats_generic*)&stats)->count))
    &total=FORMAT.DECIMALU(0., V.VALUE(((sleepStats_generic*)&stats)->total))
    &ltmin=V.VALUE(((lifetime_stats*)&lifetime)->min)
    &ltmax=V.VALUE(((lifetime_stats*)&lifetime)->max)
    
    if &count!=0
      &avg=V.VALUE(((sleepStats_generic*)&stats)->total)/&count
    else
      &avg=0
    &avg=FORMAT.DECIMALU(0, &avg)
    
    if &ltmin==-1
      &ltmin=0
    
    if &ltmax==-1
      &ltmax=0
    
    &ltmin=FORMAT.DECIMALU(0., &ltmin)
    &ltmax=FORMAT.DECIMALU(0., &ltmax)
    
    &output "Entry transition cycle stats"
    &output "                 Min Latency: &(min)"
    &output "                 Max Latency: &(max)"
    &output "                       Total: &(total)"
    &output "                       Count: &(count)"
    &output "                 Avg Latency: &(avg)"
    &output "-----------------------------"
    &output "                Lifetime min: &(ltmin)"
    &output "                Lifetime max: &(ltmax)"
    &output " "
    
    &stats=V.VALUE(&((uSleep_transition_profiling*)&transStats)->exit_stats)
    &lifetime=V.VALUE(&((uSleep_transition_profiling*)&transStats)->lifetime_exit)    
    &min=FORMAT.DECIMALU(0., V.VALUE(((sleepStats_generic*)&stats)->min))
    &max=FORMAT.DECIMALU(0., V.VALUE(((sleepStats_generic*)&stats)->max))
    &count=FORMAT.DECIMALU(0., V.VALUE(((sleepStats_generic*)&stats)->count))
    &total=FORMAT.DECIMALU(0., V.VALUE(((sleepStats_generic*)&stats)->total))
    &ltmin=V.VALUE(((lifetime_stats*)&lifetime)->min)
    &ltmax=V.VALUE(((lifetime_stats*)&lifetime)->max)
    
    if &count!=0
      &avg=V.VALUE(((sleepStats_generic*)&stats)->total)/&count
    else
      &avg=0
    &avg=FORMAT.DECIMALU(0, &avg)
    
    if &ltmin==-1
      &ltmin=0
    
    if &ltmax==-1
      &ltmax=0
    
    &ltmin=FORMAT.DECIMALU(0., &ltmin)
    &ltmax=FORMAT.DECIMALU(0., &ltmax)
    
    &output "Exit transition cycle stats"
    &output "                Min Latency: &(min)"
    &output "                Max Latency: &(max)"
    &output "                      Total: &(total)"
    &output "                      Count: &(count)"
    &output "                Avg Latency: &(avg)"
    &output "-----------------------------"
    &output "                Lifetime min: &(ltmin)"
    &output "                Lifetime max: &(ltmax)"
    &output " "
    &temp=FORMAT.DECIMALU(0.,V.VALUE(((uSleep_transition_profiling*)&transStats)->adjust_count))
    &output "Current adjust count: &(temp)"
  )
  else
  (
    &output "!! NONE !!"
  )

  RETURN
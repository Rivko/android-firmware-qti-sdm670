
;============================================================================
;
; *************** THIS SCRIPT WAS AUTOGENERATED ****************
;
; TARGET
;
;
; SCRIPT
;   TESTPLL.CMM
;
; GENERAL DESCRIPTION
;   This script can be used to lookup PLL config/status/frequency values.
;
; FUNCTIONS
;   N/A
;
;    Copyright (c) 2015 by QUALCOMM Technologies Inc.  All Rights Reserved.
;============================================================================


;-----------------------------------------------------------------------------
; Local variables
;-----------------------------------------------------------------------------

local &clk_err
local &success
local &chipset_name
local &testpll_main_area
local &log_filename
local &logging

local &subscript
local &pre_div
local &post_div
local &access_mode

; PLLs available in this version of the script
local &pll0
local &pll1
local &pll2
local &pll3
local &pll4
local &pll5
local &pll6
local &pll7
local &pll8
local &pll9
local &pll10
local &pll11
local &pll12
local &pll13
local &pll14
local &pll15
local &pll16
local &pll17
local &pll18
local &pll19
local &pll20
local &pll21
local &pll22


;-----------------------------------------------------------------------------
; Go initialize constants
;-----------------------------------------------------------------------------

goto Init_Constants
Init_Constants_Done:


;-----------------------------------------------------------------------------
; Parse commandline arguments
;-----------------------------------------------------------------------------

; These arguments are passed in from testclock.cmm to enable a PLL
&testpll_cmd_arg0=""
&testpll_cmd_arg1=""

ENTRY &testpll_cmd_arg0 &testpll_cmd_arg1

if ("&testpll_cmd_arg0"=="on")||("&testpll_cmd_arg0"=="off")
(
  &pll_on_off_choice="&testpll_cmd_arg0"
  &pll_name_choice="&testpll_cmd_arg1"
  
  gosub Enable_Disable_PLL
  
  ; Nothing else to be done
  goto SCRIPT_END
)

;-----------------------------------------------------------------------------
; Define the window
;-----------------------------------------------------------------------------

; Check if testpll was invoked by another script ('super_script_area' mode).
&testpll_main_area=string.ScanAndExtract("&testpll_cmd_arg0", "super_script_area=", "TESTPLL")

; Create new areas.
if ("&testpll_main_area"=="TESTPLL")
(
  &subscript=0
  gosub wa_area_create_list 1 &testpll_main_area 180. 1000.
  entry &success

  if (&success==0)
  (
    area.select
    print %ERROR "ERROR: Failed to create areas for testclock.cmm."
    enddo FALSE()
  )
)
else
(
  &subscript=1
)

; Create a new window if needed.
if (WIN.EXIST("testpll_main_window")==FALSE())
(
  local &x_start
  local &y_start
  local &x_len
  local &y_len

  ; Check if there are previously saved window settings.
  gosub wa_find_saved_window_settings testpll_main_window
  entry &x_start &y_start &x_len &y_len

  if (&x_start!=-1)
  (
    ; Use the previous window settings.
    winpos &x_start &y_start &x_len &y_len 0. 0. testpll_main_window
  )
  else
  (
    gosub Default_WINPOS_Main
  )
)

AREA.view &testpll_main_area
AREA.Select &testpll_main_area


;-----------------------------------------------------------------------------
; Generic Top-Level Error Handler
;-----------------------------------------------------------------------------

on ERROR gosub
(
  print %ERROR "ERROR: Caught error in 'testpll.cmm'."
  return
)


;-----------------------------------------------------------------------------
; Main Menu
;-----------------------------------------------------------------------------

print " "
print " "
print "[-------------------- [&chipset_name] TEST PLL --------------------]"
print " "

gosub Display_Help  ; print help message upon launch

&logging=0

Main_Loop:
(
  print " "
  print "[testpll.cmm] Version: <04/30/2015>" 
  print "Enter command (? for help):"
  enter &choice
  print " "

  gosub wa_save_window_settings testpll_main_window

  if ("&choice"=="?")
  (
    gosub Display_Help
  )
  else if ("&choice"=="x")
  (
    winclear testpll_main_window

    if (&logging!=0)
    (
      area.close &testpll_main_area
    )

    area.select   ; select default area

    print "Exited [&chipset_name] 'testpll.cmm'."
    enddo TRUE()
  )
  else if ("&choice"=="log")
  (
    gosub Open_Output_Log
  )
  else if ("&choice"=="wr")
  (
    ; Reset the window size/position to default settings.
    winclear testpll_main_window

    gosub Default_WINPOS_Main
    area.view &testpll_main_area
  )
  else if ("&choice"=="1")
  (
    gosub Display_Configurations
  )
  else if ("&choice"=="2")
  (
    gosub Display_Votes
  )
  else if ("&choice"=="3")
  (
    gosub Display_Dump
  )
  else if ("&choice"=="4")
  (
    gosub Configure_PLL_Enter
  )
  else if ("&choice"=="5")
  (
    gosub Enable_Disable_PLL_Enter
  )
  else if ("&choice"=="6")
  (
    gosub Route_PLL_To_Pad
  )
  else
  (
    print %ERROR "ERROR: Invalid command '&choice'. Enter '?' for help."
  )

  goto Main_Loop
)

Display_Help:
(
  print " "
  print "*** Commands ***"
  print " "
  print " 1   : Configurations."
  print " 2   : Votes."
  print " 3   : Register Dump."
  print " 4   : Configure PLLs.         [beta]"
  print " 5   : Turn PLLs on/off.       [beta]"
  print " 6   : Route PLLs to test pad. [beta]"
  print " "
  print " log : Start logging output to a file."
  print " x   : Exit."
  print " wr  : Reset window size/position."
  print " "

  return
)

Default_WINPOS_Main:
(
  winpos 0. 0. 50% 100% 0. 0. testpll_main_window
  return
)

;
; Begins logging output to a file.
;
Open_Output_Log:
(
  ; Check if an output log is already open.
  if (&logging==0)
  (
    print "Enter log file [c:\temp\testpll.log]: "
    enter &log_filename

    if ("&log_filename"=="")
    (
      &log_filename="c:\temp\testpll.log"
    )
    print "Logging output to '&log_filename'."

    ; Open the output log.
    (
      ON ERROR gosub
      (
        print %ERROR "ERROR: Failed to open clock output log '&log_filename'."
        &clk_err="failed_to_open_output_log"
        return
      )

      &clk_err=""
      area.open &testpll_main_area &log_filename
    )

    if ("&clk_err"!="failed_to_open_output_log")
    (
      &logging=1
    )
  )
  else
  (
    ; Does not currently support multiple output logs per single session.
    print "Already logging output to '&log_filename'. The log will close upon 'x' exit."
  )

  return
)

;-----------------------------------------------------------------------------
; Initialize constants
;-----------------------------------------------------------------------------

Init_Constants:

  ; Chipset Name
  &chipset_name="msm8998"

  ; Access mode
  &access_mode="ezaxi"

  ; L, M, N, ALPHA, ALPHA_U mask values
  &HWIO_PLL_L_VAL_MASK=0xFFFF
  &HWIO_PLL_M_VAL_MASK=0x7FFFF
  &HWIO_PLL_N_VAL_MASK=0x7FFFF
  &HWIO_PLL_ALPHA_VAL_MASK=0xFFFFFFFF
  &HWIO_PLL_ALPHA_U_VAL_MASK=0xFF

  ; PLL vote registers
  &HWIO_GCC_SPARE1_GPLL_ENA_VOTE_ADDR=0x15a000
  &HWIO_GCC_MSS_Q6_GPLL_ENA_VOTE_ADDR=0x135000
  &HWIO_GCC_LPASS_DSP_GPLL_ENA_VOTE_ADDR=0x155000
  &HWIO_GCC_SPARE2_GPLL_ENA_VOTE_ADDR=0x169000
  &HWIO_GCC_HYP_GPLL_ENA_VOTE_ADDR=0x156000
  &HWIO_GCC_SPARE_GPLL_ENA_VOTE_ADDR=0x157000
  &HWIO_GCC_APCS_TZ_GPLL_ENA_VOTE_ADDR=0x153000
  &HWIO_GCC_APCS_GPLL_ENA_VOTE_ADDR=0x152000
  &HWIO_GCC_RPM_GPLL_ENA_VOTE_ADDR=0x151000
  &HWIO_GCC_SSC_GPLL_ENA_VOTE_ADDR=0x154000
  &HWIO_LPASS_LPA_PLL_VOTE_APPS_ADDR=0x17005000
  &HWIO_LPASS_LPA_PLL_VOTE_LPASS_HW_ADDR=0x17007000
  &HWIO_LPASS_LPA_PLL_VOTE_LPASSQ6_ADDR=0x17006000
  &HWIO_MMSS_PLL_VOTE_APCS_ADDR=0xc8c01e0
  &HWIO_MMSS_PLL_VOTE_RPM_ADDR=0xc8c4000

  ; GPLL0 registers
  &HWIO_GCC_GPLL0_MODE_ADDR=0x100000
  &HWIO_GCC_GPLL0_L_VAL_ADDR=0x100004
  &HWIO_GCC_GPLL0_USER_CTL_ADDR=0x10000c
  &HWIO_GCC_GPLL0_USER_CTL_U_ADDR=0x100010
  &HWIO_GCC_GPLL0_CONFIG_CTL_ADDR=0x100014
  &HWIO_GCC_GPLL0_TEST_CTL_ADDR=0x10001c
  &HWIO_GCC_GPLL0_TEST_CTL_U_ADDR=0x100020
  &HWIO_GCC_GPLL0_STATUS_ADDR=0x100024
  &HWIO_GCC_GPLL0_FRAC_VAL_ADDR=0x100038

  ; GPLL1 registers
  &HWIO_GCC_GPLL1_MODE_ADDR=0x101000
  &HWIO_GCC_GPLL1_L_VAL_ADDR=0x101004
  &HWIO_GCC_GPLL1_USER_CTL_ADDR=0x10100c
  &HWIO_GCC_GPLL1_USER_CTL_U_ADDR=0x101010
  &HWIO_GCC_GPLL1_CONFIG_CTL_ADDR=0x101014
  &HWIO_GCC_GPLL1_TEST_CTL_ADDR=0x10101c
  &HWIO_GCC_GPLL1_TEST_CTL_U_ADDR=0x101020
  &HWIO_GCC_GPLL1_STATUS_ADDR=0x101024
  &HWIO_GCC_GPLL1_FRAC_VAL_ADDR=0x101038

  ; GPLL2 registers
  &HWIO_GCC_GPLL2_MODE_ADDR=0x102000
  &HWIO_GCC_GPLL2_L_VAL_ADDR=0x102004
  &HWIO_GCC_GPLL2_USER_CTL_ADDR=0x10200c
  &HWIO_GCC_GPLL2_USER_CTL_U_ADDR=0x102010
  &HWIO_GCC_GPLL2_CONFIG_CTL_ADDR=0x102014
  &HWIO_GCC_GPLL2_TEST_CTL_ADDR=0x10201c
  &HWIO_GCC_GPLL2_TEST_CTL_U_ADDR=0x102020
  &HWIO_GCC_GPLL2_STATUS_ADDR=0x102024
  &HWIO_GCC_GPLL2_FRAC_VAL_ADDR=0x102038

  ; GPLL3 registers
  &HWIO_GCC_GPLL3_MODE_ADDR=0x103000
  &HWIO_GCC_GPLL3_L_VAL_ADDR=0x103004
  &HWIO_GCC_GPLL3_USER_CTL_ADDR=0x10300c
  &HWIO_GCC_GPLL3_USER_CTL_U_ADDR=0x103010
  &HWIO_GCC_GPLL3_CONFIG_CTL_ADDR=0x103014
  &HWIO_GCC_GPLL3_TEST_CTL_ADDR=0x10301c
  &HWIO_GCC_GPLL3_TEST_CTL_U_ADDR=0x103020
  &HWIO_GCC_GPLL3_STATUS_ADDR=0x103024
  &HWIO_GCC_GPLL3_FRAC_VAL_ADDR=0x103038

  ; GPLL4 registers
  &HWIO_GCC_GPLL4_MODE_ADDR=0x177000
  &HWIO_GCC_GPLL4_L_VAL_ADDR=0x177004
  &HWIO_GCC_GPLL4_USER_CTL_ADDR=0x17700c
  &HWIO_GCC_GPLL4_USER_CTL_U_ADDR=0x177010
  &HWIO_GCC_GPLL4_CONFIG_CTL_ADDR=0x177014
  &HWIO_GCC_GPLL4_TEST_CTL_ADDR=0x17701c
  &HWIO_GCC_GPLL4_TEST_CTL_U_ADDR=0x177020
  &HWIO_GCC_GPLL4_STATUS_ADDR=0x177024
  &HWIO_GCC_GPLL4_FRAC_VAL_ADDR=0x177038

  ; GPLL5 registers
  &HWIO_GCC_GPLL5_MODE_ADDR=0x174000
  &HWIO_GCC_GPLL5_L_VAL_ADDR=0x174004
  &HWIO_GCC_GPLL5_USER_CTL_ADDR=0x17400c
  &HWIO_GCC_GPLL5_USER_CTL_U_ADDR=0x174010
  &HWIO_GCC_GPLL5_CONFIG_CTL_ADDR=0x174014
  &HWIO_GCC_GPLL5_TEST_CTL_ADDR=0x17401c
  &HWIO_GCC_GPLL5_TEST_CTL_U_ADDR=0x174020
  &HWIO_GCC_GPLL5_STATUS_ADDR=0x174024
  &HWIO_GCC_GPLL5_FRAC_VAL_ADDR=0x174038

  ; GPLL6 registers
  &HWIO_GCC_GPLL6_MODE_ADDR=0x113000
  &HWIO_GCC_GPLL6_L_VAL_ADDR=0x113004
  &HWIO_GCC_GPLL6_USER_CTL_ADDR=0x11300c
  &HWIO_GCC_GPLL6_USER_CTL_U_ADDR=0x113010
  &HWIO_GCC_GPLL6_CONFIG_CTL_ADDR=0x113014
  &HWIO_GCC_GPLL6_TEST_CTL_ADDR=0x11301c
  &HWIO_GCC_GPLL6_TEST_CTL_U_ADDR=0x113020
  &HWIO_GCC_GPLL6_STATUS_ADDR=0x113024
  &HWIO_GCC_GPLL6_FRAC_VAL_ADDR=0x113038

  ; GPLL7 registers
  &HWIO_GCC_GPLL7_MODE_ADDR=0x106000
  &HWIO_GCC_GPLL7_L_VAL_ADDR=0x106004
  &HWIO_GCC_GPLL7_USER_CTL_ADDR=0x106008
  &HWIO_GCC_GPLL7_USER_CTL_U_ADDR=0x10600c
  &HWIO_GCC_GPLL7_CONFIG_CTL_ADDR=0x106010
  &HWIO_GCC_GPLL7_TEST_CTL_ADDR=0x106018
  &HWIO_GCC_GPLL7_TEST_CTL_U_ADDR=0x10601c
  &HWIO_GCC_GPLL7_STATUS_ADDR=0x106020

  ; GPU_PLL0_PLL registers
  &HWIO_GPUCC_GPU_PLL0_PLL_MODE_ADDR=0x5065000
  &HWIO_GPUCC_GPU_PLL0_PLL_L_VAL_ADDR=0x5065004
  &HWIO_GPUCC_GPU_PLL0_PLL_USER_CTL_ADDR=0x506500c
  &HWIO_GPUCC_GPU_PLL0_PLL_USER_CTL_U_ADDR=0x5065010
  &HWIO_GPUCC_GPU_PLL0_PLL_CONFIG_CTL_ADDR=0x5065014
  &HWIO_GPUCC_GPU_PLL0_PLL_TEST_CTL_ADDR=0x506501c
  &HWIO_GPUCC_GPU_PLL0_PLL_TEST_CTL_U_ADDR=0x5065020
  &HWIO_GPUCC_GPU_PLL0_PLL_STATUS_ADDR=0x5065024
  &HWIO_GPUCC_GPU_PLL0_PLL_FRAC_VAL_ADDR=0x5065038

  ; GPU_PLL1_PLL registers
  &HWIO_GPUCC_GPU_PLL1_PLL_MODE_ADDR=0x5065040
  &HWIO_GPUCC_GPU_PLL1_PLL_L_VAL_ADDR=0x5065044
  &HWIO_GPUCC_GPU_PLL1_PLL_USER_CTL_ADDR=0x506504c
  &HWIO_GPUCC_GPU_PLL1_PLL_USER_CTL_U_ADDR=0x5065050
  &HWIO_GPUCC_GPU_PLL1_PLL_CONFIG_CTL_ADDR=0x5065054
  &HWIO_GPUCC_GPU_PLL1_PLL_TEST_CTL_ADDR=0x506505c
  &HWIO_GPUCC_GPU_PLL1_PLL_TEST_CTL_U_ADDR=0x5065060
  &HWIO_GPUCC_GPU_PLL1_PLL_STATUS_ADDR=0x5065064
  &HWIO_GPUCC_GPU_PLL1_PLL_FRAC_VAL_ADDR=0x5065078

  ; LPASS_LPAAUDIO_PLL registers
  &HWIO_LPASS_LPAAUDIO_PLL_MODE_ADDR=0x17000000
  &HWIO_LPASS_LPAAUDIO_PLL_L_VAL_ADDR=0x17000004
  &HWIO_LPASS_LPAAUDIO_PLL_ALPHA_VAL_ADDR=0x17000008
  &HWIO_LPASS_LPAAUDIO_PLL_USER_CTL_ADDR=0x1700000c
  &HWIO_LPASS_LPAAUDIO_PLL_CONFIG_CTL_ADDR=0x17000010
  &HWIO_LPASS_LPAAUDIO_PLL_TEST_CTL_ADDR=0x17000018
  &HWIO_LPASS_LPAAUDIO_PLL_TEST_CTL_U_ADDR=0x1700001c
  &HWIO_LPASS_LPAAUDIO_PLL_STATUS_ADDR=0x1700002c

  ; LPASS_LPAAUDIO_DIG_PLL registers
  &HWIO_LPASS_LPAAUDIO_DIG_PLL_MODE_ADDR=0x17001000
  &HWIO_LPASS_LPAAUDIO_DIG_PLL_L_VAL_ADDR=0x17001004
  &HWIO_LPASS_LPAAUDIO_DIG_PLL_USER_CTL_ADDR=0x1700100c
  &HWIO_LPASS_LPAAUDIO_DIG_PLL_USER_CTL_U_ADDR=0x17001010
  &HWIO_LPASS_LPAAUDIO_DIG_PLL_CONFIG_CTL_ADDR=0x17001014
  &HWIO_LPASS_LPAAUDIO_DIG_PLL_TEST_CTL_ADDR=0x1700101c
  &HWIO_LPASS_LPAAUDIO_DIG_PLL_TEST_CTL_U_ADDR=0x17001020
  &HWIO_LPASS_LPAAUDIO_DIG_PLL_STATUS_ADDR=0x17001024
  &HWIO_LPASS_LPAAUDIO_DIG_PLL_FRAC_VAL_ADDR=0x17001038

  ; LPASS_QDSP6SS_PLL registers
  &HWIO_LPASS_QDSP6SS_PLL_MODE_ADDR=0x17300200
  &HWIO_LPASS_QDSP6SS_PLL_L_VAL_ADDR=0x17300204
  &HWIO_LPASS_QDSP6SS_PLL_USER_CTL_ADDR=0x1730020c
  &HWIO_LPASS_QDSP6SS_PLL_USER_CTL_U_ADDR=0x17300210
  &HWIO_LPASS_QDSP6SS_PLL_CONFIG_CTL_ADDR=0x17300214
  &HWIO_LPASS_QDSP6SS_PLL_TEST_CTL_ADDR=0x1730021c
  &HWIO_LPASS_QDSP6SS_PLL_TEST_CTL_U_ADDR=0x17300220
  &HWIO_LPASS_QDSP6SS_PLL_STATUS_ADDR=0x17300224
  &HWIO_LPASS_QDSP6SS_PLL_FRAC_VAL_ADDR=0x17300238

  ; MMPLL0_PLL registers
  &HWIO_MMSS_MMPLL0_PLL_MODE_ADDR=0xc8cc000
  &HWIO_MMSS_MMPLL0_PLL_L_VAL_ADDR=0xc8cc004
  &HWIO_MMSS_MMPLL0_PLL_USER_CTL_ADDR=0xc8cc00c
  &HWIO_MMSS_MMPLL0_PLL_USER_CTL_U_ADDR=0xc8cc010
  &HWIO_MMSS_MMPLL0_PLL_CONFIG_CTL_ADDR=0xc8cc014
  &HWIO_MMSS_MMPLL0_PLL_TEST_CTL_ADDR=0xc8cc01c
  &HWIO_MMSS_MMPLL0_PLL_TEST_CTL_U_ADDR=0xc8cc020
  &HWIO_MMSS_MMPLL0_PLL_STATUS_ADDR=0xc8cc024
  &HWIO_MMSS_MMPLL0_PLL_FRAC_VAL_ADDR=0xc8cc038

  ; MMPLL1_PLL registers
  &HWIO_MMSS_MMPLL1_PLL_MODE_ADDR=0xc8cc050
  &HWIO_MMSS_MMPLL1_PLL_L_VAL_ADDR=0xc8cc054
  &HWIO_MMSS_MMPLL1_PLL_USER_CTL_ADDR=0xc8cc05c
  &HWIO_MMSS_MMPLL1_PLL_USER_CTL_U_ADDR=0xc8cc060
  &HWIO_MMSS_MMPLL1_PLL_CONFIG_CTL_ADDR=0xc8cc064
  &HWIO_MMSS_MMPLL1_PLL_TEST_CTL_ADDR=0xc8cc06c
  &HWIO_MMSS_MMPLL1_PLL_TEST_CTL_U_ADDR=0xc8cc070
  &HWIO_MMSS_MMPLL1_PLL_STATUS_ADDR=0xc8cc074
  &HWIO_MMSS_MMPLL1_PLL_FRAC_VAL_ADDR=0xc8cc088

  ; MMPLL3_PLL registers
  &HWIO_MMSS_MMPLL3_PLL_MODE_ADDR=0xc8c0000
  &HWIO_MMSS_MMPLL3_PLL_L_VAL_ADDR=0xc8c0004
  &HWIO_MMSS_MMPLL3_PLL_USER_CTL_ADDR=0xc8c000c
  &HWIO_MMSS_MMPLL3_PLL_USER_CTL_U_ADDR=0xc8c0010
  &HWIO_MMSS_MMPLL3_PLL_CONFIG_CTL_ADDR=0xc8c0014
  &HWIO_MMSS_MMPLL3_PLL_TEST_CTL_ADDR=0xc8c001c
  &HWIO_MMSS_MMPLL3_PLL_TEST_CTL_U_ADDR=0xc8c0020
  &HWIO_MMSS_MMPLL3_PLL_STATUS_ADDR=0xc8c0024
  &HWIO_MMSS_MMPLL3_PLL_FRAC_VAL_ADDR=0xc8c0038

  ; MMPLL4_PLL registers
  &HWIO_MMSS_MMPLL4_PLL_MODE_ADDR=0xc8c0050
  &HWIO_MMSS_MMPLL4_PLL_L_VAL_ADDR=0xc8c0054
  &HWIO_MMSS_MMPLL4_PLL_USER_CTL_ADDR=0xc8c005c
  &HWIO_MMSS_MMPLL4_PLL_USER_CTL_U_ADDR=0xc8c0060
  &HWIO_MMSS_MMPLL4_PLL_CONFIG_CTL_ADDR=0xc8c0064
  &HWIO_MMSS_MMPLL4_PLL_TEST_CTL_ADDR=0xc8c006c
  &HWIO_MMSS_MMPLL4_PLL_TEST_CTL_U_ADDR=0xc8c0070
  &HWIO_MMSS_MMPLL4_PLL_STATUS_ADDR=0xc8c0074
  &HWIO_MMSS_MMPLL4_PLL_FRAC_VAL_ADDR=0xc8c0088

  ; MMPLL5_PLL registers
  &HWIO_MMSS_MMPLL5_PLL_MODE_ADDR=0xc8c00a0
  &HWIO_MMSS_MMPLL5_PLL_L_VAL_ADDR=0xc8c00a4
  &HWIO_MMSS_MMPLL5_PLL_USER_CTL_ADDR=0xc8c00ac
  &HWIO_MMSS_MMPLL5_PLL_USER_CTL_U_ADDR=0xc8c00b0
  &HWIO_MMSS_MMPLL5_PLL_CONFIG_CTL_ADDR=0xc8c00b4
  &HWIO_MMSS_MMPLL5_PLL_TEST_CTL_ADDR=0xc8c00bc
  &HWIO_MMSS_MMPLL5_PLL_TEST_CTL_U_ADDR=0xc8c00c0
  &HWIO_MMSS_MMPLL5_PLL_STATUS_ADDR=0xc8c00c4
  &HWIO_MMSS_MMPLL5_PLL_FRAC_VAL_ADDR=0xc8c00d8

  ; MMPLL6_PLL registers
  &HWIO_MMSS_MMPLL6_PLL_MODE_ADDR=0xc8c00f0
  &HWIO_MMSS_MMPLL6_PLL_L_VAL_ADDR=0xc8c00f4
  &HWIO_MMSS_MMPLL6_PLL_USER_CTL_ADDR=0xc8c00fc
  &HWIO_MMSS_MMPLL6_PLL_USER_CTL_U_ADDR=0xc8c0100
  &HWIO_MMSS_MMPLL6_PLL_CONFIG_CTL_ADDR=0xc8c0104
  &HWIO_MMSS_MMPLL6_PLL_TEST_CTL_ADDR=0xc8c010c
  &HWIO_MMSS_MMPLL6_PLL_TEST_CTL_U_ADDR=0xc8c0110
  &HWIO_MMSS_MMPLL6_PLL_STATUS_ADDR=0xc8c0114
  &HWIO_MMSS_MMPLL6_PLL_FRAC_VAL_ADDR=0xc8c0128

  ; MMPLL7_PLL registers
  &HWIO_MMSS_MMPLL7_PLL_MODE_ADDR=0xc8c0140
  &HWIO_MMSS_MMPLL7_PLL_L_VAL_ADDR=0xc8c0144
  &HWIO_MMSS_MMPLL7_PLL_USER_CTL_ADDR=0xc8c014c
  &HWIO_MMSS_MMPLL7_PLL_USER_CTL_U_ADDR=0xc8c0150
  &HWIO_MMSS_MMPLL7_PLL_CONFIG_CTL_ADDR=0xc8c0154
  &HWIO_MMSS_MMPLL7_PLL_TEST_CTL_ADDR=0xc8c015c
  &HWIO_MMSS_MMPLL7_PLL_TEST_CTL_U_ADDR=0xc8c0160
  &HWIO_MMSS_MMPLL7_PLL_STATUS_ADDR=0xc8c0164
  &HWIO_MMSS_MMPLL7_PLL_FRAC_VAL_ADDR=0xc8c0178

  ; MMPLL10_PLL registers
  &HWIO_MMSS_MMPLL10_PLL_MODE_ADDR=0xc8c0190
  &HWIO_MMSS_MMPLL10_PLL_L_VAL_ADDR=0xc8c0194
  &HWIO_MMSS_MMPLL10_PLL_USER_CTL_ADDR=0xc8c019c
  &HWIO_MMSS_MMPLL10_PLL_USER_CTL_U_ADDR=0xc8c01a0
  &HWIO_MMSS_MMPLL10_PLL_CONFIG_CTL_ADDR=0xc8c01a4
  &HWIO_MMSS_MMPLL10_PLL_TEST_CTL_ADDR=0xc8c01ac
  &HWIO_MMSS_MMPLL10_PLL_TEST_CTL_U_ADDR=0xc8c01b0
  &HWIO_MMSS_MMPLL10_PLL_STATUS_ADDR=0xc8c01b4
  &HWIO_MMSS_MMPLL10_PLL_FRAC_VAL_ADDR=0xc8c01c8

  ; SCC_PLL registers
  &HWIO_SSC_SCC_SCC_PLL_MODE_ADDR=0x5e20000
  &HWIO_SSC_SCC_SCC_PLL_L_VAL_ADDR=0x5e20004
  &HWIO_SSC_SCC_SCC_PLL_USER_CTL_ADDR=0x5e2000c
  &HWIO_SSC_SCC_SCC_PLL_USER_CTL_U_ADDR=0x5e20010
  &HWIO_SSC_SCC_SCC_PLL_CONFIG_CTL_ADDR=0x5e20014
  &HWIO_SSC_SCC_SCC_PLL_TEST_CTL_ADDR=0x5e2001c
  &HWIO_SSC_SCC_SCC_PLL_TEST_CTL_U_ADDR=0x5e20020
  &HWIO_SSC_SCC_SCC_PLL_STATUS_ADDR=0x5e20024
  &HWIO_SSC_SCC_SCC_PLL_FRAC_VAL_ADDR=0x5e20038

  ; QDSP6SS_PLL registers
  &HWIO_SSC_QDSP6SS_PLL_MODE_ADDR=0x5c00200
  &HWIO_SSC_QDSP6SS_PLL_L_VAL_ADDR=0x5c00204
  &HWIO_SSC_QDSP6SS_PLL_USER_CTL_ADDR=0x5c0020c
  &HWIO_SSC_QDSP6SS_PLL_USER_CTL_U_ADDR=0x5c00210
  &HWIO_SSC_QDSP6SS_PLL_CONFIG_CTL_ADDR=0x5c00214
  &HWIO_SSC_QDSP6SS_PLL_TEST_CTL_ADDR=0x5c0021c
  &HWIO_SSC_QDSP6SS_PLL_TEST_CTL_U_ADDR=0x5c00220
  &HWIO_SSC_QDSP6SS_PLL_STATUS_ADDR=0x5c00224
  &HWIO_SSC_QDSP6SS_PLL_FRAC_VAL_ADDR=0x5c00238

  goto Init_Constants_Done


;-----------------------------------------------------------------------------
; Calculate Pre-div and Post-Div for SR PLLs; where
; Pre-Div  [14:12]
; Post-Div [9:8]
;-----------------------------------------------------------------------------

Calculate_Pre_Post_Div_SR:

  if (&user_ctl_val&0x7000)==0x0000
    &pre_div=1
  else if (&user_ctl_val&0x7000)==0x1000
    &pre_div=2
  else if (&user_ctl_val&0x7000)==0x2000
    &pre_div=3
  else if (&user_ctl_val&0x7000)==0x3000
    &pre_div=4
  else if (&user_ctl_val&0x7000)==0x4000
    &pre_div=5
  else if (&user_ctl_val&0x7000)==0x5000
    &pre_div=6
  else if (&user_ctl_val&0x7000)==0x6000
    &pre_div=7
  else
    &pre_div=8

  if (&user_ctl_val&0x300)==0x000
    &post_div=1
  else if (&user_ctl_val&0x300)==0x100
    &post_div=2
  else
    &post_div=4

  return


;-----------------------------------------------------------------------------
; Calculate Pre-div and Post-Div for SR2/HF PLLs; where
; Pre-Div  [12]
; Post-Div [9:8]
;-----------------------------------------------------------------------------

Calculate_Pre_Post_Div_SR2_HF:

  if (&user_ctl_val&0x1000)==0x0000
    &pre_div=1
  else
    &pre_div=2

  if (&user_ctl_val&0x300)==0x000
    &post_div=1
  else if (&user_ctl_val&0x300)==0x100
    &post_div=2
  else
    &post_div=4

  return


;-----------------------------------------------------------------------------
; Calculate Pre-div and Post-Div for PRIUS/TESLA PLLs; where
; Pre-Div  [??]
; Post-Div [??]
;-----------------------------------------------------------------------------

Calculate_Pre_Post_Div_PRIUS_TESLA:

  if (&user_ctl_val&0x7000)==0x1000
    &pre_div=2
  else
    &pre_div=1
  
  if (&user_ctl_val&0xF00)==0x100
    &post_div=2
  else if (&user_ctl_val&0xF00)==0x300
    &post_div=4
  else if (&user_ctl_val&0xF00)==0x700
    &post_div=8
  else if (&user_ctl_val&0xF00)==0xF00
    &post_div=16
  else
    &post_div=1

  return



;-----------------------------------------------------------------------------
; Display the PLL settings
;-----------------------------------------------------------------------------

Display_PLL:

  ENTRY &pll_name &pll_num &pll_type &mode_reg &l_reg &alpha_reg &alpha_u_reg &m_reg &n_reg &user_ctl_reg &status_reg &clk_ref

  local &mode_val
  local &l_val
  local &alpha_val
  local &alpha_u_val
  local &m_val
  local &n_val
  local &user_ctl_val
  local &user_ctl_u_val
  local &status_val
  local &pll_state
  local &pll_votable
  local &pll_main
  local &pll_test
  local &pll_aux
  local &pll_aux2
  local &pll_early
  local &pll_freq
  local &alpha_combined_hex
  local &alpha_divisor
  local &alpha_float
  local &pll_num_formatted
  local &pll_name_formatted

  &mode_val=data.long(&access_mode:&mode_reg)
  &l_val=data.long(&access_mode:&l_reg)&(&HWIO_PLL_L_VAL_MASK)

  ; Get m value
  if (&m_reg!=0)
    &m_val=data.long(&access_mode:&m_reg)&(&HWIO_PLL_M_VAL_MASK)
  else
    &m_val=0

  ; Get n value
  if (&n_reg!=0)
  (
    &n_val=data.long(&access_mode:&n_reg)&(&HWIO_PLL_N_VAL_MASK)
    if &n_val==0
      &n_val=1
  )
  else
    &n_val=0

  ; Get alpha value
  if (&alpha_reg!=0)
    &alpha_val=data.long(&access_mode:&alpha_reg)&(&HWIO_PLL_ALPHA_VAL_MASK)
  else
    &alpha_val=0

  ; Get alpha_u value
  if (&alpha_u_reg!=0)
    &alpha_u_val=data.long(&access_mode:&alpha_u_reg)&(&HWIO_PLL_ALPHA_U_VAL_MASK)
  else
    &alpha_u_val=0

  &status_val=data.long(&access_mode:&status_reg)
  &user_ctl_val=data.long(&access_mode:&user_ctl_reg)

 ; Check for ON/OFF status
  if (&mode_val&0x80000000)==0x80000000
    &pll_state="ON "
  else
    &pll_state="OFF"

  ; Check for FSM mode
  if (&mode_val&0x100000)==0x100000
    &pll_votable="YES"
  else
    &pll_votable="NO "

  ; Check for test output
  if (&user_ctl_val&0x10)==0x10
    &pll_test="ON "
  else
    &pll_test="OFF"

  ; Check for early output
  if (&user_ctl_val&0x08)==0x08
    &pll_early="ON "
  else
    &pll_early="OFF"

  ; Check for aux2 output
  if (&user_ctl_val&0x04)==0x04
    &pll_aux2="ON "
  else
    &pll_aux2="OFF"

  ; Check for aux output
  if (&user_ctl_val&0x02)==0x02
    &pll_aux="ON "
  else
    &pll_aux="OFF"

 ; Check for main output
  if (&user_ctl_val&0x01)==0x01
    &pll_main="ON "
  else
    &pll_main="OFF"

  ; Check pre-div and post-div
  if ("&pll_type"=="sr_pll")
  (
    gosub Calculate_Pre_Post_Div_SR
  )
  else if ("&pll_type"=="sr2_pll")||("&pll_type"=="hf_pll")
  (
    gosub Calculate_Pre_Post_Div_SR2_HF
  )
  else
  (
    gosub Calculate_Pre_Post_Div_PRIUS_TESLA
  )

  ; Calculate the PLL frequency based on PLL type.
  if (&m_reg!=0)
  (
    &pll_freq=FORMAT.FLOAT(10, 6, (&clk_ref*&l_val+&clk_ref*&m_val/&n_val)/&pre_div/&post_div)
  )
  else
  (
    ; Combine alpha lower + upper
    &alpha_combined_hex=&alpha_val+(&alpha_u_val<<32.)
    &alpha_float=(&alpha_combined_hex*1.0)/((1<<40.)*1.0)

    &pll_freq=FORMAT.FLOAT(10, 6, (&clk_ref/&pre_div)*((&l_val+&alpha_float)/&post_div))
  )

  ; Format the pll num and name strings
  ;&pll_num_formatted=FORMAT.DECIMAL(2., &pll_num)
  &pll_num_formatted=&pll_num

  ;&pll_name_formatted=STRING.CUT("        ", STRING.LEN("&pll_name"))
  ;&pll_name_formatted="&pll_name&pll_name_formatted"
  &pll_name_formatted=&pll_name

  print "&pll_num_formatted  &pll_name_formatted    &pll_state        &pll_votable        &pll_main        &pll_test        &pll_aux        &pll_aux2        &pll_early  &pll_freq"

  return


;-----------------------------------------------------------------------------
; Format dump registers 
;-----------------------------------------------------------------------------

Format_Dump_Registers:

  ENTRY &num &use &mode_reg &user_ctl_reg &user_ctl_u_reg &config_ctl_reg &test_ctl_reg &test_ctl_u_reg &status_reg &l_reg &alpha_reg &alpha_u_reg &m_reg &n_reg

  local &mode_val
  local &user_ctl_val
  local &user_ctl_u_val
  local &config_ctl_val
  local &test_ctl_val
  local &test_ctl_u_val
  local &status_val
  local &l_val
  local &alpha_val
  local &alpha_u_val
  local &m_val
  local &n_val
  local &left_width
  local &temp_string
  local &temp_string_formatted

  ; Format PLL num and use
  &num=FORMAT.DECIMAL(0x2, &num)

  ; Format mode
  &mode_val=FORMAT.HEX(0x8, data.long(&access_mode:&mode_reg))
  &mode_reg=FORMAT.HEX(0x9, &mode_reg)

  ; Format l 
  &l_val=FORMAT.HEX(0x8, data.long(&access_mode:&l_reg))
  &l_reg=FORMAT.HEX(0x9, &l_reg)

  ; Format alpha if the register address is not zero
  if (&alpha_reg!=0)
  (
    &alpha_val=FORMAT.HEX(0x8, data.long(&access_mode:&alpha_reg))
    &alpha_reg=FORMAT.HEX(0x9, &alpha_reg)
  )

  ; Format alpha_u if the register address is not zero
  if (&alpha_u_reg!=0)
  (
    &alpha_u_val=FORMAT.HEX(0x8, data.long(&access_mode:&alpha_u_reg))
    &alpha_u_reg=FORMAT.HEX(0x9, &alpha_u_reg)
  )

  ; Format m if the register address is not zero
  if (&m_reg!=0)
  (
    &m_val=FORMAT.HEX(0x8, data.long(&access_mode:&m_reg))
    &m_reg=FORMAT.HEX(0x9, &m_reg)
  )

  ; Format n if the register address is not zero
  if (&n_reg!=0)
  (
    &n_val=FORMAT.HEX(0x8, data.long(&access_mode:&n_reg))
    &n_reg=FORMAT.HEX(0x9, &n_reg)
  )

  ; Format user_ctl
  &user_ctl_val=FORMAT.HEX(0x8, data.long(&access_mode:&user_ctl_reg))
  &user_ctl_reg=FORMAT.HEX(0x9, &user_ctl_reg)

  ; Format user_ctl_u if the register address is not zero
  if (&user_ctl_u_reg!=0)
  (
    &user_ctl_u_val=FORMAT.HEX(0x8, data.long(&access_mode:&user_ctl_u_reg))
    &user_ctl_u_reg=FORMAT.HEX(0x9, &user_ctl_u_reg)
  )

  ; Format config_ctl
  &config_ctl_val=FORMAT.HEX(0x8, data.long(&access_mode:&config_ctl_reg))
  &config_ctl_reg=FORMAT.HEX(0x9, &config_ctl_reg)

  ; Format test_ctl
  &test_ctl_val=FORMAT.HEX(0x8, data.long(&access_mode:&test_ctl_reg))
  &test_ctl_reg=FORMAT.HEX(0x9, &test_ctl_reg)

  ; Format test_ctl_u if the register address is not zero
  if (&test_ctl_u_reg!=0)
  (
    &test_ctl_u_val=FORMAT.HEX(0x8, data.long(&access_mode:&test_ctl_u_reg))
    &test_ctl_u_reg=FORMAT.HEX(0x9, &test_ctl_u_reg)
  )

  ; Format status
  &status_val=FORMAT.HEX(0x8, data.long(&access_mode:&status_reg))
  &status_reg=FORMAT.HEX(0x9, &status_reg)

  &left_width="                                     "

  print "__________________________________________________________________"
  &temp_string="[PLL&num : &use]"
  &temp_string_formatted=STRING.CUT("&left_width", STRING.LEN("&temp_string"))
  &temp_string_formatted="&temp_string&temp_string_formatted"
  print "&temp_string_formatted | |     Address : Value"

  &temp_string="MODE"
  &temp_string_formatted=STRING.CUT("&left_width", STRING.LEN("&temp_string"))
  &temp_string_formatted="&temp_string_formatted&temp_string"
  print "&temp_string_formatted | | 0x&mode_reg : 0x&mode_val"

  &temp_string="L"
  &temp_string_formatted=STRING.CUT("&left_width", STRING.LEN("&temp_string"))
  &temp_string_formatted="&temp_string_formatted&temp_string"
  print "&temp_string_formatted | | 0x&l_reg : 0x&l_val"

  if (&alpha_reg!=0)
  (
    &temp_string="ALPHA"
    &temp_string_formatted=STRING.CUT("&left_width", STRING.LEN("&temp_string"))
    &temp_string_formatted="&temp_string_formatted&temp_string"
    print "&temp_string_formatted | | 0x&alpha_reg : 0x&alpha_val"
  )

  if (&alpha_u_reg!=0)
  (
    &temp_string="ALPHA_U"
    &temp_string_formatted=STRING.CUT("&left_width", STRING.LEN("&temp_string"))
    &temp_string_formatted="&temp_string_formatted&temp_string"
    print "&temp_string_formatted | | 0x&alpha_u_reg : 0x&alpha_u_val"
  )

  if (&m_reg!=0)
  (
    &temp_string="M"
    &temp_string_formatted=STRING.CUT("&left_width", STRING.LEN("&temp_string"))
    &temp_string_formatted="&temp_string_formatted&temp_string"
    print "&temp_string_formatted | | 0x&m_reg : 0x&m_val"
  )

  if (&n_reg!=0)
  (
    &temp_string="N"
    &temp_string_formatted=STRING.CUT("&left_width", STRING.LEN("&temp_string"))
    &temp_string_formatted="&temp_string_formatted&temp_string"
    print "&temp_string_formatted | | 0x&n_reg : 0x&n_val"
  )

  &temp_string="USER_CTL"
  &temp_string_formatted=STRING.CUT("&left_width", STRING.LEN("&temp_string"))
  &temp_string_formatted="&temp_string_formatted&temp_string"
  print "&temp_string_formatted | | 0x&user_ctl_reg : 0x&user_ctl_val"

  if (&user_ctl_u_reg!=0)
  (
    &temp_string="USER_CTL_U"
    &temp_string_formatted=STRING.CUT("&left_width", STRING.LEN("&temp_string"))
    &temp_string_formatted="&temp_string_formatted&temp_string"
    print "&temp_string_formatted | | 0x&user_ctl_u_reg : 0x&user_ctl_u_val"
  )

  &temp_string="CONFIG_CTL"
  &temp_string_formatted=STRING.CUT("&left_width", STRING.LEN("&temp_string"))
  &temp_string_formatted="&temp_string_formatted&temp_string"
  print "&temp_string_formatted | | 0x&config_ctl_reg : 0x&config_ctl_val"

  &temp_string="TEST_CTL"
  &temp_string_formatted=STRING.CUT("&left_width", STRING.LEN("&temp_string"))
  &temp_string_formatted="&temp_string_formatted&temp_string"
  print "&temp_string_formatted | | 0x&test_ctl_reg : 0x&test_ctl_val"

  if (&test_ctl_u_reg!=0)
  (
    &temp_string="TEST_CTL_U"
    &temp_string_formatted=STRING.CUT("&left_width", STRING.LEN("&temp_string"))
    &temp_string_formatted="&temp_string_formatted&temp_string"
    print "&temp_string_formatted | | 0x&test_ctl_u_reg : 0x&test_ctl_u_val"
  )

  &temp_string="STATUS"
  &temp_string_formatted=STRING.CUT("&left_width", STRING.LEN("&temp_string"))
  &temp_string_formatted="&temp_string_formatted&temp_string"
  print "&temp_string_formatted | | 0x&status_reg : 0x&status_val"

  return



;;;;;;;;;;;;;;;;;;;;;;;;;;;;;;;;;;;;;;;;;;;;;;;;;;;;;;;;;;;;;;;;;;;;;;;;;;;;;;
;
; Lauterbach T32 "Window/Area" Utility Subs:
;
;   bool    wa_does_area_exist ( string area )
;
;   bool    wa_try_area_create ( string area, [int cols, int rows] )
;
;   bool    wa_area_create_list (
;             int num, [string area, int cols, int rows], ... )
;
;   string  wa_get_substr_ws ( string src_str, int read_idx )
;
;   int[4]  wa_extract_stored_win_dim ( string file_name, string window_name )
;
;   bool    wa_save_window_settings ( string window_name, [flag print_error] )
;
;   int[4]  wa_find_saved_window_settings ( string window_name )
;
;   bool    wa_delete_saved_window_settings (
;             string window_name, [flag print_error] )
;
;   bool    wa_delete_saved_window_settings_ext (
;             string window, string script, [flag print_error] )
;
;;;;;;;;;;;;;;;;;;;;;;;;;;;;;;;;;;;;;;;;;;;;;;;;;;;;;;;;;;;;;;;;;;;;;;;;;;;;;;

;
; bool wa_does_area_exist ( string area )
;
; Returns non-zero if the given area currently exists.
;
; SIDE EFFECTS:  Selects the tested area if it exists, or the default area.
;
wa_does_area_exist:
(
  local &area_name
  entry &area_name

  ON ERROR gosub
  (
    ; Clear the error message.
    area.select
    print " "

    &clk_err="!"
    return
  )

  &clk_err=""
  area.select &area_name

  if ("&clk_err"=="")
  (
    return 1
  )
  else
  (
    return 0
  )
)

;
; bool wa_try_area_create ( string area, [int cols, int rows] )
;
; Attempts to create an area (see 'area.create'). Returns non-zero if the 
; area is successfully created. If the 'area.create' operation fails, the
; caller may run 'area.reset' then re-try creating the area. The 'rows' and
; 'cols' arguments can be bypassed by omitting both.
;
; T32 has a maximum number of concurrent areas (only 10 at the time of
; writing this sub). Unfortunately these areas can only be deleted in bulk
; with the highly destructive 'area.reset' (although some T32 documentation
; incorrectly states that 'area.close <area_name>' destroys the area, it
; doesn't--it only closes the area's output logging).
;
; Furthermore, areas aren't destroyed automatically upon script exit, so
; if a user were to run multiple scripts with multiple areas they could
; quickly exhaust the 10-area limit and then find that subsequent script
; launches always fail, potentially with confusing error messages. This
; utility sub is intended to mitigate this risk without having to immidiately
; resort to running a global 'area.reset' during script initialization.
;
wa_try_area_create:
(
  local &area_name
  local &cols
  local &rows

  entry &area_name &cols &rows

  ON ERROR gosub
  (
    &clk_err="!"
    return
  )

  &clk_err=""
  area.create &area_name &cols &rows

  if ("&clk_err"=="")
  (
    return 1
  )
  else
  (
    return 0
  )
)

;
; bool wa_area_create_list ( int num, [string area, int cols, int rows], ... )
;
; Attempts to create a list of areas. Will run the global 'area.reset' command
; upon the first failure, and return 0 upon the second failure. Otherwise
; returns non-zero upon success.
;
wa_area_create_list:
(
  local &success
  local &already_failed
  local &area_name
  local &cols
  local &rows
  local &area_idx
  local &num
  local &input_line
  local &line_idx
  local &area_list_line_idx

  entry %LINE &input_line

  ; Get the number of areas to create.
  gosub wa_get_substr_ws "&input_line" 0.
  entry &num &area_list_line_idx
  if ("&num"=="")
  (
    print %ERROR "ERROR: wa_area_create_list() detected invalid input: '&input_line'."
    return 0
  )

  &already_failed=0

wa_area_create_list_process_areas:

  ; Create each area.
  &area_idx=0
  &line_idx=&area_list_line_idx
  while (&area_idx<&num)
  (
    ; Read in the area information.
    gosub wa_get_substr_ws "&input_line" &line_idx
    entry &area_name &line_idx
    if ("&area_name"=="")
    (
      goto wa_area_create_list_too_few_args
    )
    gosub wa_get_substr_ws "&input_line" &line_idx
    entry &cols &line_idx
    if ("&cols"=="")
    (
      goto wa_area_create_list_too_few_args
    )
    gosub wa_get_substr_ws "&input_line" &line_idx
    entry &rows &line_idx
    if ("&rows"=="")
    (
      goto wa_area_create_list_too_few_args
    )

    ; Check if the row/col argument was bypassed.
    if (("&cols"==",")||("&rows"==","))
    (
      ; Apply a sanity check for row/col bypass.
      if (("&cols"!=",")||("&rows"!=","))
      (
        print %ERROR "ERROR: wa_area_create_list() detected invalid row/col settings for '&area_name'."
        print %ERROR "       Row/col must both be an integer or both be ',' (got row='&row', col='&col'). "
        return 0
      )

      &cols=""
      &rows=""
    )

    ; Attempt to create the area.
    gosub wa_try_area_create &area_name &cols &rows
    entry &success

    if (&success==0)
    (
      ; Already failed => infinite impending failures.
      if (&already_failed!=0)
      (
        print %ERROR %Decimal "ERROR: wa_area_create_list() failed to create &num areas."
        return 0
      )

      ; Delete all areas and try creating the area list once more.
      &already_failed=1
      area.reset
      winclear
      goto wa_area_create_list_process_areas
    )

    &area_idx=&area_idx+1
  )

  return 1

wa_area_create_list_too_few_args:

  print %ERROR "ERROR: wa_area_create_list() detected too few arguments (num_areas='&num')."
  return 0
)

;
; string wa_get_substr_ws ( string src_str, int read_idx )
;
; Returns the next sub-string word from a source string, or nothing if there
; is no such word. The words are split by spaces.
;
; Example: <gosub args_get_next_substr_ws "a  bc  de" 1.>
;          Returns "bc 5" (sans quotes).
;
wa_get_substr_ws:
(
  local &src_str
  local &src_len
  local &read_idx
  local &sub_str
  local &start_idx

  entry &src_str &read_idx

  if (&read_idx<0)
  (
    ; Negative read index--return empty string (and no index).
    return
  )

  &src_len=string.length(&src_str)

  ; Find the start of non-whitespace segment.
  while (&read_idx<&src_len)
  (
    if (string.char(&src_str, &read_idx)!=' ')
    (
      &start_idx=&read_idx
      goto wa_get_substr_ws_find_end_idx
    )

    &read_idx=&read_idx+1
  )

  ; No non-whitespace found--return empty string (and no index).
  return

wa_get_substr_ws_find_end_idx:

  ; Find the end of non-whitespace segment.
  &read_idx=&read_idx+1
  while (&read_idx<&src_len)
  (
    if (string.char(&src_str, &read_idx)==' ')
    (
      ; Cut out leading and trailing whitespace
      &sub_str=string.mid(&src_str, &start_idx, &read_idx-&start_idx)

      goto wa_get_substr_ws_return_substr
    )

    &read_idx=&read_idx+1
  )

  ; No trailing white-space found--cut out any leading whitespace.
  &sub_str=string.cut(&src_str, &start_idx)

wa_get_substr_ws_return_substr:

  return &sub_str &read_idx
)

;
; int[2] wa_extract_stored_win_dim ( string file_name,  string window_name )
;
; Returns the settings for the given window extracted from a previously
; stored file. Returns -1 if the window settings aren't found.
;
; Returns: {x_start, y_start, x_length, y_length}
;          (all values are in row or column units).
;
wa_extract_stored_win_dim:
(
  local &window_name
  local &file_name
  local &x_start
  local &y_start
  local &x_len
  local &y_len
  local &line_in
  local &idx

  entry &file_name &window_name

  &x_start=-1
  &y_start=-1
  &y_len=-1
  &x_start=-1

  ; Open the input file.
  (
    &clk_err=""
    ON ERROR gosub
    (
      print %ERROR "ERROR: wa_extract_stored_win_dim() failed to open '&file_name'."
      &clk_err="!"
      return
    )
    OPEN #1 &file_name /Read
  )

  if ("&clk_err"!="")
  (
    goto wa_extract_stored_win_dim_error
  )

  ; Scan the input file for "winpos ... window_name".
  WHILE TRUE()
  (
    READ #1 %line &line_in
    if (EOF()==TRUE())
    (
      goto wa_extract_stored_win_dim_error
    )
    &line_in=string.lower("&line_in")

    ; Search for 'winpos' line header and cut it out if found.
    &idx=string.scan("&line_in", "winpos", 0)
    if (&idx!=-1)
    (
      &line_in=string.cut("&line_in", &idx+6.)

      ; Search for the specified window name.
      if (string.scan("&line_in", "&window_name", 0)!=-1)
      (
        ; Extract the specified window's settings.
        gosub wa_get_substr_ws "&line_in" 0.
        entry &x_start &idx
        if ("&x_start"=="")
        (
          goto wa_extract_stored_win_dim_error
        )
        gosub wa_get_substr_ws "&line_in" &idx
        entry &y_start &idx
        if ("&y_start"=="")
        (
          goto wa_extract_stored_win_dim_error
        )
        gosub wa_get_substr_ws "&line_in" &idx
        entry &x_len &idx
        if ("&x_len"=="")
        (
          goto wa_extract_stored_win_dim_error
        )
        gosub wa_get_substr_ws "&line_in" &idx
        entry &y_len &idx
        if ("&y_len"=="")
        (
          goto wa_extract_stored_win_dim_error
        )

        CLOSE #1
        return &x_start &y_start &x_len &y_len
      )
    )
  )

wa_extract_stored_win_dim_error:

  CLOSE #1
  return -1 -1 -1 -1
)

;
; bool wa_save_window_settings ( string window_name, [flag print_error] )
;
; Saves a script's window configuration (position + size).
; See restore_window_settings() for the restore operation.
; Returns non-zero if the store operation succeeded.
;
; This is provided as a method to allow scripts to save/restore their window
; settings accross multiple script sessions. T32's "store <file> win" tool
; is insufficient to do this since it will only save/restore *all* T32 windows,
; not targeted windows.
;
wa_save_window_settings:
(
  local &file
  local &window_name
  local &script_name
  local &extn_less_dim_fname
  local &print_error

  &clk_err=""
  ON ERROR gosub
  (
    &clk_err="!"
    return
  )

  entry &window_name &print_error

  ; Store the full window configuration in a file under the temporary directory.
  &script_name=os.ppf()
  &script_name=os.file.name("&script_name")
  &extn_less_dim_fname="__&(script_name)_&(window_name)_dim"
  &extn_less_dim_fname=string.replace("&extn_less_dim_fname", ".", "_", 0.)

  &file=os.ptd()
  &file="&(file)\&(extn_less_dim_fname).cmm"
  store &file win

  if ("&clk_err"=="")
  (
    return 1
  )
  else
  (
    if ("&print_error"!="")
    (
      print %ERROR "ERROR: wa_save_window_settings() failed to store settings for '&window_name'."
    )
    return 0
  )
)

;
; int[4] wa_find_saved_window_settings ( string window_name )
;
; Returns the settings for the given window extracted from a previously
; save. Returns -1 if the window settings aren't found.
;
; Returns: {x_start, y_start, x_length, y_length}
;          (all values are in row or column units).
;
; This is provided as a method to allow scripts to save/restore their window
; settings accross multiple script sessions. T32's "store <file> win" tool
; is insufficient to do this since it will only save/restore *all* T32 windows,
; not targeted windows.
;
wa_find_saved_window_settings:
(
  local &x_start
  local &y_start
  local &x_len
  local &y_len
  local &window_name
  local &file
  local &script_name
  local &extn_less_dim_fname
  local &first

  entry &window_name

  &script_name=os.ppf()
  &script_name=os.file.name("&script_name")
  &extn_less_dim_fname="__&(script_name)_&(window_name)_dim"
  &extn_less_dim_fname=string.replace("&extn_less_dim_fname", ".", "_", 0.)

  &first=0.
  (
    ON ERROR gosub
    (
      var.newglobal char \&extn_less_dim_fname
      &first=1.
      return
    )

    var.assign \&extn_less_dim_fname = 0
  )

  &file=os.ptd()
  &file="&(file)\&(extn_less_dim_fname).cmm"

  if (&first!=0.)
  (
    ;
    ; Don't attempt to restore on the first time--instead delete the save.
    ; This prevents issues where a new T32 session is opened in a smaller
    ; window but the launched script maintains its old oversize dimensions.
    ;
    (
      ON ERROR continue
      del &file
    )
    return -1 -1 -1 -1
  )

  if (os.file.access("&file", "R")==FALSE())
  (
    return -1 -1 -1 -1
  )

  ; Search for previously saved settings for this window.
  gosub wa_extract_stored_win_dim &file &window_name
  entry &x_start &y_start &x_len &y_len

  return &x_start &y_start &x_len &y_len
)

;
; bool wa_delete_saved_window_settings ( string window_name, [flag print_error] )
;
; Deletes a window settings file.
;
wa_delete_saved_window_settings:
(
  local &success
  local &file
  local &script_name
  local &window_name
  local &extn_less_dim_fname
  local &print_error

  entry &window_name &print_error

  ; Check if the window's saved settings file exists.
  &script_name=os.ppf()
  &script_name=os.file.name("&script_name")
  &extn_less_dim_fname="__&(script_name)_&(window_name)_dim"
  &extn_less_dim_fname=string.replace("&extn_less_dim_fname", ".", "_", 0.)

  &file=os.ptd()
  &file="&(file)\&(extn_less_dim_fname).cmm"
  if (os.file.access("&file", "W")==TRUE())
  (
    ; Delete the file.
    del &file
    &success=1
  )
  else
  (
    if ("&print_error"!="")
    (
      print %ERROR "ERROR: wa_delete_saved_window_settings() failed to delete window settings for '&window_name'."
    )
    &success=0
  )

  return &success
)

;
; bool wa_delete_saved_window_settings_ext ( string window, string script, [flag print_error] )
;
; Deletes a window settings file.
;
wa_delete_saved_window_settings_ext:
(
  local &success
  local &file
  local &script_name
  local &extn_less_dim_fname
  local &window_name
  local &print_error

  entry &window_name &script_name &print_error

  &extn_less_dim_fname="__&(script_name)_&(window_name)_dim"
  &extn_less_dim_fname=string.replace("&extn_less_dim_fname", ".", "_", 0.)

  &file=os.ptd()
  &file="&(file)\&(extn_less_dim_fname).cmm"
  if (os.file.access("&file", "W")==TRUE())
  (
    ; Delete the file.
    del &file
    &success=1
  )
  else
  (
    if ("&print_error"!="")
    (
      print %ERROR "ERROR: delete_saved_window_settings() failed to delete window settings for '&window_name'."
    )
    &success=0
  )

  return &success
)

;;;;;;;;;;;;; End of "Lauterbach T32 "Window/Area" Utility Subs" ;;;;;;;;;;;;;


;-----------------------------------------------------------------------
; Display Configurations
;-----------------------------------------------------------------------

Display_Configurations:

  local &pll_name
  local &pll_num
  local &pll_type
  local &l_reg
  local &m_reg
  local &n_reg
  local &alpha_reg
  local &alpha_u_reg
  local &mode_reg
  local &user_ctl_reg
  local &status_reg

  print "PLL            USE                   STATE     VOTABLE   MAIN_OUT   TEST_OUT    AUX_OUT   AUX2_OUT   EARLY_OUT   CALC FREQ (MHz)"
  print "--- ------------------------------   -----     -------   --------   --------    -------   --------   ---------   ---------------"


  &pll_name="GPLL0                       "
  &pll_num="0  "
  &pll_type="fabia_pll"
  &mode_reg=&HWIO_GCC_GPLL0_MODE_ADDR
  &l_reg=&HWIO_GCC_GPLL0_L_VAL_ADDR
  &alpha_reg=0
  &alpha_u_reg=0
  &m_reg=0
  &n_reg=0
  &user_ctl_reg=&HWIO_GCC_GPLL0_USER_CTL_ADDR
  &status_reg=&HWIO_GCC_GPLL0_STATUS_ADDR
  &clk_ref=19.2


  &alpha_reg=&HWIO_GCC_GPLL0_FRAC_VAL_ADDR
  &user_ctl_u_reg=&HWIO_GCC_GPLL0_USER_CTL_U_ADDR
  gosub Display_PLL "&pll_name" "&pll_num" &pll_type &mode_reg &l_reg &alpha_reg &alpha_u_reg &m_reg &n_reg &user_ctl_reg &status_reg &clk_ref


  &pll_name="GPLL1                       "
  &pll_num="1  "
  &pll_type="fabia_pll"
  &mode_reg=&HWIO_GCC_GPLL1_MODE_ADDR
  &l_reg=&HWIO_GCC_GPLL1_L_VAL_ADDR
  &alpha_reg=0
  &alpha_u_reg=0
  &m_reg=0
  &n_reg=0
  &user_ctl_reg=&HWIO_GCC_GPLL1_USER_CTL_ADDR
  &status_reg=&HWIO_GCC_GPLL1_STATUS_ADDR
  &clk_ref=19.2


  &alpha_reg=&HWIO_GCC_GPLL1_FRAC_VAL_ADDR
  &user_ctl_u_reg=&HWIO_GCC_GPLL1_USER_CTL_U_ADDR
  gosub Display_PLL "&pll_name" "&pll_num" &pll_type &mode_reg &l_reg &alpha_reg &alpha_u_reg &m_reg &n_reg &user_ctl_reg &status_reg &clk_ref


  &pll_name="GPLL2                       "
  &pll_num="2  "
  &pll_type="fabia_pll"
  &mode_reg=&HWIO_GCC_GPLL2_MODE_ADDR
  &l_reg=&HWIO_GCC_GPLL2_L_VAL_ADDR
  &alpha_reg=0
  &alpha_u_reg=0
  &m_reg=0
  &n_reg=0
  &user_ctl_reg=&HWIO_GCC_GPLL2_USER_CTL_ADDR
  &status_reg=&HWIO_GCC_GPLL2_STATUS_ADDR
  &clk_ref=19.2


  &alpha_reg=&HWIO_GCC_GPLL2_FRAC_VAL_ADDR
  &user_ctl_u_reg=&HWIO_GCC_GPLL2_USER_CTL_U_ADDR
  gosub Display_PLL "&pll_name" "&pll_num" &pll_type &mode_reg &l_reg &alpha_reg &alpha_u_reg &m_reg &n_reg &user_ctl_reg &status_reg &clk_ref


  &pll_name="GPLL3                       "
  &pll_num="3  "
  &pll_type="fabia_pll"
  &mode_reg=&HWIO_GCC_GPLL3_MODE_ADDR
  &l_reg=&HWIO_GCC_GPLL3_L_VAL_ADDR
  &alpha_reg=0
  &alpha_u_reg=0
  &m_reg=0
  &n_reg=0
  &user_ctl_reg=&HWIO_GCC_GPLL3_USER_CTL_ADDR
  &status_reg=&HWIO_GCC_GPLL3_STATUS_ADDR
  &clk_ref=19.2


  &alpha_reg=&HWIO_GCC_GPLL3_FRAC_VAL_ADDR
  &user_ctl_u_reg=&HWIO_GCC_GPLL3_USER_CTL_U_ADDR
  gosub Display_PLL "&pll_name" "&pll_num" &pll_type &mode_reg &l_reg &alpha_reg &alpha_u_reg &m_reg &n_reg &user_ctl_reg &status_reg &clk_ref


  &pll_name="GPLL4                       "
  &pll_num="4  "
  &pll_type="fabia_pll"
  &mode_reg=&HWIO_GCC_GPLL4_MODE_ADDR
  &l_reg=&HWIO_GCC_GPLL4_L_VAL_ADDR
  &alpha_reg=0
  &alpha_u_reg=0
  &m_reg=0
  &n_reg=0
  &user_ctl_reg=&HWIO_GCC_GPLL4_USER_CTL_ADDR
  &status_reg=&HWIO_GCC_GPLL4_STATUS_ADDR
  &clk_ref=19.2


  &alpha_reg=&HWIO_GCC_GPLL4_FRAC_VAL_ADDR
  &user_ctl_u_reg=&HWIO_GCC_GPLL4_USER_CTL_U_ADDR
  gosub Display_PLL "&pll_name" "&pll_num" &pll_type &mode_reg &l_reg &alpha_reg &alpha_u_reg &m_reg &n_reg &user_ctl_reg &status_reg &clk_ref


  &pll_name="GPLL5                       "
  &pll_num="5  "
  &pll_type="fabia_pll"
  &mode_reg=&HWIO_GCC_GPLL5_MODE_ADDR
  &l_reg=&HWIO_GCC_GPLL5_L_VAL_ADDR
  &alpha_reg=0
  &alpha_u_reg=0
  &m_reg=0
  &n_reg=0
  &user_ctl_reg=&HWIO_GCC_GPLL5_USER_CTL_ADDR
  &status_reg=&HWIO_GCC_GPLL5_STATUS_ADDR
  &clk_ref=19.2


  &alpha_reg=&HWIO_GCC_GPLL5_FRAC_VAL_ADDR
  &user_ctl_u_reg=&HWIO_GCC_GPLL5_USER_CTL_U_ADDR
  gosub Display_PLL "&pll_name" "&pll_num" &pll_type &mode_reg &l_reg &alpha_reg &alpha_u_reg &m_reg &n_reg &user_ctl_reg &status_reg &clk_ref


  &pll_name="GPLL6                       "
  &pll_num="6  "
  &pll_type="fabia_pll"
  &mode_reg=&HWIO_GCC_GPLL6_MODE_ADDR
  &l_reg=&HWIO_GCC_GPLL6_L_VAL_ADDR
  &alpha_reg=0
  &alpha_u_reg=0
  &m_reg=0
  &n_reg=0
  &user_ctl_reg=&HWIO_GCC_GPLL6_USER_CTL_ADDR
  &status_reg=&HWIO_GCC_GPLL6_STATUS_ADDR
  &clk_ref=19.2


  &alpha_reg=&HWIO_GCC_GPLL6_FRAC_VAL_ADDR
  &user_ctl_u_reg=&HWIO_GCC_GPLL6_USER_CTL_U_ADDR
  gosub Display_PLL "&pll_name" "&pll_num" &pll_type &mode_reg &l_reg &alpha_reg &alpha_u_reg &m_reg &n_reg &user_ctl_reg &status_reg &clk_ref


  &pll_name="GPLL7                       "
  &pll_num="7  "
  &pll_type="pippo_pll"
  &mode_reg=&HWIO_GCC_GPLL7_MODE_ADDR
  &l_reg=&HWIO_GCC_GPLL7_L_VAL_ADDR
  &alpha_reg=0
  &alpha_u_reg=0
  &m_reg=0
  &n_reg=0
  &user_ctl_reg=&HWIO_GCC_GPLL7_USER_CTL_ADDR
  &status_reg=&HWIO_GCC_GPLL7_STATUS_ADDR
  &clk_ref=19.2


  &user_ctl_u_reg=&HWIO_GCC_GPLL7_USER_CTL_U_ADDR
  gosub Display_PLL "&pll_name" "&pll_num" &pll_type &mode_reg &l_reg &alpha_reg &alpha_u_reg &m_reg &n_reg &user_ctl_reg &status_reg &clk_ref


  &pll_name="GPU_PLL0_PLL                "
  &pll_num="8  "
  &pll_type="fabia_pll"
  &mode_reg=&HWIO_GPUCC_GPU_PLL0_PLL_MODE_ADDR
  &l_reg=&HWIO_GPUCC_GPU_PLL0_PLL_L_VAL_ADDR
  &alpha_reg=0
  &alpha_u_reg=0
  &m_reg=0
  &n_reg=0
  &user_ctl_reg=&HWIO_GPUCC_GPU_PLL0_PLL_USER_CTL_ADDR
  &status_reg=&HWIO_GPUCC_GPU_PLL0_PLL_STATUS_ADDR
  &clk_ref=19.2


  &alpha_reg=&HWIO_GPUCC_GPU_PLL0_PLL_FRAC_VAL_ADDR
  &user_ctl_u_reg=&HWIO_GPUCC_GPU_PLL0_PLL_USER_CTL_U_ADDR
  gosub Display_PLL "&pll_name" "&pll_num" &pll_type &mode_reg &l_reg &alpha_reg &alpha_u_reg &m_reg &n_reg &user_ctl_reg &status_reg &clk_ref


  &pll_name="GPU_PLL1_PLL                "
  &pll_num="9  "
  &pll_type="fabia_pll"
  &mode_reg=&HWIO_GPUCC_GPU_PLL1_PLL_MODE_ADDR
  &l_reg=&HWIO_GPUCC_GPU_PLL1_PLL_L_VAL_ADDR
  &alpha_reg=0
  &alpha_u_reg=0
  &m_reg=0
  &n_reg=0
  &user_ctl_reg=&HWIO_GPUCC_GPU_PLL1_PLL_USER_CTL_ADDR
  &status_reg=&HWIO_GPUCC_GPU_PLL1_PLL_STATUS_ADDR
  &clk_ref=19.2


  &alpha_reg=&HWIO_GPUCC_GPU_PLL1_PLL_FRAC_VAL_ADDR
  &user_ctl_u_reg=&HWIO_GPUCC_GPU_PLL1_PLL_USER_CTL_U_ADDR
  gosub Display_PLL "&pll_name" "&pll_num" &pll_type &mode_reg &l_reg &alpha_reg &alpha_u_reg &m_reg &n_reg &user_ctl_reg &status_reg &clk_ref


  &pll_name="LPASS_LPAAUDIO_PLL          "
  &pll_num="10 "
  &pll_type="agera_pll"
  &mode_reg=&HWIO_LPASS_LPAAUDIO_PLL_MODE_ADDR
  &l_reg=&HWIO_LPASS_LPAAUDIO_PLL_L_VAL_ADDR
  &alpha_reg=0
  &alpha_u_reg=0
  &m_reg=0
  &n_reg=0
  &user_ctl_reg=&HWIO_LPASS_LPAAUDIO_PLL_USER_CTL_ADDR
  &status_reg=&HWIO_LPASS_LPAAUDIO_PLL_STATUS_ADDR
  &clk_ref=19.2


  &alpha_reg=&HWIO_LPASS_LPAAUDIO_PLL_ALPHA_VAL_ADDR
  gosub Display_PLL "&pll_name" "&pll_num" &pll_type &mode_reg &l_reg &alpha_reg &alpha_u_reg &m_reg &n_reg &user_ctl_reg &status_reg &clk_ref


  &pll_name="LPASS_LPAAUDIO_DIG_PLL      "
  &pll_num="11 "
  &pll_type="fabia_pll"
  &mode_reg=&HWIO_LPASS_LPAAUDIO_DIG_PLL_MODE_ADDR
  &l_reg=&HWIO_LPASS_LPAAUDIO_DIG_PLL_L_VAL_ADDR
  &alpha_reg=0
  &alpha_u_reg=0
  &m_reg=0
  &n_reg=0
  &user_ctl_reg=&HWIO_LPASS_LPAAUDIO_DIG_PLL_USER_CTL_ADDR
  &status_reg=&HWIO_LPASS_LPAAUDIO_DIG_PLL_STATUS_ADDR
  &clk_ref=19.2


  &alpha_reg=&HWIO_LPASS_LPAAUDIO_DIG_PLL_FRAC_VAL_ADDR
  &user_ctl_u_reg=&HWIO_LPASS_LPAAUDIO_DIG_PLL_USER_CTL_U_ADDR
  gosub Display_PLL "&pll_name" "&pll_num" &pll_type &mode_reg &l_reg &alpha_reg &alpha_u_reg &m_reg &n_reg &user_ctl_reg &status_reg &clk_ref


  &pll_name="LPASS_QDSP6SS_PLL           "
  &pll_num="12 "
  &pll_type="fabia_pll"
  &mode_reg=&HWIO_LPASS_QDSP6SS_PLL_MODE_ADDR
  &l_reg=&HWIO_LPASS_QDSP6SS_PLL_L_VAL_ADDR
  &alpha_reg=0
  &alpha_u_reg=0
  &m_reg=0
  &n_reg=0
  &user_ctl_reg=&HWIO_LPASS_QDSP6SS_PLL_USER_CTL_ADDR
  &status_reg=&HWIO_LPASS_QDSP6SS_PLL_STATUS_ADDR
  &clk_ref=19.2


  &alpha_reg=&HWIO_LPASS_QDSP6SS_PLL_FRAC_VAL_ADDR
  &user_ctl_u_reg=&HWIO_LPASS_QDSP6SS_PLL_USER_CTL_U_ADDR
  gosub Display_PLL "&pll_name" "&pll_num" &pll_type &mode_reg &l_reg &alpha_reg &alpha_u_reg &m_reg &n_reg &user_ctl_reg &status_reg &clk_ref


  &pll_name="MMPLL0_PLL                  "
  &pll_num="13 "
  &pll_type="fabia_pll"
  &mode_reg=&HWIO_MMSS_MMPLL0_PLL_MODE_ADDR
  &l_reg=&HWIO_MMSS_MMPLL0_PLL_L_VAL_ADDR
  &alpha_reg=0
  &alpha_u_reg=0
  &m_reg=0
  &n_reg=0
  &user_ctl_reg=&HWIO_MMSS_MMPLL0_PLL_USER_CTL_ADDR
  &status_reg=&HWIO_MMSS_MMPLL0_PLL_STATUS_ADDR
  &clk_ref=19.2


  &alpha_reg=&HWIO_MMSS_MMPLL0_PLL_FRAC_VAL_ADDR
  &user_ctl_u_reg=&HWIO_MMSS_MMPLL0_PLL_USER_CTL_U_ADDR
  gosub Display_PLL "&pll_name" "&pll_num" &pll_type &mode_reg &l_reg &alpha_reg &alpha_u_reg &m_reg &n_reg &user_ctl_reg &status_reg &clk_ref


  &pll_name="MMPLL1_PLL                  "
  &pll_num="14 "
  &pll_type="fabia_pll"
  &mode_reg=&HWIO_MMSS_MMPLL1_PLL_MODE_ADDR
  &l_reg=&HWIO_MMSS_MMPLL1_PLL_L_VAL_ADDR
  &alpha_reg=0
  &alpha_u_reg=0
  &m_reg=0
  &n_reg=0
  &user_ctl_reg=&HWIO_MMSS_MMPLL1_PLL_USER_CTL_ADDR
  &status_reg=&HWIO_MMSS_MMPLL1_PLL_STATUS_ADDR
  &clk_ref=19.2


  &alpha_reg=&HWIO_MMSS_MMPLL1_PLL_FRAC_VAL_ADDR
  &user_ctl_u_reg=&HWIO_MMSS_MMPLL1_PLL_USER_CTL_U_ADDR
  gosub Display_PLL "&pll_name" "&pll_num" &pll_type &mode_reg &l_reg &alpha_reg &alpha_u_reg &m_reg &n_reg &user_ctl_reg &status_reg &clk_ref


  &pll_name="MMPLL3_PLL                  "
  &pll_num="15 "
  &pll_type="fabia_pll"
  &mode_reg=&HWIO_MMSS_MMPLL3_PLL_MODE_ADDR
  &l_reg=&HWIO_MMSS_MMPLL3_PLL_L_VAL_ADDR
  &alpha_reg=0
  &alpha_u_reg=0
  &m_reg=0
  &n_reg=0
  &user_ctl_reg=&HWIO_MMSS_MMPLL3_PLL_USER_CTL_ADDR
  &status_reg=&HWIO_MMSS_MMPLL3_PLL_STATUS_ADDR
  &clk_ref=19.2


  &alpha_reg=&HWIO_MMSS_MMPLL3_PLL_FRAC_VAL_ADDR
  &user_ctl_u_reg=&HWIO_MMSS_MMPLL3_PLL_USER_CTL_U_ADDR
  gosub Display_PLL "&pll_name" "&pll_num" &pll_type &mode_reg &l_reg &alpha_reg &alpha_u_reg &m_reg &n_reg &user_ctl_reg &status_reg &clk_ref


  &pll_name="MMPLL4_PLL                  "
  &pll_num="16 "
  &pll_type="fabia_pll"
  &mode_reg=&HWIO_MMSS_MMPLL4_PLL_MODE_ADDR
  &l_reg=&HWIO_MMSS_MMPLL4_PLL_L_VAL_ADDR
  &alpha_reg=0
  &alpha_u_reg=0
  &m_reg=0
  &n_reg=0
  &user_ctl_reg=&HWIO_MMSS_MMPLL4_PLL_USER_CTL_ADDR
  &status_reg=&HWIO_MMSS_MMPLL4_PLL_STATUS_ADDR
  &clk_ref=19.2


  &alpha_reg=&HWIO_MMSS_MMPLL4_PLL_FRAC_VAL_ADDR
  &user_ctl_u_reg=&HWIO_MMSS_MMPLL4_PLL_USER_CTL_U_ADDR
  gosub Display_PLL "&pll_name" "&pll_num" &pll_type &mode_reg &l_reg &alpha_reg &alpha_u_reg &m_reg &n_reg &user_ctl_reg &status_reg &clk_ref


  &pll_name="MMPLL5_PLL                  "
  &pll_num="17 "
  &pll_type="fabia_pll"
  &mode_reg=&HWIO_MMSS_MMPLL5_PLL_MODE_ADDR
  &l_reg=&HWIO_MMSS_MMPLL5_PLL_L_VAL_ADDR
  &alpha_reg=0
  &alpha_u_reg=0
  &m_reg=0
  &n_reg=0
  &user_ctl_reg=&HWIO_MMSS_MMPLL5_PLL_USER_CTL_ADDR
  &status_reg=&HWIO_MMSS_MMPLL5_PLL_STATUS_ADDR
  &clk_ref=19.2


  &alpha_reg=&HWIO_MMSS_MMPLL5_PLL_FRAC_VAL_ADDR
  &user_ctl_u_reg=&HWIO_MMSS_MMPLL5_PLL_USER_CTL_U_ADDR
  gosub Display_PLL "&pll_name" "&pll_num" &pll_type &mode_reg &l_reg &alpha_reg &alpha_u_reg &m_reg &n_reg &user_ctl_reg &status_reg &clk_ref


  &pll_name="MMPLL6_PLL                  "
  &pll_num="18 "
  &pll_type="fabia_pll"
  &mode_reg=&HWIO_MMSS_MMPLL6_PLL_MODE_ADDR
  &l_reg=&HWIO_MMSS_MMPLL6_PLL_L_VAL_ADDR
  &alpha_reg=0
  &alpha_u_reg=0
  &m_reg=0
  &n_reg=0
  &user_ctl_reg=&HWIO_MMSS_MMPLL6_PLL_USER_CTL_ADDR
  &status_reg=&HWIO_MMSS_MMPLL6_PLL_STATUS_ADDR
  &clk_ref=19.2


  &alpha_reg=&HWIO_MMSS_MMPLL6_PLL_FRAC_VAL_ADDR
  &user_ctl_u_reg=&HWIO_MMSS_MMPLL6_PLL_USER_CTL_U_ADDR
  gosub Display_PLL "&pll_name" "&pll_num" &pll_type &mode_reg &l_reg &alpha_reg &alpha_u_reg &m_reg &n_reg &user_ctl_reg &status_reg &clk_ref


  &pll_name="MMPLL7_PLL                  "
  &pll_num="19 "
  &pll_type="fabia_pll"
  &mode_reg=&HWIO_MMSS_MMPLL7_PLL_MODE_ADDR
  &l_reg=&HWIO_MMSS_MMPLL7_PLL_L_VAL_ADDR
  &alpha_reg=0
  &alpha_u_reg=0
  &m_reg=0
  &n_reg=0
  &user_ctl_reg=&HWIO_MMSS_MMPLL7_PLL_USER_CTL_ADDR
  &status_reg=&HWIO_MMSS_MMPLL7_PLL_STATUS_ADDR
  &clk_ref=19.2


  &alpha_reg=&HWIO_MMSS_MMPLL7_PLL_FRAC_VAL_ADDR
  &user_ctl_u_reg=&HWIO_MMSS_MMPLL7_PLL_USER_CTL_U_ADDR
  gosub Display_PLL "&pll_name" "&pll_num" &pll_type &mode_reg &l_reg &alpha_reg &alpha_u_reg &m_reg &n_reg &user_ctl_reg &status_reg &clk_ref


  &pll_name="MMPLL10_PLL                 "
  &pll_num="20 "
  &pll_type="fabia_pll"
  &mode_reg=&HWIO_MMSS_MMPLL10_PLL_MODE_ADDR
  &l_reg=&HWIO_MMSS_MMPLL10_PLL_L_VAL_ADDR
  &alpha_reg=0
  &alpha_u_reg=0
  &m_reg=0
  &n_reg=0
  &user_ctl_reg=&HWIO_MMSS_MMPLL10_PLL_USER_CTL_ADDR
  &status_reg=&HWIO_MMSS_MMPLL10_PLL_STATUS_ADDR
  &clk_ref=19.2


  &alpha_reg=&HWIO_MMSS_MMPLL10_PLL_FRAC_VAL_ADDR
  &user_ctl_u_reg=&HWIO_MMSS_MMPLL10_PLL_USER_CTL_U_ADDR
  gosub Display_PLL "&pll_name" "&pll_num" &pll_type &mode_reg &l_reg &alpha_reg &alpha_u_reg &m_reg &n_reg &user_ctl_reg &status_reg &clk_ref


  &pll_name="SCC_PLL                     "
  &pll_num="21 "
  &pll_type="fabia_pll"
  &mode_reg=&HWIO_SSC_SCC_SCC_PLL_MODE_ADDR
  &l_reg=&HWIO_SSC_SCC_SCC_PLL_L_VAL_ADDR
  &alpha_reg=0
  &alpha_u_reg=0
  &m_reg=0
  &n_reg=0
  &user_ctl_reg=&HWIO_SSC_SCC_SCC_PLL_USER_CTL_ADDR
  &status_reg=&HWIO_SSC_SCC_SCC_PLL_STATUS_ADDR
  &clk_ref=19.2


  &alpha_reg=&HWIO_SSC_SCC_SCC_PLL_FRAC_VAL_ADDR
  &user_ctl_u_reg=&HWIO_SSC_SCC_SCC_PLL_USER_CTL_U_ADDR
  gosub Display_PLL "&pll_name" "&pll_num" &pll_type &mode_reg &l_reg &alpha_reg &alpha_u_reg &m_reg &n_reg &user_ctl_reg &status_reg &clk_ref


  &pll_name="QDSP6SS_PLL                 "
  &pll_num="22 "
  &pll_type="fabia_pll"
  &mode_reg=&HWIO_SSC_QDSP6SS_PLL_MODE_ADDR
  &l_reg=&HWIO_SSC_QDSP6SS_PLL_L_VAL_ADDR
  &alpha_reg=0
  &alpha_u_reg=0
  &m_reg=0
  &n_reg=0
  &user_ctl_reg=&HWIO_SSC_QDSP6SS_PLL_USER_CTL_ADDR
  &status_reg=&HWIO_SSC_QDSP6SS_PLL_STATUS_ADDR
  &clk_ref=19.2


  &alpha_reg=&HWIO_SSC_QDSP6SS_PLL_FRAC_VAL_ADDR
  &user_ctl_u_reg=&HWIO_SSC_QDSP6SS_PLL_USER_CTL_U_ADDR
  gosub Display_PLL "&pll_name" "&pll_num" &pll_type &mode_reg &l_reg &alpha_reg &alpha_u_reg &m_reg &n_reg &user_ctl_reg &status_reg &clk_ref


  print " "
  print " "

  return


;-----------------------------------------------------------------------------
; Display the dump of mode/status registers.
;-----------------------------------------------------------------------------

Display_Dump:

  local &mode_reg
  local &user_ctl_reg
  local &user_ctl_u_reg
  local &config_ctl_reg
  local &test_ctl_reg
  local &test_ctl_u_reg
  local &status_reg

  ; Display the PLL mode, status, user, and test registers.


  &mode_reg=&HWIO_GCC_GPLL0_MODE_ADDR
  &status_reg=&HWIO_GCC_GPLL0_STATUS_ADDR
  &user_ctl_reg=&HWIO_GCC_GPLL0_USER_CTL_ADDR
  &config_ctl_reg=&HWIO_GCC_GPLL0_CONFIG_CTL_ADDR
  &test_ctl_reg=&HWIO_GCC_GPLL0_TEST_CTL_ADDR
  &l_reg=&HWIO_GCC_GPLL0_L_VAL_ADDR
  &alpha_reg=0
  &alpha_u_reg=0
  &m_reg=0
  &n_reg=0
  &user_ctl_u_reg=0
  &test_ctl_u_reg=0
  &alpha_reg=&HWIO_GCC_GPLL0_FRAC_VAL_ADDR
  &user_ctl_u_reg=&HWIO_GCC_GPLL0_USER_CTL_U_ADDR
  &test_ctl_u_reg=&HWIO_GCC_GPLL0_TEST_CTL_U_ADDR
  gosub Format_Dump_Registers   0. GPLL0                        &mode_reg &user_ctl_reg &user_ctl_u_reg &config_ctl_reg &test_ctl_reg &test_ctl_u_reg &status_reg &l_reg &alpha_reg &alpha_u_reg &m_reg &n_reg

  &mode_reg=&HWIO_GCC_GPLL1_MODE_ADDR
  &status_reg=&HWIO_GCC_GPLL1_STATUS_ADDR
  &user_ctl_reg=&HWIO_GCC_GPLL1_USER_CTL_ADDR
  &config_ctl_reg=&HWIO_GCC_GPLL1_CONFIG_CTL_ADDR
  &test_ctl_reg=&HWIO_GCC_GPLL1_TEST_CTL_ADDR
  &l_reg=&HWIO_GCC_GPLL1_L_VAL_ADDR
  &alpha_reg=0
  &alpha_u_reg=0
  &m_reg=0
  &n_reg=0
  &user_ctl_u_reg=0
  &test_ctl_u_reg=0
  &alpha_reg=&HWIO_GCC_GPLL1_FRAC_VAL_ADDR
  &user_ctl_u_reg=&HWIO_GCC_GPLL1_USER_CTL_U_ADDR
  &test_ctl_u_reg=&HWIO_GCC_GPLL1_TEST_CTL_U_ADDR
  gosub Format_Dump_Registers   1. GPLL1                        &mode_reg &user_ctl_reg &user_ctl_u_reg &config_ctl_reg &test_ctl_reg &test_ctl_u_reg &status_reg &l_reg &alpha_reg &alpha_u_reg &m_reg &n_reg

  &mode_reg=&HWIO_GCC_GPLL2_MODE_ADDR
  &status_reg=&HWIO_GCC_GPLL2_STATUS_ADDR
  &user_ctl_reg=&HWIO_GCC_GPLL2_USER_CTL_ADDR
  &config_ctl_reg=&HWIO_GCC_GPLL2_CONFIG_CTL_ADDR
  &test_ctl_reg=&HWIO_GCC_GPLL2_TEST_CTL_ADDR
  &l_reg=&HWIO_GCC_GPLL2_L_VAL_ADDR
  &alpha_reg=0
  &alpha_u_reg=0
  &m_reg=0
  &n_reg=0
  &user_ctl_u_reg=0
  &test_ctl_u_reg=0
  &alpha_reg=&HWIO_GCC_GPLL2_FRAC_VAL_ADDR
  &user_ctl_u_reg=&HWIO_GCC_GPLL2_USER_CTL_U_ADDR
  &test_ctl_u_reg=&HWIO_GCC_GPLL2_TEST_CTL_U_ADDR
  gosub Format_Dump_Registers   2. GPLL2                        &mode_reg &user_ctl_reg &user_ctl_u_reg &config_ctl_reg &test_ctl_reg &test_ctl_u_reg &status_reg &l_reg &alpha_reg &alpha_u_reg &m_reg &n_reg

  &mode_reg=&HWIO_GCC_GPLL3_MODE_ADDR
  &status_reg=&HWIO_GCC_GPLL3_STATUS_ADDR
  &user_ctl_reg=&HWIO_GCC_GPLL3_USER_CTL_ADDR
  &config_ctl_reg=&HWIO_GCC_GPLL3_CONFIG_CTL_ADDR
  &test_ctl_reg=&HWIO_GCC_GPLL3_TEST_CTL_ADDR
  &l_reg=&HWIO_GCC_GPLL3_L_VAL_ADDR
  &alpha_reg=0
  &alpha_u_reg=0
  &m_reg=0
  &n_reg=0
  &user_ctl_u_reg=0
  &test_ctl_u_reg=0
  &alpha_reg=&HWIO_GCC_GPLL3_FRAC_VAL_ADDR
  &user_ctl_u_reg=&HWIO_GCC_GPLL3_USER_CTL_U_ADDR
  &test_ctl_u_reg=&HWIO_GCC_GPLL3_TEST_CTL_U_ADDR
  gosub Format_Dump_Registers   3. GPLL3                        &mode_reg &user_ctl_reg &user_ctl_u_reg &config_ctl_reg &test_ctl_reg &test_ctl_u_reg &status_reg &l_reg &alpha_reg &alpha_u_reg &m_reg &n_reg

  &mode_reg=&HWIO_GCC_GPLL4_MODE_ADDR
  &status_reg=&HWIO_GCC_GPLL4_STATUS_ADDR
  &user_ctl_reg=&HWIO_GCC_GPLL4_USER_CTL_ADDR
  &config_ctl_reg=&HWIO_GCC_GPLL4_CONFIG_CTL_ADDR
  &test_ctl_reg=&HWIO_GCC_GPLL4_TEST_CTL_ADDR
  &l_reg=&HWIO_GCC_GPLL4_L_VAL_ADDR
  &alpha_reg=0
  &alpha_u_reg=0
  &m_reg=0
  &n_reg=0
  &user_ctl_u_reg=0
  &test_ctl_u_reg=0
  &alpha_reg=&HWIO_GCC_GPLL4_FRAC_VAL_ADDR
  &user_ctl_u_reg=&HWIO_GCC_GPLL4_USER_CTL_U_ADDR
  &test_ctl_u_reg=&HWIO_GCC_GPLL4_TEST_CTL_U_ADDR
  gosub Format_Dump_Registers   4. GPLL4                        &mode_reg &user_ctl_reg &user_ctl_u_reg &config_ctl_reg &test_ctl_reg &test_ctl_u_reg &status_reg &l_reg &alpha_reg &alpha_u_reg &m_reg &n_reg

  &mode_reg=&HWIO_GCC_GPLL5_MODE_ADDR
  &status_reg=&HWIO_GCC_GPLL5_STATUS_ADDR
  &user_ctl_reg=&HWIO_GCC_GPLL5_USER_CTL_ADDR
  &config_ctl_reg=&HWIO_GCC_GPLL5_CONFIG_CTL_ADDR
  &test_ctl_reg=&HWIO_GCC_GPLL5_TEST_CTL_ADDR
  &l_reg=&HWIO_GCC_GPLL5_L_VAL_ADDR
  &alpha_reg=0
  &alpha_u_reg=0
  &m_reg=0
  &n_reg=0
  &user_ctl_u_reg=0
  &test_ctl_u_reg=0
  &alpha_reg=&HWIO_GCC_GPLL5_FRAC_VAL_ADDR
  &user_ctl_u_reg=&HWIO_GCC_GPLL5_USER_CTL_U_ADDR
  &test_ctl_u_reg=&HWIO_GCC_GPLL5_TEST_CTL_U_ADDR
  gosub Format_Dump_Registers   5. GPLL5                        &mode_reg &user_ctl_reg &user_ctl_u_reg &config_ctl_reg &test_ctl_reg &test_ctl_u_reg &status_reg &l_reg &alpha_reg &alpha_u_reg &m_reg &n_reg

  &mode_reg=&HWIO_GCC_GPLL6_MODE_ADDR
  &status_reg=&HWIO_GCC_GPLL6_STATUS_ADDR
  &user_ctl_reg=&HWIO_GCC_GPLL6_USER_CTL_ADDR
  &config_ctl_reg=&HWIO_GCC_GPLL6_CONFIG_CTL_ADDR
  &test_ctl_reg=&HWIO_GCC_GPLL6_TEST_CTL_ADDR
  &l_reg=&HWIO_GCC_GPLL6_L_VAL_ADDR
  &alpha_reg=0
  &alpha_u_reg=0
  &m_reg=0
  &n_reg=0
  &user_ctl_u_reg=0
  &test_ctl_u_reg=0
  &alpha_reg=&HWIO_GCC_GPLL6_FRAC_VAL_ADDR
  &user_ctl_u_reg=&HWIO_GCC_GPLL6_USER_CTL_U_ADDR
  &test_ctl_u_reg=&HWIO_GCC_GPLL6_TEST_CTL_U_ADDR
  gosub Format_Dump_Registers   6. GPLL6                        &mode_reg &user_ctl_reg &user_ctl_u_reg &config_ctl_reg &test_ctl_reg &test_ctl_u_reg &status_reg &l_reg &alpha_reg &alpha_u_reg &m_reg &n_reg

  &mode_reg=&HWIO_GCC_GPLL7_MODE_ADDR
  &status_reg=&HWIO_GCC_GPLL7_STATUS_ADDR
  &user_ctl_reg=&HWIO_GCC_GPLL7_USER_CTL_ADDR
  &config_ctl_reg=&HWIO_GCC_GPLL7_CONFIG_CTL_ADDR
  &test_ctl_reg=&HWIO_GCC_GPLL7_TEST_CTL_ADDR
  &l_reg=&HWIO_GCC_GPLL7_L_VAL_ADDR
  &alpha_reg=0
  &alpha_u_reg=0
  &m_reg=0
  &n_reg=0
  &user_ctl_u_reg=0
  &test_ctl_u_reg=0
  &user_ctl_u_reg=&HWIO_GCC_GPLL7_USER_CTL_U_ADDR
  &test_ctl_u_reg=&HWIO_GCC_GPLL7_TEST_CTL_U_ADDR
  gosub Format_Dump_Registers   7. GPLL7                        &mode_reg &user_ctl_reg &user_ctl_u_reg &config_ctl_reg &test_ctl_reg &test_ctl_u_reg &status_reg &l_reg &alpha_reg &alpha_u_reg &m_reg &n_reg

  &mode_reg=&HWIO_GPUCC_GPU_PLL0_PLL_MODE_ADDR
  &status_reg=&HWIO_GPUCC_GPU_PLL0_PLL_STATUS_ADDR
  &user_ctl_reg=&HWIO_GPUCC_GPU_PLL0_PLL_USER_CTL_ADDR
  &config_ctl_reg=&HWIO_GPUCC_GPU_PLL0_PLL_CONFIG_CTL_ADDR
  &test_ctl_reg=&HWIO_GPUCC_GPU_PLL0_PLL_TEST_CTL_ADDR
  &l_reg=&HWIO_GPUCC_GPU_PLL0_PLL_L_VAL_ADDR
  &alpha_reg=0
  &alpha_u_reg=0
  &m_reg=0
  &n_reg=0
  &user_ctl_u_reg=0
  &test_ctl_u_reg=0
  &alpha_reg=&HWIO_GPUCC_GPU_PLL0_PLL_FRAC_VAL_ADDR
  &user_ctl_u_reg=&HWIO_GPUCC_GPU_PLL0_PLL_USER_CTL_U_ADDR
  &test_ctl_u_reg=&HWIO_GPUCC_GPU_PLL0_PLL_TEST_CTL_U_ADDR
  gosub Format_Dump_Registers   8. GPU_PLL0_PLL                 &mode_reg &user_ctl_reg &user_ctl_u_reg &config_ctl_reg &test_ctl_reg &test_ctl_u_reg &status_reg &l_reg &alpha_reg &alpha_u_reg &m_reg &n_reg

  &mode_reg=&HWIO_GPUCC_GPU_PLL1_PLL_MODE_ADDR
  &status_reg=&HWIO_GPUCC_GPU_PLL1_PLL_STATUS_ADDR
  &user_ctl_reg=&HWIO_GPUCC_GPU_PLL1_PLL_USER_CTL_ADDR
  &config_ctl_reg=&HWIO_GPUCC_GPU_PLL1_PLL_CONFIG_CTL_ADDR
  &test_ctl_reg=&HWIO_GPUCC_GPU_PLL1_PLL_TEST_CTL_ADDR
  &l_reg=&HWIO_GPUCC_GPU_PLL1_PLL_L_VAL_ADDR
  &alpha_reg=0
  &alpha_u_reg=0
  &m_reg=0
  &n_reg=0
  &user_ctl_u_reg=0
  &test_ctl_u_reg=0
  &alpha_reg=&HWIO_GPUCC_GPU_PLL1_PLL_FRAC_VAL_ADDR
  &user_ctl_u_reg=&HWIO_GPUCC_GPU_PLL1_PLL_USER_CTL_U_ADDR
  &test_ctl_u_reg=&HWIO_GPUCC_GPU_PLL1_PLL_TEST_CTL_U_ADDR
  gosub Format_Dump_Registers   9. GPU_PLL1_PLL                 &mode_reg &user_ctl_reg &user_ctl_u_reg &config_ctl_reg &test_ctl_reg &test_ctl_u_reg &status_reg &l_reg &alpha_reg &alpha_u_reg &m_reg &n_reg

  &mode_reg=&HWIO_LPASS_LPAAUDIO_PLL_MODE_ADDR
  &status_reg=&HWIO_LPASS_LPAAUDIO_PLL_STATUS_ADDR
  &user_ctl_reg=&HWIO_LPASS_LPAAUDIO_PLL_USER_CTL_ADDR
  &config_ctl_reg=&HWIO_LPASS_LPAAUDIO_PLL_CONFIG_CTL_ADDR
  &test_ctl_reg=&HWIO_LPASS_LPAAUDIO_PLL_TEST_CTL_ADDR
  &l_reg=&HWIO_LPASS_LPAAUDIO_PLL_L_VAL_ADDR
  &alpha_reg=0
  &alpha_u_reg=0
  &m_reg=0
  &n_reg=0
  &user_ctl_u_reg=0
  &test_ctl_u_reg=0
  &alpha_reg=&HWIO_LPASS_LPAAUDIO_PLL_ALPHA_VAL_ADDR
  &test_ctl_u_reg=&HWIO_LPASS_LPAAUDIO_PLL_TEST_CTL_U_ADDR
  gosub Format_Dump_Registers  10. LPASS_LPAAUDIO_PLL           &mode_reg &user_ctl_reg &user_ctl_u_reg &config_ctl_reg &test_ctl_reg &test_ctl_u_reg &status_reg &l_reg &alpha_reg &alpha_u_reg &m_reg &n_reg

  &mode_reg=&HWIO_LPASS_LPAAUDIO_DIG_PLL_MODE_ADDR
  &status_reg=&HWIO_LPASS_LPAAUDIO_DIG_PLL_STATUS_ADDR
  &user_ctl_reg=&HWIO_LPASS_LPAAUDIO_DIG_PLL_USER_CTL_ADDR
  &config_ctl_reg=&HWIO_LPASS_LPAAUDIO_DIG_PLL_CONFIG_CTL_ADDR
  &test_ctl_reg=&HWIO_LPASS_LPAAUDIO_DIG_PLL_TEST_CTL_ADDR
  &l_reg=&HWIO_LPASS_LPAAUDIO_DIG_PLL_L_VAL_ADDR
  &alpha_reg=0
  &alpha_u_reg=0
  &m_reg=0
  &n_reg=0
  &user_ctl_u_reg=0
  &test_ctl_u_reg=0
  &alpha_reg=&HWIO_LPASS_LPAAUDIO_DIG_PLL_FRAC_VAL_ADDR
  &user_ctl_u_reg=&HWIO_LPASS_LPAAUDIO_DIG_PLL_USER_CTL_U_ADDR
  &test_ctl_u_reg=&HWIO_LPASS_LPAAUDIO_DIG_PLL_TEST_CTL_U_ADDR
  gosub Format_Dump_Registers  11. LPASS_LPAAUDIO_DIG_PLL       &mode_reg &user_ctl_reg &user_ctl_u_reg &config_ctl_reg &test_ctl_reg &test_ctl_u_reg &status_reg &l_reg &alpha_reg &alpha_u_reg &m_reg &n_reg

  &mode_reg=&HWIO_LPASS_QDSP6SS_PLL_MODE_ADDR
  &status_reg=&HWIO_LPASS_QDSP6SS_PLL_STATUS_ADDR
  &user_ctl_reg=&HWIO_LPASS_QDSP6SS_PLL_USER_CTL_ADDR
  &config_ctl_reg=&HWIO_LPASS_QDSP6SS_PLL_CONFIG_CTL_ADDR
  &test_ctl_reg=&HWIO_LPASS_QDSP6SS_PLL_TEST_CTL_ADDR
  &l_reg=&HWIO_LPASS_QDSP6SS_PLL_L_VAL_ADDR
  &alpha_reg=0
  &alpha_u_reg=0
  &m_reg=0
  &n_reg=0
  &user_ctl_u_reg=0
  &test_ctl_u_reg=0
  &alpha_reg=&HWIO_LPASS_QDSP6SS_PLL_FRAC_VAL_ADDR
  &user_ctl_u_reg=&HWIO_LPASS_QDSP6SS_PLL_USER_CTL_U_ADDR
  &test_ctl_u_reg=&HWIO_LPASS_QDSP6SS_PLL_TEST_CTL_U_ADDR
  gosub Format_Dump_Registers  12. LPASS_QDSP6SS_PLL            &mode_reg &user_ctl_reg &user_ctl_u_reg &config_ctl_reg &test_ctl_reg &test_ctl_u_reg &status_reg &l_reg &alpha_reg &alpha_u_reg &m_reg &n_reg

  &mode_reg=&HWIO_MMSS_MMPLL0_PLL_MODE_ADDR
  &status_reg=&HWIO_MMSS_MMPLL0_PLL_STATUS_ADDR
  &user_ctl_reg=&HWIO_MMSS_MMPLL0_PLL_USER_CTL_ADDR
  &config_ctl_reg=&HWIO_MMSS_MMPLL0_PLL_CONFIG_CTL_ADDR
  &test_ctl_reg=&HWIO_MMSS_MMPLL0_PLL_TEST_CTL_ADDR
  &l_reg=&HWIO_MMSS_MMPLL0_PLL_L_VAL_ADDR
  &alpha_reg=0
  &alpha_u_reg=0
  &m_reg=0
  &n_reg=0
  &user_ctl_u_reg=0
  &test_ctl_u_reg=0
  &alpha_reg=&HWIO_MMSS_MMPLL0_PLL_FRAC_VAL_ADDR
  &user_ctl_u_reg=&HWIO_MMSS_MMPLL0_PLL_USER_CTL_U_ADDR
  &test_ctl_u_reg=&HWIO_MMSS_MMPLL0_PLL_TEST_CTL_U_ADDR
  gosub Format_Dump_Registers  13. MMPLL0_PLL                   &mode_reg &user_ctl_reg &user_ctl_u_reg &config_ctl_reg &test_ctl_reg &test_ctl_u_reg &status_reg &l_reg &alpha_reg &alpha_u_reg &m_reg &n_reg

  &mode_reg=&HWIO_MMSS_MMPLL1_PLL_MODE_ADDR
  &status_reg=&HWIO_MMSS_MMPLL1_PLL_STATUS_ADDR
  &user_ctl_reg=&HWIO_MMSS_MMPLL1_PLL_USER_CTL_ADDR
  &config_ctl_reg=&HWIO_MMSS_MMPLL1_PLL_CONFIG_CTL_ADDR
  &test_ctl_reg=&HWIO_MMSS_MMPLL1_PLL_TEST_CTL_ADDR
  &l_reg=&HWIO_MMSS_MMPLL1_PLL_L_VAL_ADDR
  &alpha_reg=0
  &alpha_u_reg=0
  &m_reg=0
  &n_reg=0
  &user_ctl_u_reg=0
  &test_ctl_u_reg=0
  &alpha_reg=&HWIO_MMSS_MMPLL1_PLL_FRAC_VAL_ADDR
  &user_ctl_u_reg=&HWIO_MMSS_MMPLL1_PLL_USER_CTL_U_ADDR
  &test_ctl_u_reg=&HWIO_MMSS_MMPLL1_PLL_TEST_CTL_U_ADDR
  gosub Format_Dump_Registers  14. MMPLL1_PLL                   &mode_reg &user_ctl_reg &user_ctl_u_reg &config_ctl_reg &test_ctl_reg &test_ctl_u_reg &status_reg &l_reg &alpha_reg &alpha_u_reg &m_reg &n_reg

  &mode_reg=&HWIO_MMSS_MMPLL3_PLL_MODE_ADDR
  &status_reg=&HWIO_MMSS_MMPLL3_PLL_STATUS_ADDR
  &user_ctl_reg=&HWIO_MMSS_MMPLL3_PLL_USER_CTL_ADDR
  &config_ctl_reg=&HWIO_MMSS_MMPLL3_PLL_CONFIG_CTL_ADDR
  &test_ctl_reg=&HWIO_MMSS_MMPLL3_PLL_TEST_CTL_ADDR
  &l_reg=&HWIO_MMSS_MMPLL3_PLL_L_VAL_ADDR
  &alpha_reg=0
  &alpha_u_reg=0
  &m_reg=0
  &n_reg=0
  &user_ctl_u_reg=0
  &test_ctl_u_reg=0
  &alpha_reg=&HWIO_MMSS_MMPLL3_PLL_FRAC_VAL_ADDR
  &user_ctl_u_reg=&HWIO_MMSS_MMPLL3_PLL_USER_CTL_U_ADDR
  &test_ctl_u_reg=&HWIO_MMSS_MMPLL3_PLL_TEST_CTL_U_ADDR
  gosub Format_Dump_Registers  15. MMPLL3_PLL                   &mode_reg &user_ctl_reg &user_ctl_u_reg &config_ctl_reg &test_ctl_reg &test_ctl_u_reg &status_reg &l_reg &alpha_reg &alpha_u_reg &m_reg &n_reg

  &mode_reg=&HWIO_MMSS_MMPLL4_PLL_MODE_ADDR
  &status_reg=&HWIO_MMSS_MMPLL4_PLL_STATUS_ADDR
  &user_ctl_reg=&HWIO_MMSS_MMPLL4_PLL_USER_CTL_ADDR
  &config_ctl_reg=&HWIO_MMSS_MMPLL4_PLL_CONFIG_CTL_ADDR
  &test_ctl_reg=&HWIO_MMSS_MMPLL4_PLL_TEST_CTL_ADDR
  &l_reg=&HWIO_MMSS_MMPLL4_PLL_L_VAL_ADDR
  &alpha_reg=0
  &alpha_u_reg=0
  &m_reg=0
  &n_reg=0
  &user_ctl_u_reg=0
  &test_ctl_u_reg=0
  &alpha_reg=&HWIO_MMSS_MMPLL4_PLL_FRAC_VAL_ADDR
  &user_ctl_u_reg=&HWIO_MMSS_MMPLL4_PLL_USER_CTL_U_ADDR
  &test_ctl_u_reg=&HWIO_MMSS_MMPLL4_PLL_TEST_CTL_U_ADDR
  gosub Format_Dump_Registers  16. MMPLL4_PLL                   &mode_reg &user_ctl_reg &user_ctl_u_reg &config_ctl_reg &test_ctl_reg &test_ctl_u_reg &status_reg &l_reg &alpha_reg &alpha_u_reg &m_reg &n_reg

  &mode_reg=&HWIO_MMSS_MMPLL5_PLL_MODE_ADDR
  &status_reg=&HWIO_MMSS_MMPLL5_PLL_STATUS_ADDR
  &user_ctl_reg=&HWIO_MMSS_MMPLL5_PLL_USER_CTL_ADDR
  &config_ctl_reg=&HWIO_MMSS_MMPLL5_PLL_CONFIG_CTL_ADDR
  &test_ctl_reg=&HWIO_MMSS_MMPLL5_PLL_TEST_CTL_ADDR
  &l_reg=&HWIO_MMSS_MMPLL5_PLL_L_VAL_ADDR
  &alpha_reg=0
  &alpha_u_reg=0
  &m_reg=0
  &n_reg=0
  &user_ctl_u_reg=0
  &test_ctl_u_reg=0
  &alpha_reg=&HWIO_MMSS_MMPLL5_PLL_FRAC_VAL_ADDR
  &user_ctl_u_reg=&HWIO_MMSS_MMPLL5_PLL_USER_CTL_U_ADDR
  &test_ctl_u_reg=&HWIO_MMSS_MMPLL5_PLL_TEST_CTL_U_ADDR
  gosub Format_Dump_Registers  17. MMPLL5_PLL                   &mode_reg &user_ctl_reg &user_ctl_u_reg &config_ctl_reg &test_ctl_reg &test_ctl_u_reg &status_reg &l_reg &alpha_reg &alpha_u_reg &m_reg &n_reg

  &mode_reg=&HWIO_MMSS_MMPLL6_PLL_MODE_ADDR
  &status_reg=&HWIO_MMSS_MMPLL6_PLL_STATUS_ADDR
  &user_ctl_reg=&HWIO_MMSS_MMPLL6_PLL_USER_CTL_ADDR
  &config_ctl_reg=&HWIO_MMSS_MMPLL6_PLL_CONFIG_CTL_ADDR
  &test_ctl_reg=&HWIO_MMSS_MMPLL6_PLL_TEST_CTL_ADDR
  &l_reg=&HWIO_MMSS_MMPLL6_PLL_L_VAL_ADDR
  &alpha_reg=0
  &alpha_u_reg=0
  &m_reg=0
  &n_reg=0
  &user_ctl_u_reg=0
  &test_ctl_u_reg=0
  &alpha_reg=&HWIO_MMSS_MMPLL6_PLL_FRAC_VAL_ADDR
  &user_ctl_u_reg=&HWIO_MMSS_MMPLL6_PLL_USER_CTL_U_ADDR
  &test_ctl_u_reg=&HWIO_MMSS_MMPLL6_PLL_TEST_CTL_U_ADDR
  gosub Format_Dump_Registers  18. MMPLL6_PLL                   &mode_reg &user_ctl_reg &user_ctl_u_reg &config_ctl_reg &test_ctl_reg &test_ctl_u_reg &status_reg &l_reg &alpha_reg &alpha_u_reg &m_reg &n_reg

  &mode_reg=&HWIO_MMSS_MMPLL7_PLL_MODE_ADDR
  &status_reg=&HWIO_MMSS_MMPLL7_PLL_STATUS_ADDR
  &user_ctl_reg=&HWIO_MMSS_MMPLL7_PLL_USER_CTL_ADDR
  &config_ctl_reg=&HWIO_MMSS_MMPLL7_PLL_CONFIG_CTL_ADDR
  &test_ctl_reg=&HWIO_MMSS_MMPLL7_PLL_TEST_CTL_ADDR
  &l_reg=&HWIO_MMSS_MMPLL7_PLL_L_VAL_ADDR
  &alpha_reg=0
  &alpha_u_reg=0
  &m_reg=0
  &n_reg=0
  &user_ctl_u_reg=0
  &test_ctl_u_reg=0
  &alpha_reg=&HWIO_MMSS_MMPLL7_PLL_FRAC_VAL_ADDR
  &user_ctl_u_reg=&HWIO_MMSS_MMPLL7_PLL_USER_CTL_U_ADDR
  &test_ctl_u_reg=&HWIO_MMSS_MMPLL7_PLL_TEST_CTL_U_ADDR
  gosub Format_Dump_Registers  19. MMPLL7_PLL                   &mode_reg &user_ctl_reg &user_ctl_u_reg &config_ctl_reg &test_ctl_reg &test_ctl_u_reg &status_reg &l_reg &alpha_reg &alpha_u_reg &m_reg &n_reg

  &mode_reg=&HWIO_MMSS_MMPLL10_PLL_MODE_ADDR
  &status_reg=&HWIO_MMSS_MMPLL10_PLL_STATUS_ADDR
  &user_ctl_reg=&HWIO_MMSS_MMPLL10_PLL_USER_CTL_ADDR
  &config_ctl_reg=&HWIO_MMSS_MMPLL10_PLL_CONFIG_CTL_ADDR
  &test_ctl_reg=&HWIO_MMSS_MMPLL10_PLL_TEST_CTL_ADDR
  &l_reg=&HWIO_MMSS_MMPLL10_PLL_L_VAL_ADDR
  &alpha_reg=0
  &alpha_u_reg=0
  &m_reg=0
  &n_reg=0
  &user_ctl_u_reg=0
  &test_ctl_u_reg=0
  &alpha_reg=&HWIO_MMSS_MMPLL10_PLL_FRAC_VAL_ADDR
  &user_ctl_u_reg=&HWIO_MMSS_MMPLL10_PLL_USER_CTL_U_ADDR
  &test_ctl_u_reg=&HWIO_MMSS_MMPLL10_PLL_TEST_CTL_U_ADDR
  gosub Format_Dump_Registers  20. MMPLL10_PLL                  &mode_reg &user_ctl_reg &user_ctl_u_reg &config_ctl_reg &test_ctl_reg &test_ctl_u_reg &status_reg &l_reg &alpha_reg &alpha_u_reg &m_reg &n_reg

  &mode_reg=&HWIO_SSC_SCC_SCC_PLL_MODE_ADDR
  &status_reg=&HWIO_SSC_SCC_SCC_PLL_STATUS_ADDR
  &user_ctl_reg=&HWIO_SSC_SCC_SCC_PLL_USER_CTL_ADDR
  &config_ctl_reg=&HWIO_SSC_SCC_SCC_PLL_CONFIG_CTL_ADDR
  &test_ctl_reg=&HWIO_SSC_SCC_SCC_PLL_TEST_CTL_ADDR
  &l_reg=&HWIO_SSC_SCC_SCC_PLL_L_VAL_ADDR
  &alpha_reg=0
  &alpha_u_reg=0
  &m_reg=0
  &n_reg=0
  &user_ctl_u_reg=0
  &test_ctl_u_reg=0
  &alpha_reg=&HWIO_SSC_SCC_SCC_PLL_FRAC_VAL_ADDR
  &user_ctl_u_reg=&HWIO_SSC_SCC_SCC_PLL_USER_CTL_U_ADDR
  &test_ctl_u_reg=&HWIO_SSC_SCC_SCC_PLL_TEST_CTL_U_ADDR
  gosub Format_Dump_Registers  21. SCC_PLL                      &mode_reg &user_ctl_reg &user_ctl_u_reg &config_ctl_reg &test_ctl_reg &test_ctl_u_reg &status_reg &l_reg &alpha_reg &alpha_u_reg &m_reg &n_reg

  &mode_reg=&HWIO_SSC_QDSP6SS_PLL_MODE_ADDR
  &status_reg=&HWIO_SSC_QDSP6SS_PLL_STATUS_ADDR
  &user_ctl_reg=&HWIO_SSC_QDSP6SS_PLL_USER_CTL_ADDR
  &config_ctl_reg=&HWIO_SSC_QDSP6SS_PLL_CONFIG_CTL_ADDR
  &test_ctl_reg=&HWIO_SSC_QDSP6SS_PLL_TEST_CTL_ADDR
  &l_reg=&HWIO_SSC_QDSP6SS_PLL_L_VAL_ADDR
  &alpha_reg=0
  &alpha_u_reg=0
  &m_reg=0
  &n_reg=0
  &user_ctl_u_reg=0
  &test_ctl_u_reg=0
  &alpha_reg=&HWIO_SSC_QDSP6SS_PLL_FRAC_VAL_ADDR
  &user_ctl_u_reg=&HWIO_SSC_QDSP6SS_PLL_USER_CTL_U_ADDR
  &test_ctl_u_reg=&HWIO_SSC_QDSP6SS_PLL_TEST_CTL_U_ADDR
  gosub Format_Dump_Registers  22. QDSP6SS_PLL                  &mode_reg &user_ctl_reg &user_ctl_u_reg &config_ctl_reg &test_ctl_reg &test_ctl_u_reg &status_reg &l_reg &alpha_reg &alpha_u_reg &m_reg &n_reg

  print " " 
  print " " 
    
  return


;-----------------------------------------------------------------------
; Get votes for GCC's
;-----------------------------------------------------------------------

Get_PLL_Vote_GCC:

  ENTRY &vote_reg

  &temp_reg=data.long(&access_mode:&vote_reg)

  if (&temp_reg&0x40)==0x40
    &pll6="Y"
  else
    &pll6=" "

  if (&temp_reg&0x20)==0x20
    &pll5="Y"
  else
    &pll5=" "

  if (&temp_reg&0x10)==0x10
    &pll4="Y"
  else
    &pll4=" "

  if (&temp_reg&0x8)==0x8
    &pll3="Y"
  else
    &pll3=" "

  if (&temp_reg&0x4)==0x4
    &pll2="Y"
  else
    &pll2=" "

  if (&temp_reg&0x2)==0x2
    &pll1="Y"
  else
    &pll1=" "

  if (&temp_reg&0x1)==0x1
    &pll0="Y"
  else
    &pll0=" "

  return


;-----------------------------------------------------------------------
; Get votes for LPASS's
;-----------------------------------------------------------------------

Get_PLL_Vote_LPASS:

  ENTRY &vote_reg

  &temp_reg=data.long(&access_mode:&vote_reg)

  if (&temp_reg&0x4)==0x4
    &pll12="Y"
  else
    &pll12=" "

  if (&temp_reg&0x2)==0x2
    &pll11="Y"
  else
    &pll11=" "

  if (&temp_reg&0x1)==0x1
    &pll10="Y"
  else
    &pll10=" "

  return


;-----------------------------------------------------------------------
; Get votes for MMSS's
;-----------------------------------------------------------------------

Get_PLL_Vote_MMSS:

  ENTRY &vote_reg

  &temp_reg=data.long(&access_mode:&vote_reg)

  if (&temp_reg&0x2)==0x2
    &pll14="Y"
  else
    &pll14=" "

  if (&temp_reg&0x1)==0x1
    &pll13="Y"
  else
    &pll13=" "

  return


;-----------------------------------------------------------------------
; Display PLL vote headline
;-----------------------------------------------------------------------

Display_PLL_Vote:
  
  print "&image |  &pll0  |  &pll1  |  &pll2  |  &pll3  |  &pll4  |  &pll5  |  &pll6  |  &pll10  |  &pll11  |  &pll12  |  &pll13  |  &pll14  |   "

  return


;-----------------------------------------------------------------------
; Reset PLL votes
;-----------------------------------------------------------------------

Reset_PLL_Votes:

  &pll0=" "
  &pll1=" "
  &pll2=" "
  &pll3=" "
  &pll4=" "
  &pll5=" "
  &pll6=" "
  &pll10=" "
  &pll11=" "
  &pll12=" "
  &pll13=" "
  &pll14=" "


  return


;-----------------------------------------------------------------------
; Display PLL voting table
;-----------------------------------------------------------------------

Display_Votes:

  local &vote_reg

  print " _________________________________       _____ _____ _____ _____ _____ _____ _____ _____ _____ _____ _____ _____    "
  print "|\                                \    |\     \     \     \     \     \     \     \     \     \     \     \     \   "
  print "| \                                \   | \  0  \  1  \  2  \  3  \  4  \  5  \  6  \  10 \  11 \  12 \  13 \  14 \  "
  print "|  \________________________________\__|  \_____\_____\_____\_____\_____\_____\_____\_____\_____\_____\_____\_____\ "
  print "|  |                                |  |  |     |     |     |     |     |     |     |     |     |     |     |     | "


  ; Display GCC_APCS_GPLL_ENA_VOTE votes
  gosub Reset_PLL_Votes
  &image="|\ |  GCC_APCS_GPLL_ENA_VOTE        |  |\"

  ; Get GCC_APCS_GPLL_ENA_VOTE votes on GCC's
  &vote_reg=&HWIO_GCC_APCS_GPLL_ENA_VOTE_ADDR
  gosub Get_PLL_Vote_GCC &vote_reg

  gosub Display_PLL_Vote

  print "| \|________________________________|__| \|_____|_____|_____|_____|_____|_____|_____|_____|_____|_____|_____|_____| "
  print "|  |                                |  |  |     |     |     |     |     |     |     |     |     |     |     |     | "


  ; Display GCC_APCS_TZ_GPLL_ENA_VOTE votes
  gosub Reset_PLL_Votes
  &image="|\ |  GCC_APCS_TZ_GPLL_ENA_VOTE     |  |\"

  ; Get GCC_APCS_TZ_GPLL_ENA_VOTE votes on GCC's
  &vote_reg=&HWIO_GCC_APCS_TZ_GPLL_ENA_VOTE_ADDR
  gosub Get_PLL_Vote_GCC &vote_reg

  gosub Display_PLL_Vote

  print "| \|________________________________|__| \|_____|_____|_____|_____|_____|_____|_____|_____|_____|_____|_____|_____| "
  print "|  |                                |  |  |     |     |     |     |     |     |     |     |     |     |     |     | "


  ; Display GCC_HYP_GPLL_ENA_VOTE votes
  gosub Reset_PLL_Votes
  &image="|\ |  GCC_HYP_GPLL_ENA_VOTE         |  |\"

  ; Get GCC_HYP_GPLL_ENA_VOTE votes on GCC's
  &vote_reg=&HWIO_GCC_HYP_GPLL_ENA_VOTE_ADDR
  gosub Get_PLL_Vote_GCC &vote_reg

  gosub Display_PLL_Vote

  print "| \|________________________________|__| \|_____|_____|_____|_____|_____|_____|_____|_____|_____|_____|_____|_____| "
  print "|  |                                |  |  |     |     |     |     |     |     |     |     |     |     |     |     | "


  ; Display GCC_LPASS_DSP_GPLL_ENA_VOTE votes
  gosub Reset_PLL_Votes
  &image="|\ |  GCC_LPASS_DSP_GPLL_ENA_VOTE   |  |\"

  ; Get GCC_LPASS_DSP_GPLL_ENA_VOTE votes on GCC's
  &vote_reg=&HWIO_GCC_LPASS_DSP_GPLL_ENA_VOTE_ADDR
  gosub Get_PLL_Vote_GCC &vote_reg

  gosub Display_PLL_Vote

  print "| \|________________________________|__| \|_____|_____|_____|_____|_____|_____|_____|_____|_____|_____|_____|_____| "
  print "|  |                                |  |  |     |     |     |     |     |     |     |     |     |     |     |     | "


  ; Display GCC_MSS_Q6_GPLL_ENA_VOTE votes
  gosub Reset_PLL_Votes
  &image="|\ |  GCC_MSS_Q6_GPLL_ENA_VOTE      |  |\"

  ; Get GCC_MSS_Q6_GPLL_ENA_VOTE votes on GCC's
  &vote_reg=&HWIO_GCC_MSS_Q6_GPLL_ENA_VOTE_ADDR
  gosub Get_PLL_Vote_GCC &vote_reg

  gosub Display_PLL_Vote

  print "| \|________________________________|__| \|_____|_____|_____|_____|_____|_____|_____|_____|_____|_____|_____|_____| "
  print "|  |                                |  |  |     |     |     |     |     |     |     |     |     |     |     |     | "


  ; Display GCC_RPM_GPLL_ENA_VOTE votes
  gosub Reset_PLL_Votes
  &image="|\ |  GCC_RPM_GPLL_ENA_VOTE         |  |\"

  ; Get GCC_RPM_GPLL_ENA_VOTE votes on GCC's
  &vote_reg=&HWIO_GCC_RPM_GPLL_ENA_VOTE_ADDR
  gosub Get_PLL_Vote_GCC &vote_reg

  gosub Display_PLL_Vote

  print "| \|________________________________|__| \|_____|_____|_____|_____|_____|_____|_____|_____|_____|_____|_____|_____| "
  print "|  |                                |  |  |     |     |     |     |     |     |     |     |     |     |     |     | "


  ; Display GCC_SPARE1_GPLL_ENA_VOTE votes
  gosub Reset_PLL_Votes
  &image="|\ |  GCC_SPARE1_GPLL_ENA_VOTE      |  |\"

  ; Get GCC_SPARE1_GPLL_ENA_VOTE votes on GCC's
  &vote_reg=&HWIO_GCC_SPARE1_GPLL_ENA_VOTE_ADDR
  gosub Get_PLL_Vote_GCC &vote_reg

  gosub Display_PLL_Vote

  print "| \|________________________________|__| \|_____|_____|_____|_____|_____|_____|_____|_____|_____|_____|_____|_____| "
  print "|  |                                |  |  |     |     |     |     |     |     |     |     |     |     |     |     | "


  ; Display GCC_SPARE2_GPLL_ENA_VOTE votes
  gosub Reset_PLL_Votes
  &image="|\ |  GCC_SPARE2_GPLL_ENA_VOTE      |  |\"

  ; Get GCC_SPARE2_GPLL_ENA_VOTE votes on GCC's
  &vote_reg=&HWIO_GCC_SPARE2_GPLL_ENA_VOTE_ADDR
  gosub Get_PLL_Vote_GCC &vote_reg

  gosub Display_PLL_Vote

  print "| \|________________________________|__| \|_____|_____|_____|_____|_____|_____|_____|_____|_____|_____|_____|_____| "
  print "|  |                                |  |  |     |     |     |     |     |     |     |     |     |     |     |     | "


  ; Display GCC_SPARE_GPLL_ENA_VOTE votes
  gosub Reset_PLL_Votes
  &image="|\ |  GCC_SPARE_GPLL_ENA_VOTE       |  |\"

  ; Get GCC_SPARE_GPLL_ENA_VOTE votes on GCC's
  &vote_reg=&HWIO_GCC_SPARE_GPLL_ENA_VOTE_ADDR
  gosub Get_PLL_Vote_GCC &vote_reg

  gosub Display_PLL_Vote

  print "| \|________________________________|__| \|_____|_____|_____|_____|_____|_____|_____|_____|_____|_____|_____|_____| "
  print "|  |                                |  |  |     |     |     |     |     |     |     |     |     |     |     |     | "


  ; Display GCC_SSC_GPLL_ENA_VOTE votes
  gosub Reset_PLL_Votes
  &image="|\ |  GCC_SSC_GPLL_ENA_VOTE         |  |\"

  ; Get GCC_SSC_GPLL_ENA_VOTE votes on GCC's
  &vote_reg=&HWIO_GCC_SSC_GPLL_ENA_VOTE_ADDR
  gosub Get_PLL_Vote_GCC &vote_reg

  gosub Display_PLL_Vote

  print "| \|________________________________|__| \|_____|_____|_____|_____|_____|_____|_____|_____|_____|_____|_____|_____| "
  print "|  |                                |  |  |     |     |     |     |     |     |     |     |     |     |     |     | "


  ; Display LPASS_LPA_PLL_VOTE_APPS votes
  gosub Reset_PLL_Votes
  &image="|\ |  LPASS_LPA_PLL_VOTE_APPS       |  |\"

  ; Get LPASS_LPA_PLL_VOTE_APPS votes on LPASS's
  &vote_reg=&HWIO_LPASS_LPA_PLL_VOTE_APPS_ADDR
  gosub Get_PLL_Vote_LPASS &vote_reg

  gosub Display_PLL_Vote

  print "| \|________________________________|__| \|_____|_____|_____|_____|_____|_____|_____|_____|_____|_____|_____|_____| "
  print "|  |                                |  |  |     |     |     |     |     |     |     |     |     |     |     |     | "


  ; Display LPASS_LPA_PLL_VOTE_LPASSQ6 votes
  gosub Reset_PLL_Votes
  &image="|\ |  LPASS_LPA_PLL_VOTE_LPASSQ6    |  |\"

  ; Get LPASS_LPA_PLL_VOTE_LPASSQ6 votes on LPASS's
  &vote_reg=&HWIO_LPASS_LPA_PLL_VOTE_LPASSQ6_ADDR
  gosub Get_PLL_Vote_LPASS &vote_reg

  gosub Display_PLL_Vote

  print "| \|________________________________|__| \|_____|_____|_____|_____|_____|_____|_____|_____|_____|_____|_____|_____| "
  print "|  |                                |  |  |     |     |     |     |     |     |     |     |     |     |     |     | "


  ; Display LPASS_LPA_PLL_VOTE_LPASS_HW votes
  gosub Reset_PLL_Votes
  &image="|\ |  LPASS_LPA_PLL_VOTE_LPASS_HW   |  |\"

  ; Get LPASS_LPA_PLL_VOTE_LPASS_HW votes on LPASS's
  &vote_reg=&HWIO_LPASS_LPA_PLL_VOTE_LPASS_HW_ADDR
  gosub Get_PLL_Vote_LPASS &vote_reg

  gosub Display_PLL_Vote

  print "| \|________________________________|__| \|_____|_____|_____|_____|_____|_____|_____|_____|_____|_____|_____|_____| "
  print "|  |                                |  |  |     |     |     |     |     |     |     |     |     |     |     |     | "


  ; Display MMSS_PLL_VOTE_APCS votes
  gosub Reset_PLL_Votes
  &image="|\ |  MMSS_PLL_VOTE_APCS            |  |\"

  ; Get MMSS_PLL_VOTE_APCS votes on MMSS's
  &vote_reg=&HWIO_MMSS_PLL_VOTE_APCS_ADDR
  gosub Get_PLL_Vote_MMSS &vote_reg

  gosub Display_PLL_Vote

  print "| \|________________________________|__| \|_____|_____|_____|_____|_____|_____|_____|_____|_____|_____|_____|_____| "
  print "|  |                                |  |  |     |     |     |     |     |     |     |     |     |     |     |     | "


  ; Display MMSS_PLL_VOTE_RPM votes
  gosub Reset_PLL_Votes
  &image="|\ |  MMSS_PLL_VOTE_RPM             |  |\"

  ; Get MMSS_PLL_VOTE_RPM votes on MMSS's
  &vote_reg=&HWIO_MMSS_PLL_VOTE_RPM_ADDR
  gosub Get_PLL_Vote_MMSS &vote_reg

  gosub Display_PLL_Vote

  print "| \|________________________________|__| \|_____|_____|_____|_____|_____|_____|_____|_____|_____|_____|_____|_____| "
  print "|  |                                |  |  |     |     |     |     |     |     |     |     |     |     |     |     | "


  print " " 
  print " " 
    
  return


;-----------------------------------------------------------------------
; Configure a PLL - Wrapper
;-----------------------------------------------------------------------

Configure_PLL_Enter:

  &pll_name_choice=""
  gosub Configure_PLL

  return


;-----------------------------------------------------------------------
; Configure SR / SR2 / HF / Prius / Tesla PLLs.
; Note:
;-----------------------------------------------------------------------
          
Generic_PLL_Configure:

  ENTRY &mode_reg &user_reg &prediv &postdiv &l_reg &l_val &alpha_reg &alpha_val &alpha_u_reg &alpha_u_val &m_reg &m_val &n_reg &n_val &is_votable &pll_type

  &HWIO_PLL_VOTE_FSM_ENA_MASK=0x100000
  &HWIO_PLL_VOTE_FSM_RESET_MASK=0x200000

  &HWIO_PLL_BIAS_COUNT_MASK=0xfc000
  &HWIO_PLL_LOCK_COUNT_MASK=0x3f00

  &HWIO_PLL_BIAS_COUNT_VAL=(0x1<<0xe)
  &HWIO_PLL_LOCK_COUNT_VAL=0x0

  &HWIO_PLL_ALPHA_EN_MASK=0x1000000
  &HWIO_PLL_VCO_SEL_MASK=0x300000
  &HWIO_PLL_PRE_DIV_RATIO_MASK=0x7000
  &HWIO_PLL_POST_DIV_RATIO_MASK=0xf00

  &HWIO_PLL_VOTE_FSM_ENA_SHIFT=0x14
  &HWIO_PLL_ALPHA_EN_SHIFT=0x18
  &HWIO_PLL_VCO_SEL_SHIFT=0x14
  &HWIO_PLL_PRE_DIV_RATIO_SHIFT=0xc
  &HWIO_PLL_POST_DIV_RATIO_SHIFT=0x8

  local &mode_val
  local &user_val
  local &is_fsm_mode_enabled

  &is_fsm_mode_enabled=0x0
  ;data.set &access_mode:&mode_reg %long 0x0

  &mode_val=data.long(&access_mode:&mode_reg)

  if (&is_votable==0x1)
  (
    ; Disable FSM mode
    if (&mode_val&(&HWIO_PLL_VOTE_FSM_ENA_MASK))==&HWIO_PLL_VOTE_FSM_ENA_MASK
    (
      &is_fsm_mode_enabled=0x1
      &mode_val=&mode_val&~(&HWIO_PLL_VOTE_FSM_ENA_MASK)
      data.set &access_mode:&mode_reg %long &mode_val
    )
  )

  ; Set L
  data.set &access_mode:&l_reg %long &l_val

  ; Set ALPHA if register is non-zero
  if (&alpha_reg!=0)
  (
    data.set &access_mode:&alpha_reg %long &alpha_val
  )

  ; Set ALPHA_U if register is non-zero
  if (&alpha_u_reg!=0)
  (
    data.set &access_mode:&alpha_u_reg %long &alpha_u_val
  )

  ; Set M if register is non-zero
  if (&m_reg!=0)
  (
    data.set &access_mode:&m_reg %long &m_val
  )

  ; Set N if register is non-zero
  if (&n_reg!=0)
  (
    data.set &access_mode:&n_reg %long &n_val
  )

  ; Clear fields in user control register
  &user_val=data.long(&access_mode:&user_reg)
  &user_val=&user_val&~((&HWIO_PLL_ALPHA_EN_MASK)|(&HWIO_PLL_VCO_SEL_MASK)|(&HWIO_PLL_PRE_DIV_RATIO_MASK)|(&HWIO_PLL_POST_DIV_RATIO_MASK))

  ; Set fields in user control register
  &user_val=&user_val|(0x2<<&HWIO_PLL_VCO_SEL_SHIFT)
  &user_val=&user_val|((&prediv-1)<<&HWIO_PLL_PRE_DIV_RATIO_SHIFT)
  &user_val=&user_val|((&postdiv-1)<<&HWIO_PLL_POST_DIV_RATIO_SHIFT)

  if (&alpha_val!=0)||(&alpha_u_val!=0)
  (
    &user_val=&user_val|(&HWIO_PLL_ALPHA_EN_MASK)
  )

  ; Program the user control register
  data.set &access_mode:&user_reg %long &user_val


  if (&is_votable==0x1)
  (
    ; Put the FSM in reset
    &mode_val=&mode_val|(&HWIO_PLL_VOTE_FSM_RESET_MASK)
    data.set &access_mode:&mode_reg %long &mode_val

    ; Set the lock and bias
    &mode_val=&mode_val&~((&HWIO_PLL_BIAS_COUNT_MASK)|(&HWIO_PLL_LOCK_COUNT_MASK))
    &mode_val=&mode_val|(&HWIO_PLL_BIAS_COUNT_VAL)
    &mode_val=&mode_val|(&HWIO_PLL_LOCK_COUNT_VAL)

    ; Enable the FSM
    &mode_val=&mode_val|(&HWIO_PLL_VOTE_FSM_ENA_MASK)

    ; Program the mode register
    data.set &access_mode:&mode_reg %long &mode_val

    ; Take the FSM out of reset
    &mode_val=&mode_val&~(&HWIO_PLL_VOTE_FSM_RESET_MASK)
    data.set &access_mode:&mode_reg %long &mode_val
  )

  return


;-----------------------------------------------------------------------
; Configure a PLL
;-----------------------------------------------------------------------

Configure_PLL:

  local &pll_name_choice

  ; Prompt user to choose PLL if choice not passed in via commandline
  if ("&pll_name_choice"=="")
  (
    print "Available PLLs are: "

  print "  GPLL0                       GPLL1                       GPLL2                       GPLL3                       "

  print "  GPLL4                       GPLL5                       GPLL6                       GPLL7                       "

  print "  GPU_PLL0_PLL                GPU_PLL1_PLL                LPASS_LPAAUDIO_PLL          LPASS_LPAAUDIO_DIG_PLL      "

  print "  LPASS_QDSP6SS_PLL           MMPLL0_PLL                  MMPLL1_PLL                  MMPLL3_PLL                  "

  print "  MMPLL4_PLL                  MMPLL5_PLL                  MMPLL6_PLL                  MMPLL7_PLL                  "

  print "  MMPLL10_PLL                 SCC_PLL                     QDSP6SS_PLL                 "

    print " "
    print "Enter PLL: "
    enter &pll_name_choice
  )

  if ("&pll_name_choice"=="GPLL0")
  (
    &mode_reg=&HWIO_GCC_GPLL0_MODE_ADDR
    &user_reg=&HWIO_GCC_GPLL0_USER_CTL_ADDR

    &l_reg=&HWIO_GCC_GPLL0_L_VAL_ADDR
    &l_val=0x001F

    &prediv=0x0001
    &postdiv=0x0001

    &alpha_reg=0
    &alpha_val=0x0

    &alpha_u_reg=0
    &alpha_u_val=0x0

    &m_reg=0
    &m_val=0x0

    &n_reg=0
    &n_val=0x0

    &is_votable=0x1
    &pll_type="fabia_pll"

  &alpha_reg=&HWIO_GCC_GPLL0_FRAC_VAL_ADDR
    &alpha_val=0x00004000
    &alpha_u_val=0x00
    gosub Generic_PLL_Configure &mode_reg &user_reg &prediv &postdiv &l_reg &l_val &alpha_reg &alpha_val &alpha_u_reg &alpha_u_val &m_reg &m_val &n_reg &n_val &is_votable &pll_type

    print "Configured GPLL0 "
    print " "

    return
  )

  if ("&pll_name_choice"=="GPLL1")
  (
    &mode_reg=&HWIO_GCC_GPLL1_MODE_ADDR
    &user_reg=&HWIO_GCC_GPLL1_USER_CTL_ADDR

    &l_reg=&HWIO_GCC_GPLL1_L_VAL_ADDR
    &l_val=0x001B

    &prediv=0x0001
    &postdiv=0x0001

    &alpha_reg=0
    &alpha_val=0x0

    &alpha_u_reg=0
    &alpha_u_val=0x0

    &m_reg=0
    &m_val=0x0

    &n_reg=0
    &n_val=0x0

    &is_votable=0x1
    &pll_type="fabia_pll"

  &alpha_reg=&HWIO_GCC_GPLL1_FRAC_VAL_ADDR
    &alpha_val=0x0000C2AA
    &alpha_u_val=0x00
    gosub Generic_PLL_Configure &mode_reg &user_reg &prediv &postdiv &l_reg &l_val &alpha_reg &alpha_val &alpha_u_reg &alpha_u_val &m_reg &m_val &n_reg &n_val &is_votable &pll_type

    print "Configured GPLL1 "
    print " "

    return
  )

  if ("&pll_name_choice"=="GPLL2")
  (
    &mode_reg=&HWIO_GCC_GPLL2_MODE_ADDR
    &user_reg=&HWIO_GCC_GPLL2_USER_CTL_ADDR

    &l_reg=&HWIO_GCC_GPLL2_L_VAL_ADDR
    &l_val=0x001B

    &prediv=0x0001
    &postdiv=0x0001

    &alpha_reg=0
    &alpha_val=0x0

    &alpha_u_reg=0
    &alpha_u_val=0x0

    &m_reg=0
    &m_val=0x0

    &n_reg=0
    &n_val=0x0

    &is_votable=0x1
    &pll_type="fabia_pll"

  &alpha_reg=&HWIO_GCC_GPLL2_FRAC_VAL_ADDR
    &alpha_val=0x0000C2AA
    &alpha_u_val=0x00
    gosub Generic_PLL_Configure &mode_reg &user_reg &prediv &postdiv &l_reg &l_val &alpha_reg &alpha_val &alpha_u_reg &alpha_u_val &m_reg &m_val &n_reg &n_val &is_votable &pll_type

    print "Configured GPLL2 "
    print " "

    return
  )

  if ("&pll_name_choice"=="GPLL3")
  (
    &mode_reg=&HWIO_GCC_GPLL3_MODE_ADDR
    &user_reg=&HWIO_GCC_GPLL3_USER_CTL_ADDR

    &l_reg=&HWIO_GCC_GPLL3_L_VAL_ADDR
    &l_val=0x0030

    &prediv=0x0001
    &postdiv=0x0001

    &alpha_reg=0
    &alpha_val=0x0

    &alpha_u_reg=0
    &alpha_u_val=0x0

    &m_reg=0
    &m_val=0x0

    &n_reg=0
    &n_val=0x0

    &is_votable=0x1
    &pll_type="fabia_pll"

  &alpha_reg=&HWIO_GCC_GPLL3_FRAC_VAL_ADDR
    &alpha_val=0x00009800
    &alpha_u_val=0x00
    gosub Generic_PLL_Configure &mode_reg &user_reg &prediv &postdiv &l_reg &l_val &alpha_reg &alpha_val &alpha_u_reg &alpha_u_val &m_reg &m_val &n_reg &n_val &is_votable &pll_type

    print "Configured GPLL3 "
    print " "

    return
  )

  if ("&pll_name_choice"=="GPLL4")
  (
    &mode_reg=&HWIO_GCC_GPLL4_MODE_ADDR
    &user_reg=&HWIO_GCC_GPLL4_USER_CTL_ADDR

    &l_reg=&HWIO_GCC_GPLL4_L_VAL_ADDR
    &l_val=0x0050

    &prediv=0x0001
    &postdiv=0x0004

    &alpha_reg=0
    &alpha_val=0x0

    &alpha_u_reg=0
    &alpha_u_val=0x0

    &m_reg=0
    &m_val=0x0

    &n_reg=0
    &n_val=0x0

    &is_votable=0x1
    &pll_type="fabia_pll"

  &alpha_reg=&HWIO_GCC_GPLL4_FRAC_VAL_ADDR
    &alpha_val=0x00000000
    &alpha_u_val=0x00
    gosub Generic_PLL_Configure &mode_reg &user_reg &prediv &postdiv &l_reg &l_val &alpha_reg &alpha_val &alpha_u_reg &alpha_u_val &m_reg &m_val &n_reg &n_val &is_votable &pll_type

    print "Configured GPLL4 "
    print " "

    return
  )

  if ("&pll_name_choice"=="GPU_PLL0_PLL")
  (
    &mode_reg=&HWIO_GPUCC_GPU_PLL0_PLL_MODE_ADDR
    &user_reg=&HWIO_GPUCC_GPU_PLL0_PLL_USER_CTL_ADDR

    &l_reg=&HWIO_GPUCC_GPU_PLL0_PLL_L_VAL_ADDR
    &l_val=0x0011

    &prediv=0x0001
    &postdiv=0x0002

    &alpha_reg=0
    &alpha_val=0x0

    &alpha_u_reg=0
    &alpha_u_val=0x0

    &m_reg=0
    &m_val=0x0

    &n_reg=0
    &n_val=0x0

    &is_votable=0x0
    &pll_type="fabia_pll"

  &alpha_reg=&HWIO_GPUCC_GPU_PLL0_PLL_FRAC_VAL_ADDR
    &alpha_val=0x0000D000
    &alpha_u_val=0x00
    gosub Generic_PLL_Configure &mode_reg &user_reg &prediv &postdiv &l_reg &l_val &alpha_reg &alpha_val &alpha_u_reg &alpha_u_val &m_reg &m_val &n_reg &n_val &is_votable &pll_type

    print "Configured GPU_PLL0_PLL "
    print " "

    return
  )

  if ("&pll_name_choice"=="GPU_PLL1_PLL")
  (
    &mode_reg=&HWIO_GPUCC_GPU_PLL1_PLL_MODE_ADDR
    &user_reg=&HWIO_GPUCC_GPU_PLL1_PLL_USER_CTL_ADDR

    &l_reg=&HWIO_GPUCC_GPU_PLL1_PLL_L_VAL_ADDR
    &l_val=0x0011

    &prediv=0x0001
    &postdiv=0x0002

    &alpha_reg=0
    &alpha_val=0x0

    &alpha_u_reg=0
    &alpha_u_val=0x0

    &m_reg=0
    &m_val=0x0

    &n_reg=0
    &n_val=0x0

    &is_votable=0x0
    &pll_type="fabia_pll"

  &alpha_reg=&HWIO_GPUCC_GPU_PLL1_PLL_FRAC_VAL_ADDR
    &alpha_val=0x0000D000
    &alpha_u_val=0x00
    gosub Generic_PLL_Configure &mode_reg &user_reg &prediv &postdiv &l_reg &l_val &alpha_reg &alpha_val &alpha_u_reg &alpha_u_val &m_reg &m_val &n_reg &n_val &is_votable &pll_type

    print "Configured GPU_PLL1_PLL "
    print " "

    return
  )

  if ("&pll_name_choice"=="LPASS_LPAAUDIO_PLL")
  (
    &mode_reg=&HWIO_LPASS_LPAAUDIO_PLL_MODE_ADDR
    &user_reg=&HWIO_LPASS_LPAAUDIO_PLL_USER_CTL_ADDR

    &l_reg=&HWIO_LPASS_LPAAUDIO_PLL_L_VAL_ADDR
    &l_val=0x0020

    &prediv=0x0001
    &postdiv=0x0001

    &alpha_reg=0
    &alpha_val=0x0

    &alpha_u_reg=0
    &alpha_u_val=0x0

    &m_reg=0
    &m_val=0x0

    &n_reg=0
    &n_val=0x0

    &is_votable=0x1
    &pll_type="agera_pll"

  &alpha_reg=&HWIO_LPASS_LPAAUDIO_PLL_ALPHA_VAL_ADDR
    &alpha_val=0x00000000
    &alpha_u_val=0x00
    gosub Generic_PLL_Configure &mode_reg &user_reg &prediv &postdiv &l_reg &l_val &alpha_reg &alpha_val &alpha_u_reg &alpha_u_val &m_reg &m_val &n_reg &n_val &is_votable &pll_type

    print "Configured LPASS_LPAAUDIO_PLL "
    print " "

    return
  )

  if ("&pll_name_choice"=="LPASS_LPAAUDIO_DIG_PLL")
  (
    &mode_reg=&HWIO_LPASS_LPAAUDIO_DIG_PLL_MODE_ADDR
    &user_reg=&HWIO_LPASS_LPAAUDIO_DIG_PLL_USER_CTL_ADDR

    &l_reg=&HWIO_LPASS_LPAAUDIO_DIG_PLL_L_VAL_ADDR
    &l_val=0x0020

    &prediv=0x0001
    &postdiv=0x0001

    &alpha_reg=0
    &alpha_val=0x0

    &alpha_u_reg=0
    &alpha_u_val=0x0

    &m_reg=0
    &m_val=0x0

    &n_reg=0
    &n_val=0x0

    &is_votable=0x1
    &pll_type="fabia_pll"

  &alpha_reg=&HWIO_LPASS_LPAAUDIO_DIG_PLL_FRAC_VAL_ADDR
    &alpha_val=0x00000000
    &alpha_u_val=0x00
    gosub Generic_PLL_Configure &mode_reg &user_reg &prediv &postdiv &l_reg &l_val &alpha_reg &alpha_val &alpha_u_reg &alpha_u_val &m_reg &m_val &n_reg &n_val &is_votable &pll_type

    print "Configured LPASS_LPAAUDIO_DIG_PLL "
    print " "

    return
  )

  if ("&pll_name_choice"=="LPASS_QDSP6SS_PLL")
  (
    &mode_reg=&HWIO_LPASS_QDSP6SS_PLL_MODE_ADDR
    &user_reg=&HWIO_LPASS_QDSP6SS_PLL_USER_CTL_ADDR

    &l_reg=&HWIO_LPASS_QDSP6SS_PLL_L_VAL_ADDR
    &l_val=0x000F

    &prediv=0x0001
    &postdiv=0x0001

    &alpha_reg=0
    &alpha_val=0x0

    &alpha_u_reg=0
    &alpha_u_val=0x0

    &m_reg=0
    &m_val=0x0

    &n_reg=0
    &n_val=0x0

    &is_votable=0x1
    &pll_type="fabia_pll"

  &alpha_reg=&HWIO_LPASS_QDSP6SS_PLL_FRAC_VAL_ADDR
    &alpha_val=0x00000000
    &alpha_u_val=0x00
    gosub Generic_PLL_Configure &mode_reg &user_reg &prediv &postdiv &l_reg &l_val &alpha_reg &alpha_val &alpha_u_reg &alpha_u_val &m_reg &m_val &n_reg &n_val &is_votable &pll_type

    print "Configured LPASS_QDSP6SS_PLL "
    print " "

    return
  )

  if ("&pll_name_choice"=="MMPLL0_PLL")
  (
    &mode_reg=&HWIO_MMSS_MMPLL0_PLL_MODE_ADDR
    &user_reg=&HWIO_MMSS_MMPLL0_PLL_USER_CTL_ADDR

    &l_reg=&HWIO_MMSS_MMPLL0_PLL_L_VAL_ADDR
    &l_val=0x002A

    &prediv=0x0001
    &postdiv=0x0001

    &alpha_reg=0
    &alpha_val=0x0

    &alpha_u_reg=0
    &alpha_u_val=0x0

    &m_reg=0
    &m_val=0x0

    &n_reg=0
    &n_val=0x0

    &is_votable=0x1
    &pll_type="fabia_pll"

  &alpha_reg=&HWIO_MMSS_MMPLL0_PLL_FRAC_VAL_ADDR
    &alpha_val=0x00001555
    &alpha_u_val=0x00
    gosub Generic_PLL_Configure &mode_reg &user_reg &prediv &postdiv &l_reg &l_val &alpha_reg &alpha_val &alpha_u_reg &alpha_u_val &m_reg &m_val &n_reg &n_val &is_votable &pll_type

    print "Configured MMPLL0_PLL "
    print " "

    return
  )

  if ("&pll_name_choice"=="MMPLL1_PLL")
  (
    &mode_reg=&HWIO_MMSS_MMPLL1_PLL_MODE_ADDR
    &user_reg=&HWIO_MMSS_MMPLL1_PLL_USER_CTL_ADDR

    &l_reg=&HWIO_MMSS_MMPLL1_PLL_L_VAL_ADDR
    &l_val=0x002A

    &prediv=0x0001
    &postdiv=0x0001

    &alpha_reg=0
    &alpha_val=0x0

    &alpha_u_reg=0
    &alpha_u_val=0x0

    &m_reg=0
    &m_val=0x0

    &n_reg=0
    &n_val=0x0

    &is_votable=0x1
    &pll_type="fabia_pll"

  &alpha_reg=&HWIO_MMSS_MMPLL1_PLL_FRAC_VAL_ADDR
    &alpha_val=0x00004AAA
    &alpha_u_val=0x00
    gosub Generic_PLL_Configure &mode_reg &user_reg &prediv &postdiv &l_reg &l_val &alpha_reg &alpha_val &alpha_u_reg &alpha_u_val &m_reg &m_val &n_reg &n_val &is_votable &pll_type

    print "Configured MMPLL1_PLL "
    print " "

    return
  )

  if ("&pll_name_choice"=="MMPLL3_PLL")
  (
    &mode_reg=&HWIO_MMSS_MMPLL3_PLL_MODE_ADDR
    &user_reg=&HWIO_MMSS_MMPLL3_PLL_USER_CTL_ADDR

    &l_reg=&HWIO_MMSS_MMPLL3_PLL_L_VAL_ADDR
    &l_val=0x0037

    &prediv=0x0001
    &postdiv=0x0001

    &alpha_reg=0
    &alpha_val=0x0

    &alpha_u_reg=0
    &alpha_u_val=0x0

    &m_reg=0
    &m_val=0x0

    &n_reg=0
    &n_val=0x0

    &is_votable=0x0
    &pll_type="fabia_pll"

  &alpha_reg=&HWIO_MMSS_MMPLL3_PLL_FRAC_VAL_ADDR
    &alpha_val=0x00008555
    &alpha_u_val=0x00
    gosub Generic_PLL_Configure &mode_reg &user_reg &prediv &postdiv &l_reg &l_val &alpha_reg &alpha_val &alpha_u_reg &alpha_u_val &m_reg &m_val &n_reg &n_val &is_votable &pll_type

    print "Configured MMPLL3_PLL "
    print " "

    return
  )

  if ("&pll_name_choice"=="MMPLL4_PLL")
  (
    &mode_reg=&HWIO_MMSS_MMPLL4_PLL_MODE_ADDR
    &user_reg=&HWIO_MMSS_MMPLL4_PLL_USER_CTL_ADDR

    &l_reg=&HWIO_MMSS_MMPLL4_PLL_L_VAL_ADDR
    &l_val=0x0028

    &prediv=0x0001
    &postdiv=0x0001

    &alpha_reg=0
    &alpha_val=0x0

    &alpha_u_reg=0
    &alpha_u_val=0x0

    &m_reg=0
    &m_val=0x0

    &n_reg=0
    &n_val=0x0

    &is_votable=0x0
    &pll_type="fabia_pll"

  &alpha_reg=&HWIO_MMSS_MMPLL4_PLL_FRAC_VAL_ADDR
    &alpha_val=0x00000000
    &alpha_u_val=0x00
    gosub Generic_PLL_Configure &mode_reg &user_reg &prediv &postdiv &l_reg &l_val &alpha_reg &alpha_val &alpha_u_reg &alpha_u_val &m_reg &m_val &n_reg &n_val &is_votable &pll_type

    print "Configured MMPLL4_PLL "
    print " "

    return
  )

  if ("&pll_name_choice"=="MMPLL5_PLL")
  (
    &mode_reg=&HWIO_MMSS_MMPLL5_PLL_MODE_ADDR
    &user_reg=&HWIO_MMSS_MMPLL5_PLL_USER_CTL_ADDR

    &l_reg=&HWIO_MMSS_MMPLL5_PLL_L_VAL_ADDR
    &l_val=0x002A

    &prediv=0x0001
    &postdiv=0x0001

    &alpha_reg=0
    &alpha_val=0x0

    &alpha_u_reg=0
    &alpha_u_val=0x0

    &m_reg=0
    &m_val=0x0

    &n_reg=0
    &n_val=0x0

    &is_votable=0x0
    &pll_type="fabia_pll"

  &alpha_reg=&HWIO_MMSS_MMPLL5_PLL_FRAC_VAL_ADDR
    &alpha_val=0x0000F800
    &alpha_u_val=0x00
    gosub Generic_PLL_Configure &mode_reg &user_reg &prediv &postdiv &l_reg &l_val &alpha_reg &alpha_val &alpha_u_reg &alpha_u_val &m_reg &m_val &n_reg &n_val &is_votable &pll_type

    print "Configured MMPLL5_PLL "
    print " "

    return
  )

  if ("&pll_name_choice"=="MMPLL6_PLL")
  (
    &mode_reg=&HWIO_MMSS_MMPLL6_PLL_MODE_ADDR
    &user_reg=&HWIO_MMSS_MMPLL6_PLL_USER_CTL_ADDR

    &l_reg=&HWIO_MMSS_MMPLL6_PLL_L_VAL_ADDR
    &l_val=0x0029

    &prediv=0x0001
    &postdiv=0x0002

    &alpha_reg=0
    &alpha_val=0x0

    &alpha_u_reg=0
    &alpha_u_val=0x0

    &m_reg=0
    &m_val=0x0

    &n_reg=0
    &n_val=0x0

    &is_votable=0x0
    &pll_type="fabia_pll"

  &alpha_reg=&HWIO_MMSS_MMPLL6_PLL_FRAC_VAL_ADDR
    &alpha_val=0x0000AAAA
    &alpha_u_val=0x00
    gosub Generic_PLL_Configure &mode_reg &user_reg &prediv &postdiv &l_reg &l_val &alpha_reg &alpha_val &alpha_u_reg &alpha_u_val &m_reg &m_val &n_reg &n_val &is_votable &pll_type

    print "Configured MMPLL6_PLL "
    print " "

    return
  )

  if ("&pll_name_choice"=="MMPLL7_PLL")
  (
    &mode_reg=&HWIO_MMSS_MMPLL7_PLL_MODE_ADDR
    &user_reg=&HWIO_MMSS_MMPLL7_PLL_USER_CTL_ADDR

    &l_reg=&HWIO_MMSS_MMPLL7_PLL_L_VAL_ADDR
    &l_val=0x0032

    &prediv=0x0001
    &postdiv=0x0001

    &alpha_reg=0
    &alpha_val=0x0

    &alpha_u_reg=0
    &alpha_u_val=0x0

    &m_reg=0
    &m_val=0x0

    &n_reg=0
    &n_val=0x0

    &is_votable=0x0
    &pll_type="fabia_pll"

  &alpha_reg=&HWIO_MMSS_MMPLL7_PLL_FRAC_VAL_ADDR
    &alpha_val=0x00000000
    &alpha_u_val=0x00
    gosub Generic_PLL_Configure &mode_reg &user_reg &prediv &postdiv &l_reg &l_val &alpha_reg &alpha_val &alpha_u_reg &alpha_u_val &m_reg &m_val &n_reg &n_val &is_votable &pll_type

    print "Configured MMPLL7_PLL "
    print " "

    return
  )

  if ("&pll_name_choice"=="MMPLL10_PLL")
  (
    &mode_reg=&HWIO_MMSS_MMPLL10_PLL_MODE_ADDR
    &user_reg=&HWIO_MMSS_MMPLL10_PLL_USER_CTL_ADDR

    &l_reg=&HWIO_MMSS_MMPLL10_PLL_L_VAL_ADDR
    &l_val=0x001E

    &prediv=0x0001
    &postdiv=0x0001

    &alpha_reg=0
    &alpha_val=0x0

    &alpha_u_reg=0
    &alpha_u_val=0x0

    &m_reg=0
    &m_val=0x0

    &n_reg=0
    &n_val=0x0

    &is_votable=0x0
    &pll_type="fabia_pll"

  &alpha_reg=&HWIO_MMSS_MMPLL10_PLL_FRAC_VAL_ADDR
    &alpha_val=0x00000000
    &alpha_u_val=0x00
    gosub Generic_PLL_Configure &mode_reg &user_reg &prediv &postdiv &l_reg &l_val &alpha_reg &alpha_val &alpha_u_reg &alpha_u_val &m_reg &m_val &n_reg &n_val &is_votable &pll_type

    print "Configured MMPLL10_PLL "
    print " "

    return
  )

  ; PLL name did not match
  return


;-----------------------------------------------------------------------
; Enable or Disable a PLL - Wrapper
;-----------------------------------------------------------------------

Enable_Disable_PLL_Enter:

  &pll_name_choice=""
  gosub Enable_Disable_PLL

  return


;-----------------------------------------------------------------------
; Enable SR / SR2 / HF / Prius / Tesla PLLs.
; Note: This function turns on the PLLs from OFF state. It does not
; support the 'saved state' feature found on Prius PLLs.
;-----------------------------------------------------------------------
          
Generic_PLL_Enable:

  ENTRY &mode_reg &status_reg

  ; Return if PLL is already locked
  if (data.long(&access_mode:&status_reg)&0x10000)==0x10000
  (
    return
  )

  ; Put the PLL in reset
  &mode_val=data.long(&access_mode:&mode_reg)
  &mode_val=&mode_val&~(0x00000001|0x00000002|0x00000004)
  data.set &access_mode:&mode_reg %long &mode_val

  if ("&pll_type"=="sr_pll")
  (
    ; Deassert reset and bypass
    &mode_val=&mode_val|0x00000004|0x00000002
    data.set &access_mode:&mode_reg %long &mode_val
  )
  else if ("&pll_type"=="sr2_pll")||("&pll_type"=="hf_pll")||("&pll_type"=="prius_pll")||("&pll_type"=="tesla_pll")
  (
    ; Deassert bypass
    &mode_val=&mode_val|0x00000002
    data.set &access_mode:&mode_reg %long &mode_val

    ; Wait for PLL to initialize
    ; The actual PLL Init time is 5us, but T32 does not seem to allow this small value
    wait 1.ms
    
    ; Deassert reset
    &mode_val=&mode_val|0x00000004
    data.set &access_mode:&mode_reg %long &mode_val
  )
  
  ; Wait for PLL to warm up
  ; The actual PLL warm-up time is 50us, but T32 does not seem to allow this small value
  wait 1.ms
  
  ; Wait for PLL to lock
  while (data.long(&access_mode:&mode_reg)&0x80000000)==0x0
  (
  )
  
  ; Assert outctrl
  &mode_val=&mode_val|0x00000001
  data.set &access_mode:&mode_reg %long &mode_val

  return


;-----------------------------------------------------------------------
; Disable PLL
;-----------------------------------------------------------------------
                
Generic_PLL_Disable:

  ENTRY &mode_reg

  ; Put the PLL in reset
  &mode_val=data.long(&access_mode:&mode_reg)
  &mode_val=&mode_val&~(0x00000001|0x00000002|0x00000004)
  data.set &access_mode:&mode_reg %LONG &mode_val
  
  return


;-----------------------------------------------------------------------
; Enable or Disable a PLL
;-----------------------------------------------------------------------

Enable_Disable_PLL:

  local &pll_name_choice
  local &pll_on_off_choice

  print "Warning: PLL must already be configured, or the script will hang while waiting for the PLL to lock."
  print " "

  ; Prompt user to choose PLL if choice not passed in via commandline
  if ("&pll_name_choice"=="")
  (
    print "Available PLLs are: "

  print "  GPLL0                       GPLL1                       GPLL2                       GPLL3                       "

  print "  GPLL4                       GPLL5                       GPLL6                       GPLL7                       "

  print "  GPU_PLL0_PLL                GPU_PLL1_PLL                LPASS_LPAAUDIO_PLL          LPASS_LPAAUDIO_DIG_PLL      "

  print "  LPASS_QDSP6SS_PLL           MMPLL0_PLL                  MMPLL1_PLL                  MMPLL3_PLL                  "

  print "  MMPLL4_PLL                  MMPLL5_PLL                  MMPLL6_PLL                  MMPLL7_PLL                  "

  print "  MMPLL10_PLL                 SCC_PLL                     QDSP6SS_PLL                 "

    print " "
    print "Enter PLL: "
    enter &pll_name_choice
    
    print "Enter on/off: "
    enter &pll_on_off_choice
  )

  print "PLL: " "&pll_name_choice" "."

  
  ; Votable PLLs

  if ("&pll_name_choice"=="GPLL0")
  (
    &vote_reg=0
    &mode_reg=&HWIO_GCC_GPLL0_MODE_ADDR
    &mode_val=data.long(&access_mode:&mode_reg)
    &status_reg=&HWIO_GCC_GPLL0_STATUS_ADDR
    &pll_sel=0x1

    ; this votable PLL is in FSM mode
    if (&mode_val&0x100000)==0x100000
    (
      print "This source is votable. Which processor do you want to vote from? Choices are: "
      print "[  APCS  APCS_TZ  HYP  LPASS_DSP  MSS_Q6  RPM  SPARE  SPARE1  SPARE2  SSC  ]"

      print " "
      print "Enter your choice: "
      enter &subsystem

      if ("&subsystem"=="APCS")
      (
        &vote_reg=&HWIO_GCC_APCS_GPLL_ENA_VOTE_ADDR
      )
      else if ("&subsystem"=="APCS_TZ")
      (
        &vote_reg=&HWIO_GCC_APCS_TZ_GPLL_ENA_VOTE_ADDR
      )
      else if ("&subsystem"=="HYP")
      (
        &vote_reg=&HWIO_GCC_HYP_GPLL_ENA_VOTE_ADDR
      )
      else if ("&subsystem"=="LPASS_DSP")
      (
        &vote_reg=&HWIO_GCC_LPASS_DSP_GPLL_ENA_VOTE_ADDR
      )
      else if ("&subsystem"=="MSS_Q6")
      (
        &vote_reg=&HWIO_GCC_MSS_Q6_GPLL_ENA_VOTE_ADDR
      )
      else if ("&subsystem"=="RPM")
      (
        &vote_reg=&HWIO_GCC_RPM_GPLL_ENA_VOTE_ADDR
      )
      else if ("&subsystem"=="SPARE")
      (
        &vote_reg=&HWIO_GCC_SPARE_GPLL_ENA_VOTE_ADDR
      )
      else if ("&subsystem"=="SPARE1")
      (
        &vote_reg=&HWIO_GCC_SPARE1_GPLL_ENA_VOTE_ADDR
      )
      else if ("&subsystem"=="SPARE2")
      (
        &vote_reg=&HWIO_GCC_SPARE2_GPLL_ENA_VOTE_ADDR
      )
      else if ("&subsystem"=="SSC")
      (
        &vote_reg=&HWIO_GCC_SSC_GPLL_ENA_VOTE_ADDR
      )
      else
      (
        print "Invalid selection."
        print " "
        goto Enable_Disable_PLL
      )

      if ("&pll_on_off_choice"=="on")
      (
        data.set &access_mode:&vote_reg %long (data.long(&access_mode:&vote_reg)|(&pll_sel))
      )
      else
      (
        data.set &access_mode:&vote_reg %long (data.long(&access_mode:&vote_reg)&~(&pll_sel))
      )

    )
    ; this PLL supports HW voting, but is currently in legacy mode
    else
    (
      if ("&pll_on_off_choice"=="on")
      (
        gosub Generic_PLL_Enable &mode_reg &status_reg
      )
      else
      (
        gosub Generic_PLL_Disable &mode_reg
      )
    )

    print "Turned GPLL0 " "&pll_on_off_choice" "."
    print " "

    return
  )


  if ("&pll_name_choice"=="GPLL1")
  (
    &vote_reg=0
    &mode_reg=&HWIO_GCC_GPLL1_MODE_ADDR
    &mode_val=data.long(&access_mode:&mode_reg)
    &status_reg=&HWIO_GCC_GPLL1_STATUS_ADDR
    &pll_sel=0x2

    ; this votable PLL is in FSM mode
    if (&mode_val&0x100000)==0x100000
    (
      print "This source is votable. Which processor do you want to vote from? Choices are: "
      print "[  APCS  APCS_TZ  HYP  LPASS_DSP  MSS_Q6  RPM  SPARE  SPARE1  SPARE2  SSC  ]"

      print " "
      print "Enter your choice: "
      enter &subsystem

      if ("&subsystem"=="APCS")
      (
        &vote_reg=&HWIO_GCC_APCS_GPLL_ENA_VOTE_ADDR
      )
      else if ("&subsystem"=="APCS_TZ")
      (
        &vote_reg=&HWIO_GCC_APCS_TZ_GPLL_ENA_VOTE_ADDR
      )
      else if ("&subsystem"=="HYP")
      (
        &vote_reg=&HWIO_GCC_HYP_GPLL_ENA_VOTE_ADDR
      )
      else if ("&subsystem"=="LPASS_DSP")
      (
        &vote_reg=&HWIO_GCC_LPASS_DSP_GPLL_ENA_VOTE_ADDR
      )
      else if ("&subsystem"=="MSS_Q6")
      (
        &vote_reg=&HWIO_GCC_MSS_Q6_GPLL_ENA_VOTE_ADDR
      )
      else if ("&subsystem"=="RPM")
      (
        &vote_reg=&HWIO_GCC_RPM_GPLL_ENA_VOTE_ADDR
      )
      else if ("&subsystem"=="SPARE")
      (
        &vote_reg=&HWIO_GCC_SPARE_GPLL_ENA_VOTE_ADDR
      )
      else if ("&subsystem"=="SPARE1")
      (
        &vote_reg=&HWIO_GCC_SPARE1_GPLL_ENA_VOTE_ADDR
      )
      else if ("&subsystem"=="SPARE2")
      (
        &vote_reg=&HWIO_GCC_SPARE2_GPLL_ENA_VOTE_ADDR
      )
      else if ("&subsystem"=="SSC")
      (
        &vote_reg=&HWIO_GCC_SSC_GPLL_ENA_VOTE_ADDR
      )
      else
      (
        print "Invalid selection."
        print " "
        goto Enable_Disable_PLL
      )

      if ("&pll_on_off_choice"=="on")
      (
        data.set &access_mode:&vote_reg %long (data.long(&access_mode:&vote_reg)|(&pll_sel))
      )
      else
      (
        data.set &access_mode:&vote_reg %long (data.long(&access_mode:&vote_reg)&~(&pll_sel))
      )

    )
    ; this PLL supports HW voting, but is currently in legacy mode
    else
    (
      if ("&pll_on_off_choice"=="on")
      (
        gosub Generic_PLL_Enable &mode_reg &status_reg
      )
      else
      (
        gosub Generic_PLL_Disable &mode_reg
      )
    )

    print "Turned GPLL1 " "&pll_on_off_choice" "."
    print " "

    return
  )


  if ("&pll_name_choice"=="GPLL2")
  (
    &vote_reg=0
    &mode_reg=&HWIO_GCC_GPLL2_MODE_ADDR
    &mode_val=data.long(&access_mode:&mode_reg)
    &status_reg=&HWIO_GCC_GPLL2_STATUS_ADDR
    &pll_sel=0x4

    ; this votable PLL is in FSM mode
    if (&mode_val&0x100000)==0x100000
    (
      print "This source is votable. Which processor do you want to vote from? Choices are: "
      print "[  APCS  APCS_TZ  HYP  LPASS_DSP  MSS_Q6  RPM  SPARE  SPARE1  SPARE2  SSC  ]"

      print " "
      print "Enter your choice: "
      enter &subsystem

      if ("&subsystem"=="APCS")
      (
        &vote_reg=&HWIO_GCC_APCS_GPLL_ENA_VOTE_ADDR
      )
      else if ("&subsystem"=="APCS_TZ")
      (
        &vote_reg=&HWIO_GCC_APCS_TZ_GPLL_ENA_VOTE_ADDR
      )
      else if ("&subsystem"=="HYP")
      (
        &vote_reg=&HWIO_GCC_HYP_GPLL_ENA_VOTE_ADDR
      )
      else if ("&subsystem"=="LPASS_DSP")
      (
        &vote_reg=&HWIO_GCC_LPASS_DSP_GPLL_ENA_VOTE_ADDR
      )
      else if ("&subsystem"=="MSS_Q6")
      (
        &vote_reg=&HWIO_GCC_MSS_Q6_GPLL_ENA_VOTE_ADDR
      )
      else if ("&subsystem"=="RPM")
      (
        &vote_reg=&HWIO_GCC_RPM_GPLL_ENA_VOTE_ADDR
      )
      else if ("&subsystem"=="SPARE")
      (
        &vote_reg=&HWIO_GCC_SPARE_GPLL_ENA_VOTE_ADDR
      )
      else if ("&subsystem"=="SPARE1")
      (
        &vote_reg=&HWIO_GCC_SPARE1_GPLL_ENA_VOTE_ADDR
      )
      else if ("&subsystem"=="SPARE2")
      (
        &vote_reg=&HWIO_GCC_SPARE2_GPLL_ENA_VOTE_ADDR
      )
      else if ("&subsystem"=="SSC")
      (
        &vote_reg=&HWIO_GCC_SSC_GPLL_ENA_VOTE_ADDR
      )
      else
      (
        print "Invalid selection."
        print " "
        goto Enable_Disable_PLL
      )

      if ("&pll_on_off_choice"=="on")
      (
        data.set &access_mode:&vote_reg %long (data.long(&access_mode:&vote_reg)|(&pll_sel))
      )
      else
      (
        data.set &access_mode:&vote_reg %long (data.long(&access_mode:&vote_reg)&~(&pll_sel))
      )

    )
    ; this PLL supports HW voting, but is currently in legacy mode
    else
    (
      if ("&pll_on_off_choice"=="on")
      (
        gosub Generic_PLL_Enable &mode_reg &status_reg
      )
      else
      (
        gosub Generic_PLL_Disable &mode_reg
      )
    )

    print "Turned GPLL2 " "&pll_on_off_choice" "."
    print " "

    return
  )


  if ("&pll_name_choice"=="GPLL3")
  (
    &vote_reg=0
    &mode_reg=&HWIO_GCC_GPLL3_MODE_ADDR
    &mode_val=data.long(&access_mode:&mode_reg)
    &status_reg=&HWIO_GCC_GPLL3_STATUS_ADDR
    &pll_sel=0x8

    ; this votable PLL is in FSM mode
    if (&mode_val&0x100000)==0x100000
    (
      print "This source is votable. Which processor do you want to vote from? Choices are: "
      print "[  APCS  APCS_TZ  HYP  LPASS_DSP  MSS_Q6  RPM  SPARE  SPARE1  SPARE2  SSC  ]"

      print " "
      print "Enter your choice: "
      enter &subsystem

      if ("&subsystem"=="APCS")
      (
        &vote_reg=&HWIO_GCC_APCS_GPLL_ENA_VOTE_ADDR
      )
      else if ("&subsystem"=="APCS_TZ")
      (
        &vote_reg=&HWIO_GCC_APCS_TZ_GPLL_ENA_VOTE_ADDR
      )
      else if ("&subsystem"=="HYP")
      (
        &vote_reg=&HWIO_GCC_HYP_GPLL_ENA_VOTE_ADDR
      )
      else if ("&subsystem"=="LPASS_DSP")
      (
        &vote_reg=&HWIO_GCC_LPASS_DSP_GPLL_ENA_VOTE_ADDR
      )
      else if ("&subsystem"=="MSS_Q6")
      (
        &vote_reg=&HWIO_GCC_MSS_Q6_GPLL_ENA_VOTE_ADDR
      )
      else if ("&subsystem"=="RPM")
      (
        &vote_reg=&HWIO_GCC_RPM_GPLL_ENA_VOTE_ADDR
      )
      else if ("&subsystem"=="SPARE")
      (
        &vote_reg=&HWIO_GCC_SPARE_GPLL_ENA_VOTE_ADDR
      )
      else if ("&subsystem"=="SPARE1")
      (
        &vote_reg=&HWIO_GCC_SPARE1_GPLL_ENA_VOTE_ADDR
      )
      else if ("&subsystem"=="SPARE2")
      (
        &vote_reg=&HWIO_GCC_SPARE2_GPLL_ENA_VOTE_ADDR
      )
      else if ("&subsystem"=="SSC")
      (
        &vote_reg=&HWIO_GCC_SSC_GPLL_ENA_VOTE_ADDR
      )
      else
      (
        print "Invalid selection."
        print " "
        goto Enable_Disable_PLL
      )

      if ("&pll_on_off_choice"=="on")
      (
        data.set &access_mode:&vote_reg %long (data.long(&access_mode:&vote_reg)|(&pll_sel))
      )
      else
      (
        data.set &access_mode:&vote_reg %long (data.long(&access_mode:&vote_reg)&~(&pll_sel))
      )

    )
    ; this PLL supports HW voting, but is currently in legacy mode
    else
    (
      if ("&pll_on_off_choice"=="on")
      (
        gosub Generic_PLL_Enable &mode_reg &status_reg
      )
      else
      (
        gosub Generic_PLL_Disable &mode_reg
      )
    )

    print "Turned GPLL3 " "&pll_on_off_choice" "."
    print " "

    return
  )


  if ("&pll_name_choice"=="GPLL4")
  (
    &vote_reg=0
    &mode_reg=&HWIO_GCC_GPLL4_MODE_ADDR
    &mode_val=data.long(&access_mode:&mode_reg)
    &status_reg=&HWIO_GCC_GPLL4_STATUS_ADDR
    &pll_sel=0x10

    ; this votable PLL is in FSM mode
    if (&mode_val&0x100000)==0x100000
    (
      print "This source is votable. Which processor do you want to vote from? Choices are: "
      print "[  APCS  APCS_TZ  HYP  LPASS_DSP  MSS_Q6  RPM  SPARE  SPARE1  SPARE2  SSC  ]"

      print " "
      print "Enter your choice: "
      enter &subsystem

      if ("&subsystem"=="APCS")
      (
        &vote_reg=&HWIO_GCC_APCS_GPLL_ENA_VOTE_ADDR
      )
      else if ("&subsystem"=="APCS_TZ")
      (
        &vote_reg=&HWIO_GCC_APCS_TZ_GPLL_ENA_VOTE_ADDR
      )
      else if ("&subsystem"=="HYP")
      (
        &vote_reg=&HWIO_GCC_HYP_GPLL_ENA_VOTE_ADDR
      )
      else if ("&subsystem"=="LPASS_DSP")
      (
        &vote_reg=&HWIO_GCC_LPASS_DSP_GPLL_ENA_VOTE_ADDR
      )
      else if ("&subsystem"=="MSS_Q6")
      (
        &vote_reg=&HWIO_GCC_MSS_Q6_GPLL_ENA_VOTE_ADDR
      )
      else if ("&subsystem"=="RPM")
      (
        &vote_reg=&HWIO_GCC_RPM_GPLL_ENA_VOTE_ADDR
      )
      else if ("&subsystem"=="SPARE")
      (
        &vote_reg=&HWIO_GCC_SPARE_GPLL_ENA_VOTE_ADDR
      )
      else if ("&subsystem"=="SPARE1")
      (
        &vote_reg=&HWIO_GCC_SPARE1_GPLL_ENA_VOTE_ADDR
      )
      else if ("&subsystem"=="SPARE2")
      (
        &vote_reg=&HWIO_GCC_SPARE2_GPLL_ENA_VOTE_ADDR
      )
      else if ("&subsystem"=="SSC")
      (
        &vote_reg=&HWIO_GCC_SSC_GPLL_ENA_VOTE_ADDR
      )
      else
      (
        print "Invalid selection."
        print " "
        goto Enable_Disable_PLL
      )

      if ("&pll_on_off_choice"=="on")
      (
        data.set &access_mode:&vote_reg %long (data.long(&access_mode:&vote_reg)|(&pll_sel))
      )
      else
      (
        data.set &access_mode:&vote_reg %long (data.long(&access_mode:&vote_reg)&~(&pll_sel))
      )

    )
    ; this PLL supports HW voting, but is currently in legacy mode
    else
    (
      if ("&pll_on_off_choice"=="on")
      (
        gosub Generic_PLL_Enable &mode_reg &status_reg
      )
      else
      (
        gosub Generic_PLL_Disable &mode_reg
      )
    )

    print "Turned GPLL4 " "&pll_on_off_choice" "."
    print " "

    return
  )


  if ("&pll_name_choice"=="GPLL5")
  (
    &vote_reg=0
    &mode_reg=&HWIO_GCC_GPLL5_MODE_ADDR
    &mode_val=data.long(&access_mode:&mode_reg)
    &status_reg=&HWIO_GCC_GPLL5_STATUS_ADDR
    &pll_sel=0x20

    ; this votable PLL is in FSM mode
    if (&mode_val&0x100000)==0x100000
    (
      print "This source is votable. Which processor do you want to vote from? Choices are: "
      print "[  APCS  APCS_TZ  HYP  LPASS_DSP  MSS_Q6  RPM  SPARE  SPARE1  SPARE2  SSC  ]"

      print " "
      print "Enter your choice: "
      enter &subsystem

      if ("&subsystem"=="APCS")
      (
        &vote_reg=&HWIO_GCC_APCS_GPLL_ENA_VOTE_ADDR
      )
      else if ("&subsystem"=="APCS_TZ")
      (
        &vote_reg=&HWIO_GCC_APCS_TZ_GPLL_ENA_VOTE_ADDR
      )
      else if ("&subsystem"=="HYP")
      (
        &vote_reg=&HWIO_GCC_HYP_GPLL_ENA_VOTE_ADDR
      )
      else if ("&subsystem"=="LPASS_DSP")
      (
        &vote_reg=&HWIO_GCC_LPASS_DSP_GPLL_ENA_VOTE_ADDR
      )
      else if ("&subsystem"=="MSS_Q6")
      (
        &vote_reg=&HWIO_GCC_MSS_Q6_GPLL_ENA_VOTE_ADDR
      )
      else if ("&subsystem"=="RPM")
      (
        &vote_reg=&HWIO_GCC_RPM_GPLL_ENA_VOTE_ADDR
      )
      else if ("&subsystem"=="SPARE")
      (
        &vote_reg=&HWIO_GCC_SPARE_GPLL_ENA_VOTE_ADDR
      )
      else if ("&subsystem"=="SPARE1")
      (
        &vote_reg=&HWIO_GCC_SPARE1_GPLL_ENA_VOTE_ADDR
      )
      else if ("&subsystem"=="SPARE2")
      (
        &vote_reg=&HWIO_GCC_SPARE2_GPLL_ENA_VOTE_ADDR
      )
      else if ("&subsystem"=="SSC")
      (
        &vote_reg=&HWIO_GCC_SSC_GPLL_ENA_VOTE_ADDR
      )
      else
      (
        print "Invalid selection."
        print " "
        goto Enable_Disable_PLL
      )

      if ("&pll_on_off_choice"=="on")
      (
        data.set &access_mode:&vote_reg %long (data.long(&access_mode:&vote_reg)|(&pll_sel))
      )
      else
      (
        data.set &access_mode:&vote_reg %long (data.long(&access_mode:&vote_reg)&~(&pll_sel))
      )

    )
    ; this PLL supports HW voting, but is currently in legacy mode
    else
    (
      if ("&pll_on_off_choice"=="on")
      (
        gosub Generic_PLL_Enable &mode_reg &status_reg
      )
      else
      (
        gosub Generic_PLL_Disable &mode_reg
      )
    )

    print "Turned GPLL5 " "&pll_on_off_choice" "."
    print " "

    return
  )


  if ("&pll_name_choice"=="GPLL6")
  (
    &vote_reg=0
    &mode_reg=&HWIO_GCC_GPLL6_MODE_ADDR
    &mode_val=data.long(&access_mode:&mode_reg)
    &status_reg=&HWIO_GCC_GPLL6_STATUS_ADDR
    &pll_sel=0x40

    ; this votable PLL is in FSM mode
    if (&mode_val&0x100000)==0x100000
    (
      print "This source is votable. Which processor do you want to vote from? Choices are: "
      print "[  APCS  APCS_TZ  HYP  LPASS_DSP  MSS_Q6  RPM  SPARE  SPARE1  SPARE2  SSC  ]"

      print " "
      print "Enter your choice: "
      enter &subsystem

      if ("&subsystem"=="APCS")
      (
        &vote_reg=&HWIO_GCC_APCS_GPLL_ENA_VOTE_ADDR
      )
      else if ("&subsystem"=="APCS_TZ")
      (
        &vote_reg=&HWIO_GCC_APCS_TZ_GPLL_ENA_VOTE_ADDR
      )
      else if ("&subsystem"=="HYP")
      (
        &vote_reg=&HWIO_GCC_HYP_GPLL_ENA_VOTE_ADDR
      )
      else if ("&subsystem"=="LPASS_DSP")
      (
        &vote_reg=&HWIO_GCC_LPASS_DSP_GPLL_ENA_VOTE_ADDR
      )
      else if ("&subsystem"=="MSS_Q6")
      (
        &vote_reg=&HWIO_GCC_MSS_Q6_GPLL_ENA_VOTE_ADDR
      )
      else if ("&subsystem"=="RPM")
      (
        &vote_reg=&HWIO_GCC_RPM_GPLL_ENA_VOTE_ADDR
      )
      else if ("&subsystem"=="SPARE")
      (
        &vote_reg=&HWIO_GCC_SPARE_GPLL_ENA_VOTE_ADDR
      )
      else if ("&subsystem"=="SPARE1")
      (
        &vote_reg=&HWIO_GCC_SPARE1_GPLL_ENA_VOTE_ADDR
      )
      else if ("&subsystem"=="SPARE2")
      (
        &vote_reg=&HWIO_GCC_SPARE2_GPLL_ENA_VOTE_ADDR
      )
      else if ("&subsystem"=="SSC")
      (
        &vote_reg=&HWIO_GCC_SSC_GPLL_ENA_VOTE_ADDR
      )
      else
      (
        print "Invalid selection."
        print " "
        goto Enable_Disable_PLL
      )

      if ("&pll_on_off_choice"=="on")
      (
        data.set &access_mode:&vote_reg %long (data.long(&access_mode:&vote_reg)|(&pll_sel))
      )
      else
      (
        data.set &access_mode:&vote_reg %long (data.long(&access_mode:&vote_reg)&~(&pll_sel))
      )

    )
    ; this PLL supports HW voting, but is currently in legacy mode
    else
    (
      if ("&pll_on_off_choice"=="on")
      (
        gosub Generic_PLL_Enable &mode_reg &status_reg
      )
      else
      (
        gosub Generic_PLL_Disable &mode_reg
      )
    )

    print "Turned GPLL6 " "&pll_on_off_choice" "."
    print " "

    return
  )


  if ("&pll_name_choice"=="LPASS_LPAAUDIO_PLL")
  (
    &vote_reg=0
    &mode_reg=&HWIO_LPASS_LPAAUDIO_PLL_MODE_ADDR
    &mode_val=data.long(&access_mode:&mode_reg)
    &status_reg=&HWIO_LPASS_LPAAUDIO_PLL_STATUS_ADDR
    &pll_sel=0x1

    ; this votable PLL is in FSM mode
    if (&mode_val&0x100000)==0x100000
    (
      print "This source is votable. Which processor do you want to vote from? Choices are: "
      print "[  APPS  LPASSQ6  LPASS_HW  ]"

      print " "
      print "Enter your choice: "
      enter &subsystem

      if ("&subsystem"=="APPS")
      (
        &vote_reg=&HWIO_LPASS_LPA_PLL_VOTE_APPS_ADDR
      )
      else if ("&subsystem"=="LPASSQ6")
      (
        &vote_reg=&HWIO_LPASS_LPA_PLL_VOTE_LPASSQ6_ADDR
      )
      else if ("&subsystem"=="LPASS_HW")
      (
        &vote_reg=&HWIO_LPASS_LPA_PLL_VOTE_LPASS_HW_ADDR
      )
      else
      (
        print "Invalid selection."
        print " "
        goto Enable_Disable_PLL
      )

      if ("&pll_on_off_choice"=="on")
      (
        data.set &access_mode:&vote_reg %long (data.long(&access_mode:&vote_reg)|(&pll_sel))
      )
      else
      (
        data.set &access_mode:&vote_reg %long (data.long(&access_mode:&vote_reg)&~(&pll_sel))
      )

    )
    ; this PLL supports HW voting, but is currently in legacy mode
    else
    (
      if ("&pll_on_off_choice"=="on")
      (
        gosub Generic_PLL_Enable &mode_reg &status_reg
      )
      else
      (
        gosub Generic_PLL_Disable &mode_reg
      )
    )

    print "Turned LPASS_LPAAUDIO_PLL " "&pll_on_off_choice" "."
    print " "

    return
  )


  if ("&pll_name_choice"=="LPASS_LPAAUDIO_DIG_PLL")
  (
    &vote_reg=0
    &mode_reg=&HWIO_LPASS_LPAAUDIO_DIG_PLL_MODE_ADDR
    &mode_val=data.long(&access_mode:&mode_reg)
    &status_reg=&HWIO_LPASS_LPAAUDIO_DIG_PLL_STATUS_ADDR
    &pll_sel=0x2

    ; this votable PLL is in FSM mode
    if (&mode_val&0x100000)==0x100000
    (
      print "This source is votable. Which processor do you want to vote from? Choices are: "
      print "[  APPS  LPASSQ6  LPASS_HW  ]"

      print " "
      print "Enter your choice: "
      enter &subsystem

      if ("&subsystem"=="APPS")
      (
        &vote_reg=&HWIO_LPASS_LPA_PLL_VOTE_APPS_ADDR
      )
      else if ("&subsystem"=="LPASSQ6")
      (
        &vote_reg=&HWIO_LPASS_LPA_PLL_VOTE_LPASSQ6_ADDR
      )
      else if ("&subsystem"=="LPASS_HW")
      (
        &vote_reg=&HWIO_LPASS_LPA_PLL_VOTE_LPASS_HW_ADDR
      )
      else
      (
        print "Invalid selection."
        print " "
        goto Enable_Disable_PLL
      )

      if ("&pll_on_off_choice"=="on")
      (
        data.set &access_mode:&vote_reg %long (data.long(&access_mode:&vote_reg)|(&pll_sel))
      )
      else
      (
        data.set &access_mode:&vote_reg %long (data.long(&access_mode:&vote_reg)&~(&pll_sel))
      )

    )
    ; this PLL supports HW voting, but is currently in legacy mode
    else
    (
      if ("&pll_on_off_choice"=="on")
      (
        gosub Generic_PLL_Enable &mode_reg &status_reg
      )
      else
      (
        gosub Generic_PLL_Disable &mode_reg
      )
    )

    print "Turned LPASS_LPAAUDIO_DIG_PLL " "&pll_on_off_choice" "."
    print " "

    return
  )


  if ("&pll_name_choice"=="LPASS_QDSP6SS_PLL")
  (
    &vote_reg=0
    &mode_reg=&HWIO_LPASS_QDSP6SS_PLL_MODE_ADDR
    &mode_val=data.long(&access_mode:&mode_reg)
    &status_reg=&HWIO_LPASS_QDSP6SS_PLL_STATUS_ADDR
    &pll_sel=0x4

    ; this votable PLL is in FSM mode
    if (&mode_val&0x100000)==0x100000
    (
      print "This source is votable. Which processor do you want to vote from? Choices are: "
      print "[  APPS  LPASSQ6  LPASS_HW  ]"

      print " "
      print "Enter your choice: "
      enter &subsystem

      if ("&subsystem"=="APPS")
      (
        &vote_reg=&HWIO_LPASS_LPA_PLL_VOTE_APPS_ADDR
      )
      else if ("&subsystem"=="LPASSQ6")
      (
        &vote_reg=&HWIO_LPASS_LPA_PLL_VOTE_LPASSQ6_ADDR
      )
      else if ("&subsystem"=="LPASS_HW")
      (
        &vote_reg=&HWIO_LPASS_LPA_PLL_VOTE_LPASS_HW_ADDR
      )
      else
      (
        print "Invalid selection."
        print " "
        goto Enable_Disable_PLL
      )

      if ("&pll_on_off_choice"=="on")
      (
        data.set &access_mode:&vote_reg %long (data.long(&access_mode:&vote_reg)|(&pll_sel))
      )
      else
      (
        data.set &access_mode:&vote_reg %long (data.long(&access_mode:&vote_reg)&~(&pll_sel))
      )

    )
    ; this PLL supports HW voting, but is currently in legacy mode
    else
    (
      if ("&pll_on_off_choice"=="on")
      (
        gosub Generic_PLL_Enable &mode_reg &status_reg
      )
      else
      (
        gosub Generic_PLL_Disable &mode_reg
      )
    )

    print "Turned LPASS_QDSP6SS_PLL " "&pll_on_off_choice" "."
    print " "

    return
  )


  if ("&pll_name_choice"=="MMPLL0_PLL")
  (
    &vote_reg=0
    &mode_reg=&HWIO_MMSS_MMPLL0_PLL_MODE_ADDR
    &mode_val=data.long(&access_mode:&mode_reg)
    &status_reg=&HWIO_MMSS_MMPLL0_PLL_STATUS_ADDR
    &pll_sel=0x1

    ; this votable PLL is in FSM mode
    if (&mode_val&0x100000)==0x100000
    (
      print "This source is votable. Which processor do you want to vote from? Choices are: "
      print "[  APCS  RPM  ]"

      print " "
      print "Enter your choice: "
      enter &subsystem

      if ("&subsystem"=="APCS")
      (
        &vote_reg=&HWIO_MMSS_PLL_VOTE_APCS_ADDR
      )
      else if ("&subsystem"=="RPM")
      (
        &vote_reg=&HWIO_MMSS_PLL_VOTE_RPM_ADDR
      )
      else
      (
        print "Invalid selection."
        print " "
        goto Enable_Disable_PLL
      )

      if ("&pll_on_off_choice"=="on")
      (
        data.set &access_mode:&vote_reg %long (data.long(&access_mode:&vote_reg)|(&pll_sel))
      )
      else
      (
        data.set &access_mode:&vote_reg %long (data.long(&access_mode:&vote_reg)&~(&pll_sel))
      )

    )
    ; this PLL supports HW voting, but is currently in legacy mode
    else
    (
      if ("&pll_on_off_choice"=="on")
      (
        gosub Generic_PLL_Enable &mode_reg &status_reg
      )
      else
      (
        gosub Generic_PLL_Disable &mode_reg
      )
    )

    print "Turned MMPLL0_PLL " "&pll_on_off_choice" "."
    print " "

    return
  )


  if ("&pll_name_choice"=="MMPLL1_PLL")
  (
    &vote_reg=0
    &mode_reg=&HWIO_MMSS_MMPLL1_PLL_MODE_ADDR
    &mode_val=data.long(&access_mode:&mode_reg)
    &status_reg=&HWIO_MMSS_MMPLL1_PLL_STATUS_ADDR
    &pll_sel=0x2

    ; this votable PLL is in FSM mode
    if (&mode_val&0x100000)==0x100000
    (
      print "This source is votable. Which processor do you want to vote from? Choices are: "
      print "[  APCS  RPM  ]"

      print " "
      print "Enter your choice: "
      enter &subsystem

      if ("&subsystem"=="APCS")
      (
        &vote_reg=&HWIO_MMSS_PLL_VOTE_APCS_ADDR
      )
      else if ("&subsystem"=="RPM")
      (
        &vote_reg=&HWIO_MMSS_PLL_VOTE_RPM_ADDR
      )
      else
      (
        print "Invalid selection."
        print " "
        goto Enable_Disable_PLL
      )

      if ("&pll_on_off_choice"=="on")
      (
        data.set &access_mode:&vote_reg %long (data.long(&access_mode:&vote_reg)|(&pll_sel))
      )
      else
      (
        data.set &access_mode:&vote_reg %long (data.long(&access_mode:&vote_reg)&~(&pll_sel))
      )

    )
    ; this PLL supports HW voting, but is currently in legacy mode
    else
    (
      if ("&pll_on_off_choice"=="on")
      (
        gosub Generic_PLL_Enable &mode_reg &status_reg
      )
      else
      (
        gosub Generic_PLL_Disable &mode_reg
      )
    )

    print "Turned MMPLL1_PLL " "&pll_on_off_choice" "."
    print " "

    return
  )


  ; Non Votable PLLs

  if ("&pll_name_choice"=="GPLL7")
  (
    &mode_reg=&HWIO_GCC_GPLL7_MODE_ADDR
    &status_reg=&HWIO_GCC_GPLL7_STATUS_ADDR
    &pll_type="pippo_pll"


    if ("&pll_on_off_choice"=="on")
    (
      gosub Generic_PLL_Enable &mode_reg &status_reg
    )
    else
    (
      gosub Generic_PLL_Disable &mode_reg
    )

    print "Turned GPLL7 " "&pll_on_off_choice" "."
    print " "

    return
  )

  if ("&pll_name_choice"=="GPU_PLL0_PLL")
  (
    &mode_reg=&HWIO_GPUCC_GPU_PLL0_PLL_MODE_ADDR
    &status_reg=&HWIO_GPUCC_GPU_PLL0_PLL_STATUS_ADDR
    &pll_type="fabia_pll"


    if ("&pll_on_off_choice"=="on")
    (
      gosub Generic_PLL_Enable &mode_reg &status_reg
    )
    else
    (
      gosub Generic_PLL_Disable &mode_reg
    )

    print "Turned GPU_PLL0_PLL " "&pll_on_off_choice" "."
    print " "

    return
  )

  if ("&pll_name_choice"=="GPU_PLL1_PLL")
  (
    &mode_reg=&HWIO_GPUCC_GPU_PLL1_PLL_MODE_ADDR
    &status_reg=&HWIO_GPUCC_GPU_PLL1_PLL_STATUS_ADDR
    &pll_type="fabia_pll"


    if ("&pll_on_off_choice"=="on")
    (
      gosub Generic_PLL_Enable &mode_reg &status_reg
    )
    else
    (
      gosub Generic_PLL_Disable &mode_reg
    )

    print "Turned GPU_PLL1_PLL " "&pll_on_off_choice" "."
    print " "

    return
  )

  if ("&pll_name_choice"=="MMPLL3_PLL")
  (
    &mode_reg=&HWIO_MMSS_MMPLL3_PLL_MODE_ADDR
    &status_reg=&HWIO_MMSS_MMPLL3_PLL_STATUS_ADDR
    &pll_type="fabia_pll"


    if ("&pll_on_off_choice"=="on")
    (
      gosub Generic_PLL_Enable &mode_reg &status_reg
    )
    else
    (
      gosub Generic_PLL_Disable &mode_reg
    )

    print "Turned MMPLL3_PLL " "&pll_on_off_choice" "."
    print " "

    return
  )

  if ("&pll_name_choice"=="MMPLL4_PLL")
  (
    &mode_reg=&HWIO_MMSS_MMPLL4_PLL_MODE_ADDR
    &status_reg=&HWIO_MMSS_MMPLL4_PLL_STATUS_ADDR
    &pll_type="fabia_pll"


    if ("&pll_on_off_choice"=="on")
    (
      gosub Generic_PLL_Enable &mode_reg &status_reg
    )
    else
    (
      gosub Generic_PLL_Disable &mode_reg
    )

    print "Turned MMPLL4_PLL " "&pll_on_off_choice" "."
    print " "

    return
  )

  if ("&pll_name_choice"=="MMPLL5_PLL")
  (
    &mode_reg=&HWIO_MMSS_MMPLL5_PLL_MODE_ADDR
    &status_reg=&HWIO_MMSS_MMPLL5_PLL_STATUS_ADDR
    &pll_type="fabia_pll"


    if ("&pll_on_off_choice"=="on")
    (
      gosub Generic_PLL_Enable &mode_reg &status_reg
    )
    else
    (
      gosub Generic_PLL_Disable &mode_reg
    )

    print "Turned MMPLL5_PLL " "&pll_on_off_choice" "."
    print " "

    return
  )

  if ("&pll_name_choice"=="MMPLL6_PLL")
  (
    &mode_reg=&HWIO_MMSS_MMPLL6_PLL_MODE_ADDR
    &status_reg=&HWIO_MMSS_MMPLL6_PLL_STATUS_ADDR
    &pll_type="fabia_pll"


    if ("&pll_on_off_choice"=="on")
    (
      gosub Generic_PLL_Enable &mode_reg &status_reg
    )
    else
    (
      gosub Generic_PLL_Disable &mode_reg
    )

    print "Turned MMPLL6_PLL " "&pll_on_off_choice" "."
    print " "

    return
  )

  if ("&pll_name_choice"=="MMPLL7_PLL")
  (
    &mode_reg=&HWIO_MMSS_MMPLL7_PLL_MODE_ADDR
    &status_reg=&HWIO_MMSS_MMPLL7_PLL_STATUS_ADDR
    &pll_type="fabia_pll"


    if ("&pll_on_off_choice"=="on")
    (
      gosub Generic_PLL_Enable &mode_reg &status_reg
    )
    else
    (
      gosub Generic_PLL_Disable &mode_reg
    )

    print "Turned MMPLL7_PLL " "&pll_on_off_choice" "."
    print " "

    return
  )

  if ("&pll_name_choice"=="MMPLL10_PLL")
  (
    &mode_reg=&HWIO_MMSS_MMPLL10_PLL_MODE_ADDR
    &status_reg=&HWIO_MMSS_MMPLL10_PLL_STATUS_ADDR
    &pll_type="fabia_pll"


    if ("&pll_on_off_choice"=="on")
    (
      gosub Generic_PLL_Enable &mode_reg &status_reg
    )
    else
    (
      gosub Generic_PLL_Disable &mode_reg
    )

    print "Turned MMPLL10_PLL " "&pll_on_off_choice" "."
    print " "

    return
  )

  if ("&pll_name_choice"=="SCC_PLL")
  (
    &mode_reg=&HWIO_SSC_SCC_SCC_PLL_MODE_ADDR
    &status_reg=&HWIO_SSC_SCC_SCC_PLL_STATUS_ADDR
    &pll_type="fabia_pll"


    if ("&pll_on_off_choice"=="on")
    (
      gosub Generic_PLL_Enable &mode_reg &status_reg
    )
    else
    (
      gosub Generic_PLL_Disable &mode_reg
    )

    print "Turned SCC_PLL " "&pll_on_off_choice" "."
    print " "

    return
  )

  if ("&pll_name_choice"=="QDSP6SS_PLL")
  (
    &mode_reg=&HWIO_SSC_QDSP6SS_PLL_MODE_ADDR
    &status_reg=&HWIO_SSC_QDSP6SS_PLL_STATUS_ADDR
    &pll_type="fabia_pll"


    if ("&pll_on_off_choice"=="on")
    (
      gosub Generic_PLL_Enable &mode_reg &status_reg
    )
    else
    (
      gosub Generic_PLL_Disable &mode_reg
    )

    print "Turned QDSP6SS_PLL " "&pll_on_off_choice" "."
    print " "

    return
  )

  ; PLL name did not match
  return


;-----------------------------------------------------------------------
; Route PLL to PLLTEST_PAD 
;-----------------------------------------------------------------------

Route_PLL_To_Pad:

  local &pll_name_choice
  local &plltest_pad_field_val
  local &user_ctl_reg
  local &test_ctl_u_reg
  local &user_ctl_val
  local &test_ctl_u_val

  ; Prompt user to choose PLL if choice not passed in via commandline
  if ("&pll_name_choice"=="")
  (
    print "Available PLLs are: "

  print "  GPLL0                       GPLL1                       GPLL2                       GPLL3                       "

  print "  GPLL4                       GPLL5                       GPLL6                       GPLL7                       "

  print "  GPU_PLL0_PLL                GPU_PLL1_PLL                LPASS_LPAAUDIO_PLL          LPASS_LPAAUDIO_DIG_PLL      "

  print "  LPASS_QDSP6SS_PLL           MMPLL0_PLL                  MMPLL1_PLL                  MMPLL3_PLL                  "

  print "  MMPLL4_PLL                  MMPLL5_PLL                  MMPLL6_PLL                  MMPLL7_PLL                  "

  print "  MMPLL10_PLL                 SCC_PLL                     QDSP6SS_PLL                 "

    print " "
    print "Enter PLL: "
    enter &pll_name_choice
  )

  &plltest_pad_field_val=0x0
  &user_ctl_reg=0x0
  &test_ctl_u_reg=0x0

  if ("&pll_name_choice"=="GPLL0")
  (
    &plltest_pad_field_val=0x1
    &user_ctl_reg=&HWIO_GCC_GPLL0_USER_CTL_ADDR

  &test_ctl_u_reg=&HWIO_GCC_GPLL0_TEST_CTL_U_ADDR
    ; Enable test output in the PLL's user control register
    &user_ctl_val=data.long(&access_mode:&user_ctl_reg)
    &user_ctl_val=&user_ctl_val|0x10
    data.set &access_mode:&user_ctl_reg %long &user_ctl_val

    ; Enable test output in the PLL's test control upper register if available
    if (&test_ctl_u_reg!=0x0)
    (
      &test_ctl_u_val=data.long(&access_mode:&test_ctl_u_reg)
      &test_ctl_u_val=&test_ctl_u_val|0x6
      data.set &access_mode:&test_ctl_u_reg %long &test_ctl_u_val
    )

  )

  if ("&pll_name_choice"=="GPLL1")
  (
    &plltest_pad_field_val=0x2
    &user_ctl_reg=&HWIO_GCC_GPLL1_USER_CTL_ADDR

  &test_ctl_u_reg=&HWIO_GCC_GPLL1_TEST_CTL_U_ADDR
    ; Enable test output in the PLL's user control register
    &user_ctl_val=data.long(&access_mode:&user_ctl_reg)
    &user_ctl_val=&user_ctl_val|0x10
    data.set &access_mode:&user_ctl_reg %long &user_ctl_val

    ; Enable test output in the PLL's test control upper register if available
    if (&test_ctl_u_reg!=0x0)
    (
      &test_ctl_u_val=data.long(&access_mode:&test_ctl_u_reg)
      &test_ctl_u_val=&test_ctl_u_val|0x6
      data.set &access_mode:&test_ctl_u_reg %long &test_ctl_u_val
    )

  )

  if ("&pll_name_choice"=="GPLL2")
  (
    &plltest_pad_field_val=0x3
    &user_ctl_reg=&HWIO_GCC_GPLL2_USER_CTL_ADDR

  &test_ctl_u_reg=&HWIO_GCC_GPLL2_TEST_CTL_U_ADDR
    ; Enable test output in the PLL's user control register
    &user_ctl_val=data.long(&access_mode:&user_ctl_reg)
    &user_ctl_val=&user_ctl_val|0x10
    data.set &access_mode:&user_ctl_reg %long &user_ctl_val

    ; Enable test output in the PLL's test control upper register if available
    if (&test_ctl_u_reg!=0x0)
    (
      &test_ctl_u_val=data.long(&access_mode:&test_ctl_u_reg)
      &test_ctl_u_val=&test_ctl_u_val|0x6
      data.set &access_mode:&test_ctl_u_reg %long &test_ctl_u_val
    )

  )

  if ("&pll_name_choice"=="GPLL3")
  (
    &plltest_pad_field_val=0x4
    &user_ctl_reg=&HWIO_GCC_GPLL3_USER_CTL_ADDR

  &test_ctl_u_reg=&HWIO_GCC_GPLL3_TEST_CTL_U_ADDR
    ; Enable test output in the PLL's user control register
    &user_ctl_val=data.long(&access_mode:&user_ctl_reg)
    &user_ctl_val=&user_ctl_val|0x10
    data.set &access_mode:&user_ctl_reg %long &user_ctl_val

    ; Enable test output in the PLL's test control upper register if available
    if (&test_ctl_u_reg!=0x0)
    (
      &test_ctl_u_val=data.long(&access_mode:&test_ctl_u_reg)
      &test_ctl_u_val=&test_ctl_u_val|0x6
      data.set &access_mode:&test_ctl_u_reg %long &test_ctl_u_val
    )

  )

  if ("&pll_name_choice"=="GPLL4")
  (
    &plltest_pad_field_val=0x5
    &user_ctl_reg=&HWIO_GCC_GPLL4_USER_CTL_ADDR

  &test_ctl_u_reg=&HWIO_GCC_GPLL4_TEST_CTL_U_ADDR
    ; Enable test output in the PLL's user control register
    &user_ctl_val=data.long(&access_mode:&user_ctl_reg)
    &user_ctl_val=&user_ctl_val|0x10
    data.set &access_mode:&user_ctl_reg %long &user_ctl_val

    ; Enable test output in the PLL's test control upper register if available
    if (&test_ctl_u_reg!=0x0)
    (
      &test_ctl_u_val=data.long(&access_mode:&test_ctl_u_reg)
      &test_ctl_u_val=&test_ctl_u_val|0x6
      data.set &access_mode:&test_ctl_u_reg %long &test_ctl_u_val
    )

  )

  if ("&pll_name_choice"=="GPLL5")
  (
    &plltest_pad_field_val=0x6
    &user_ctl_reg=&HWIO_GCC_GPLL5_USER_CTL_ADDR

  &test_ctl_u_reg=&HWIO_GCC_GPLL5_TEST_CTL_U_ADDR
    ; Enable test output in the PLL's user control register
    &user_ctl_val=data.long(&access_mode:&user_ctl_reg)
    &user_ctl_val=&user_ctl_val|0x10
    data.set &access_mode:&user_ctl_reg %long &user_ctl_val

    ; Enable test output in the PLL's test control upper register if available
    if (&test_ctl_u_reg!=0x0)
    (
      &test_ctl_u_val=data.long(&access_mode:&test_ctl_u_reg)
      &test_ctl_u_val=&test_ctl_u_val|0x6
      data.set &access_mode:&test_ctl_u_reg %long &test_ctl_u_val
    )

  )

  if ("&pll_name_choice"=="GPLL6")
  (
    &plltest_pad_field_val=0x7
    &user_ctl_reg=&HWIO_GCC_GPLL6_USER_CTL_ADDR

  &test_ctl_u_reg=&HWIO_GCC_GPLL6_TEST_CTL_U_ADDR
    ; Enable test output in the PLL's user control register
    &user_ctl_val=data.long(&access_mode:&user_ctl_reg)
    &user_ctl_val=&user_ctl_val|0x10
    data.set &access_mode:&user_ctl_reg %long &user_ctl_val

    ; Enable test output in the PLL's test control upper register if available
    if (&test_ctl_u_reg!=0x0)
    (
      &test_ctl_u_val=data.long(&access_mode:&test_ctl_u_reg)
      &test_ctl_u_val=&test_ctl_u_val|0x6
      data.set &access_mode:&test_ctl_u_reg %long &test_ctl_u_val
    )

  )

  if ("&pll_name_choice"=="GPU_PLL0_PLL")
  (
    &plltest_pad_field_val=0xD
    &user_ctl_reg=&HWIO_GPUCC_GPU_PLL0_PLL_USER_CTL_ADDR

  &test_ctl_u_reg=&HWIO_GPUCC_GPU_PLL0_PLL_TEST_CTL_U_ADDR
    ; Enable test output in the PLL's user control register
    &user_ctl_val=data.long(&access_mode:&user_ctl_reg)
    &user_ctl_val=&user_ctl_val|0x10
    data.set &access_mode:&user_ctl_reg %long &user_ctl_val

    ; Enable test output in the PLL's test control upper register if available
    if (&test_ctl_u_reg!=0x0)
    (
      &test_ctl_u_val=data.long(&access_mode:&test_ctl_u_reg)
      &test_ctl_u_val=&test_ctl_u_val|0x6
      data.set &access_mode:&test_ctl_u_reg %long &test_ctl_u_val
    )

    ; Get the GPU pll debug register
    &gpucc_debug_clk_ctl_reg=0x5065120
    &gpucc_debug_clk_ctl_val=data.long(&access_mode:&gpucc_debug_clk_ctl_reg)

    ; Clear the source selection field
    &gpucc_debug_clk_ctl_val=&gpucc_debug_clk_ctl_val&~(0x1<<0x17)

    ; Write to the GPU pll debug register source selection field
    &gpucc_debug_clk_ctl_val=&gpucc_debug_clk_ctl_val|((0x0&0x1)<<0x17)
    data.set &access_mode:&gpucc_debug_clk_ctl_reg %long &gpucc_debug_clk_ctl_val

  )

  if ("&pll_name_choice"=="GPU_PLL1_PLL")
  (
    &plltest_pad_field_val=0xD
    &user_ctl_reg=&HWIO_GPUCC_GPU_PLL1_PLL_USER_CTL_ADDR

  &test_ctl_u_reg=&HWIO_GPUCC_GPU_PLL1_PLL_TEST_CTL_U_ADDR
    ; Enable test output in the PLL's user control register
    &user_ctl_val=data.long(&access_mode:&user_ctl_reg)
    &user_ctl_val=&user_ctl_val|0x10
    data.set &access_mode:&user_ctl_reg %long &user_ctl_val

    ; Enable test output in the PLL's test control upper register if available
    if (&test_ctl_u_reg!=0x0)
    (
      &test_ctl_u_val=data.long(&access_mode:&test_ctl_u_reg)
      &test_ctl_u_val=&test_ctl_u_val|0x6
      data.set &access_mode:&test_ctl_u_reg %long &test_ctl_u_val
    )

    ; Get the GPU pll debug register
    &gpucc_debug_clk_ctl_reg=0x5065120
    &gpucc_debug_clk_ctl_val=data.long(&access_mode:&gpucc_debug_clk_ctl_reg)

    ; Clear the source selection field
    &gpucc_debug_clk_ctl_val=&gpucc_debug_clk_ctl_val&~(0x1<<0x17)

    ; Write to the GPU pll debug register source selection field
    &gpucc_debug_clk_ctl_val=&gpucc_debug_clk_ctl_val|((0x1&0x1)<<0x17)
    data.set &access_mode:&gpucc_debug_clk_ctl_reg %long &gpucc_debug_clk_ctl_val

  )

  if ("&pll_name_choice"=="LPASS_LPAAUDIO_PLL")
  (
    &plltest_pad_field_val=0xB
    &user_ctl_reg=&HWIO_LPASS_LPAAUDIO_PLL_USER_CTL_ADDR

  &test_ctl_u_reg=&HWIO_LPASS_LPAAUDIO_PLL_TEST_CTL_U_ADDR
    ; Enable test output in the PLL's user control register
    &user_ctl_val=data.long(&access_mode:&user_ctl_reg)
    &user_ctl_val=&user_ctl_val|0x10
    data.set &access_mode:&user_ctl_reg %long &user_ctl_val

    ; Enable test output in the PLL's test control upper register if available
    if (&test_ctl_u_reg!=0x0)
    (
      &test_ctl_u_val=data.long(&access_mode:&test_ctl_u_reg)
      &test_ctl_u_val=&test_ctl_u_val|0x6
      data.set &access_mode:&test_ctl_u_reg %long &test_ctl_u_val
    )

    ; Get the LPASS pll debug register
    &lpass_pllout_lv_test_sel_reg=0x17041000
    &lpass_pllout_lv_test_sel_val=data.long(&access_mode:&lpass_pllout_lv_test_sel_reg)

    ; Clear the source selection field
    &lpass_pllout_lv_test_sel_val=&lpass_pllout_lv_test_sel_val&~(0x3<<0x0)

    ; Write to the LPASS pll debug register source selection field
    &lpass_pllout_lv_test_sel_val=&lpass_pllout_lv_test_sel_val|((0x0&0x3)<<0x0)
    data.set &access_mode:&lpass_pllout_lv_test_sel_reg %long &lpass_pllout_lv_test_sel_val

  )

  if ("&pll_name_choice"=="LPASS_LPAAUDIO_DIG_PLL")
  (
    &plltest_pad_field_val=0xB
    &user_ctl_reg=&HWIO_LPASS_LPAAUDIO_DIG_PLL_USER_CTL_ADDR

  &test_ctl_u_reg=&HWIO_LPASS_LPAAUDIO_DIG_PLL_TEST_CTL_U_ADDR
    ; Enable test output in the PLL's user control register
    &user_ctl_val=data.long(&access_mode:&user_ctl_reg)
    &user_ctl_val=&user_ctl_val|0x10
    data.set &access_mode:&user_ctl_reg %long &user_ctl_val

    ; Enable test output in the PLL's test control upper register if available
    if (&test_ctl_u_reg!=0x0)
    (
      &test_ctl_u_val=data.long(&access_mode:&test_ctl_u_reg)
      &test_ctl_u_val=&test_ctl_u_val|0x6
      data.set &access_mode:&test_ctl_u_reg %long &test_ctl_u_val
    )

    ; Get the LPASS pll debug register
    &lpass_pllout_lv_test_sel_reg=0x17041000
    &lpass_pllout_lv_test_sel_val=data.long(&access_mode:&lpass_pllout_lv_test_sel_reg)

    ; Clear the source selection field
    &lpass_pllout_lv_test_sel_val=&lpass_pllout_lv_test_sel_val&~(0x3<<0x0)

    ; Write to the LPASS pll debug register source selection field
    &lpass_pllout_lv_test_sel_val=&lpass_pllout_lv_test_sel_val|((0x1&0x3)<<0x0)
    data.set &access_mode:&lpass_pllout_lv_test_sel_reg %long &lpass_pllout_lv_test_sel_val

  )

  if ("&pll_name_choice"=="LPASS_QDSP6SS_PLL")
  (
    &plltest_pad_field_val=0xB
    &user_ctl_reg=&HWIO_LPASS_QDSP6SS_PLL_USER_CTL_ADDR

  &test_ctl_u_reg=&HWIO_LPASS_QDSP6SS_PLL_TEST_CTL_U_ADDR
    ; Enable test output in the PLL's user control register
    &user_ctl_val=data.long(&access_mode:&user_ctl_reg)
    &user_ctl_val=&user_ctl_val|0x10
    data.set &access_mode:&user_ctl_reg %long &user_ctl_val

    ; Enable test output in the PLL's test control upper register if available
    if (&test_ctl_u_reg!=0x0)
    (
      &test_ctl_u_val=data.long(&access_mode:&test_ctl_u_reg)
      &test_ctl_u_val=&test_ctl_u_val|0x6
      data.set &access_mode:&test_ctl_u_reg %long &test_ctl_u_val
    )

    ; Get the LPASS pll debug register
    &lpass_pllout_lv_test_sel_reg=0x17041000
    &lpass_pllout_lv_test_sel_val=data.long(&access_mode:&lpass_pllout_lv_test_sel_reg)

    ; Clear the source selection field
    &lpass_pllout_lv_test_sel_val=&lpass_pllout_lv_test_sel_val&~(0x3<<0x0)

    ; Write to the LPASS pll debug register source selection field
    &lpass_pllout_lv_test_sel_val=&lpass_pllout_lv_test_sel_val|((0x2&0x3)<<0x0)
    data.set &access_mode:&lpass_pllout_lv_test_sel_reg %long &lpass_pllout_lv_test_sel_val

  )

  if ("&pll_name_choice"=="MMPLL0_PLL")
  (
    &plltest_pad_field_val=0xC
    &user_ctl_reg=&HWIO_MMSS_MMPLL0_PLL_USER_CTL_ADDR

  &test_ctl_u_reg=&HWIO_MMSS_MMPLL0_PLL_TEST_CTL_U_ADDR
    ; Enable test output in the PLL's user control register
    &user_ctl_val=data.long(&access_mode:&user_ctl_reg)
    &user_ctl_val=&user_ctl_val|0x10
    data.set &access_mode:&user_ctl_reg %long &user_ctl_val

    ; Enable test output in the PLL's test control upper register if available
    if (&test_ctl_u_reg!=0x0)
    (
      &test_ctl_u_val=data.long(&access_mode:&test_ctl_u_reg)
      &test_ctl_u_val=&test_ctl_u_val|0x6
      data.set &access_mode:&test_ctl_u_reg %long &test_ctl_u_val
    )

    ; Get the MMSS pll debug register
    &mmss_debug_clk_ctl_reg=0xc8c0900
    &mmss_debug_clk_ctl_val=data.long(&access_mode:&mmss_debug_clk_ctl_reg)

    ; Clear the source selection field
    &mmss_debug_clk_ctl_val=&mmss_debug_clk_ctl_val&~(0x7<<0x17)

    ; Write to the MMSS pll debug register source selection field
    &mmss_debug_clk_ctl_val=&mmss_debug_clk_ctl_val|((0x0&0x7)<<0x17)
    data.set &access_mode:&mmss_debug_clk_ctl_reg %long &mmss_debug_clk_ctl_val

  )

  if ("&pll_name_choice"=="MMPLL1_PLL")
  (
    &plltest_pad_field_val=0xC
    &user_ctl_reg=&HWIO_MMSS_MMPLL1_PLL_USER_CTL_ADDR

  &test_ctl_u_reg=&HWIO_MMSS_MMPLL1_PLL_TEST_CTL_U_ADDR
    ; Enable test output in the PLL's user control register
    &user_ctl_val=data.long(&access_mode:&user_ctl_reg)
    &user_ctl_val=&user_ctl_val|0x10
    data.set &access_mode:&user_ctl_reg %long &user_ctl_val

    ; Enable test output in the PLL's test control upper register if available
    if (&test_ctl_u_reg!=0x0)
    (
      &test_ctl_u_val=data.long(&access_mode:&test_ctl_u_reg)
      &test_ctl_u_val=&test_ctl_u_val|0x6
      data.set &access_mode:&test_ctl_u_reg %long &test_ctl_u_val
    )

    ; Get the MMSS pll debug register
    &mmss_debug_clk_ctl_reg=0xc8c0900
    &mmss_debug_clk_ctl_val=data.long(&access_mode:&mmss_debug_clk_ctl_reg)

    ; Clear the source selection field
    &mmss_debug_clk_ctl_val=&mmss_debug_clk_ctl_val&~(0x7<<0x17)

    ; Write to the MMSS pll debug register source selection field
    &mmss_debug_clk_ctl_val=&mmss_debug_clk_ctl_val|((0x1&0x7)<<0x17)
    data.set &access_mode:&mmss_debug_clk_ctl_reg %long &mmss_debug_clk_ctl_val

  )

  if ("&pll_name_choice"=="MMPLL3_PLL")
  (
    &plltest_pad_field_val=0xC
    &user_ctl_reg=&HWIO_MMSS_MMPLL3_PLL_USER_CTL_ADDR

  &test_ctl_u_reg=&HWIO_MMSS_MMPLL3_PLL_TEST_CTL_U_ADDR
    ; Enable test output in the PLL's user control register
    &user_ctl_val=data.long(&access_mode:&user_ctl_reg)
    &user_ctl_val=&user_ctl_val|0x10
    data.set &access_mode:&user_ctl_reg %long &user_ctl_val

    ; Enable test output in the PLL's test control upper register if available
    if (&test_ctl_u_reg!=0x0)
    (
      &test_ctl_u_val=data.long(&access_mode:&test_ctl_u_reg)
      &test_ctl_u_val=&test_ctl_u_val|0x6
      data.set &access_mode:&test_ctl_u_reg %long &test_ctl_u_val
    )

    ; Get the MMSS pll debug register
    &mmss_debug_clk_ctl_reg=0xc8c0900
    &mmss_debug_clk_ctl_val=data.long(&access_mode:&mmss_debug_clk_ctl_reg)

    ; Clear the source selection field
    &mmss_debug_clk_ctl_val=&mmss_debug_clk_ctl_val&~(0x7<<0x17)

    ; Write to the MMSS pll debug register source selection field
    &mmss_debug_clk_ctl_val=&mmss_debug_clk_ctl_val|((0x2&0x7)<<0x17)
    data.set &access_mode:&mmss_debug_clk_ctl_reg %long &mmss_debug_clk_ctl_val

  )

  if ("&pll_name_choice"=="MMPLL4_PLL")
  (
    &plltest_pad_field_val=0xC
    &user_ctl_reg=&HWIO_MMSS_MMPLL4_PLL_USER_CTL_ADDR

  &test_ctl_u_reg=&HWIO_MMSS_MMPLL4_PLL_TEST_CTL_U_ADDR
    ; Enable test output in the PLL's user control register
    &user_ctl_val=data.long(&access_mode:&user_ctl_reg)
    &user_ctl_val=&user_ctl_val|0x10
    data.set &access_mode:&user_ctl_reg %long &user_ctl_val

    ; Enable test output in the PLL's test control upper register if available
    if (&test_ctl_u_reg!=0x0)
    (
      &test_ctl_u_val=data.long(&access_mode:&test_ctl_u_reg)
      &test_ctl_u_val=&test_ctl_u_val|0x6
      data.set &access_mode:&test_ctl_u_reg %long &test_ctl_u_val
    )

    ; Get the MMSS pll debug register
    &mmss_debug_clk_ctl_reg=0xc8c0900
    &mmss_debug_clk_ctl_val=data.long(&access_mode:&mmss_debug_clk_ctl_reg)

    ; Clear the source selection field
    &mmss_debug_clk_ctl_val=&mmss_debug_clk_ctl_val&~(0x7<<0x17)

    ; Write to the MMSS pll debug register source selection field
    &mmss_debug_clk_ctl_val=&mmss_debug_clk_ctl_val|((0x3&0x7)<<0x17)
    data.set &access_mode:&mmss_debug_clk_ctl_reg %long &mmss_debug_clk_ctl_val

  )

  if ("&pll_name_choice"=="MMPLL5_PLL")
  (
    &plltest_pad_field_val=0xC
    &user_ctl_reg=&HWIO_MMSS_MMPLL5_PLL_USER_CTL_ADDR

  &test_ctl_u_reg=&HWIO_MMSS_MMPLL5_PLL_TEST_CTL_U_ADDR
    ; Enable test output in the PLL's user control register
    &user_ctl_val=data.long(&access_mode:&user_ctl_reg)
    &user_ctl_val=&user_ctl_val|0x10
    data.set &access_mode:&user_ctl_reg %long &user_ctl_val

    ; Enable test output in the PLL's test control upper register if available
    if (&test_ctl_u_reg!=0x0)
    (
      &test_ctl_u_val=data.long(&access_mode:&test_ctl_u_reg)
      &test_ctl_u_val=&test_ctl_u_val|0x6
      data.set &access_mode:&test_ctl_u_reg %long &test_ctl_u_val
    )

    ; Get the MMSS pll debug register
    &mmss_debug_clk_ctl_reg=0xc8c0900
    &mmss_debug_clk_ctl_val=data.long(&access_mode:&mmss_debug_clk_ctl_reg)

    ; Clear the source selection field
    &mmss_debug_clk_ctl_val=&mmss_debug_clk_ctl_val&~(0x7<<0x17)

    ; Write to the MMSS pll debug register source selection field
    &mmss_debug_clk_ctl_val=&mmss_debug_clk_ctl_val|((0x4&0x7)<<0x17)
    data.set &access_mode:&mmss_debug_clk_ctl_reg %long &mmss_debug_clk_ctl_val

  )

  if ("&pll_name_choice"=="MMPLL6_PLL")
  (
    &plltest_pad_field_val=0xC
    &user_ctl_reg=&HWIO_MMSS_MMPLL6_PLL_USER_CTL_ADDR

  &test_ctl_u_reg=&HWIO_MMSS_MMPLL6_PLL_TEST_CTL_U_ADDR
    ; Enable test output in the PLL's user control register
    &user_ctl_val=data.long(&access_mode:&user_ctl_reg)
    &user_ctl_val=&user_ctl_val|0x10
    data.set &access_mode:&user_ctl_reg %long &user_ctl_val

    ; Enable test output in the PLL's test control upper register if available
    if (&test_ctl_u_reg!=0x0)
    (
      &test_ctl_u_val=data.long(&access_mode:&test_ctl_u_reg)
      &test_ctl_u_val=&test_ctl_u_val|0x6
      data.set &access_mode:&test_ctl_u_reg %long &test_ctl_u_val
    )

    ; Get the MMSS pll debug register
    &mmss_debug_clk_ctl_reg=0xc8c0900
    &mmss_debug_clk_ctl_val=data.long(&access_mode:&mmss_debug_clk_ctl_reg)

    ; Clear the source selection field
    &mmss_debug_clk_ctl_val=&mmss_debug_clk_ctl_val&~(0x7<<0x17)

    ; Write to the MMSS pll debug register source selection field
    &mmss_debug_clk_ctl_val=&mmss_debug_clk_ctl_val|((0x5&0x7)<<0x17)
    data.set &access_mode:&mmss_debug_clk_ctl_reg %long &mmss_debug_clk_ctl_val

  )

  if ("&pll_name_choice"=="MMPLL7_PLL")
  (
    &plltest_pad_field_val=0xC
    &user_ctl_reg=&HWIO_MMSS_MMPLL7_PLL_USER_CTL_ADDR

  &test_ctl_u_reg=&HWIO_MMSS_MMPLL7_PLL_TEST_CTL_U_ADDR
    ; Enable test output in the PLL's user control register
    &user_ctl_val=data.long(&access_mode:&user_ctl_reg)
    &user_ctl_val=&user_ctl_val|0x10
    data.set &access_mode:&user_ctl_reg %long &user_ctl_val

    ; Enable test output in the PLL's test control upper register if available
    if (&test_ctl_u_reg!=0x0)
    (
      &test_ctl_u_val=data.long(&access_mode:&test_ctl_u_reg)
      &test_ctl_u_val=&test_ctl_u_val|0x6
      data.set &access_mode:&test_ctl_u_reg %long &test_ctl_u_val
    )

    ; Get the MMSS pll debug register
    &mmss_debug_clk_ctl_reg=0xc8c0900
    &mmss_debug_clk_ctl_val=data.long(&access_mode:&mmss_debug_clk_ctl_reg)

    ; Clear the source selection field
    &mmss_debug_clk_ctl_val=&mmss_debug_clk_ctl_val&~(0x7<<0x17)

    ; Write to the MMSS pll debug register source selection field
    &mmss_debug_clk_ctl_val=&mmss_debug_clk_ctl_val|((0x6&0x7)<<0x17)
    data.set &access_mode:&mmss_debug_clk_ctl_reg %long &mmss_debug_clk_ctl_val

  )

  if ("&pll_name_choice"=="MMPLL10_PLL")
  (
    &plltest_pad_field_val=0xC
    &user_ctl_reg=&HWIO_MMSS_MMPLL10_PLL_USER_CTL_ADDR

  &test_ctl_u_reg=&HWIO_MMSS_MMPLL10_PLL_TEST_CTL_U_ADDR
    ; Enable test output in the PLL's user control register
    &user_ctl_val=data.long(&access_mode:&user_ctl_reg)
    &user_ctl_val=&user_ctl_val|0x10
    data.set &access_mode:&user_ctl_reg %long &user_ctl_val

    ; Enable test output in the PLL's test control upper register if available
    if (&test_ctl_u_reg!=0x0)
    (
      &test_ctl_u_val=data.long(&access_mode:&test_ctl_u_reg)
      &test_ctl_u_val=&test_ctl_u_val|0x6
      data.set &access_mode:&test_ctl_u_reg %long &test_ctl_u_val
    )

    ; Get the MMSS pll debug register
    &mmss_debug_clk_ctl_reg=0xc8c0900
    &mmss_debug_clk_ctl_val=data.long(&access_mode:&mmss_debug_clk_ctl_reg)

    ; Clear the source selection field
    &mmss_debug_clk_ctl_val=&mmss_debug_clk_ctl_val&~(0x7<<0x17)

    ; Write to the MMSS pll debug register source selection field
    &mmss_debug_clk_ctl_val=&mmss_debug_clk_ctl_val|((0x7&0x7)<<0x17)
    data.set &access_mode:&mmss_debug_clk_ctl_reg %long &mmss_debug_clk_ctl_val

  )

  if ("&pll_name_choice"=="SCC_PLL")
  (
    &plltest_pad_field_val=0x9
    &user_ctl_reg=&HWIO_SSC_SCC_SCC_PLL_USER_CTL_ADDR

  &test_ctl_u_reg=&HWIO_SSC_SCC_SCC_PLL_TEST_CTL_U_ADDR
    ; Enable test output in the PLL's user control register
    &user_ctl_val=data.long(&access_mode:&user_ctl_reg)
    &user_ctl_val=&user_ctl_val|0x10
    data.set &access_mode:&user_ctl_reg %long &user_ctl_val

    ; Enable test output in the PLL's test control upper register if available
    if (&test_ctl_u_reg!=0x0)
    (
      &test_ctl_u_val=data.long(&access_mode:&test_ctl_u_reg)
      &test_ctl_u_val=&test_ctl_u_val|0x6
      data.set &access_mode:&test_ctl_u_reg %long &test_ctl_u_val
    )

    ; Get the SSC pll debug register
    &ssc_scc_scc_debug_clk_ctl_reg=0x5e20048
    &ssc_scc_scc_debug_clk_ctl_val=data.long(&access_mode:&ssc_scc_scc_debug_clk_ctl_reg)

    ; Clear the source selection field
    &ssc_scc_scc_debug_clk_ctl_val=&ssc_scc_scc_debug_clk_ctl_val&~(0x3<<0xA)

    ; Write to the SSC pll debug register source selection field
    &ssc_scc_scc_debug_clk_ctl_val=&ssc_scc_scc_debug_clk_ctl_val|((0x0&0x3)<<0xA)
    data.set &access_mode:&ssc_scc_scc_debug_clk_ctl_reg %long &ssc_scc_scc_debug_clk_ctl_val

  )

  if ("&pll_name_choice"=="QDSP6SS_PLL")
  (
    &plltest_pad_field_val=0x9
    &user_ctl_reg=&HWIO_SSC_QDSP6SS_PLL_USER_CTL_ADDR

  &test_ctl_u_reg=&HWIO_SSC_QDSP6SS_PLL_TEST_CTL_U_ADDR
    ; Enable test output in the PLL's user control register
    &user_ctl_val=data.long(&access_mode:&user_ctl_reg)
    &user_ctl_val=&user_ctl_val|0x10
    data.set &access_mode:&user_ctl_reg %long &user_ctl_val

    ; Enable test output in the PLL's test control upper register if available
    if (&test_ctl_u_reg!=0x0)
    (
      &test_ctl_u_val=data.long(&access_mode:&test_ctl_u_reg)
      &test_ctl_u_val=&test_ctl_u_val|0x6
      data.set &access_mode:&test_ctl_u_reg %long &test_ctl_u_val
    )

    ; Get the SSC pll debug register
    &ssc_scc_scc_debug_clk_ctl_reg=0x5e20048
    &ssc_scc_scc_debug_clk_ctl_val=data.long(&access_mode:&ssc_scc_scc_debug_clk_ctl_reg)

    ; Clear the source selection field
    &ssc_scc_scc_debug_clk_ctl_val=&ssc_scc_scc_debug_clk_ctl_val&~(0x3<<0xA)

    ; Write to the SSC pll debug register source selection field
    &ssc_scc_scc_debug_clk_ctl_val=&ssc_scc_scc_debug_clk_ctl_val|((0x1&0x3)<<0xA)
    data.set &access_mode:&ssc_scc_scc_debug_clk_ctl_reg %long &ssc_scc_scc_debug_clk_ctl_val

  )

  if (&user_ctl_reg!=0x0)&&(&plltest_pad_field_val!=0x0)
  (
    ; Get the PLLTEST_PAD register
    &plltest_pad_reg=0x16200c
    &plltest_pad_val=data.long(&access_mode:&plltest_pad_reg)

    ; Clear the source selection field
    &plltest_pad_val=&plltest_pad_val&~(0x1F<<0x0)

    ; Set CORE_OE
    &plltest_pad_val=&plltest_pad_val|0x1000

    ; Write to the testpad's source selection field
    &plltest_pad_val=&plltest_pad_val|((&plltest_pad_field_val&0x1F)<<0x0)
    data.set &access_mode:&plltest_pad_reg %long &plltest_pad_val
  )
  else
  (
    print "Invalid source."
  )

  return


entry &addr
local &pname
local &plen
local &rname
&pname=y.name(&addr)
if "&pname"==""
(
print "Cannot find this address =" &addr
)
else
(
&pname=os.file.name(&pname)
&plen=string.len("&pname")
&rname=string.mid("&pname",5.,&plen-10.)
// print "&pname"
// print "&plen"
print "&rname"
do hwioreg &rname
)
end



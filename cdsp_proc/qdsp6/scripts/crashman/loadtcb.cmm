LoadTCBRegs:
ENTRY &tcb &QURTVerFlag &OutputPath_temp

local &thread
local &filename

if "&OutputPath_temp"==""
(
    &OutputPath_temp="C:\Temp"
)
if "&tcb"==""
(
   print "pls. provide the TCB address, you can get it by double click <task name> in task list"
   print "..."
   enddo
)

if ("&QURTVerFlag"=="")
(
    &QURTVerFlag=0
)

&thread=v.value(((QURTK_thread_context*)&tcb)->hthread)

if "&thread"=="0xFF"  ;not running task, get HW thread from SSR
(
  &thread=v.value(((QURTK_thread_context*)&tcb)->error.hthread)
)

&thread=string.mid("&thread", 2, 1)

;set HW thread
thread &thread

;backup current registers in register window
&filename="&OutputPath_temp\_Q6tmp_&thread.cmm"
thread &thread
store &filename hex register
;print "original registers for thread &thread are saved at &filename"

;restore registers

&value=v.value(((QURTK_thread_context*)&tcb)->ssrelr)
&value_lo=&value&0xFFFFFFFF
&value_hi=&value>>0x20
r.s SSR &value_hi
r.s ELR &value_lo
r.s PC &value_lo

&value=v.value(((QURTK_thread_context*)&tcb)->error.badva)
r.s BADVA &value

&value=v.value(((QURTK_thread_context*)&tcb)->r3130)
&value_lo=&value&0xFFFFFFFF
&value_hi=&value>>0x20
r.s LR &value_hi
r.s FP &value_lo

&value=v.value(((QURTK_thread_context*)&tcb)->r2928)
&value_lo=&value&0xFFFFFFFF
&value_hi=&value>>0x20
r.s R29 &value_hi
r.s R28 &value_lo

&value=v.value(((QURTK_thread_context*)&tcb)->ugpgp)
&value_lo=&value&0xFFFFFFFF
&value_hi=&value>>0x20
r.s UGP &value_hi
r.s GP &value_lo

&value=v.value(((QURTK_thread_context*)&tcb)->r2322)
&value_lo=&value&0xFFFFFFFF
&value_hi=&value>>0x20
r.s R23 &value_hi
r.s R22 &value_lo

&value=v.value(((QURTK_thread_context*)&tcb)->r2120)
&value_lo=&value&0xFFFFFFFF
&value_hi=&value>>0x20
r.s r21 &value_hi
r.s r20 &value_lo

&value=v.value(((QURTK_thread_context*)&tcb)->r1918)
&value_lo=&value&0xFFFFFFFF
&value_hi=&value>>0x20
r.s R19 &value_hi
r.s R18 &value_lo

&value=v.value(((QURTK_thread_context*)&tcb)->r1716)
&value_lo=&value&0xFFFFFFFF
&value_hi=&value>>0x20
r.s R17 &value_hi
r.s R16 &value_lo

&value=v.value(((QURTK_thread_context*)&tcb)->r1514)
&value_lo=&value&0xFFFFFFFF
&value_hi=&value>>0x20
r.s R15 &value_hi
r.s R14 &value_lo

&value=v.value(((QURTK_thread_context*)&tcb)->r1312)
&value_lo=&value&0xFFFFFFFF
&value_hi=&value>>0x20
r.s R13 &value_hi
r.s R12 &value_lo

&value=v.value(((QURTK_thread_context*)&tcb)->r1110)
&value_lo=&value&0xFFFFFFFF
&value_hi=&value>>0x20
r.s R11 &value_hi
r.s R10 &value_lo

&value=v.value(((QURTK_thread_context*)&tcb)->r0908)
&value_lo=&value&0xFFFFFFFF
&value_hi=&value>>0x20
r.s R9 &value_hi
r.s R8 &value_lo

&value=v.value(((QURTK_thread_context*)&tcb)->r0706)
&value_lo=&value&0xFFFFFFFF
&value_hi=&value>>0x20
r.s R7 &value_hi
r.s R6 &value_lo

&value=v.value(((QURTK_thread_context*)&tcb)->r0504)
&value_lo=&value&0xFFFFFFFF
&value_hi=&value>>0x20
r.s R5 &value_hi
r.s R4 &value_lo

&value=v.value(((QURTK_thread_context*)&tcb)->r0302)
&value_lo=&value&0xFFFFFFFF
&value_hi=&value>>0x20
r.s R3 &value_hi
r.s R2 &value_lo

&value=v.value(((QURTK_thread_context*)&tcb)->r0100)
&value_lo=&value&0xFFFFFFFF
&value_hi=&value>>0x20
r.s R1 &value_hi
r.s R0 &value_lo

&value=v.value(((QURTK_thread_context*)&tcb)->lc0sa0)
&value_lo=&value&0xFFFFFFFF
&value_hi=&value>>0x20
r.s LC0 &value_hi
r.s SA0 &value_lo

&value=v.value(((QURTK_thread_context*)&tcb)->lc1sa1)
&value_lo=&value&0xFFFFFFFF
&value_hi=&value>>0x20
r.s LC1 &value_hi
r.s SA1 &value_lo

if (&QURTVerFlag==2)
(
    if (Y.EXIST(((QURTK_thread_context*)&tcb)->m1m0))
    (
        &value=v.value(((QURTK_thread_context*)&tcb)->m1m0)
    )    
    if (Y.EXIST(((QURTK_thread_context*)&tcb)->m0m1))
    (
        &value=v.value(((QURTK_thread_context*)&tcb)->m0m1)
    )    
&value_lo=&value&0xFFFFFFFF
&value_hi=&value>>0x20
r.s M0 &value_hi
r.s M1 &value_lo
)
else
(
    if (Y.EXIST(((QURTK_thread_context*)&tcb)->m0m1))
    (
        &value=v.value(((QURTK_thread_context*)&tcb)->m0m1)
    )    
    if (Y.EXIST(((QURTK_thread_context*)&tcb)->m1m0))
    (
        &value=v.value(((QURTK_thread_context*)&tcb)->m1m0)
    )
&value_lo=&value&0xFFFFFFFF
&value_hi=&value>>0x20
r.s M1 &value_hi
r.s M0 &value_lo
)
&value=v.value(((QURTK_thread_context*)&tcb)->sr_preds)
r.s P &value

&value=v.value(((QURTK_thread_context*)&tcb)->tid)
r.s STID &value

&value=v.value(((QURTK_thread_context*)&tcb)->r2726)
&value_lo=&value&0xFFFFFFFF
&value_hi=&value>>0x20
r.s R27 &value_hi
r.s R26 &value_lo

&value=v.value(((QURTK_thread_context*)&tcb)->r2524)
&value_lo=&value&0xFFFFFFFF
&value_hi=&value>>0x20
r.s R25 &value_hi
r.s R24 &value_lo

enddo




global &idx
&idx=0

&tlbaddr=v.value((unsigned int)QURTK_tlb_dump)

start:
&first=v.value((unsigned int&)(&tlbaddr+&idx*0x8))
&second=v.value((unsigned int&)((&tlbaddr+0x4)+&idx*0x8))
mmu.set tlb &idx &first &second
; print &idx "  " &first "  " &second
&idx=&idx+1
if &idx<64
(
goto start
)

done:


enddo



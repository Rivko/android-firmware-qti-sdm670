entry &OutputPath &Target_Name &frpcshell_name

LOCAL &Linkedlist_l_next
LOCAL &Linkedlist_l_addr
LOCAL &Linkedlist_l_name
LOCAL &Linkedlist_l_name_full
&Linkedlist_l_next=0
&Linkedlist_l_addr=0
&Linkedlist_l_name=0
&Linkedlist_l_name_full=0

Area.Create DSP 200. 1000.       ;create an AREA window              
WINPOS 50% 0. 50% 103% 0. 0. DSP
Area.Select DSP                  ;select the AREA window as PRACTICE 
                                ;input/output window                
Area DSP                         ;display the AREA window   

ON ERROR JUMPTO rtld_end
print " "
;printer.file &OutputPath_temp\soaddress.txt
;printer.filetype ascii
;printer.size 0xfa,0xfa
;wp.area DSP
&_rtld_debug=" "
if ("&Target_Name"=="8952")
(
    &_rtld_debug="\\M8952AAAAAAAAQ1234\Global\_rtld_debug"
)
else if ("&Target_Name"=="8976")
(
    &_rtld_debug="\\M8976AAAAAAAAQ1234\Global\_rtld_debug"
)
else if ("&Target_Name"=="8910")
(
    if (Y.EXIST("_rtld_debug"))
    (
        &_rtld_debug="_rtld_debug"
    )
    else
    (
        &_rtld_debug="\\M8910AAAAAAAAQ1234\Global\_rtld_debug"
    )    
)
else if ("&Target_Name"=="8x10")
(
    if (Y.EXIST("_rtld_debug"))
    (
        &_rtld_debug="_rtld_debug"
    )
    else
    (
        &_rtld_debug="\\M8x10AAAAAAAAQ1234\Global\_rtld_debug"
    )    
)
if ("&_rtld_debug"!=" ")
(
    if (Y.EXIST("&_rtld_debug"))
    (
        &Linkedlist_l_next=V.VALUE((*((&_rtld_debug).r_map)).l_next)
        if (&Linkedlist_l_next==0)
        (
            print " No Dynamic objects loaded using fastrpc"
        )
        else
        (
            print " DYNAMIC OBJECTS LOADED: "
            print " "
            OPEN #1 "&OutputPath_temp\soaddress.txt" /APPEND
            while (&Linkedlist_l_next!=0)
            (
                &Linkedlist_l_addr=V.VALUE((*(((struct link_map *)&Linkedlist_l_next))).l_addr)
                &Linkedlist_l_name_full=V.STRING((*(((struct link_map *)&Linkedlist_l_next))).l_name)
                &Linkedlist_l_name=string.cut("&Linkedlist_l_name_full", 0xa)
                print " Start address: &Linkedlist_l_addr, Obj Name: &Linkedlist_l_name "  
                &Linkedlist_l_next=V.VALUE((*(((struct link_map *)&Linkedlist_l_next))).l_next)
                WRITE #1 " Start address: &Linkedlist_l_addr, Obj Name: &Linkedlist_l_name "
            )
            CLOSE #1
        )
    )
)
if (Y.EXIST("\\fastrpc_shell_0\Global\_rtld_debug"))||(Y.EXIST("\\&frpcshell_name\Global\_rtld_debug"))||(Y.EXIST("\\fastrpc_shell_3\Global\_rtld_debug"))
(
    
    if (Y.EXIST("\\&frpcshell_name\Global\_rtld_debug"))
    (
        &Linkedlist_l_next=V.VALUE((*((\\&frpcshell_name\Global\_rtld_debug).r_map)).l_next)
    )
    else if (Y.EXIST("\\fastrpc_shell_0\Global\_rtld_debug"))
    (
        &Linkedlist_l_next=V.VALUE((*((\\fastrpc_shell_0\Global\_rtld_debug).r_map)).l_next)
    )
    else if (Y.EXIST("\\fastrpc_shell_3\Global\_rtld_debug"))
    (
        &Linkedlist_l_next=V.VALUE((*((\\fastrpc_shell_3\Global\_rtld_debug).r_map)).l_next)
    )
    if (&Linkedlist_l_next==0)
    (
        print " No Dynamic objects loaded using fastrpc_shell_0"
    )
    else
    (
        print " "
        print " "
        print " DYNAMIC OBJECTS LOADED FROM FASTRPC_SHELL_0: "
        print " "
        OPEN #1 "&OutputPath_temp\soaddress.txt" /APPEND
        while (&Linkedlist_l_next!=0)
        (
            &Linkedlist_l_addr=V.VALUE((*(((struct link_map *)&Linkedlist_l_next))).l_addr)
            &Linkedlist_l_name_full=V.STRING((*(((struct link_map *)&Linkedlist_l_next))).l_name)
            &Linkedlist_l_name=string.cut("&Linkedlist_l_name_full", 0xa)
            print " Start address: &Linkedlist_l_addr, Obj Name: &Linkedlist_l_name "  
            &Linkedlist_l_next=V.VALUE((*(((struct link_map *)&Linkedlist_l_next))).l_next)
            ;WRITE #1 " Start address: &Linkedlist_l_addr, Obj Name: &Linkedlist_l_name "
        )
        CLOSE #1
    )
)
if ("&Target_Name"=="8996")
(
    &_rtld_debug=" "
    if ("&Target_Name"=="8996")
    (
        &_rtld_debug="\\M8996AAAAAAAAQ1234\Global\_rtld_debug"
    )
    if ("&_rtld_debug"!=" ")
    (
        if (Y.EXIST("&_rtld_debug"))
        (
            &Linkedlist_l_next=V.VALUE((*((&_rtld_debug).r_map)).l_next)
            if (&Linkedlist_l_next==0)
            (
                print " No Dynamic objects loaded"
            )
            else
            (
                print " DYNAMIC OBJECTS LOADED: "
                print " "
                OPEN #1 "&OutputPath_temp\soaddress.txt" /APPEND
                while (&Linkedlist_l_next!=0)
                (
                    &Linkedlist_l_addr=V.VALUE((*(((struct link_map *)&Linkedlist_l_next))).l_addr)
                    &Linkedlist_l_name_full=V.STRING((*(((struct link_map *)&Linkedlist_l_next))).l_name)
                    &Linkedlist_l_name=string.cut("&Linkedlist_l_name_full", 0xa)
                    print " Start address: &Linkedlist_l_addr, Obj Name: &Linkedlist_l_name "  
                    &Linkedlist_l_next=V.VALUE((*(((struct link_map *)&Linkedlist_l_next))).l_next)
                    WRITE #1 " Start address: &Linkedlist_l_addr, Obj Name: &Linkedlist_l_name "
                )
                CLOSE #1
            )
        )
    )
    &_rtld_debug=" "
    if ("&Target_Name"=="8996")
    (
        &_rtld_debug="\\M8996AAAAAAAAQ1234_AUDIO\Global\_rtld_debug"
    )
    if ("&_rtld_debug"!=" ")
    (
        if (Y.EXIST("&_rtld_debug"))
        (
            &Linkedlist_l_next=V.VALUE((*((&_rtld_debug).r_map)).l_next)
            if (&Linkedlist_l_next==0)
            (
                print " No Dynamic objects loaded"
            )
            else
            (
                print " DYNAMIC OBJECTS LOADED: "
                print " "
                OPEN #1 "&OutputPath_temp\soaddress.txt" /APPEND
                while (&Linkedlist_l_next!=0)
                (
                    &Linkedlist_l_addr=V.VALUE((*(((struct link_map *)&Linkedlist_l_next))).l_addr)
                    &Linkedlist_l_name_full=V.STRING((*(((struct link_map *)&Linkedlist_l_next))).l_name)
                    &Linkedlist_l_name=string.cut("&Linkedlist_l_name_full", 0xa)
                    print " Start address: &Linkedlist_l_addr, Obj Name: &Linkedlist_l_name "  
                    &Linkedlist_l_next=V.VALUE((*(((struct link_map *)&Linkedlist_l_next))).l_next)
                    WRITE #1 " Start address: &Linkedlist_l_addr, Obj Name: &Linkedlist_l_name "
                )
                CLOSE #1
            )
        )
    )
)
if ("&Target_Name"=="8998")
(
    &_rtld_debug=" "
    if ("&Target_Name"=="8998")
    (
        &_rtld_debug="\\M8998AAAAAAAAQ1234\Global\_rtld_debug"
        &_rtld_debug1="\\M8998AAAAAAAAQ1234_v1\Global\_rtld_debug"
        &_rtld_debug2="\\M8998AAAAAAAAQ1234_v2\Global\_rtld_debug"
        if (Y.EXIST("&_rtld_debug1"))
        (
            &_rtld_debug="\\M8998AAAAAAAAQ1234_v1\Global\_rtld_debug"
        )
        if (Y.EXIST("&_rtld_debug2"))
        (
            &_rtld_debug="\\M8998AAAAAAAAQ1234_v2\Global\_rtld_debug"
        )
    )
    if ("&_rtld_debug"!=" ")
    (
        if (Y.EXIST("&_rtld_debug"))
        (
            &Linkedlist_l_next=V.VALUE((*((&_rtld_debug).r_map)).l_next)
            if (&Linkedlist_l_next==0)
            (
                print " No Dynamic objects loaded"
            )
            else
            (
                print " DYNAMIC OBJECTS LOADED: "
                print " "
                OPEN #1 "&OutputPath_temp\soaddress.txt" /APPEND
                while (&Linkedlist_l_next!=0)
                (
                    &Linkedlist_l_addr=V.VALUE((*(((struct link_map *)&Linkedlist_l_next))).l_addr)
                    &Linkedlist_l_name_full=V.STRING((*(((struct link_map *)&Linkedlist_l_next))).l_name)
                    &Linkedlist_l_name=string.cut("&Linkedlist_l_name_full", 0xa)
                    print " Start address: &Linkedlist_l_addr, Obj Name: &Linkedlist_l_name "  
                    &Linkedlist_l_next=V.VALUE((*(((struct link_map *)&Linkedlist_l_next))).l_next)
                    WRITE #1 " Start address: &Linkedlist_l_addr, Obj Name: &Linkedlist_l_name "
                )
                CLOSE #1
            )
        )
    )
    &_rtld_debug=" "
    if ("&Target_Name"=="8998")
    (
        &_rtld_debug="\\M8998AAAAAAAAQ1234_AUDIO\Global\_rtld_debug"
    )
    if ("&_rtld_debug"!=" ")
    (
        if (Y.EXIST("&_rtld_debug"))
        (
            &Linkedlist_l_next=V.VALUE((*((&_rtld_debug).r_map)).l_next)
            if (&Linkedlist_l_next==0)
            (
                print " No Dynamic objects loaded"
            )
            else
            (
                print " DYNAMIC OBJECTS LOADED: "
                print " "
                OPEN #1 "&OutputPath_temp\soaddress.txt" /APPEND
                while (&Linkedlist_l_next!=0)
                (
                    &Linkedlist_l_addr=V.VALUE((*(((struct link_map *)&Linkedlist_l_next))).l_addr)
                    &Linkedlist_l_name_full=V.STRING((*(((struct link_map *)&Linkedlist_l_next))).l_name)
                    &Linkedlist_l_name=string.cut("&Linkedlist_l_name_full", 0xa)
                    print " Start address: &Linkedlist_l_addr, Obj Name: &Linkedlist_l_name "  
                    &Linkedlist_l_next=V.VALUE((*(((struct link_map *)&Linkedlist_l_next))).l_next)
                    WRITE #1 " Start address: &Linkedlist_l_addr, Obj Name: &Linkedlist_l_name "
                )
                CLOSE #1
            )
        )
    )
)
if ("&Target_Name"=="660")
(
    &_rtld_debug=" "
    if ("&Target_Name"=="660")
    (
        &_rtld_debug="\\ROOT_660\Global\_rtld_debug"
    )
    if ("&_rtld_debug"!=" ")
    (
        if (Y.EXIST("&_rtld_debug"))
        (
            &Linkedlist_l_next=V.VALUE((*((&_rtld_debug).r_map)).l_next)
            if (&Linkedlist_l_next==0)
            (
                print " No Dynamic objects loaded"
            )
            else
            (
                print " DYNAMIC OBJECTS LOADED: "
                print " "
                OPEN #1 "&OutputPath_temp\soaddress.txt" /APPEND
                while (&Linkedlist_l_next!=0)
                (
                    &Linkedlist_l_addr=V.VALUE((*(((struct link_map *)&Linkedlist_l_next))).l_addr)
                    &Linkedlist_l_name_full=V.STRING((*(((struct link_map *)&Linkedlist_l_next))).l_name)
                    &Linkedlist_l_name=string.cut("&Linkedlist_l_name_full", 0xa)
                    print " Start address: &Linkedlist_l_addr, Obj Name: &Linkedlist_l_name "  
                    &Linkedlist_l_next=V.VALUE((*(((struct link_map *)&Linkedlist_l_next))).l_next)
                    WRITE #1 " Start address: &Linkedlist_l_addr, Obj Name: &Linkedlist_l_name "
                )
                CLOSE #1
            )
        )
    )
    &_rtld_debug=" "
    if ("&Target_Name"=="660")
    (
        &_rtld_debug="\\AUDIO_660\Global\_rtld_debug"
    )
    if ("&_rtld_debug"!=" ")
    (
        if (Y.EXIST("&_rtld_debug"))
        (
            &Linkedlist_l_next=V.VALUE((*((&_rtld_debug).r_map)).l_next)
            if (&Linkedlist_l_next==0)
            (
                print " No Dynamic objects loaded"
            )
            else
            (
                print " DYNAMIC OBJECTS LOADED: "
                print " "
                OPEN #1 "&OutputPath_temp\soaddress.txt" /APPEND
                while (&Linkedlist_l_next!=0)
                (
                    &Linkedlist_l_addr=V.VALUE((*(((struct link_map *)&Linkedlist_l_next))).l_addr)
                    &Linkedlist_l_name_full=V.STRING((*(((struct link_map *)&Linkedlist_l_next))).l_name)
                    &Linkedlist_l_name=string.cut("&Linkedlist_l_name_full", 0xa)
                    print " Start address: &Linkedlist_l_addr, Obj Name: &Linkedlist_l_name "  
                    &Linkedlist_l_next=V.VALUE((*(((struct link_map *)&Linkedlist_l_next))).l_next)
                    WRITE #1 " Start address: &Linkedlist_l_addr, Obj Name: &Linkedlist_l_name "
                )
                CLOSE #1
            )
        )
    )
    &_rtld_debug=" "
    if ("&Target_Name"=="660")
    (
        &_rtld_debug="\\SENSOR_660\Global\_rtld_debug"
    )
    if ("&_rtld_debug"!=" ")
    (
        if (Y.EXIST("&_rtld_debug"))
        (
            &Linkedlist_l_next=V.VALUE((*((&_rtld_debug).r_map)).l_next)
            if (&Linkedlist_l_next==0)
            (
                print " No Dynamic objects loaded"
            )
            else
            (
                print " DYNAMIC OBJECTS LOADED: "
                print " "
                OPEN #1 "&OutputPath_temp\soaddress.txt" /APPEND
                while (&Linkedlist_l_next!=0)
                (
                    &Linkedlist_l_addr=V.VALUE((*(((struct link_map *)&Linkedlist_l_next))).l_addr)
                    &Linkedlist_l_name_full=V.STRING((*(((struct link_map *)&Linkedlist_l_next))).l_name)
                    &Linkedlist_l_name=string.cut("&Linkedlist_l_name_full", 0xa)
                    print " Start address: &Linkedlist_l_addr, Obj Name: &Linkedlist_l_name "  
                    &Linkedlist_l_next=V.VALUE((*(((struct link_map *)&Linkedlist_l_next))).l_next)
                    WRITE #1 " Start address: &Linkedlist_l_addr, Obj Name: &Linkedlist_l_name "
                )
                CLOSE #1
            )
        )
    )
)
if ("&Target_Name"=="845")
(
    &_rtld_debug=" "
    if ("&Target_Name"=="845")
    (
        &_rtld_debug="\\ROOT_845\Global\_rtld_debug"
    )
    if ("&_rtld_debug"!=" ")
    (
        if (Y.EXIST("&_rtld_debug"))
        (
            &Linkedlist_l_next=V.VALUE((*((&_rtld_debug).r_map)).l_next)
            if (&Linkedlist_l_next==0)
            (
                print " No Dynamic objects loaded"
            )
            else
            (
                print " DYNAMIC OBJECTS LOADED: "
                print " "
                OPEN #1 "&OutputPath_temp\soaddress.txt" /APPEND
                while (&Linkedlist_l_next!=0)
                (
                    &Linkedlist_l_addr=V.VALUE((*(((struct link_map *)&Linkedlist_l_next))).l_addr)
                    &Linkedlist_l_name_full=V.STRING((*(((struct link_map *)&Linkedlist_l_next))).l_name)
                    &Linkedlist_l_name=string.cut("&Linkedlist_l_name_full", 0xa)
                    print " Start address: &Linkedlist_l_addr, Obj Name: &Linkedlist_l_name "  
                    &Linkedlist_l_next=V.VALUE((*(((struct link_map *)&Linkedlist_l_next))).l_next)
                    WRITE #1 " Start address: &Linkedlist_l_addr, Obj Name: &Linkedlist_l_name "
                )
                CLOSE #1
            )
        )
    )
    &_rtld_debug=" "
    if ("&Target_Name"=="845")
    (
        &_rtld_debug="\\AUDIO_845\Global\_rtld_debug"
    )
    if ("&_rtld_debug"!=" ")
    (
        if (Y.EXIST("&_rtld_debug"))
        (
            &Linkedlist_l_next=V.VALUE((*((&_rtld_debug).r_map)).l_next)
            if (&Linkedlist_l_next==0)
            (
                print " No Dynamic objects loaded"
            )
            else
            (
                print " DYNAMIC OBJECTS LOADED: "
                print " "
                OPEN #1 "&OutputPath_temp\soaddress.txt" /APPEND
                while (&Linkedlist_l_next!=0)
                (
                    &Linkedlist_l_addr=V.VALUE((*(((struct link_map *)&Linkedlist_l_next))).l_addr)
                    &Linkedlist_l_name_full=V.STRING((*(((struct link_map *)&Linkedlist_l_next))).l_name)
                    &Linkedlist_l_name=string.cut("&Linkedlist_l_name_full", 0xa)
                    print " Start address: &Linkedlist_l_addr, Obj Name: &Linkedlist_l_name "  
                    &Linkedlist_l_next=V.VALUE((*(((struct link_map *)&Linkedlist_l_next))).l_next)
                    WRITE #1 " Start address: &Linkedlist_l_addr, Obj Name: &Linkedlist_l_name "
                )
                CLOSE #1
            )
        )
    )
    &_rtld_debug=" "
    if ("&Target_Name"=="845")
    (
        &_rtld_debug="\\SENSOR_845\Global\_rtld_debug"
    )
    if ("&_rtld_debug"!=" ")
    (
        if (Y.EXIST("&_rtld_debug"))
        (
            &Linkedlist_l_next=V.VALUE((*((&_rtld_debug).r_map)).l_next)
            if (&Linkedlist_l_next==0)
            (
                print " No Dynamic objects loaded"
            )
            else
            (
                print " DYNAMIC OBJECTS LOADED: "
                print " "
                OPEN #1 "&OutputPath_temp\soaddress.txt" /APPEND
                while (&Linkedlist_l_next!=0)
                (
                    &Linkedlist_l_addr=V.VALUE((*(((struct link_map *)&Linkedlist_l_next))).l_addr)
                    &Linkedlist_l_name_full=V.STRING((*(((struct link_map *)&Linkedlist_l_next))).l_name)
                    &Linkedlist_l_name=string.cut("&Linkedlist_l_name_full", 0xa)
                    print " Start address: &Linkedlist_l_addr, Obj Name: &Linkedlist_l_name "  
                    &Linkedlist_l_next=V.VALUE((*(((struct link_map *)&Linkedlist_l_next))).l_next)
                    WRITE #1 " Start address: &Linkedlist_l_addr, Obj Name: &Linkedlist_l_name "
                )
                CLOSE #1
            )
        )
    )
)
if ("&Target_Name"=="8953")
(
    &_rtld_debug=" "
    if ("&Target_Name"=="8953")
    (
        &_rtld_debug="\\M8953AAAAAAAAQ1234\Global\_rtld_debug"
    )
    if ("&_rtld_debug"!=" ")
    (
        if (Y.EXIST("&_rtld_debug"))
        (
            &Linkedlist_l_next=V.VALUE((*((&_rtld_debug).r_map)).l_next)
            if (&Linkedlist_l_next==0)
            (
                print " No Dynamic objects loaded"
            )
            else
            (
                print " DYNAMIC OBJECTS LOADED: "
                print " "
                OPEN #1 "&OutputPath_temp\soaddress.txt" /APPEND
                while (&Linkedlist_l_next!=0)
                (
                    &Linkedlist_l_addr=V.VALUE((*(((struct link_map *)&Linkedlist_l_next))).l_addr)
                    &Linkedlist_l_name_full=V.STRING((*(((struct link_map *)&Linkedlist_l_next))).l_name)
                    &Linkedlist_l_name=string.cut("&Linkedlist_l_name_full", 0xa)
                    print " Start address: &Linkedlist_l_addr, Obj Name: &Linkedlist_l_name "  
                    &Linkedlist_l_next=V.VALUE((*(((struct link_map *)&Linkedlist_l_next))).l_next)
                    WRITE #1 " Start address: &Linkedlist_l_addr, Obj Name: &Linkedlist_l_name "
                )
                CLOSE #1
            )
        )
    )
    &_rtld_debug=" "
    if ("&Target_Name"=="8953")
    (
        &_rtld_debug="\\M8953AAAAAAAAQ1234_AUDIO\Global\_rtld_debug"
    )
    if ("&_rtld_debug"!=" ")
    (
        if (Y.EXIST("&_rtld_debug"))
        (
            &Linkedlist_l_next=V.VALUE((*((&_rtld_debug).r_map)).l_next)
            if (&Linkedlist_l_next==0)
            (
                print " No Dynamic objects loaded"
            )
            else
            (
                print " DYNAMIC OBJECTS LOADED: "
                print " "
                OPEN #1 "&OutputPath_temp\soaddress.txt" /APPEND
                while (&Linkedlist_l_next!=0)
                (
                    &Linkedlist_l_addr=V.VALUE((*(((struct link_map *)&Linkedlist_l_next))).l_addr)
                    &Linkedlist_l_name_full=V.STRING((*(((struct link_map *)&Linkedlist_l_next))).l_name)
                    &Linkedlist_l_name=string.cut("&Linkedlist_l_name_full", 0xa)
                    print " Start address: &Linkedlist_l_addr, Obj Name: &Linkedlist_l_name "  
                    &Linkedlist_l_next=V.VALUE((*(((struct link_map *)&Linkedlist_l_next))).l_next)
                    WRITE #1 " Start address: &Linkedlist_l_addr, Obj Name: &Linkedlist_l_name "
                )
                CLOSE #1
            )
        )
    )
)
if ("&Target_Name"=="8937")
(
    &_rtld_debug=" "
    if ("&Target_Name"=="8937")
    (
        &_rtld_debug="\\M8937AAAAAAAAQ1234\Global\_rtld_debug"
    )
    if ("&_rtld_debug"!=" ")
    (
        if (Y.EXIST("&_rtld_debug"))
        (
            &Linkedlist_l_next=V.VALUE((*((&_rtld_debug).r_map)).l_next)
            if (&Linkedlist_l_next==0)
            (
                print " No Dynamic objects loaded"
            )
            else
            (
                print " DYNAMIC OBJECTS LOADED: "
                print " "
                OPEN #1 "&OutputPath_temp\soaddress.txt" /APPEND
                while (&Linkedlist_l_next!=0)
                (
                    &Linkedlist_l_addr=V.VALUE((*(((struct link_map *)&Linkedlist_l_next))).l_addr)
                    &Linkedlist_l_name_full=V.STRING((*(((struct link_map *)&Linkedlist_l_next))).l_name)
                    &Linkedlist_l_name=string.cut("&Linkedlist_l_name_full", 0xa)
                    print " Start address: &Linkedlist_l_addr, Obj Name: &Linkedlist_l_name "  
                    &Linkedlist_l_next=V.VALUE((*(((struct link_map *)&Linkedlist_l_next))).l_next)
                    WRITE #1 " Start address: &Linkedlist_l_addr, Obj Name: &Linkedlist_l_name "
                )
                CLOSE #1
            )
        )
    )
    &_rtld_debug=" "
    if ("&Target_Name"=="8937")
    (
        &_rtld_debug="\\M8937AAAAAAAAQ1234_AUDIO\Global\_rtld_debug"
    )
    if ("&_rtld_debug"!=" ")
    (
        if (Y.EXIST("&_rtld_debug"))
        (
            &Linkedlist_l_next=V.VALUE((*((&_rtld_debug).r_map)).l_next)
            if (&Linkedlist_l_next==0)
            (
                print " No Dynamic objects loaded"
            )
            else
            (
                print " DYNAMIC OBJECTS LOADED: "
                print " "
                OPEN #1 "&OutputPath_temp\soaddress.txt" /APPEND
                while (&Linkedlist_l_next!=0)
                (
                    &Linkedlist_l_addr=V.VALUE((*(((struct link_map *)&Linkedlist_l_next))).l_addr)
                    &Linkedlist_l_name_full=V.STRING((*(((struct link_map *)&Linkedlist_l_next))).l_name)
                    &Linkedlist_l_name=string.cut("&Linkedlist_l_name_full", 0xa)
                    print " Start address: &Linkedlist_l_addr, Obj Name: &Linkedlist_l_name "  
                    &Linkedlist_l_next=V.VALUE((*(((struct link_map *)&Linkedlist_l_next))).l_next)
                    WRITE #1 " Start address: &Linkedlist_l_addr, Obj Name: &Linkedlist_l_name "
                )
                CLOSE #1
            )
        )
    )
)
enddo
rtld_end:
do &CurrentDirectory\cmm_error.cmm "rtld_debug.cmm"
enddo



entry &elf_file  &dump_file &Target_Name &cdsp_flag

if ("&Target_Name"=="8994")
(
    sys.cpu HexagonV56
)
else if ("&Target_Name"=="8992")
(
    sys.cpu HexagonV56
)
else if ("&Target_Name"=="8952")
(
    sys.cpu HexagonV56
)
else if ("&Target_Name"=="8953")
(
    sys.cpu HexagonV56
)
else if ("&Target_Name"=="8937")
(
    sys.cpu HexagonV56
)
else if ("&Target_Name"=="8976")
(
    sys.cpu HexagonV56
)
else if ("&Target_Name"=="8996")
(
    sys.cpu HexagonV60
)
else if ("&Target_Name"=="8998")
(
    sys.cpu HexagonV62
)
else if ("&Target_Name"=="660")
(
    if ("&cdsp_flag"=="True")
    (
        sys.cpu HexagonV60
    )
    else
    (
        sys.cpu HexagonV62
    )
)
else
(
    sys.cpu HexagonV5
)
sys.config.etr.base 0x4
sys.config.tpiu.base 0x8
system.up
trace.method.la
etm.portmode wrapped
if ("&cdsp_flag"=="True")&&("&Target_Name"=="660")
(
    etm.traceid 0x26
)
else
(
    etm.traceid 0x28
)    
etm.ca ON
analyzer.clock 500.mhz
la.mode.flowtrace.on
d.load.elf &elf_file
la.import.etb &dump_file
trace.list tp tpc tpinfo def l.nd.off
enddo
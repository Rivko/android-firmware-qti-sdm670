entry &address


OPEN #1 "C:\Temp\bitflip.txt" /CREATE
&count=0
RePeaT 
(
    &add=1<<&count
    &xor=&address^&add
    &idx=0
    ON ERROR Continue
    &value=v.value((unsigned int&)(&xor))
    WRITE #1 "&xor: &value"
    &count=&count+1
    if &count==0x20
    (
        GOTO endloop
    )
)
endloop: CLOSE #1
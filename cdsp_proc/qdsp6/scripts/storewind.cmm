// SIM_lds_d_01_28_2011_t_18_24_19.cmm Fri Jan 28 18:28:35 2011

 B::
 
 TOOLBAR ON
 STATUSBAR ON
 FRAMEPOS 14.286,8.3333,,,Maximized
 WINPAGE.RESET
 
 WINCLEAR
 WINPOS 96.0 29.25 68. 11. 0. 0. W002
 Area 
 
 WINPOS 96.143 0.083333 68. 25. 0. 1. winDBList NORMAL "Debug buffer"
 task.dbg
 
 WINPOS 169.29 0.0 65. 25. 0. 1. W006
 task.tracelist 7
 
 WINPOS 169.14 29.5 67. 11. 0. 1. winINList NORMAL "QuRT interrupt list"
 task.irql
 
 WINPOS 0.0 29.333 91. 11. 0. 0. W003
 v.v QURT_error_info
 
 WINPOS 0.0 44.833 92. 19. 0. 0. W005
 area
 
 WINPOS 169.0 45.5 77. 19. 0. 1. winMMList NORMAL "QuRT memory usage"
 task.memlist
 WINPAN 0. 5.
 
 WINPOS 97.429 45.333 68. 25. 23. 1. W000
 mmu.list PAGETABLE
 
 WINPOS 118.43 5.0833 91. 53. 0. 1. winBTList NORMAL "QuRT thread list"
 task.TaskList
 
 WINPAGE.SELECT P000     
 
 ENDDO

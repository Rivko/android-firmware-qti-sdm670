;****************************************************************************
;**         boot_debug_target_data.cmm
;**
;**         This script performs setup for debugging target on secboot 3.0 Architecture.
;**
;** Copyright  2014 - 2017 by Qualcomm Technologies, Incorporated.  All Rights Reserved.
;**
;****************************************************************************
;**
;**                        EDIT HISTORY FOR MODULE
;**
;**
;** when       who     what, where, why
;** --------   ---     ------------------------------------------------------
;** 04/20/17   kedara   Added shared imem defines
;** 05/09/16   digant  Increased the sbl1_entry_time and sbl1_dload_entry_time
;** 04/12/16   kedara  Update for 8998
;** 01/06/16   kedara  Update dload cookie logic
;** 07/08/15   ck      Increased sbl1_log_timeout to 30 seconds due to DDR training
;** 06/24/15   as      Add boot timing numbers.
;** 02/20/15   kedara  Updates to change dload cookie address based on chip version.
;** 02/19/15   kedara  Updated for msm8996
;** 03/25/14   ck      Updated for Bear family
;** 08/07/12   jz      ported from target's boot_debug to make it shared

;****************************************************************************

;****************************************************************************
;  CMM script variables
;****************************************************************************
global &shared_imem_base
global &boot_dload_enable_value
global &boot_logger_loop_magic_num
global &shared_imem_boot_etb_addr
global &boot_dload_boot_misc_detect_addr
global &boot_debug_cookie_addr
global &boot_debug_cookie_val
global &shared_imem_magic_num
global &shared_imem_version_value
global &shared_imem_reset_val
global &boot_shared_imem_size
global &shared_imem_version_addr
global &shared_imem_boot_magic_num_addr


;global variable for intercom name and apps core reset function
global &apcs_start_address_reg
global &rpmview_temp_apps_start_address
global &appview_temp_apps_start_address
global &pbl_bring_apps_out_of_reset_func
global &apps_reset_handler_addr
global &APPS_CORE0_T32

;global variable for boot timing
global &sbl1_log_timeout
global &sbl1_log_timeout_post_reset
global &sbl1_entry_time
global &sbl1_entry_time_post_reset
global &sbl1_dload_entry_time
global &sbl1_dload_entry_time_post_reset
global &sbl1_exit_time
global &sbl1_exit_time_post_reset

local &tcsr_soc_hw_version_reg
local &tcsr_soc_hw_version_major_version
local &tcsr_soc_hw_version_device_number

;Intercom port number for APPS core 0
&APPS_CORE0_T32="localhost:10001."

;Bear family uses ocimem as shared imem
&shared_imem_base=0x146BF000

&shared_imem_magic_num=0xC1F8DB40
&shared_imem_version_value=0x00000002
&boot_logger_loop_magic_num=0xD1C2B3A3
&shared_imem_reset_val=0xFFFFFFFF

;boot shared imem size of 200 bytes
&boot_shared_imem_size=0x0c7

;dload is now a bit in the BOOT_MISC_DETECT register for v3 onwards
&boot_dload_enable_value=0x10
&boot_dload_boot_misc_detect_addr=0x01FD3000

;boot shared imem magic num location
&shared_imem_boot_magic_num_addr=&shared_imem_base

;boot shared imem version location
&shared_imem_version_addr=&shared_imem_base+4

;boot shared imem etb pointer location
&shared_imem_boot_etb_addr=&shared_imem_base+8

;sbl1 debug cookie address and value, it's always in ocimem
&boot_debug_cookie_addr=&shared_imem_base+944
&boot_debug_cookie_val=0x53444247

;sbl1 boot times
&sbl1_log_timeout=30.s
&sbl1_log_timeout_post_reset=0.s
&sbl1_entry_time=10.s
&sbl1_entry_time_post_reset=0.s
&sbl1_dload_entry_time=10.s
&sbl1_dload_entry_time_post_reset=0.s
&sbl1_exit_time=15.s
&sbl1_exit_time_post_reset=0.s
;============================================================================
; Name: runtime_symbol_load.cmm
; Parse info block and load symbols for drivers
; 
; Copyright (c) 2013,2015-2016 Qualcomm Technologies, Incorporated.
; All Rights Reserved.
; Qualcomm Confidential and Proprietary
;
;----------------------------------------------------------------------------
;============================================================================
;
;
;
;when         who     what, where, why
;----------   ---     ----------------------------------------------------------
;2016-03-17   bh      Pass info block offset as parameter
;2016-02-18   bh      Update UEFI entry address
;2015-09-17   vk      Move FD base
;2013-12-02   vk      Initial Version
;============================================================================;

;  Info Block Structure - QcomPkg/Sec/UefiInfoBlk.h
;  Make sure runtime driver list is up to date in QcomPkg/Drivers/EnvDxe.c
;
; Current List:
;
;STATIC  RtDriversReadyType RtDrivers[] = 
;{ 
;  { "RuntimeDxe", 0 },
;  { "VariableDxe", 0 },
;  { "EmbeddedMonotonicCounter", 0 },
;  { "ResetRuntimeDxe", 0 },
;  { "RealTimeClockRuntime", 0 },
;  { "CapsuleRuntimeDxe", 0},
;};

local &BakDir

;---------------------------------------------------
; ENTRY point for cmm - start here
;---------------------------------------------------
ENTRY

  &BakDir=os.pwd()

  &UefiBase=0x9FC00000
  &InfoBlkPtrOffset=0x003FF000

  cd ..\..\..
  
  do QcomPkg/Tools/common_runtime_symbol_load.cmm  &UefiBase &InfoBlkPtrOffset

  cd &BakDir  
END


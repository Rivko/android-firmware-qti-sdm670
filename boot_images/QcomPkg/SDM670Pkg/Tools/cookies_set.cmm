;============================================================================
;  Name:
;    cookies_set.cmm
;
;  Description:
;     Setting cookie locations and values
;
; Copyright (c) 2016 Qualcomm Technologies Incorporated.
; All Rights Reserved.
; Qualcomm Technologies Confidential and Proprietary
;
;----------------------------------------------------------------------------
;============================================================================
;
;                        EDIT HISTORY FOR MODULE

;
;when         who     what, where, why
;----------   ---     ----------------------------------------------------------
;2016-08-18   bh      Remove legacy items
;2016-03-23   bh      Initial Version
;============================================================================;

global &UefiDebugCookieAddr

&SharedImemBase=0x146BF000
&DLOAD_COOKIE1_ADDR=0x01FD3000
&UefiDebugCookieAddr=&SharedImemBase+944

&UefiDebugCookie=0x55444247

D.S A:&UefiDebugCookieAddr %LE %LONG &UefiDebugCookie
D.S AZ:&DLOAD_COOKIE1_ADDR %LE %LONG 0x0

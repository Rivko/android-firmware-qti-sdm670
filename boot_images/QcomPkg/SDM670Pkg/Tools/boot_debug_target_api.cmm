;****************************************************************************
;**         boot_debug_target_api.cmm
;**
;** This script performs setup for debugging target on secboot 3.0 Architecture.
;**
;** Copyright  2014 - 2016 by Qualcomm Technologies, Incorporated.  All Rights Reserved.
;**
;****************************************************************************
;**
;**                        EDIT HISTORY FOR MODULE
;**
;**
;** when       who     what, where, why
;** --------   ---     ------------------------------------------------------
;** 04/12/17   kpa     Initial creation

;****************************************************************************

;=====================================================
; Target Specific functions
;=====================================================
ENTRY &Api &TargetScriptPath
MainApi:
  if ("&Api"=="SystemUp")
  (
    gosub SystemUp
  )
  else if("&Api"=="SystemDown")
  (
    gosub SystemDown
  )

EndofMain:
enddo

;=====================================================
; Function to clean up just before exit
;=====================================================
SystemDown:
  sys.d
  return  ;SystemDown

  
;=====================================================
; Function to bring the system up
;=====================================================
SystemUp:
  sys.u
  IF File.exist("&TargetScriptPath/PreSil/boot_bringup_init.cmm")
  (
    do &TargetScriptPath/PreSil/boot_bringup_init.cmm
  )
  return  ;SystemUp

; Variables
local &BootBuildPath
local &StorageToolsPath
local &EmmcCDTProgramPath


&StorageToolsPath="QcomPkg/Tools/storage/eMMC"
&EmmcCDTProgramPath="QcomPkg/Tools/emmc_cdt_program_scripts"

; Assuming that the user is running the script from QcomPkg/Tools/emmc_cdt_program_scripts
cd ../../../

&BootBuildPath=os.pwd()
&StorageToolsPath="&BootBuildPath"+"/"+"&StorageToolsPath"
&EmmcCDTProgramPath="&BootBuildPath"+"/"+"&EmmcCDTProgramPath"


; Set up the display window
area.reset
area.create cdt
WINPOS 0% 50% 68% 50% 0. 0. W001
area.view cdt
area.select cdt


cd &StorageToolsPath
do jtagprogrammer.cmm LOAD xml=rawprogram2.xml searchpaths=&EmmcCDTProgramPath
do jtagprogrammer.cmm PATCH xml=patch2.xml searchpaths=&EmmcCDTProgramPath
cd &EmmcCDTProgramPath

enddo
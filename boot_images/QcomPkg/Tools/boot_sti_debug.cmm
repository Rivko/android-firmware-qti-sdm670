;****************************************************************************
;**         boot_sti_debug.cmm
;**
;**         This script performs setup for XBL STI  
;**
;** Copyright  2012-2015 by Qualcomm Technologies, Incorporated.  All Rights Reserved.
;**
;****************************************************************************
;**
;**                        EDIT HISTORY FOR MODULE
;**
;** $$
;**
;** when       who     what, where, why
;** --------   ---     ------------------------------------------------------
;** 09/04/15   fz      modify the script for XBL-Loader STI
; 

;****************************************************************************

  ; This script is a wrapper for the target specific debug script

  ;============================================================================
  ; Declare variables used
  ;============================================================================
  local &Choice
  local &Option  ; Menu Option
  
  ;============================================================================
  ; Get the arguments passed in.
  ;============================================================================
  ENTRY &Choice &Option 
  
  ;============================================================================
  ; Set up the display window
  ;============================================================================

  winclear
  area.RESET 
  WINPOS 0% 50% 68% 50% 0. 0. W001
  Area.create MAIN
  Area.view MAIN
  Area.select MAIN

  ;============================================================================
  ; If user passed TARGET on command line, just go
  ;============================================================================ 
  if "&Choice"=="8996"
  (
    do boot_debug_common.cmm Msm8996 Loader False &Option 
    enddo
  )
  else if "&Choice"=="2432"
  (
    do boot_debug_common.cmm Qdf2432 Loader True &Option 
    enddo
  )
  ;============================================================================
  ; Provide user with a choice for the chipset
  ;============================================================================
    
  print "Please enter chipset under debug: "
  print " 1: 8996"
  print " 2: 2432"
  print
  print "Please make a choice: "
  enter &Choice
  if "&Choice"=="1"
  (
    do sti_debug_common.cmm Msm8996 Loader False
    enddo
  )
  else if "&Choice"=="2"
  (
    do sti_debug_common.cmm Qdf2432 Loader True
    enddo
  )
  else
  (
    print "Incorrect entry"
    enddo
  )

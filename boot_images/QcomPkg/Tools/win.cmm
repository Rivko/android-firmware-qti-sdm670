;============================================================================
;  Name:
;    win.cmm
;
;  Description:
;     Windows size, pos configurations in T32. Overwrite to the desired
;     T32 setting using store windows to option.
;
; Copyright (c) 2010-2011, 2015 , 2018 by Qualcomm Technologies, Inc. All Rights Reserved
; All Rights Reserved.
; Qualcomm Confidential and Proprietary
;
;----------------------------------------------------------------------------
;============================================================================
;
;                        EDIT HISTORY FOR MODULE
;
;
;
; when         who     what, where, why
; ----------   ---     ----------------------------------------------------------
; 2015-11-17   bh      Remove terminal
; 2015-06-25   bh      Fix UEFI_Logs area issues
; 2015-03-10   jb      Add terminal window
; 2015-01-27   bh      Unifying 32/64-bit scripts
; 2010-12-03   yg      Better Layout and Fonts
; 2011-03-16   niting  Updated windows to show rt
; 2010-12-03   yg      Initial Version
;============================================================================;

 B::
 
 area.create UEFI_Logs 1000. 8192.
 TOOLBAR ON
 STATUSBAR ON
 FramePOS 2.0 0.0 191. 73.
 WinPAGE.RESet
 
 WinPAGE.Create P000
 
 WinCLEAR
 WinPOS 0.0 62.667 152. 7. 0. 0. W004
 ws.area.view UEFI_Logs 
 
 WinPOS 135.0 23.308 61. 52. 5. 0. W003
 ws.v.f
 
 WinPOS 134.86 0.0 52. 20. 0. 0. W002
 r /spotlight
 
 ;WinPOS 69.143 39.231 120. 25. 0. 0. W005
 ;TERM.METHOD DCC3
 ;term.reset
 ;term.size 120. 10000
 ;term.scroll on
 ;term.mode VT100
 ;TERM.GATE
 ;screen.always
 
 WinPOS 0.0 0.076923 131. 56. 13. 1. W001
 WinTABS 10. 18. 25. 56.
 d.l
 

 WinPAGE.select P000
 
 ENDDO

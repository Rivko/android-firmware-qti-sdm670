;============================================================================
;  Name:
;    ram_load.cmm
;
;  Description:
;     Load the UEFI FV image into RAM for debugging
;
; Copyright (c) 2010-2011 Qualcomm Technologies Incorporated.
; All Rights Reserved.
; Qualcomm Confidential and Proprietary
;
;----------------------------------------------------------------------------
;============================================================================
;
;                        EDIT HISTORY FOR MODULE
;
;
;
;when       who     what, where, why
;--------   ---     ----------------------------------------------------------
;06/30/11   niting  Rename emmc_appsboot.mbn to uefi.mbn
;03/16/11   niting  Created generic reload script
;12/03/10   yg      Initial Version
;============================================================================;


entry &TargetPkgLoc &RamEntryAddr
  
  data.load.binary &TargetPkgLoc/Bin/uefi.mbn &RamEntryAddr /skip 0x28
  
  r.s pc &RamEntryAddr

enddo


;============================================================================
; Copyright (c) 2016 Qualcomm Technologies Incorporated.
; All Rights Reserved.
; Qualcomm Technologies Confidential and Proprietary
;============================================================================

global &UefiCorePath
local  &currentDir
local  &practiceDir

ENTRY

  &currentDir=os.pwd()
  &practiceDir=os.ppd()

  cd &practiceDir
  do check_paths.cmm
  cd &currentDir

  do &UefiCorePath/symbol_load.cmm

enddo

;============================================================================
; Copyright (c) 2016 Qualcomm Technologies Incorporated.
; All Rights Reserved.
; Qualcomm Technologies Confidential and Proprietary
;============================================================================

global &UefiCorePath
local  &currentDir
local  &practiceDir

; Parameter LogFileName is optional
ENTRY &LogFileName

  &currentDir=os.pwd()
  &practiceDir=os.ppd()

  cd &practiceDir
  do check_paths.cmm
  cd &currentDir

  do &UefiCorePath/log_save.cmm &LogFileName

enddo

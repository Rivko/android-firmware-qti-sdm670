;============================================================================
; Copyright (c) 2016 Qualcomm Technologies Incorporated.
; All Rights Reserved.
; Qualcomm Technologies Confidential and Proprietary
;============================================================================

global &UefiCorePath
global &AppObjPath
global &AppSrcPath

local &scanres
local &scanpos

ENTRY

  ; Check if path to UEFI is already defined
  if ("&UefiCorePath"=="")
  (
    dialog.ok "Run script uefi_core_path_set.cmm to set path to UEFI core <TargetPkg>/Tools directory"
    end
  )
  ; Sanity check UEFI path ends with "Tools"
  &scanres=0.
  &scanpos=0.
  &scanpos=string.length("&UefiCorePath")-string.length("Tools")
  &scanres=string.scan("&UefiCorePath", "Tools", &scanpos)
  if (&scanres==-1.)
  (
    dialog.ok "UEFI path is inavalid!" "Run script uefi_core_path_set.cmm to set path to UEFI core <TargetPkg>/Tools directory"
    end
  )

  ; Check if App pkg paths are already defined
  if (("&AppObjPath"=="")||("&AppSrcPath"==""))
  (
    dialog.ok "Run script app_path_set.cmm to set path to AppPkg Src/Obj directories"
    end
  )
  ; Sanity check App Obj Path has "Build" subdirectory
  &path="&AppObjPath/Build"
  if (os.access("&path", "r")!=TRUE())
  (
    dialog.ok "Obj Path does not contain _Build_ subdirectory!" "Run script app_path_set.cmm to set path to AppPkg Src/Obj directories"
    end
  )
  ; Sanity check App Src Path has "MdePkg" subdirectory
  &path="&AppSrcPath/MdePkg"
  if (os.access("&path", "r")!=TRUE())
  (
    dialog.ok "Src Path does not contain _MdePkg_ subdirectory!" "Run script app_path_set.cmm to set path to AppPkg Src/Obj directories"
    end
  )
  

enddo

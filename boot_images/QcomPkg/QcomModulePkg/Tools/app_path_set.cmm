;============================================================================
; Copyright (c) 2016 Qualcomm Technologies Incorporated.
; All Rights Reserved.
; Qualcomm Technologies Confidential and Proprietary
;============================================================================

global &AppObjPath
global &AppSrcPath
local  &Path
local  &SrcPath
local  &ObjPath
local  &currentDir

;
;  Optional argument with obj, src path to be set
;
ENTRY &AppObjPath &AppSrcPath

  &currentDir=os.pwd()

  ; If any path is empty then use current app base path
  if (("&AppObjPath"=="")||("&AppSrcPath"==""))
  (
    &Path=os.ppd()

    ; Determine if App pkg resides within QcomPkg or not
    if (os.dir("&Path/../../../BaseTools")==TRUE())
    (
      cd "&Path/../../../"
      &ObjPath=os.pwd()

      cd "&Path/../../../"
      &SrcPath=os.pwd()
    )
    else if (os.dir("&Path/../../BaseTools")==TRUE())
    (
      cd "&Path/../../"
      &ObjPath=os.pwd()

      cd "&Path/../../"
      &SrcPath=os.pwd()
    )

    cd &currentDir
  )

  if ("&AppObjPath"=="")
  (
    &AppObjPath="&ObjPath"
  )

  if ("&AppSrcPath"=="")
  (
    &AppSrcPath="&SrcPath"
  )

enddo

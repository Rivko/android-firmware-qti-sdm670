;============================================================================
; Copyright (c) 2016 Qualcomm Technologies Incorporated.
; All Rights Reserved.
; Qualcomm Technologies Confidential and Proprietary
;============================================================================

global &UefiCorePath

;
;  Optional argument with path to be set
;
ENTRY &PathParam

  if ("&PathParam"=="")
  (
    &PathParam=os.pwd()
  )

  &UefiCorePath="&PathParam"

enddo

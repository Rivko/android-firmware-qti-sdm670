;============================================================================
;
;           M S M 8 9 6 0   T E S T   C L O C K   S C R I P T
;
; GENERAL DESCRIPTION
;   This script can be used to route specific clocks to the clock test output
;   on GPIO 40 and 167.
;   High speed clock test GPIO:  40 (dbg_hs_out_clk)
;   Low speed clock test GPIO :  167 (dbg_ls_out_clk)
;
; FUNCTIONS
;   N/A
;
; INITIALIZATION AND SEQUENCING REQUIREMENTS
;   Invoke this script, and choose the clock to test.  The script will program
;   the necessary registers accordingly.  Run the test clock script in the
;   ARM11 debug window to select the specific ARM11 clock to see.
;
;      Copyright (c) 2011 by Qualcomm Technologies, Inc.  All Rights Reserved.
;============================================================================


;-----------------------------------------------------------------------------
; Physical addresses - find in hwio.cmm
;-----------------------------------------------------------------------------

&HWIO_GPIO_CFG0_PHYS=0x801000
&HWIO_PLLTEST_PAD_CFG_PHYS=0x902fa4
&HWIO_CLK_TEST_PHYS=0x902fa0
&HWIO_LCC_CLK_HS_DEBUG_CFG_PHYS=0x280000a4
&HWIO_LCC_CLK_LS_DEBUG_CFG_PHYS=0x280000a8
&HWIO_MMSS_DBG_CFG_REG_LS_PHYS=0x40001b8
&HWIO_MMSS_DBG_CFG_REG_HS_PHYS=0x40001b4
&HWIO_PMU_SPARE_OUT_PHYS=0x032040b4
&HWIO_PDM_CLK_NS_PHYS=0x902cc0
&HWIO_RINGOSC_NS_PHYS=0x902dc0
&HWIO_RINGOSC_TCXO_CTL_PHYS=0x902dc4
&HWIO_RINGOSC_STATUS_PHYS=0x902dcc
&HWIO_CLK_HALT_AFAB_SFAB_STATEA_PHYS=0x902fc0
&HWIO_CLK_HALT_AFAB_SFAB_STATEB_PHYS=0x902fc4
&HWIO_NAV_CLK_CTL_PHYS=0x08AF8008
&HWIO_MSS_CLK_DBG_CFG_PHYS=0x8B00018
&HWIO_APCS_CLK_DIAG_PHYS=0x0201101C

&HWIO_LCC_PLL0_MODE_PHYS=0x28000000
&HWIO_LCC_PLL0_STATUS_PHYS=0x28000018
&HWIO_PLL0_MODE_PHYS=0x9030c0
&HWIO_PLL0_STATUS_PHYS=0x9030d8
&HWIO_PLL5_MODE_PHYS=0x9030e0
&HWIO_PLL5_STATUS_PHYS=0x9030f8
&HWIO_PLL6_MODE_PHYS=0x903100
&HWIO_PLL6_STATUS_PHYS=0x903118
&HWIO_PLL8_MODE_PHYS=0x903140
&HWIO_PLL8_STATUS_PHYS=0x903158
&HWIO_MMSS_PLL0_MODE_PHYS=0x4000300
&HWIO_MMSS_PLL0_STATUS_PHYS=0x4000318
&HWIO_MMSS_PLL1_MODE_PHYS=0x400031c
&HWIO_MMSS_PLL1_STATUS_PHYS=0x4000334
&HWIO_MMSS_PLL2_MODE_PHYS=0x4000338
&HWIO_MMSS_PLL2_STATUS_PHYS=0x4000350
&HWIO_EBI1_PLL_MODE_PHYS=0x903180
&HWIO_EBI1_PLL_STATUS_PHYS=0x903198

; Addresses of the HS and LS GPIO configuration registers.
; LS: GPIO 167
; HS: GPIO 40
&HWIO_GPIO_CFG_HS_PHYS=(&HWIO_GPIO_CFG0_PHYS+40.*0x10)
&HWIO_GPIO_CFG_LS_PHYS=(&HWIO_GPIO_CFG0_PHYS+167.*0x10)

;-----------------------------------------------------------------------------
; Local variables
;-----------------------------------------------------------------------------

local &choice
local &clk_name
local &clk_state
local &clk_freq
local &temp
local &header_printed
local &choice_handled
local &old_choice
local &reset_ringosc_cnt
local &clk_test
local &clk_reg
local &print_if_off

;-----------------------------------------------------------------------------
; Define the window
;-----------------------------------------------------------------------------

AREA.Create A000 100. 1000.
AREA.Select A000
AREA.View
winresize 100. 24.

;-----------------------------------------------------------------------------
; Initialize autogenerated constants
;-----------------------------------------------------------------------------

goto Init_Constants
Init_Constants_Done:

;-----------------------------------------------------------------------------
; Print banner and go to main menu
;-----------------------------------------------------------------------------

print " "
print "---------------------------- MSM8960 Clock Test ---------------------------------"
print " "

;-----------------------------------------------------------------------------
; Read input
;-----------------------------------------------------------------------------

entry &inchoice

&print_if_off=1

if "&inchoice"!=""
(
  &choice="&inchoice"
  goto Handle_Choice
)


Main_Menu:

print " "
print "Clock (? for list): "

&t32_cmm_stopped=1
&old_choice="&choice"
enter &choice
&t32_cmm_stopped=0

Handle_Choice:

&header_printed=0
&choice_handled=0

; Exit
if "&choice"=="?"
(
  gosub Help
  &choice_handled=1
)
else if "&choice"=="x"
(
  print "Exit"
  area.close
  enddo
)
else if "&choice"=="s"
(
  gosub Display_Status
  &choice_handled=1
)
else if "&choice"=="."
(
  &choice="&old_choice"
)

;-----------------------------------------------------------------------------
; Check for enabling the clock test output on GPIOs
;-----------------------------------------------------------------------------

if "&choice"=="gpio"
(
  ; Configure HS GPIO
  data.set a:&HWIO_GPIO_CFG_HS_PHYS %LONG 0x1D0

  ; Configure LS GPIO
  data.set a:&HWIO_GPIO_CFG_LS_PHYS %LONG 0x1CC

  ; Enable the dbg_hs_clk on PLLTEST.
  data.set a:&HWIO_PLLTEST_PAD_CFG_PHYS %LONG 0x38F8

  &choice_handled=1
)

;-----------------------------------------------------------------------------
; Check for enabling the log output
;-----------------------------------------------------------------------------

if "&choice"=="log"
(
  print "Enter log file [c:\temp\testclock.log]: "
  enter &logfile
  if "&logfile"==""
  (
    &logfile="c:\temp\testclock.log"
  )
  print "Output logging enabled to &logfile"
  area.open A000 &logfile

  &choice_handled=1
)

;-----------------------------------------------------------------------------
; Check for dumping all or all/on clocks
;-----------------------------------------------------------------------------

if ("&choice"=="all")||("&choice"=="all_on")
(
  gosub Print_Header

  if ("&choice"=="all_on")
  (
    &print_if_off=0
  )

  gosub Print_All

  &print_if_off=1
  &choice_handled=1
)

gosub Print_All_SS

;-----------------------------------------------------------------------------
; If nothing else, then assume it was a clock name
;-----------------------------------------------------------------------------

if &choice_handled==0
(
  gosub Print_Header
  gosub Print_Clk_Info_Line &choice
)

goto Main_Menu


;-----------------------------------------------------------------------------
; Display header
;-----------------------------------------------------------------------------

Print_Header:

  if &header_printed==0
  (
    print ""
    print "Clock                     State     Frequency (MHz)      Control Reg   "
    print "------------------------------------------------------------------------"

    &header_printed=1
  )

  return


;-----------------------------------------------------------------------------
; Display help
;-----------------------------------------------------------------------------

Help:

  ;-----------------------------------------------------------------------------
  ; Display available clock sources that can be output to the clock test output
  ; and prompt for selection.
  ;-----------------------------------------------------------------------------

  AREA.Create HELP 100. 1000.
  AREA.View HELP
  AREA.Select HELP
  winresize 100. 24.

  print " "
  print " "
  gosub Print_Clock_Help
  print ""
  print "*** Clock groups***   "
  print "   all/_on    - all/on clocks"
  print "  <ss>_all   - all subsystem clocks"
  print "*** Other options ***"
  print "  s  - status"
  print "  x  - exit"
  print "  ?  - help"
  print "  .  - repeat" 
  print "*** Debug options ***"
  print "   gpio       - enable GPIO's for clock output"
  print "   log        - log output to a given file"
  print ""

  AREA.Select A000

  return


;-----------------------------------------------------------------------------
; Display clock info line
;-----------------------------------------------------------------------------

Print_Clk_Info_Line:

  ENTRY  &clk

  &is_on=0
  &clk_test=0
  &clk_reg="N/A"

  ; Set the default name
  &clk_name=string.cut("&clk                         ", -string.len("&clk"))

  gosub Reset_RingOsc_Count
 
  gosub Find_Clock &clk

  ;-----------------------------------------------------------------------------
  ; Print clock state
  ;-----------------------------------------------------------------------------
  
  if "&is_on"=="0x0"
  (
    &clk_state="OFF"
  )
  else if ("&is_on"=="0x1")
  (
    &clk_state="ON "
  )
  else if ("&is_on"=="0x2")
  (
    &clk_state="N/A"
  )
  else
  (
    print "Invalid clock: &clk"
    return
  )
  
  ;-----------------------------------------------------------------------------
  ; Calculate the clock frequency based on the TCXO counter
  ;-----------------------------------------------------------------------------

  if ("&is_on"!="0x0")&&("&clk_test"!="0")
  (
    gosub Program_Clk_Test

    gosub Calc_Clock_Freq

    ; Give ringosc one more chance to return proper value.
    if (&clk_freq==0)
    (
      wait 50.ms
      gosub Calc_Clock_Freq
    )

    if (&clk_freq==0)
    (
      &clk_freq="0               "
    )
  )
  else if ("&is_on"=="0x0")
  (
    &clk_freq="                "
  )
  else
  (
    &clk_freq="Not available   "
  )
  
  if (&print_if_off==1)||("&is_on"=="0x1")||("&is_on"=="0x2")
  (
    print "&clk_name &clk_state       &clk_freq     &clk_reg"
  )

  return


;-----------------------------------------------------------------------------
; Display the status registers.
;-----------------------------------------------------------------------------

Display_Status:

  ; Display the clock status registers.
  &temp_reg=data.long(a:&HWIO_CLK_HALT_AFAB_SFAB_STATEA_PHYS)
  print "CLK_HALT_AFAB_SFAB_STATEA           = &temp_reg"
  &temp_reg=data.long(a:&HWIO_CLK_HALT_AFAB_SFAB_STATEB_PHYS)
  print "CLK_HALT_AFAB_SFAB_STATEB         = &temp_reg"
  &temp_reg=data.long(a:&HWIO_CLK_HALT_DFAB_STATE_PHYS)
  print "CLK_HALT_DFAB_STATE          = &temp_reg"
  &temp_reg=data.long(a:&HWIO_CLK_HALT_CFPB_STATEA_PHYS)
  print "CLK_HALT_CFPB_STATEA          = &temp_reg"
  &temp_reg=data.long(a:&HWIO_CLK_HALT_CFPB_STATEB_PHYS)
  print "CLK_HALT_CFPB_STATEB          = &temp_reg"
  &temp_reg=data.long(a:&HWIO_CLK_HALT_CFPB_STATEC_PHYS)
  print "CLK_HALT_CFPB_STATEC           = &temp_reg"
  &temp_reg=data.long(a:&HWIO_CLK_HALT_SFPB_MISC_STATE_PHYS)
  print "CLK_HALT_SFPB_MISC_STATE          = &temp_reg"
  &temp_reg=data.long(a:&HWIO_CLK_HALT_MSS_SMPSS_MISC_STATE_PHYS)
  print "CLK_HALT_MSS_SMPSS_MISC_STATE     = &temp_reg"
  
  ; Display the PLL mode registers.
  &temp_reg=data.long(a:&HWIO_PLL0_MODE_PHYS)
  print "PLL0: PLL0_MODE                = &temp_reg"
  &temp_reg=data.long(a:&HWIO_MMSS_PLL0_MODE_PHYS)
  print "PLL1: MMSS_PLL0_MODE           = &temp_reg"
  &temp_reg=data.long(a:&HWIO_MMSS_PLL1_MODE_PHYS)
  print "PLL2: MMSS_PLL1_MODE           = &temp_reg"
  &temp_reg=data.long(a:&HWIO_MMSS_PLL2_MODE_PHYS)
  print "PLL3: MMSS_PLL2_MODE           = &temp_reg"
  &temp_reg=data.long(a:&HWIO_LCC_PLL0_MODE_PHYS)
  print "PLL4: LCC_PLL0_MODE            = &temp_reg"
  &temp_reg=data.long(a:&HWIO_PLL5_MODE_PHYS)
  print "PLL5: PLL5_MODE (Modem)        = &temp_reg"
  &temp_reg=data.long(a:&HWIO_PLL6_MODE_PHYS)
  print "PLL6: PLL6_MODE (Modem)        = &temp_reg"
  &temp_reg=data.long(a:&HWIO_PLL8_MODE_PHYS)
  print "PLL8: PLL8_MODE (Shared)       = &temp_reg"
  ;print "TODO:: ADD SC_PLL0 Here "
  ;print "TODO:: ADD SC_PLL1 Here "
  &temp_reg=data.long(a:&HWIO_EBI1_PLL_MODE_PHYS)
  print "PLL11: EBI1_PLL_MODE           = &temp_reg"  
  ;print "TODO:: ADD SC L2 Here "     

  ; Display the PLL status registers.
  &temp_reg=data.long(a:&HWIO_PLL0_STATUS_PHYS)
  print "PLL0: PLL0_STATUS              = &temp_reg"
  &temp_reg=data.long(a:&HWIO_MMSS_PLL0_STATUS_PHYS)
  print "PLL1: MMSS_PLL0_STATUS         = &temp_reg"
  &temp_reg=data.long(a:&HWIO_MMSS_PLL1_STATUS_PHYS)
  print "PLL2: MMSS_PLL1_STATUS         = &temp_reg"
  &temp_reg=data.long(a:&HWIO_MMSS_PLL2_STATUS_PHYS)
  print "PLL3: MMSS_PLL2_STATUS         = &temp_reg"
  &temp_reg=data.long(a:&HWIO_LCC_PLL0_STATUS_PHYS)
  print "PLL4: LCC_PLL0_STATUS          = &temp_reg"
  &temp_reg=data.long(a:&HWIO_PLL5_STATUS_PHYS)
  print "PLL5: PLL5_STATUS (Modem)      = &temp_reg"
  &temp_reg=data.long(a:&HWIO_PLL6_STATUS_PHYS)
  print "PLL6: PLL6_STATUS (Modem)      = &temp_reg"
  &temp_reg=data.long(a:&HWIO_PLL8_STATUS_PHYS)
  print "PLL8: PLL8_STATUS (Shared)     = &temp_reg"
  ;print "TODO:: ADD SC_PLL0 Here "
  ;print "TODO:: ADD SC_PLL1 Here "
  &temp_reg=data.long(a:&HWIO_EBI1_PLL_STATUS_PHYS)
  print "PLL11: EBI1_PLL_STATUS         = &temp_reg"  
  ;print "TODO:: ADD SC L2 Here "     

  return


;-----------------------------------------------------------------------
; Manually reset ringosc count
;-----------------------------------------------------------------------

Reset_RingOsc_Count:

  &reset_ringosc_cnt=0

  &pdm_clk_ns=data.long(a:&HWIO_PDM_CLK_NS_PHYS)
  &ringosc_ns=data.long(a:&HWIO_RINGOSC_NS_PHYS)
  data.set a:&HWIO_PDM_CLK_NS_PHYS %LONG 0x2898
  data.set a:&HWIO_CLK_TEST_PHYS   %LONG 0x0  
  data.set a:&HWIO_RINGOSC_NS_PHYS %LONG 0xA00
  
  &ringosc_tcxo_cnt_clr=(0x0)
  &ringosc_tcxo_cnt_set=(0x0012c0)
  &ringosc_tcxo_cnt_val=(0x1012c0)
      
  data.set a:&HWIO_RINGOSC_TCXO_CTL_PHYS   %LONG &ringosc_tcxo_cnt_clr
  data.set a:&HWIO_CLK_TEST_PHYS           %LONG 0x0A
  data.set a:&HWIO_RINGOSC_TCXO_CTL_PHYS   %LONG &ringosc_tcxo_cnt_set
  data.set a:&HWIO_RINGOSC_TCXO_CTL_PHYS   %LONG &ringosc_tcxo_cnt_val
      
  wait 20.ms
  while (data.long(a:&HWIO_RINGOSC_STATUS_PHYS)&0x2000000)==0
  (
  )
  
  &reset_ringosc_cnt=data.long(a:&HWIO_RINGOSC_STATUS_PHYS)
  ; Remove the TCXO_CNT_DONE to get just RINGOSC_CNT
  &reset_ringosc_cnt=(&reset_ringosc_cnt&0x1FFFFF)
  
  data.set a:&HWIO_RINGOSC_TCXO_CTL_PHYS    %LONG &ringosc_tcxo_cnt_clr
  data.set a:&HWIO_PDM_CLK_NS_PHYS          %LONG &pdm_clk_ns
  data.set a:&HWIO_RINGOSC_NS_PHYS          %LONG &ringosc_ns

  wait 20.ms

  return


;-----------------------------------------------------------------------------
; Program the clk_test register
;-----------------------------------------------------------------------------

Program_Clk_Test:

  &testval=&clk_test&0xFF
  &selval=&clk_test&0xFF00

  ; Low speed
  if &selval==&CLK_TEST_LS
  (
    data.set a:&HWIO_CLK_TEST_PHYS %LONG 0x4030D00|&testval
  )
  ; High speed
  if &selval==&CLK_TEST_HS
  (
    data.set a:&HWIO_CLK_TEST_PHYS %LONG 0x4020000|(&testval<<10.)
  )
  ; LPASS low speed
  if &selval==&CLK_LPASS_TEST_LS
  (
    data.set a:&HWIO_CLK_TEST_PHYS %LONG 0x4030D98
    data.set a:&HWIO_LCC_CLK_LS_DEBUG_CFG_PHYS %LONG 0x1|(&testval<<1.)
  )
  ; LPASS high speed
  if &selval==&CLK_LPASS_TEST_HS
  (
    data.set a:&HWIO_CLK_TEST_PHYS %LONG 0x402BC00
    data.set a:&HWIO_LCC_CLK_HS_DEBUG_CFG_PHYS %LONG 0x1|(&testval<<1.)
  )
  ; MMSS low speed
  if &selval==&CLK_MMSS_TEST_LS
  (
    data.set a:&HWIO_CLK_TEST_PHYS %LONG 0x4030D97
    data.set a:&HWIO_MMSS_DBG_CFG_REG_LS_PHYS %LONG 0x1|(&testval<<1.)
  )
  ; MMSS high speed
  if &selval==&CLK_MMSS_TEST_HS
  (
    data.set a:&HWIO_CLK_TEST_PHYS %LONG 0x402B800
    data.set a:&HWIO_MMSS_DBG_CFG_REG_HS_PHYS %LONG 0x1|(&testval<<1.)
  )
  ; RIVA low speed
  if &selval==&CLK_RIVA_TEST_LS
  (
    data.set a:&HWIO_CLK_TEST_PHYS %LONG 0x4030DA6
    data.set a:&HWIO_PMU_SPARE_OUT_PHYS %LONG (&testval<<8.)
  )
  ; RIVA high speed
  if &selval==&CLK_RIVA_TEST_HS
  (
    data.set a:&HWIO_CLK_TEST_PHYS %LONG 0x4034400
    data.set a:&HWIO_PMU_SPARE_OUT_PHYS %LONG (&testval<<4.)
  )
  ; MSS low speed
  if &selval==&CLK_MSS_TEST_LS
  (
    data.set a:&HWIO_CLK_TEST_PHYS %LONG 0x402B595
    data.set a:&HWIO_MSS_CLK_DBG_CFG_PHYS %LONG 0x28
    ;Read current NAV_CLK_CTL register value and mask off bits for test sel values
    &nav_clk_ctl=data.long(a:&HWIO_NAV_CLK_CTL_PHYS)
    &nav_clk_ctl=(&nav_clk_ctl&0xFFE3FFFF)
    data.set a:&HWIO_NAV_CLK_CTL_PHYS %LONG &nav_clk_ctl|(&testval<<18.) 
  )
  ; MSS high speed
  if &selval==&CLK_MSS_TEST_HS
  (
    data.set a:&HWIO_CLK_TEST_PHYS %LONG 0x402B400
    data.set a:&HWIO_MSS_CLK_DBG_CFG_PHYS %LONG 0x28
    ;Read current NAV_CLK_CTL register value and mask off bits for test sel values
    &nav_clk_ctl=data.long(a:&HWIO_NAV_CLK_CTL_PHYS)
    &nav_clk_ctl=(&nav_clk_ctl&0xFFE3FFFF)
    data.set a:&HWIO_NAV_CLK_CTL_PHYS %LONG &nav_clk_ctl|(&testval<<20.)
  )
  ; APCS low speed
  if &selval==&CLK_APCS_TEST_LS
  (
    data.set a:&HWIO_CLK_TEST_PHYS %LONG 0x4030196
    data.set a:&HWIO_APCS_CLK_DIAG_PHYS %LONG (&testval)
  )
  ; APCS high speed
  if &selval==&CLK_APCS_TEST_HS
  (
    data.set a:&HWIO_CLK_TEST_PHYS %LONG 0x5030400
    data.set a:&HWIO_APCS_CLK_DIAG_PHYS %LONG 0x84|(&testval<<3.)
  )
  ; Return
  return


;-----------------------------------------------------------------------------
; Determine clock frequency.
;-----------------------------------------------------------------------------

Calc_Clock_Freq:

  ; Enable XO4 (19.2/4) clock for RINGOSC_TCXO_CTL[TCXO_TERM_CNT]
  &pdm_clk_ns=data.long(a:&HWIO_PDM_CLK_NS_PHYS)
  &ringosc_ns=data.long(a:&HWIO_RINGOSC_NS_PHYS)
  data.set a:&HWIO_PDM_CLK_NS_PHYS %LONG 0x2898
  ; div by 4
  data.set a:&HWIO_RINGOSC_NS_PHYS %LONG 0xA30
  &multiplier=4

  if ((&clk_test&0xFF00)==&CLK_APCS_TEST_HS)||((&clk_test&0xFF00)==&CLK_APCS_TEST_LS)
  (
    &multiplier=&multiplier*2
  )
      
  ; The RINGOSC_STATUS is limited to 0x200000, and
  ; the max clock rate is about 2GHz, so the max
  ; sample size is 1ms or 4800 clocks of 4.8Mhz.
  ; Note: the SWI lies about RINGOSC_STATUS, but
  ; experiments show it rolls over at 0x200000.

  &ringosc_tcxo_cnt_clr=(0x0)
  &ringosc_tcxo_cnt_set=(0x0012c0)
  &ringosc_tcxo_cnt_val=(0x1012c0)
      
  data.set a:&HWIO_RINGOSC_TCXO_CTL_PHYS    %LONG &ringosc_tcxo_cnt_clr
  data.set a:&HWIO_RINGOSC_TCXO_CTL_PHYS    %LONG &ringosc_tcxo_cnt_set
  data.set a:&HWIO_RINGOSC_TCXO_CTL_PHYS    %LONG &ringosc_tcxo_cnt_val    
    
  wait 20.ms
  while (data.long(a:&HWIO_RINGOSC_STATUS_PHYS)&0x2000000)==0
  (
  )

  ;-----------------------------------------------------------------------------
  ; Validate ringosc count
  ;-----------------------------------------------------------------------------

  &clock_count=data.long(a:&HWIO_RINGOSC_STATUS_PHYS)
  ; Remove the TCXO_CNT_DONE to get just RINGOSC_CNT
  &clock_count=(&clock_count&0x1FFFFF)
  
  if (&clock_count==&reset_ringosc_cnt)
  (
    &clk_freq=0
  )
  else
  (
    &clk_freq=4.800*(&multiplier)*(&clock_count+1.5)/(0x012c0+3.5)
  )
  
  data.set a:&HWIO_RINGOSC_TCXO_CTL_PHYS    %LONG &ringosc_tcxo_cnt_clr
  data.set a:&HWIO_PDM_CLK_NS_PHYS          %LONG &pdm_clk_ns
  data.set a:&HWIO_RINGOSC_NS_PHYS          %LONG &ringosc_ns
  
  return



;============================================================================
;
; AUTOGENERATION BEGIN
;
;============================================================================

Init_Constants:
&CLK_TEST_LS=(1<<8)
&CLK_TEST_HS=(2<<8)
&CLK_MSS_TEST_LS=(3<<8)
&CLK_MSS_TEST_HS=(4<<8)
&CLK_Q6FW_TEST_LS=(5<<8)
&CLK_Q6FW_TEST_HS=(6<<8)
&CLK_Q6SW_TEST_LS=(7<<8)
&CLK_Q6SW_TEST_HS=(8<<8)
&CLK_MMSS_TEST_LS=(9<<8)
&CLK_MMSS_TEST_HS=(10<<8)
&CLK_LPASS_TEST_LS=(11<<8)
&CLK_LPASS_TEST_HS=(12<<8)
&CLK_RIVA_TEST_LS=(13<<8)
&CLK_RIVA_TEST_HS=(14<<8)
&CLK_APCS_TEST_LS=(15<<8)
&CLK_APCS_TEST_HS=(16<<8)
&CLK_TEST_AFAB_EBI1_S_ACLK=(&CLK_TEST_HS|0x00)
&CLK_TEST_AFAB_KPSS_M0_ACLK=(&CLK_TEST_HS|0x01)
&CLK_TEST_AFAB_KPSS_M1_ACLK=(&CLK_TEST_HS|0x02)
&CLK_TEST_AFAB_SFAB_M0_ACLK=(&CLK_TEST_HS|0x03)
&CLK_TEST_AFAB_SFAB_M1_ACLK=(&CLK_TEST_HS|0x04)
&CLK_TEST_AFAB_SMPSS_S_ACLK=(&CLK_TEST_HS|0x05)
&CLK_TEST_AFAB_SFAB_S_ACLK=(&CLK_TEST_HS|0x06)
&CLK_TEST_AFAB_CORE_CLK=(&CLK_TEST_HS|0x07)
&CLK_TEST_AFAB_AXI_S0_FCLK=(&CLK_TEST_HS|0x08)
&CLK_TEST_AFAB_AXI_S1_FCLK=(&CLK_TEST_HS|0x09)
&CLK_TEST_AFAB_AXI_S2_FCLK=(&CLK_TEST_HS|0x0A)
&CLK_TEST_AFAB_AXI_S3_FCLK=(&CLK_TEST_HS|0x0B)
&CLK_TEST_AFAB_AXI_S4_FCLK=(&CLK_TEST_HS|0x0C)
&CLK_TEST_SFAB_AFAB_M_ACLK=(&CLK_TEST_HS|0x0D)
&CLK_TEST_SFAB_ADM0_M0_ACLK=(&CLK_TEST_HS|0x0E)
&CLK_TEST_SFAB_ADM0_M1_ACLK=(&CLK_TEST_HS|0x0F)
&CLK_TEST_SFAB_ADM0_M2_HCLK=(&CLK_TEST_HS|0x10)
&CLK_TEST_Q6FW_CC_DBG_HS_CLK=(&CLK_TEST_HS|0x11)
&CLK_TEST_Q6SW_CC_DBG_HS_CLK=(&CLK_TEST_HS|0x12)
&CLK_TEST_SFAB_LPASS_Q6_ACLK=(&CLK_TEST_HS|0x15)
&CLK_TEST_SFAB_AFAB_S0_ACLK=(&CLK_TEST_HS|0x16)
&CLK_TEST_SFAB_AFAB_S1_ACLK=(&CLK_TEST_HS|0x17)
&CLK_TEST_SFAB_CORE_CLK=(&CLK_TEST_HS|0x18)
&CLK_TEST_SFAB_AXI_S0_FCLK=(&CLK_TEST_HS|0x19)
&CLK_TEST_SFAB_AXI_S1_FCLK=(&CLK_TEST_HS|0x1A)
&CLK_TEST_SFAB_AXI_S2_FCLK=(&CLK_TEST_HS|0x1B)
&CLK_TEST_SFAB_AXI_S3_FCLK=(&CLK_TEST_HS|0x1C)
&CLK_TEST_SFAB_AXI_S4_FCLK=(&CLK_TEST_HS|0x1D)
&CLK_TEST_SFAB_AHB_S0_FCLK=(&CLK_TEST_HS|0x1E)
&CLK_TEST_SFAB_AHB_S1_FCLK=(&CLK_TEST_HS|0x1F)
&CLK_TEST_SFAB_AHB_S2_FCLK=(&CLK_TEST_HS|0x20)
&CLK_TEST_SFAB_AHB_S3_FCLK=(&CLK_TEST_HS|0x21)
&CLK_TEST_SFAB_AHB_S4_FCLK=(&CLK_TEST_HS|0x22)
&CLK_TEST_SFAB_AHB_S5_FCLK=(&CLK_TEST_HS|0x23)
&CLK_TEST_SFAB_AHB_S6_FCLK=(&CLK_TEST_HS|0x24)
&CLK_TEST_MSS_XPU_CLK=(&CLK_TEST_HS|0x25)
&CLK_TEST_Q6SW_CLK_SRC=(&CLK_TEST_HS|0x26)
&CLK_TEST_Q6FW_CLK_SRC=(&CLK_TEST_HS|0x27)
&CLK_TEST_SC_ACLK=(&CLK_TEST_HS|0x28)
&CLK_TEST_SC_DBG_CLK=(&CLK_TEST_HS|0x29)
&CLK_TEST_ADM0_CLK_RAW=(&CLK_TEST_HS|0x2A)
&CLK_TEST_IMEM0_ACLK=(&CLK_TEST_HS|0x2C)
&CLK_TEST_MSS_DBG_HS_CLK=(&CLK_TEST_HS|0x2D)
&CLK_TEST_MMSS_CC_DBG_HS_IN_CLK=(&CLK_TEST_HS|0x2E)
&CLK_TEST_LPASS_CC_DBG_HS_IN_CLK=(&CLK_TEST_HS|0x2F)
&CLK_TEST_LPASS_Q6_CC_DBG_HS_IN_CLK=(&CLK_TEST_HS|0x30)
&CLK_TEST_MMFAB_SYNC_SRC=(&CLK_TEST_HS|0x31)
&CLK_TEST_PCIE_ACLK=(&CLK_TEST_HS|0x32)
&CLK_TEST_EBI1_CLK_SRC=(&CLK_TEST_HS|0x33)
&CLK_TEST_DDR_CLK=(&CLK_TEST_HS|0x34)
&CLK_TEST_EBI1_CH0_CC_DBG_HS_CLK=(&CLK_TEST_HS|0x35)
&CLK_TEST_EBI1_CH1_CC_DBG_HS_CLK=(&CLK_TEST_HS|0x36)
&CLK_TEST_SPDM_CY_PORT0_CLK=(&CLK_TEST_HS|0x37)
&CLK_TEST_SPDM_CY_PORT1_CLK=(&CLK_TEST_HS|0x38)
&CLK_TEST_SPDM_CY_PORT2_CLK=(&CLK_TEST_HS|0x39)
&CLK_TEST_SPDM_CY_PORT4_CLK=(&CLK_TEST_HS|0x3A)
&CLK_TEST_SPDM_CY_PORT5_CLK=(&CLK_TEST_HS|0x3B)
&CLK_TEST_SPDM_CY_PORT6_CLK=(&CLK_TEST_HS|0x3C)
&CLK_TEST_SPDM_CY_PORT7_CLK=(&CLK_TEST_HS|0x3D)
&CLK_TEST_SC_L2_CLK=(&CLK_TEST_HS|0x3F)
&CLK_TEST_SC_DBG_HS0_CLK=(&CLK_TEST_HS|0x40)
&CLK_TEST_SC_DBG_HS1_CLK=(&CLK_TEST_HS|0x41)
&CLK_TEST_SC_DBG_HS2_CLK=(&CLK_TEST_HS|0x42)
&CLK_TEST_LOW_SPEED_DEBUG_CLOCK=(&CLK_TEST_HS|0x43)
&CLK_TEST_SEC_CTRL_ACC_CLK=(&CLK_TEST_HS|0x44)
&CLK_TEST_SFAB_MSS_M_ACLK=(&CLK_TEST_HS|0x46)
&CLK_TEST_SFAB_USB3_M_ACLK=(&CLK_TEST_HS|0x47)
&CLK_TEST_QDSS_AT_CLK=(&CLK_TEST_HS|0x48)
&CLK_TEST_QDSS_PCLKDBG_CLK=(&CLK_TEST_HS|0x49)
&CLK_TEST_QDSS_TRACECLKIN_CLK=(&CLK_TEST_HS|0x4A)
&CLK_TEST_QDSS_TSCTR_CLK=(&CLK_TEST_HS|0x4B)
&CLK_TEST_SFAB_MSS_Q6_SW_ACLK=(&CLK_TEST_HS|0x4C)
&CLK_TEST_SFAB_MSS_Q6_FW_ACLK=(&CLK_TEST_HS|0x4D)
&CLK_TEST_SFAB_MSS_S_HCLK=(&CLK_TEST_HS|0x4E)
&CLK_TEST_QDSS_STM_CLK=(&CLK_TEST_HS|0x4F)
&CLK_TEST_RIVA_CC_DBG_CLK_HS=(&CLK_TEST_HS|0x51)
&CLK_TEST_AFAB_EBI1_CH1_ACLK=(&CLK_TEST_HS|0x52)
&CLK_TEST_SFAB_CFPB_M_HCLK=(&CLK_TEST_LS|0x01)
&CLK_TEST_SFAB_SFPB_M_HCLK=(&CLK_TEST_LS|0x02)
&CLK_TEST_SFAB_DFAB_S_ACLK=(&CLK_TEST_LS|0x03)
&CLK_TEST_SFAB_SMPSS_S_HCLK=(&CLK_TEST_LS|0x04)
&CLK_TEST_QDSS_HCLK=(&CLK_TEST_LS|0x05)
&CLK_TEST_SFAB_CFPB_S_HCLK=(&CLK_TEST_LS|0x06)
&CLK_TEST_SFAB_SFPB_S_HCLK=(&CLK_TEST_LS|0x07)
&CLK_TEST_SLIMBUS_XO_SRC=(&CLK_TEST_LS|0x08)
&CLK_TEST_DFAB_A2_HCLK=(&CLK_TEST_LS|0x09)
&CLK_TEST_MSS_SLP_CLK=(&CLK_TEST_LS|0x0A)
&CLK_TEST_MSS_Q6SW_JTAG_CLK=(&CLK_TEST_LS|0x0B)
&CLK_TEST_MSS_Q6FW_JTAG_CLK=(&CLK_TEST_LS|0x0C)
&CLK_TEST_SC_HCLK=(&CLK_TEST_LS|0x0D)
&CLK_TEST_SC_XO_SRC=(&CLK_TEST_LS|0x0E)
&CLK_TEST_LPASS_CXO_SRC=(&CLK_TEST_LS|0x0F)
&CLK_TEST_LPASS_PXO_SRC=(&CLK_TEST_LS|0x10)
&CLK_TEST_LPASS_MXO_SRC=(&CLK_TEST_LS|0x11)
&CLK_TEST_SDC1_HCLK=(&CLK_TEST_LS|0x12)
&CLK_TEST_SDC1_APPS_CLK=(&CLK_TEST_LS|0x13)
&CLK_TEST_SDC2_HCLK=(&CLK_TEST_LS|0x14)
&CLK_TEST_SDC2_APPS_CLK=(&CLK_TEST_LS|0x15)
&CLK_TEST_SDC3_HCLK=(&CLK_TEST_LS|0x16)
&CLK_TEST_SDC3_APPS_CLK=(&CLK_TEST_LS|0x17)
&CLK_TEST_SDC4_HCLK=(&CLK_TEST_LS|0x18)
&CLK_TEST_SDC4_APPS_CLK=(&CLK_TEST_LS|0x19)
&CLK_TEST_SDC5_HCLK=(&CLK_TEST_LS|0x1A)
&CLK_TEST_SDC5_APPS_CLK=(&CLK_TEST_LS|0x1B)
&CLK_TEST_EBI1_XO_SRC=(&CLK_TEST_LS|0x1C)
&CLK_TEST_GP0_CLK=(&CLK_TEST_LS|0x1F)
&CLK_TEST_GP1_CLK=(&CLK_TEST_LS|0x20)
&CLK_TEST_GP2_CLK=(&CLK_TEST_LS|0x21)
&CLK_TEST_RING_OSC_CLK=(&CLK_TEST_LS|0x22)
&CLK_TEST_DFAB_SFAB_M_ACLK=(&CLK_TEST_LS|0x23)
&CLK_TEST_DFAB_SFAB_S_ACLK=(&CLK_TEST_LS|0x24)
&CLK_TEST_DFAB_CORE_CLK=(&CLK_TEST_LS|0x25)
&CLK_TEST_PMEM_ACLK=(&CLK_TEST_LS|0x26)
&CLK_TEST_DFAB_SWAY0_HCLK=(&CLK_TEST_LS|0x27)
&CLK_TEST_DFAB_SWAY1_HCLK=(&CLK_TEST_LS|0x28)
&CLK_TEST_DFAB_ARB0_HCLK=(&CLK_TEST_LS|0x29)
&CLK_TEST_DFAB_ARB1_HCLK=(&CLK_TEST_LS|0x2A)
&CLK_TEST_PPSS_HCLK=(&CLK_TEST_LS|0x2B)
&CLK_TEST_PPSS_PROC_CLK=(&CLK_TEST_LS|0x2C)
&CLK_TEST_PPSS_TIMER0_CLK=(&CLK_TEST_LS|0x2D)
&CLK_TEST_PPSS_TIMER1_CLK=(&CLK_TEST_LS|0x2E)
&CLK_TEST_SPS_TIC_HCLK=(&CLK_TEST_LS|0x2F)
&CLK_TEST_SLIMBUS_HCLK=(&CLK_TEST_LS|0x30)
&CLK_TEST_SIC_HCLK=(&CLK_TEST_LS|0x31)
&CLK_TEST_DMA_BAM_HCLK=(&CLK_TEST_LS|0x32)
&CLK_TEST_CFPB0_HCLK=(&CLK_TEST_LS|0x33)
&CLK_TEST_CFPB1_HCLK=(&CLK_TEST_LS|0x35)
&CLK_TEST_CFPB2_HCLK=(&CLK_TEST_LS|0x37)
&CLK_TEST_CFPB_SPLITTER_HCLK=(&CLK_TEST_LS|0x3A)
&CLK_TEST_CFPB_MASTER_NOHWGATE_HCLK=(&CLK_TEST_LS|0x3B)
&CLK_TEST_CFPB_MASTER_HCLK=(&CLK_TEST_LS|0x3C)
&CLK_TEST_GSBI1_HCLK=(&CLK_TEST_LS|0x3D)
&CLK_TEST_GSBI1_UART_APPS_CLK=(&CLK_TEST_LS|0x3E)
&CLK_TEST_GSBI1_QUP_APPS_CLK=(&CLK_TEST_LS|0x3F)
&CLK_TEST_GSBI1_SIM_CLK_SRC=(&CLK_TEST_LS|0x40)
&CLK_TEST_GSBI2_HCLK=(&CLK_TEST_LS|0x41)
&CLK_TEST_GSBI2_UART_APPS_CLK=(&CLK_TEST_LS|0x42)
&CLK_TEST_GSBI2_SIM_CLK_SRC=(&CLK_TEST_LS|0x43)
&CLK_TEST_GSBI2_QUP_APPS_CLK=(&CLK_TEST_LS|0x44)
&CLK_TEST_GSBI3_HCLK=(&CLK_TEST_LS|0x45)
&CLK_TEST_GSBI3_UART_APPS_CLK=(&CLK_TEST_LS|0x46)
&CLK_TEST_GSBI3_SIM_CLK_SRC=(&CLK_TEST_LS|0x47)
&CLK_TEST_GSBI3_QUP_APPS_CLK=(&CLK_TEST_LS|0x48)
&CLK_TEST_GSBI4_HCLK=(&CLK_TEST_LS|0x49)
&CLK_TEST_GSBI4_UART_APPS_CLK=(&CLK_TEST_LS|0x4A)
&CLK_TEST_GSBI4_SIM_CLK_SRC=(&CLK_TEST_LS|0x4B)
&CLK_TEST_GSBI4_QUP_APPS_CLK=(&CLK_TEST_LS|0x4C)
&CLK_TEST_GSBI5_HCLK=(&CLK_TEST_LS|0x4D)
&CLK_TEST_GSBI5_UART_APPS_CLK=(&CLK_TEST_LS|0x4E)
&CLK_TEST_GSBI5_SIM_CLK_SRC=(&CLK_TEST_LS|0x4F)
&CLK_TEST_GSBI5_QUP_APPS_CLK=(&CLK_TEST_LS|0x50)
&CLK_TEST_GSBI6_HCLK=(&CLK_TEST_LS|0x51)
&CLK_TEST_GSBI6_UART_APPS_CLK=(&CLK_TEST_LS|0x52)
&CLK_TEST_GSBI6_SIM_CLK_SRC=(&CLK_TEST_LS|0x53)
&CLK_TEST_GSBI6_QUP_APPS_CLK=(&CLK_TEST_LS|0x54)
&CLK_TEST_GSBI7_HCLK=(&CLK_TEST_LS|0x55)
&CLK_TEST_GSBI7_UART_APPS_CLK=(&CLK_TEST_LS|0x56)
&CLK_TEST_GSBI7_SIM_CLK_SRC=(&CLK_TEST_LS|0x57)
&CLK_TEST_GSBI7_QUP_APPS_CLK=(&CLK_TEST_LS|0x58)
&CLK_TEST_GSBI8_HCLK=(&CLK_TEST_LS|0x59)
&CLK_TEST_GSBI8_UART_APPS_CLK=(&CLK_TEST_LS|0x5A)
&CLK_TEST_GSBI8_SIM_CLK_SRC=(&CLK_TEST_LS|0x5B)
&CLK_TEST_GSBI8_QUP_APPS_CLK=(&CLK_TEST_LS|0x5C)
&CLK_TEST_GSBI9_HCLK=(&CLK_TEST_LS|0x5D)
&CLK_TEST_GSBI9_UART_APPS_CLK=(&CLK_TEST_LS|0x5E)
&CLK_TEST_GSBI9_SIM_CLK_SRC=(&CLK_TEST_LS|0x5F)
&CLK_TEST_GSBI9_QUP_APPS_CLK=(&CLK_TEST_LS|0x60)
&CLK_TEST_GSBI10_HCLK=(&CLK_TEST_LS|0x61)
&CLK_TEST_GSBI10_UART_APPS_CLK=(&CLK_TEST_LS|0x62)
&CLK_TEST_GSBI10_SIM_CLK_SRC=(&CLK_TEST_LS|0x63)
&CLK_TEST_GSBI10_QUP_APPS_CLK=(&CLK_TEST_LS|0x64)
&CLK_TEST_GSBI11_HCLK=(&CLK_TEST_LS|0x65)
&CLK_TEST_GSBI11_UART_APPS_CLK=(&CLK_TEST_LS|0x66)
&CLK_TEST_GSBI11_SIM_CLK_SRC=(&CLK_TEST_LS|0x67)
&CLK_TEST_GSBI11_QUP_APPS_CLK=(&CLK_TEST_LS|0x68)
&CLK_TEST_GSBI12_HCLK=(&CLK_TEST_LS|0x69)
&CLK_TEST_GSBI12_UART_APPS_CLK=(&CLK_TEST_LS|0x6A)
&CLK_TEST_GSBI12_SIM_CLK_SRC=(&CLK_TEST_LS|0x6B)
&CLK_TEST_GSBI12_QUP_APPS_CLK=(&CLK_TEST_LS|0x6C)
&CLK_TEST_MPM_HCLK=(&CLK_TEST_LS|0x6D)
&CLK_TEST_BBRX_SSBI_CLK=(&CLK_TEST_LS|0x6E)
&CLK_TEST_TLMM_HCLK=(&CLK_TEST_LS|0x6F)
&CLK_TEST_TLMM_CLK=(&CLK_TEST_LS|0x70)
&CLK_TEST_SPDM_CFG_HCLK=(&CLK_TEST_LS|0x71)
&CLK_TEST_SPDM_MSTR_HCLK=(&CLK_TEST_LS|0x72)
&CLK_TEST_SPDM_FF_CLK=(&CLK_TEST_LS|0x73)
&CLK_TEST_RPM_SLEEP_CLK=(&CLK_TEST_LS|0x74)
&CLK_TEST_RPM_PROC_CLK=(&CLK_TEST_LS|0x75)
&CLK_TEST_RPM_BUS_HCLK=(&CLK_TEST_LS|0x76)
&CLK_TEST_RPM_TIMER_CLK=(&CLK_TEST_LS|0x77)
&CLK_TEST_SFPB_NOHWGATE_HCLK=(&CLK_TEST_LS|0x78)
&CLK_TEST_SFPB_HCLK=(&CLK_TEST_LS|0x79)
&CLK_TEST_PMIC_SSBI2_CLK=(&CLK_TEST_LS|0x7A)
&CLK_TEST_PMIC_ARB0_HCLK=(&CLK_TEST_LS|0x7B)
&CLK_TEST_PMIC_ARB1_HCLK=(&CLK_TEST_LS|0x7C)
&CLK_TEST_PRNG_CLK=(&CLK_TEST_LS|0x7D)
&CLK_TEST_SEC_CTRL_CLK=(&CLK_TEST_LS|0x7E)
&CLK_TEST_RPM_MSG_RAM_HCLK=(&CLK_TEST_LS|0x7F)
&CLK_TEST_ADM0_PBUS_HCLK=(&CLK_TEST_LS|0x80)
&CLK_TEST_PDM_CLK=(&CLK_TEST_LS|0x82)
&CLK_TEST_PDM_XO4_CLK=(&CLK_TEST_LS|0x83)
&CLK_TEST_USB_HS1_HCLK=(&CLK_TEST_LS|0x84)
&CLK_TEST_USB_HS1_XCVR_FS_CLK=(&CLK_TEST_LS|0x85)
&CLK_TEST_USB_HS2_HCLK=(&CLK_TEST_LS|0x86)
&CLK_TEST_USB_HS2_SYSTEM_CLK=(&CLK_TEST_LS|0x87)
&CLK_TEST_USB_HS2_XCVR_FS_CLK=(&CLK_TEST_LS|0x88)
&CLK_TEST_USB_FS1_HCLK=(&CLK_TEST_LS|0x89)
&CLK_TEST_USB_FS1_SYSTEM_CLK=(&CLK_TEST_LS|0x8A)
&CLK_TEST_USB_FS1_XCVR_FS_CLK=(&CLK_TEST_LS|0x8B)
&CLK_TEST_USB_FS2_HCLK=(&CLK_TEST_LS|0x8C)
&CLK_TEST_USB_FS2_SYSTEM_CLK=(&CLK_TEST_LS|0x8D)
&CLK_TEST_USB_FS2_XCVR_FS_CLK=(&CLK_TEST_LS|0x8E)
&CLK_TEST_TSIF_HCLK_RAW=(&CLK_TEST_LS|0x8F)
&CLK_TEST_TSIF_INACTIVITY_TIMERS_CLK=(&CLK_TEST_LS|0x90)
&CLK_TEST_TSIF_REF_CLK=(&CLK_TEST_LS|0x91)
&CLK_TEST_CE1_HCLK=(&CLK_TEST_LS|0x92)
&CLK_TEST_CE2_HCLK=(&CLK_TEST_LS|0x93)
&CLK_TEST_TSSC_CLK=(&CLK_TEST_LS|0x94)
&CLK_TEST_MSS_DBG_LS_CLK=(&CLK_TEST_LS|0x95)
&CLK_TEST_SC_CC_DBG_LS_CLK=(&CLK_TEST_LS|0x96)
&CLK_TEST_MMSS_CC_DBG_LS_IN_CLK=(&CLK_TEST_LS|0x97)
&CLK_TEST_LPASS_CC_DBG_LS_IN_CLK=(&CLK_TEST_LS|0x98)
&CLK_TEST_LPASS_Q6_CC_DBG_LS_IN_CLK=(&CLK_TEST_LS|0x99)
&CLK_TEST_Q6FW_CC_DBG_LS_CLK=(&CLK_TEST_LS|0x9A)
&CLK_TEST_Q6SW_CC_DBG_LS_CLK=(&CLK_TEST_LS|0x9B)
&CLK_TEST_CE2_CORE_CLK=(&CLK_TEST_LS|0x9C)
&CLK_TEST_SPDM_CY_PORT3_CLK=(&CLK_TEST_LS|0xA0)
&CLK_TEST_VOLTAGE_SENSOR_DEBUG_CLOCK=(&CLK_TEST_LS|0xA1)
&CLK_TEST_MMSS_PXO_SRC=(&CLK_TEST_LS|0xA2)
&CLK_TEST_MMSS_MXO_SRC=(&CLK_TEST_LS|0xA3)
&CLK_TEST_CE1_CORE_CLK=(&CLK_TEST_LS|0xA4)
&CLK_TEST_CE1_SLEEP_CLK=(&CLK_TEST_LS|0xA5)
&CLK_TEST_RIVA_CC_DBG_CLK_LS=(&CLK_TEST_LS|0xA6)
&CLK_TEST_MSS_S_HCLK=(&CLK_TEST_LS|0xA7)
&CLK_TEST_CFPB0_C0_HCLK=(&CLK_TEST_LS|0xA8)
&CLK_TEST_CFPB0_D0_HCLK=(&CLK_TEST_LS|0xA9)
&CLK_TEST_CFPB0_C1_HCLK=(&CLK_TEST_LS|0xAA)
&CLK_TEST_CFPB0_D1_HCLK=(&CLK_TEST_LS|0xAB)
&CLK_TEST_EBI1_CH0_CA_XO_SRC=(&CLK_TEST_LS|0xAC)
&CLK_TEST_EBI1_CH0_DQ_XO_SRC=(&CLK_TEST_LS|0xAD)
&CLK_TEST_EBI1_CH1_CA_XO_SRC=(&CLK_TEST_LS|0xAE)
&CLK_TEST_EBI1_CH1_DQ_XO_SRC=(&CLK_TEST_LS|0xAF)
&CLK_MSS_TEST_NAV_RSREF_CLK=(&CLK_MSS_TEST_HS|0x01)
&CLK_MSS_TEST_NAV_MAIN_CLK=(&CLK_MSS_TEST_LS|0x01)
&CLK_MSS_TEST_NAV_ADC1_CLK=(&CLK_MSS_TEST_LS|0x02)
&CLK_MSS_TEST_NAV_ADC2_CLK=(&CLK_MSS_TEST_LS|0x03)
&CLK_MMSS_TEST_CSI0_CLK=(&CLK_MMSS_TEST_HS|0x00)
&CLK_MMSS_TEST_CSI1_CLK=(&CLK_MMSS_TEST_HS|0x01)
&CLK_MMSS_TEST_DSI1_CLK=(&CLK_MMSS_TEST_HS|0x02)
&CLK_MMSS_TEST_DSI2_CLK=(&CLK_MMSS_TEST_HS|0x03)
&CLK_MMSS_TEST_CSI_VFE_CLK=(&CLK_MMSS_TEST_HS|0x04)
&CLK_MMSS_TEST_IJPEG_CLK=(&CLK_MMSS_TEST_HS|0x05)
&CLK_MMSS_TEST_VFE_CLK=(&CLK_MMSS_TEST_HS|0x06)
&CLK_MMSS_TEST_GFX2D0_CLK=(&CLK_MMSS_TEST_HS|0x07)
&CLK_MMSS_TEST_GFX2D1_CLK=(&CLK_MMSS_TEST_HS|0x08)
&CLK_MMSS_TEST_GFX3D_CLK=(&CLK_MMSS_TEST_HS|0x09)
&CLK_MMSS_TEST_JPEGD_CLK=(&CLK_MMSS_TEST_HS|0x0A)
&CLK_MMSS_TEST_VCODEC_CLK=(&CLK_MMSS_TEST_HS|0x0B)
&CLK_MMSS_TEST_AXI_S0_CLK=(&CLK_MMSS_TEST_HS|0x0C)
&CLK_MMSS_TEST_AXI_S1_CLK=(&CLK_MMSS_TEST_HS|0x0D)
&CLK_MMSS_TEST_AXI_S2_CLK=(&CLK_MMSS_TEST_HS|0x0E)
&CLK_MMSS_TEST_FAB_CORE_CLK=(&CLK_MMSS_TEST_HS|0x0F)
&CLK_MMSS_TEST_FAB_MSP_AXI_CLK=(&CLK_MMSS_TEST_HS|0x10)
&CLK_MMSS_TEST_GMEM_AXI_CLK=(&CLK_MMSS_TEST_HS|0x11)
&CLK_MMSS_TEST_IJPEG_AXI_CLK=(&CLK_MMSS_TEST_HS|0x12)
&CLK_MMSS_TEST_IMEM_AXI_CLK=(&CLK_MMSS_TEST_HS|0x13)
&CLK_MMSS_TEST_JPEGD_AXI_CLK=(&CLK_MMSS_TEST_HS|0x14)
&CLK_MMSS_TEST_MDP_AXI_CLK=(&CLK_MMSS_TEST_HS|0x15)
&CLK_MMSS_TEST_ROT_AXI_CLK=(&CLK_MMSS_TEST_HS|0x16)
&CLK_MMSS_TEST_VCODEC_AXI_CLK=(&CLK_MMSS_TEST_HS|0x17)
&CLK_MMSS_TEST_VFE_AXI_CLK=(&CLK_MMSS_TEST_HS|0x18)
&CLK_MMSS_TEST_VPE_AXI_CLK=(&CLK_MMSS_TEST_HS|0x19)
&CLK_MMSS_TEST_MDP_CLK=(&CLK_MMSS_TEST_HS|0x1A)
&CLK_MMSS_TEST_ROT_CLK=(&CLK_MMSS_TEST_HS|0x1B)
&CLK_MMSS_TEST_VPE_CLK=(&CLK_MMSS_TEST_HS|0x1C)
&CLK_MMSS_TEST_HDMI_REF_CLK=(&CLK_MMSS_TEST_HS|0x1D)
&CLK_MMSS_TEST_HDMI_TV_CLK=(&CLK_MMSS_TEST_HS|0x1E)
&CLK_MMSS_TEST_MDP_TV_CLK=(&CLK_MMSS_TEST_HS|0x1F)
&CLK_MMSS_TEST_AXI_S0_FCLK=(&CLK_MMSS_TEST_HS|0x20)
&CLK_MMSS_TEST_AXI_S1_FCLK=(&CLK_MMSS_TEST_HS|0x21)
&CLK_MMSS_TEST_AXI_S2_FCLK=(&CLK_MMSS_TEST_HS|0x22)
&CLK_MMSS_TEST_AXI_S3_FCLK=(&CLK_MMSS_TEST_HS|0x23)
&CLK_MMSS_TEST_CSIPHY0_CLK=(&CLK_MMSS_TEST_HS|0x24)
&CLK_MMSS_TEST_CSIPHY1_CLK=(&CLK_MMSS_TEST_HS|0x25)
&CLK_MMSS_TEST_CSI_PIX_CLK=(&CLK_MMSS_TEST_HS|0x26)
&CLK_MMSS_TEST_CSI_RDI_CLK=(&CLK_MMSS_TEST_HS|0x27)
&CLK_MMSS_TEST_LUT_MDP_CLK=(&CLK_MMSS_TEST_HS|0x28)
&CLK_MMSS_TEST_VCODEC_A_AXI_CLK=(&CLK_MMSS_TEST_HS|0x29)
&CLK_MMSS_TEST_VCODEC_B_AXI_CLK=(&CLK_MMSS_TEST_HS|0x2A)
&CLK_MMSS_TEST_CSIPHY1_TIMER_CLK=(&CLK_MMSS_TEST_HS|0x2B)
&CLK_MMSS_TEST_CSIPHY0_TIMER_CLK=(&CLK_MMSS_TEST_HS|0x2C)
&CLK_MMSS_TEST_DSI1_BYTE_CLK=(&CLK_MMSS_TEST_LS|0x00)
&CLK_MMSS_TEST_DSI2_BYTE_CLK=(&CLK_MMSS_TEST_LS|0x01)
&CLK_MMSS_TEST_CAMCLK1_PO=(&CLK_MMSS_TEST_LS|0x02)
&CLK_MMSS_TEST_MDP_DSI1_PCLK=(&CLK_MMSS_TEST_LS|0x03)
&CLK_MMSS_TEST_MDP_DSI2_PCLK=(&CLK_MMSS_TEST_LS|0x04)
&CLK_MMSS_TEST_VCODEC_PCLK=(&CLK_MMSS_TEST_LS|0x05)
&CLK_MMSS_TEST_AMP_AHB_CLK=(&CLK_MMSS_TEST_LS|0x06)
&CLK_MMSS_TEST_CSI_AHB_CLK=(&CLK_MMSS_TEST_LS|0x07)
&CLK_MMSS_TEST_DSI2_S_AHB_CLK=(&CLK_MMSS_TEST_LS|0x08)
&CLK_MMSS_TEST_DSI1_M_AHB_CLK=(&CLK_MMSS_TEST_LS|0x09)
&CLK_MMSS_TEST_DSI1_S_AHB_CLK=(&CLK_MMSS_TEST_LS|0x0A)
&CLK_MMSS_TEST_FAB_AHB_CLK=(&CLK_MMSS_TEST_LS|0x0B)
&CLK_MMSS_TEST_GFX2D0_AHB_CLK=(&CLK_MMSS_TEST_LS|0x0C)
&CLK_MMSS_TEST_GFX2D1_AHB_CLK=(&CLK_MMSS_TEST_LS|0x0D)
&CLK_MMSS_TEST_GFX3D_AHB_CLK=(&CLK_MMSS_TEST_LS|0x0E)
&CLK_MMSS_TEST_HDMI_M_AHB_CLK=(&CLK_MMSS_TEST_LS|0x0F)
&CLK_MMSS_TEST_HDMI_S_AHB_CLK=(&CLK_MMSS_TEST_LS|0x10)
&CLK_MMSS_TEST_IJPEG_AHB_CLK=(&CLK_MMSS_TEST_LS|0x11)
&CLK_MMSS_TEST_IMEM_AHB_CLK=(&CLK_MMSS_TEST_LS|0x12)
&CLK_MMSS_TEST_JPEGD_AHB_CLK=(&CLK_MMSS_TEST_LS|0x13)
&CLK_MMSS_TEST_MDP_AHB_CLK=(&CLK_MMSS_TEST_LS|0x14)
&CLK_MMSS_TEST_MMSS_FPB_CLK=(&CLK_MMSS_TEST_LS|0x15)
&CLK_MMSS_TEST_ROT_AHB_CLK=(&CLK_MMSS_TEST_LS|0x16)
&CLK_MMSS_TEST_DSI1_ESC_CLK=(&CLK_MMSS_TEST_LS|0x17)
&CLK_MMSS_TEST_SMMU_AHB_CLK=(&CLK_MMSS_TEST_LS|0x18)
&CLK_MMSS_TEST_TV_ENC_AHB_CLK=(&CLK_MMSS_TEST_LS|0x19)
&CLK_MMSS_TEST_VCODEC_AHB_CLK=(&CLK_MMSS_TEST_LS|0x1A)
&CLK_MMSS_TEST_VFE_AHB_CLK=(&CLK_MMSS_TEST_LS|0x1B)
&CLK_MMSS_TEST_VPE_AHB_CLK=(&CLK_MMSS_TEST_LS|0x1C)
&CLK_MMSS_TEST_CAMCLK0_PO=(&CLK_MMSS_TEST_LS|0x1D)
&CLK_MMSS_TEST_DSI_REF_CLK=(&CLK_MMSS_TEST_LS|0x1E)
&CLK_MMSS_TEST_HDMI_APP_CLK=(&CLK_MMSS_TEST_LS|0x1F)
&CLK_MMSS_TEST_MDP_VSYNC_CLK=(&CLK_MMSS_TEST_LS|0x20)
&CLK_MMSS_TEST_TV_DAC_CLK=(&CLK_MMSS_TEST_LS|0x21)
&CLK_MMSS_TEST_TV_ENC_CLK=(&CLK_MMSS_TEST_LS|0x22)
&CLK_MMSS_TEST_DSI2_ESC_CLK=(&CLK_MMSS_TEST_LS|0x23)
&CLK_MMSS_TEST_APU_AHB_CLK=(&CLK_MMSS_TEST_LS|0x24)
&CLK_MMSS_TEST_MMSS_FPB_ALWAYS_ON_CLK=(&CLK_MMSS_TEST_LS|0x25)
&CLK_MMSS_TEST_DSI2_M_AHB_CLK=(&CLK_MMSS_TEST_LS|0x26)
&CLK_LPASS_TEST_LCC_Q6_FUNC_CLK=(&CLK_LPASS_TEST_HS|0x00)
&CLK_LPASS_TEST_LCC_Q6_FRACDIV_CLK=(&CLK_LPASS_TEST_HS|0x01)
&CLK_LPASS_TEST_LCC_AHB_HCLK=(&CLK_LPASS_TEST_LS|0x00)
&CLK_LPASS_TEST_LCC_AIF_HCLK=(&CLK_LPASS_TEST_LS|0x01)
&CLK_LPASS_TEST_LCC_SECURITY_HCLK=(&CLK_LPASS_TEST_LS|0x02)
&CLK_LPASS_TEST_LCC_DML_HCLK=(&CLK_LPASS_TEST_LS|0x03)
&CLK_LPASS_TEST_LCC_FAB_LPB_HCLK=(&CLK_LPASS_TEST_LS|0x04)
&CLK_LPASS_TEST_LCC_LPB_FAB_HCLK=(&CLK_LPASS_TEST_LS|0x05)
&CLK_LPASS_TEST_LCC_LPM_HCLK=(&CLK_LPASS_TEST_LS|0x06)
&CLK_LPASS_TEST_LCC_MIDI_HCLK=(&CLK_LPASS_TEST_LS|0x07)
&CLK_LPASS_TEST_LCC_Q6SS_HCLK=(&CLK_LPASS_TEST_LS|0x08)
&CLK_LPASS_TEST_LCC_AVT_HCLK=(&CLK_LPASS_TEST_LS|0x09)
&CLK_LPASS_TEST_LCC_EBUS_HCLK=(&CLK_LPASS_TEST_LS|0x0A)
&CLK_LPASS_TEST_LCC_IBUS_HCLK=(&CLK_LPASS_TEST_LS|0x0B)
&CLK_LPASS_TEST_LCC_CORE_CSR_HCLK=(&CLK_LPASS_TEST_LS|0x0C)
&CLK_LPASS_TEST_LCC_LPAIF_CSR_HCLK=(&CLK_LPASS_TEST_LS|0x0D)
&CLK_LPASS_TEST_LCC_SLIMBUS_HCLK=(&CLK_LPASS_TEST_LS|0x0E)
&CLK_LPASS_TEST_LCC_MI2S_BIT_CLK=(&CLK_LPASS_TEST_LS|0x0F)
&CLK_LPASS_TEST_LCC_CODEC_I2S_MIC_BIT_CLK=(&CLK_LPASS_TEST_LS|0x10)
&CLK_LPASS_TEST_LCC_CODEC_I2S_SPKR_BIT_CLK=(&CLK_LPASS_TEST_LS|0x11)
&CLK_LPASS_TEST_LCC_SPARE_I2S_MIC_BIT_CLK=(&CLK_LPASS_TEST_LS|0x12)
&CLK_LPASS_TEST_LCC_SPARE_I2S_SPKR_BIT_CLK=(&CLK_LPASS_TEST_LS|0x13)
&CLK_LPASS_TEST_LCC_PCM_CLK=(&CLK_LPASS_TEST_LS|0x14)
&CLK_LPASS_TEST_LCC_MIDI_CLK=(&CLK_LPASS_TEST_LS|0x15)
&CLK_LPASS_TEST_LCC_Q6_TCXO_CLK=(&CLK_LPASS_TEST_LS|0x16)
&CLK_LPASS_TEST_LCC_Q6_JTAG_CLK=(&CLK_LPASS_TEST_LS|0x17)
&CLK_LPASS_TEST_LCC_Q6_SLP_CLK=(&CLK_LPASS_TEST_LS|0x18)
&CLK_LPASS_TEST_LCC_AVT_MCLK=(&CLK_LPASS_TEST_LS|0x19)
&CLK_LPASS_TEST_LCC_AVT_PCLK=(&CLK_LPASS_TEST_LS|0x1A)
&CLK_LPASS_TEST_LCC_AVT_RIVA_BT_CLK=(&CLK_LPASS_TEST_LS|0x1B)
&CLK_LPASS_TEST_LCC_AVT_RIVA_FM_CLK=(&CLK_LPASS_TEST_LS|0x1C)
&CLK_LPASS_TEST_LCC_SLIMBUS_CORE_CLK=(&CLK_LPASS_TEST_LS|0x1D)
&CLK_RIVA_TEST_ROOT1_CLK=(&CLK_RIVA_TEST_HS|0x01)
&CLK_RIVA_TEST_ROOT2_CLK=(&CLK_RIVA_TEST_HS|0x02)
&CLK_RIVA_TEST_ROOT3_CLK=(&CLK_RIVA_TEST_HS|0x03)
&CLK_RIVA_TEST_ROOT3_120_CLK=(&CLK_RIVA_TEST_HS|0x04)
&CLK_RIVA_TEST_PHY_RFIF_CLK=(&CLK_RIVA_TEST_HS|0x05)
&CLK_RIVA_TEST_AHB_MAIN_HS_CLK=(&CLK_RIVA_TEST_HS|0x06)
&CLK_RIVA_TEST_PHY_DAC_HS_CLK=(&CLK_RIVA_TEST_HS|0x07)
&CLK_RIVA_TEST_PHY_ADC_HS_CLK=(&CLK_RIVA_TEST_HS|0x08)
&CLK_RIVA_TEST_BT_CLK=(&CLK_RIVA_TEST_LS|0x01)
&CLK_RIVA_TEST_BT_FM_CLK=(&CLK_RIVA_TEST_LS|0x02)
&CLK_RIVA_TEST_TCXO_CLK=(&CLK_RIVA_TEST_LS|0x03)
&CLK_RIVA_TEST_SLP_CLK=(&CLK_RIVA_TEST_LS|0x04)
&CLK_RIVA_TEST_TCK_CLK=(&CLK_RIVA_TEST_LS|0x05)
&CLK_RIVA_TEST_AHB_MAIN_LS_CLK=(&CLK_RIVA_TEST_LS|0x06)
&CLK_RIVA_TEST_PHY_DAC_LS_CLK=(&CLK_RIVA_TEST_LS|0x07)
&CLK_RIVA_TEST_PHY_ADC_LS_CLK=(&CLK_RIVA_TEST_LS|0x08)
&CLK_APCS_TEST_SYS_APCSQSB_CLK=(&CLK_APCS_TEST_HS|0x00)
&CLK_APCS_TEST_APCC_SYSL2LEAF_CLK=(&CLK_APCS_TEST_HS|0x01)
&CLK_APCS_TEST_APC0_SYSLEAF_CLK=(&CLK_APCS_TEST_HS|0x02)
&CLK_APCS_TEST_APC1_SYSLEAF_CLK=(&CLK_APCS_TEST_HS|0x03)
&CLK_APCS_TEST_SYS_APCSAHB_CLK=(&CLK_APCS_TEST_LS|0x01)
&CLK_APCS_TEST_SYS_APCSREF_CLK=(&CLK_APCS_TEST_LS|0x02)
&CLK_APCS_TEST_SYS_APCSPISLEEP_CLK=(&CLK_APCS_TEST_LS|0x03)
&CLK_APCS_TEST_APB_APCCDBG_CLK=(&CLK_APCS_TEST_LS|0x04)
&CLK_APCS_TEST_ATB_APCC_CLK=(&CLK_APCS_TEST_LS|0x05)

&HWIO_CLK_HALT_AFAB_SFAB_STATEA_PHYS=0x902fc0
&HWIO_CLK_HALT_AFAB_SFAB_STATEB_PHYS=0x902fc4
&HWIO_CLK_HALT_DFAB_STATE_PHYS=0x902fc8
&HWIO_CLK_HALT_CFPB_STATEA_PHYS=0x902fcc
&HWIO_CLK_HALT_CFPB_STATEB_PHYS=0x902fd0
&HWIO_CLK_HALT_CFPB_STATEC_PHYS=0x902fd4
&HWIO_CLK_HALT_SFPB_MISC_STATE_PHYS=0x902fd8
&HWIO_CLK_HALT_MSS_KPSS_MISC_STATE_PHYS=0x902fdc
&HWIO_MMSS_DBG_BUS_VEC_A_PHYS=0x40001c8
&HWIO_MMSS_DBG_BUS_VEC_B_PHYS=0x40001cc
&HWIO_MMSS_DBG_BUS_VEC_C_PHYS=0x40001d0
&HWIO_MMSS_DBG_BUS_VEC_D_PHYS=0x40001d4
&HWIO_MMSS_DBG_BUS_VEC_E_PHYS=0x40001d8
&HWIO_MMSS_DBG_BUS_VEC_F_PHYS=0x40001dc
&HWIO_MMSS_DBG_BUS_VEC_H_PHYS=0x40001e4
&HWIO_MMSS_DBG_BUS_VEC_I_PHYS=0x40001e8
&HWIO_FW_QDSP6SS_GFMUX_STATUS_PHYS=0x8800034
&HWIO_SW_QDSP6SS_GFMUX_STATUS_PHYS=0x8900034
&HWIO_PMU_CLK_ROOT1_PHYS=0x3204070
&HWIO_PMU_CLK_ROOT2_PHYS=0x3204074
&HWIO_PMU_CLK_ROOT3_PHYS=0x3204078
&HWIO_PMU_CLK_ROOT4_PHYS=0x320407c
&HWIO_PMU_CLK_ROOT5_PHYS=0x3204080
&HWIO_PMU_CLK_ROOT6_PHYS=0x3204084

&HWIO_CLK_HALT_AFAB_SFAB_STATEA_SFAB_MSS_S_HCLK_BMSK=0x2
&HWIO_CLK_HALT_AFAB_SFAB_STATEB_QDSS_STM_CLK_BMSK=0x100000
&HWIO_CLK_HALT_AFAB_SFAB_STATEB_SFAB_MSS_Q6_SW_ACLK_BMSK=0x80000
&HWIO_CLK_HALT_AFAB_SFAB_STATEB_SFAB_MSS_Q6_FW_ACLK_BMSK=0x40000
&HWIO_CLK_HALT_AFAB_SFAB_STATEB_SFAB_MSS_M_ACLK_BMSK=0x10000
&HWIO_CLK_HALT_DFAB_STATE_PMEM_ACLK_BMSK=0x100000
&HWIO_CLK_HALT_DFAB_STATE_SDC1_HCLK_BMSK=0x800
&HWIO_CLK_HALT_DFAB_STATE_SDC2_HCLK_BMSK=0x400
&HWIO_CLK_HALT_DFAB_STATE_SDC3_HCLK_BMSK=0x200
&HWIO_CLK_HALT_DFAB_STATE_SDC4_HCLK_BMSK=0x100
&HWIO_CLK_HALT_DFAB_STATE_SDC5_HCLK_BMSK=0x80
&HWIO_CLK_HALT_DFAB_STATE_SDC1_APPS_CLK_BMSK=0x40
&HWIO_CLK_HALT_DFAB_STATE_SDC2_APPS_CLK_BMSK=0x20
&HWIO_CLK_HALT_DFAB_STATE_SDC3_APPS_CLK_BMSK=0x10
&HWIO_CLK_HALT_DFAB_STATE_SDC4_APPS_CLK_BMSK=0x8
&HWIO_CLK_HALT_DFAB_STATE_SDC5_APPS_CLK_BMSK=0x4
&HWIO_CLK_HALT_DFAB_STATE_USB_HS1_HCLK_BMSK=0x2
&HWIO_CLK_HALT_DFAB_STATE_USB_HS1_XCVR_FS_CLK_BMSK=0x1
&HWIO_CLK_HALT_CFPB_STATEA_USB_FS1_HCLK_BMSK=0x20000
&HWIO_CLK_HALT_CFPB_STATEA_USB_FS1_SYSTEM_CLK_BMSK=0x10000
&HWIO_CLK_HALT_CFPB_STATEA_USB_FS1_XCVR_FS_CLK_BMSK=0x8000
&HWIO_CLK_HALT_CFPB_STATEA_USB_FS2_HCLK_BMSK=0x4000
&HWIO_CLK_HALT_CFPB_STATEA_USB_FS2_SYSTEM_CLK_BMSK=0x2000
&HWIO_CLK_HALT_CFPB_STATEA_USB_FS2_XCVR_FS_CLK_BMSK=0x1000
&HWIO_CLK_HALT_CFPB_STATEA_GSBI1_HCLK_BMSK=0x800
&HWIO_CLK_HALT_CFPB_STATEA_GSBI1_UART_APPS_CLK_BMSK=0x400
&HWIO_CLK_HALT_CFPB_STATEA_GSBI1_QUP_APPS_CLK_BMSK=0x200
&HWIO_CLK_HALT_CFPB_STATEA_GSBI1_SIM_CLK_SRC_BMSK=0x100
&HWIO_CLK_HALT_CFPB_STATEA_GSBI2_HCLK_BMSK=0x80
&HWIO_CLK_HALT_CFPB_STATEA_GSBI2_UART_APPS_CLK_BMSK=0x40
&HWIO_CLK_HALT_CFPB_STATEA_GSBI2_SIM_CLK_SRC_BMSK=0x20
&HWIO_CLK_HALT_CFPB_STATEA_GSBI2_QUP_APPS_CLK_BMSK=0x10
&HWIO_CLK_HALT_CFPB_STATEA_GSBI3_HCLK_BMSK=0x8
&HWIO_CLK_HALT_CFPB_STATEA_GSBI3_UART_APPS_CLK_BMSK=0x4
&HWIO_CLK_HALT_CFPB_STATEA_GSBI3_SIM_CLK_SRC_BMSK=0x2
&HWIO_CLK_HALT_CFPB_STATEA_GSBI3_QUP_APPS_CLK_BMSK=0x1
&HWIO_CLK_HALT_CFPB_STATEB_CE2_CORE_CLK_BMSK=0x10000000
&HWIO_CLK_HALT_CFPB_STATEB_GSBI4_HCLK_BMSK=0x8000000
&HWIO_CLK_HALT_CFPB_STATEB_GSBI4_UART_APPS_CLK_BMSK=0x4000000
&HWIO_CLK_HALT_CFPB_STATEB_GSBI4_SIM_CLK_SRC_BMSK=0x2000000
&HWIO_CLK_HALT_CFPB_STATEB_GSBI4_QUP_APPS_CLK_BMSK=0x1000000
&HWIO_CLK_HALT_CFPB_STATEB_GSBI5_HCLK_BMSK=0x800000
&HWIO_CLK_HALT_CFPB_STATEB_GSBI5_UART_APPS_CLK_BMSK=0x400000
&HWIO_CLK_HALT_CFPB_STATEB_GSBI5_SIM_CLK_SRC_BMSK=0x200000
&HWIO_CLK_HALT_CFPB_STATEB_GSBI5_QUP_APPS_CLK_BMSK=0x100000
&HWIO_CLK_HALT_CFPB_STATEB_GSBI6_HCLK_BMSK=0x80000
&HWIO_CLK_HALT_CFPB_STATEB_GSBI6_UART_APPS_CLK_BMSK=0x40000
&HWIO_CLK_HALT_CFPB_STATEB_GSBI6_SIM_CLK_SRC_BMSK=0x20000
&HWIO_CLK_HALT_CFPB_STATEB_GSBI6_QUP_APPS_CLK_BMSK=0x10000
&HWIO_CLK_HALT_CFPB_STATEB_GSBI7_HCLK_BMSK=0x8000
&HWIO_CLK_HALT_CFPB_STATEB_GSBI7_UART_APPS_CLK_BMSK=0x4000
&HWIO_CLK_HALT_CFPB_STATEB_GSBI7_SIM_CLK_SRC_BMSK=0x2000
&HWIO_CLK_HALT_CFPB_STATEB_GSBI7_QUP_APPS_CLK_BMSK=0x1000
&HWIO_CLK_HALT_CFPB_STATEB_GSBI8_HCLK_BMSK=0x800
&HWIO_CLK_HALT_CFPB_STATEB_GSBI8_UART_APPS_CLK_BMSK=0x400
&HWIO_CLK_HALT_CFPB_STATEB_GSBI8_SIM_CLK_SRC_BMSK=0x200
&HWIO_CLK_HALT_CFPB_STATEB_GSBI8_QUP_APPS_CLK_BMSK=0x100
&HWIO_CLK_HALT_CFPB_STATEB_GSBI9_HCLK_BMSK=0x80
&HWIO_CLK_HALT_CFPB_STATEB_GSBI9_UART_APPS_CLK_BMSK=0x40
&HWIO_CLK_HALT_CFPB_STATEB_GSBI9_SIM_CLK_SRC_BMSK=0x20
&HWIO_CLK_HALT_CFPB_STATEB_GSBI9_QUP_APPS_CLK_BMSK=0x10
&HWIO_CLK_HALT_CFPB_STATEB_GSBI10_HCLK_BMSK=0x8
&HWIO_CLK_HALT_CFPB_STATEB_GSBI10_UART_APPS_CLK_BMSK=0x4
&HWIO_CLK_HALT_CFPB_STATEB_GSBI10_SIM_CLK_SRC_BMSK=0x2
&HWIO_CLK_HALT_CFPB_STATEB_GSBI10_QUP_APPS_CLK_BMSK=0x1
&HWIO_CLK_HALT_CFPB_STATEC_CE1_CORE_CLK_BMSK=0x8000000
&HWIO_CLK_HALT_CFPB_STATEC_GSBI11_HCLK_BMSK=0x40000
&HWIO_CLK_HALT_CFPB_STATEC_GSBI11_UART_APPS_CLK_BMSK=0x20000
&HWIO_CLK_HALT_CFPB_STATEC_GSBI11_SIM_CLK_SRC_BMSK=0x10000
&HWIO_CLK_HALT_CFPB_STATEC_GSBI11_QUP_APPS_CLK_BMSK=0x8000
&HWIO_CLK_HALT_CFPB_STATEC_GSBI12_HCLK_BMSK=0x4000
&HWIO_CLK_HALT_CFPB_STATEC_GSBI12_UART_APPS_CLK_BMSK=0x2000
&HWIO_CLK_HALT_CFPB_STATEC_GSBI12_SIM_CLK_SRC_BMSK=0x1000
&HWIO_CLK_HALT_CFPB_STATEC_GSBI12_QUP_APPS_CLK_BMSK=0x800
&HWIO_CLK_HALT_CFPB_STATEC_CE1_HCLK_BMSK=0x2
&HWIO_CLK_HALT_CFPB_STATEC_CE2_HCLK_BMSK=0x1
&HWIO_CLK_HALT_SFPB_MISC_STATE_PMIC_SSBI2_CLK_BMSK=0x800000
&HWIO_CLK_HALT_SFPB_MISC_STATE_PMIC_ARB0_HCLK_BMSK=0x400000
&HWIO_CLK_HALT_SFPB_MISC_STATE_PMIC_ARB1_HCLK_BMSK=0x200000
&HWIO_CLK_HALT_SFPB_MISC_STATE_QDSS_HCLK_BMSK=0x800
&HWIO_CLK_HALT_MSS_KPSS_MISC_STATE_MSS_S_HCLK_BMSK=0x1000
&HWIO_CLK_HALT_MSS_KPSS_MISC_STATE_QDSS_AT_CLK_BMSK=0x400
&HWIO_CLK_HALT_MSS_KPSS_MISC_STATE_QDSS_PCLKDBG_CLK_BMSK=0x200
&HWIO_CLK_HALT_MSS_KPSS_MISC_STATE_QDSS_TRACECLKIN_CLK_BMSK=0x100
&HWIO_CLK_HALT_MSS_KPSS_MISC_STATE_QDSS_TSCTR_CLK_BMSK=0x80
&HWIO_CLK_HALT_MSS_KPSS_MISC_STATE_MSS_SLP_CLK_BMSK=0x40
&HWIO_CLK_HALT_MSS_KPSS_MISC_STATE_MSS_Q6SW_JTAG_CLK_BMSK=0x20
&HWIO_CLK_HALT_MSS_KPSS_MISC_STATE_MSS_Q6FW_JTAG_CLK_BMSK=0x10


&HWIO_MMSS_DBG_BUS_VEC_A_VPE_CLK_OFF_BMSK=0x10000000
&HWIO_MMSS_DBG_BUS_VEC_A_IJPEG_CLK_OFF_BMSK=0x1000000
&HWIO_MMSS_DBG_BUS_VEC_A_JPEGD_CLK_OFF_BMSK=0x80000
&HWIO_MMSS_DBG_BUS_VEC_A_GFX2D1_CLK_OFF_BMSK=0x4000
&HWIO_MMSS_DBG_BUS_VEC_A_GFX2D0_CLK_OFF_BMSK=0x200
&HWIO_MMSS_DBG_BUS_VEC_A_GFX3D_CLK_OFF_BMSK=0x10
&HWIO_MMSS_DBG_BUS_VEC_B_HDMI_APP_CLK_OFF_BMSK=0x2000000
&HWIO_MMSS_DBG_BUS_VEC_B_MDP_VSYNC_CLK_OFF_BMSK=0x400000
&HWIO_MMSS_DBG_BUS_VEC_B_DSI1_BYTE_CLK_OFF_BMSK=0x200000
&HWIO_MMSS_DBG_BUS_VEC_B_DSI2_BYTE_CLK_OFF_BMSK=0x100000
&HWIO_MMSS_DBG_BUS_VEC_B_CSI1_CLK_OFF_BMSK=0x4000
&HWIO_MMSS_DBG_BUS_VEC_B_CSI0_CLK_OFF_BMSK=0x2000
&HWIO_MMSS_DBG_BUS_VEC_B_CSI_VFE_CLK_OFF_BMSK=0x100
&HWIO_MMSS_DBG_BUS_VEC_B_VFE_CLK_OFF_BMSK=0x40
&HWIO_MMSS_DBG_BUS_VEC_C_VCODEC_CLK_OFF_BMSK=0x20000000
&HWIO_MMSS_DBG_BUS_VEC_C_DSI2_CLK_OFF_BMSK=0x100000
&HWIO_MMSS_DBG_BUS_VEC_C_DSI2_PIXEL_CLK_OFF_BMSK=0x80000
&HWIO_MMSS_DBG_BUS_VEC_C_ROT_CLK_OFF_BMSK=0x8000
&HWIO_MMSS_DBG_BUS_VEC_C_MDP_CLK_OFF_BMSK=0x400
&HWIO_MMSS_DBG_BUS_VEC_C_DSI1_PIXEL_CLK_OFF_BMSK=0x40
&HWIO_MMSS_DBG_BUS_VEC_C_DSI1_CLK_OFF_BMSK=0x4
&HWIO_MMSS_DBG_BUS_VEC_D_MDP_TV_CLK_OFF_BMSK=0x1000
&HWIO_MMSS_DBG_BUS_VEC_D_HDMI_TV_CLK_OFF_BMSK=0x800
&HWIO_MMSS_DBG_BUS_VEC_D_TV_DAC_CLK_OFF_BMSK=0x400
&HWIO_MMSS_DBG_BUS_VEC_D_TV_ENC_CLK_OFF_BMSK=0x200
&HWIO_MMSS_DBG_BUS_VEC_E_DSI2_M_AHB_CLK_OFF_BMSK=0x40000
&HWIO_MMSS_DBG_BUS_VEC_E_FAB_CORE_CLK_OFF_BMSK=0x20000
&HWIO_MMSS_DBG_BUS_VEC_E_AXI_S3_FCLK_CLK_OFF_BMSK=0x10000
&HWIO_MMSS_DBG_BUS_VEC_E_AXI_S2_FCLK_CLK_OFF_BMSK=0x8000
&HWIO_MMSS_DBG_BUS_VEC_E_AXI_S1_FCLK_CLK_OFF_BMSK=0x4000
&HWIO_MMSS_DBG_BUS_VEC_E_AXI_S2_CLK_OFF_BMSK=0x1000
&HWIO_MMSS_DBG_BUS_VEC_E_AXI_S1_CLK_OFF_BMSK=0x800
&HWIO_MMSS_DBG_BUS_VEC_E_FAB_MSP_AXI_CLK_OFF_BMSK=0x200
&HWIO_MMSS_DBG_BUS_VEC_E_MDP_AXI_CLK_OFF_BMSK=0x100
&HWIO_MMSS_DBG_BUS_VEC_E_IMEM_AXI_CLK_OFF_BMSK=0x80
&HWIO_MMSS_DBG_BUS_VEC_E_GMEM_AXI_CLK_OFF_BMSK=0x40
&HWIO_MMSS_DBG_BUS_VEC_E_JPEGD_AXI_CLK_OFF_BMSK=0x20
&HWIO_MMSS_DBG_BUS_VEC_E_IJPEG_AXI_CLK_OFF_BMSK=0x10
&HWIO_MMSS_DBG_BUS_VEC_E_VCODEC_AXI_CLK_OFF_BMSK=0x8
&HWIO_MMSS_DBG_BUS_VEC_E_ROT_AXI_CLK_OFF_BMSK=0x4
&HWIO_MMSS_DBG_BUS_VEC_E_VPE_AXI_CLK_OFF_BMSK=0x2
&HWIO_MMSS_DBG_BUS_VEC_E_VFE_AXI_CLK_OFF_BMSK=0x1
&HWIO_MMSS_DBG_BUS_VEC_F_TV_ENC_AHB_CLK_OFF_BMSK=0x800000
&HWIO_MMSS_DBG_BUS_VEC_F_SMMU_AHB_CLK_OFF_BMSK=0x400000
&HWIO_MMSS_DBG_BUS_VEC_F_DSI1_S_AHB_CLK_OFF_BMSK=0x200000
&HWIO_MMSS_DBG_BUS_VEC_F_DSI2_S_AHB_CLK_OFF_BMSK=0x100000
&HWIO_MMSS_DBG_BUS_VEC_F_DSI1_M_AHB_CLK_OFF_BMSK=0x80000
&HWIO_MMSS_DBG_BUS_VEC_F_AMP_AHB_CLK_OFF_BMSK=0x40000
&HWIO_MMSS_DBG_BUS_VEC_F_CSI_AHB_CLK_OFF_BMSK=0x10000
&HWIO_MMSS_DBG_BUS_VEC_F_VPE_AHB_CLK_OFF_BMSK=0x8000
&HWIO_MMSS_DBG_BUS_VEC_F_VFE_AHB_CLK_OFF_BMSK=0x4000
&HWIO_MMSS_DBG_BUS_VEC_F_ROT_AHB_CLK_OFF_BMSK=0x2000
&HWIO_MMSS_DBG_BUS_VEC_F_VCODEC_AHB_CLK_OFF_BMSK=0x1000
&HWIO_MMSS_DBG_BUS_VEC_F_MDP_AHB_CLK_OFF_BMSK=0x800
&HWIO_MMSS_DBG_BUS_VEC_F_IMEM_AHB_CLK_OFF_BMSK=0x400
&HWIO_MMSS_DBG_BUS_VEC_F_IJPEG_AHB_CLK_OFF_BMSK=0x200
&HWIO_MMSS_DBG_BUS_VEC_F_APU_AHB_CLK_OFF_BMSK=0x100
&HWIO_MMSS_DBG_BUS_VEC_F_JPEGD_AHB_CLK_OFF_BMSK=0x80
&HWIO_MMSS_DBG_BUS_VEC_F_HDMI_S_AHB_CLK_OFF_BMSK=0x40
&HWIO_MMSS_DBG_BUS_VEC_F_HDMI_M_AHB_CLK_OFF_BMSK=0x20
&HWIO_MMSS_DBG_BUS_VEC_F_GFX3D_AHB_CLK_OFF_BMSK=0x10
&HWIO_MMSS_DBG_BUS_VEC_F_GFX2D1_AHB_CLK_OFF_BMSK=0x8
&HWIO_MMSS_DBG_BUS_VEC_F_GFX2D0_AHB_CLK_OFF_BMSK=0x4
&HWIO_MMSS_DBG_BUS_VEC_F_FAB_AHB_CLK_OFF_BMSK=0x2
&HWIO_MMSS_DBG_BUS_VEC_F_MMSS_FPB_CLK_OFF_BMSK=0x1
&HWIO_MMSS_DBG_BUS_VEC_H_MMSS_FPB_ALWAYS_ON_CLK_OFF_BMSK=0x2000
&HWIO_MMSS_DBG_BUS_VEC_I_VCODEC_AXI_A_CLK_OFF_BMSK=0x4000000
&HWIO_MMSS_DBG_BUS_VEC_I_VCODEC_AXI_B_CLK_OFF_BMSK=0x2000000
&HWIO_MMSS_DBG_BUS_VEC_I_CSI1PHYTIMER_CLKOFF_BMSK=0x40000
&HWIO_MMSS_DBG_BUS_VEC_I_CSI0PHYTIMER_CLKOFF_BMSK=0x20000
&HWIO_MMSS_DBG_BUS_VEC_I_CAMCLK1_PO_CLK_OFF_BMSK=0x10000
&HWIO_MMSS_DBG_BUS_VEC_I_CAMCLK0_PO_CLK_OFF_BMSK=0x8000
&HWIO_MMSS_DBG_BUS_VEC_I_LUT_MDP_CLK_OFF_BMSK=0x2000
&HWIO_MMSS_DBG_BUS_VEC_I_CSIPHY1_CLK_OFF_BMSK=0x400
&HWIO_MMSS_DBG_BUS_VEC_I_CSIPHY0_CLK_OFF_BMSK=0x200
&HWIO_MMSS_DBG_BUS_VEC_I_DSI2_ESC_CLK_OFF_BMSK=0x8
&HWIO_MMSS_DBG_BUS_VEC_I_DSI1_ESC_CLK_OFF_BMSK=0x2


&HWIO_FW_QDSP6SS_GFMUX_STATUS_SEL_STATUS_BMSK=0x1e
&HWIO_SW_QDSP6SS_GFMUX_STATUS_SEL_STATUS_BMSK=0x1e


&HWIO_PMU_CLK_ROOT1_CLK_ENA_BMSK=0x1
&HWIO_PMU_CLK_ROOT2_CLK_ENA_BMSK=0x1
&HWIO_PMU_CLK_ROOT3_CLK_ENA_BMSK=0x1
&HWIO_PMU_CLK_ROOT4_CLK_ENA_BMSK=0x1
&HWIO_PMU_CLK_ROOT5_CLK_ENA_BMSK=0x1
&HWIO_PMU_CLK_ROOT6_CLK_ENA_BMSK=0x1


&HWIO_APCS_SYSL2AUX_CLK=0x380
&HWIO_APCS_SYSL2PLL_CLK=0x40
&HWIO_APCS_SYSATB_CLK=0x20
&HWIO_APCS_SYSAPBDBG_CLK=0x10
&HWIO_APCS_SYSSLEEP_CLK=0x08
&HWIO_APCS_SYSREF_CLK=0x04
&HWIO_APCS_SYSAHB_CLK=0x02
&HWIO_APCS_SYSQSB_CLK=0x01


goto Init_Constants_Done


Print_Clock_Help:

  print ""
  print "TOP:"
  print " adm0_clk_raw                   adm0_pbus_hclk                 afab_axi_s0_fclk              "
  print " afab_axi_s1_fclk               afab_axi_s2_fclk               afab_axi_s3_fclk              "
  print " afab_axi_s4_fclk               afab_core_clk                  afab_ebi1_ch1_aclk            "
  print " afab_ebi1_s_aclk               afab_kpss_m0_aclk              afab_kpss_m1_aclk             "
  print " afab_sfab_m0_aclk              afab_sfab_m1_aclk              afab_sfab_s_aclk              "
  print " afab_smpss_s_aclk              bbrx_ssbi_clk                  cc_ce1_core_clk               "
  print " cc_ce1_hclk                    cc_ce2_core_clk                cc_ce2_hclk                   "
  print " cc_gsbi10_hclk                 cc_gsbi10_qup_apps_clk         cc_gsbi10_uart_apps_clk       "
  print " cc_gsbi11_hclk                 cc_gsbi11_qup_apps_clk         cc_gsbi11_qup_apps_clk        "
  print " cc_gsbi11_uart_apps_clk        cc_gsbi12_hclk                 cc_gsbi12_hclk                "
  print " cc_gsbi12_qup_apps_clk         cc_gsbi12_qup_apps_clk         cc_gsbi12_uart_apps_clk       "
  print " cc_gsbi1_hclk                  cc_gsbi1_qup_apps_clk          cc_gsbi1_uart_apps_clk        "
  print " cc_gsbi2_hclk                  cc_gsbi2_qup_apps_clk          cc_gsbi2_uart_apps_clk        "
  print " cc_gsbi3_hclk                  cc_gsbi3_qup_apps_clk          cc_gsbi3_uart_apps_clk        "
  print " cc_gsbi4_hclk                  cc_gsbi4_qup_apps_clk          cc_gsbi4_uart_apps_clk        "
  print " cc_gsbi5_hclk                  cc_gsbi5_qup_apps_clk          cc_gsbi5_uart_apps_clk        "
  print " cc_gsbi6_hclk                  cc_gsbi6_qup_apps_clk          cc_gsbi6_uart_apps_clk        "
  print " cc_gsbi7_hclk                  cc_gsbi7_qup_apps_clk          cc_gsbi7_uart_apps_clk        "
  print " cc_gsbi8_hclk                  cc_gsbi8_qup_apps_clk          cc_gsbi8_uart_apps_clk        "
  print " cc_gsbi9_hclk                  cc_gsbi9_qup_apps_clk          cc_gsbi9_uart_apps_clk        "
  print " cc_mss_q6fw_jtag_clk           cc_mss_q6sw_jtag_clk           cc_mss_s_hclk                 "
  print " cc_mss_slp_clk                 cc_pmic_arb0_hclk              cc_pmic_arb1_hclk             "
  print " cc_pmic_ssbi2_clk              cc_q6fw_core_clk               cc_q6sw_core_clk              "
  print " cc_qdss_at_clk                 cc_qdss_hclk                   cc_qdss_pclkdbg_clk           "
  print " cc_qdss_stm_clk                cc_qdss_traceclkin_clk         cc_qdss_tsctr_clk             "
  print " cc_sdc1_apps_clk               cc_sdc1_hclk                   cc_sdc2_apps_clk              "
  print " cc_sdc2_hclk                   cc_sdc3_apps_clk               cc_sdc3_hclk                  "
  print " cc_sdc4_apps_clk               cc_sdc4_hclk                   cc_sdc5_apps_clk              "
  print " cc_sdc5_hclk                   cc_sfab_mss_m_aclk             cc_sfab_mss_q6fw_aclk         "
  print " cc_sfab_mss_q6sw_aclk          cc_sfab_mss_s_hclk             cc_usb_fs1_hclk               "
  print " cc_usb_fs1_system_clk          cc_usb_fs1_xcvr_fs_clk         cc_usb_fs2_hclk               "
  print " cc_usb_fs2_system_clk          cc_usb_fs2_xcvr_fs_clk         cc_usb_hs1_hclk               "
  print " cc_usb_hs1_xcvr_fs_clk         ce1_sleep_clk                  cfpb0_c0_hclk                 "
  print " cfpb0_c1_hclk                  cfpb0_d0_hclk                  cfpb0_d1_hclk                 "
  print " cfpb0_hclk                     cfpb1_hclk                     cfpb2_hclk                    "
  print " cfpb_master_hclk               cfpb_master_nohwgate_hclk      cfpb_splitter_hclk            "
  print " ddr_clk                        dfab_a2_hclk                   dfab_arb0_hclk                "
  print " dfab_arb1_hclk                 dfab_core_clk                  dfab_sfab_m_aclk              "
  print " dfab_sfab_s_aclk               dfab_sway0_hclk                dfab_sway1_hclk               "
  print " dma_bam_hclk                   ebi1_ch0_ca_xo_src             ebi1_ch0_cc_dbg_hs_clk        "
  print " ebi1_ch0_dq_xo_src             ebi1_ch1_ca_xo_src             ebi1_ch1_cc_dbg_hs_clk        "
  print " ebi1_ch1_dq_xo_src             ebi1_clk_src                   ebi1_xo_src                   "
  print " gp0_clk                        gp1_clk                        gp2_clk                       "
  print " cc_gsbi10_sim_clk_src          cc_gsbi11_sim_clk_src          cc_gsbi12_sim_clk_src         "
  print " cc_gsbi1_sim_clk_src           cc_gsbi2_sim_clk_src           cc_gsbi3_sim_clk_src          "
  print " cc_gsbi4_sim_clk_src           cc_gsbi5_sim_clk_src           cc_gsbi6_sim_clk_src          "
  print " cc_gsbi7_sim_clk_src           cc_gsbi8_sim_clk_src           cc_gsbi9_sim_clk_src          "
  print " imem0_aclk                     low_speed_debug_clock          lpass_cc_dbg_hs_in_clk        "
  print " lpass_cc_dbg_ls_in_clk         lpass_cxo_src                  lpass_mxo_src                 "
  print " lpass_pxo_src                  lpass_q6_cc_dbg_hs_in_clk      lpass_q6_cc_dbg_ls_in_clk     "
  print " mmfab_sync_src                 mmss_cc_dbg_hs_in_clk          mmss_cc_dbg_ls_in_clk         "
  print " mmss_mxo_src                   mmss_pxo_src                   mpm_hclk                      "
  print " mss_dbg_hs_clk                 mss_dbg_ls_clk                 mss_xpu_clk                   "
  print " pcie_aclk                      pdm_clk                        pdm_xo4_clk                   "
  print " cc_pmem_aclk                   ppss_hclk                      ppss_proc_clk                 "
  print " ppss_timer0_clk                ppss_timer1_clk                prng_clk                      "
  print " q6fw_cc_dbg_hs_clk             q6fw_cc_dbg_ls_clk             q6sw_cc_dbg_hs_clk            "
  print " q6sw_cc_dbg_ls_clk             ring_osc_clk                   riva_cc_dbg_clk_hs            "
  print " riva_cc_dbg_clk_ls             rpm_bus_hclk                   rpm_msg_ram_hclk              "
  print " rpm_proc_clk                   rpm_sleep_clk                  rpm_timer_clk                 "
  print " sc_aclk                        sc_cc_dbg_ls_clk               sc_dbg_clk                    "
  print " sc_dbg_hs0_clk                 sc_dbg_hs1_clk                 sc_dbg_hs2_clk                "
  print " sc_hclk                        sc_l2_clk                      sc_xo_src                     "
  print " sec_ctrl_acc_clk               sec_ctrl_clk                   sfab_adm0_m0_aclk             "
  print " sfab_adm0_m1_aclk              sfab_adm0_m2_hclk              sfab_afab_m_aclk              "
  print " sfab_afab_s0_aclk              sfab_afab_s1_aclk              sfab_ahb_s0_fclk              "
  print " sfab_ahb_s1_fclk               sfab_ahb_s2_fclk               sfab_ahb_s3_fclk              "
  print " sfab_ahb_s4_fclk               sfab_ahb_s5_fclk               sfab_ahb_s6_fclk              "
  print " sfab_axi_s0_fclk               sfab_axi_s1_fclk               sfab_axi_s2_fclk              "
  print " sfab_axi_s3_fclk               sfab_axi_s4_fclk               sfab_cfpb_m_hclk              "
  print " sfab_cfpb_s_hclk               sfab_core_clk                  sfab_dfab_s_aclk              "
  print " sfab_lpass_q6_aclk             sfab_sfpb_m_hclk               sfab_sfpb_s_hclk              "
  print " sfab_smpss_s_hclk              sfab_usb3_m_aclk               sfpb_hclk                     "
  print " sfpb_nohwgate_hclk             sic_hclk                       slimbus_hclk                  "
  print " slimbus_xo_src                 spdm_cfg_hclk                  spdm_cy_port0_clk             "
  print " spdm_cy_port1_clk              spdm_cy_port2_clk              spdm_cy_port3_clk             "
  print " spdm_cy_port4_clk              spdm_cy_port5_clk              spdm_cy_port6_clk             "
  print " spdm_cy_port7_clk              spdm_ff_clk                    spdm_mstr_hclk                "
  print " sps_tic_hclk                   tlmm_clk                       tlmm_hclk                     "
  print " tsif_hclk_raw                  tsif_inactivity_timers_clk     tsif_ref_clk                  "
  print " tssc_clk                       usb_hs2_hclk                   usb_hs2_system_clk            "
  print " usb_hs2_xcvr_fs_clk            voltage_sensor_debug_clock    "
  print ""
  print "LPASS:"
  print " lcc_ahb_hclk                   lcc_aif_hclk                   lcc_avt_hclk                  "
  print " lcc_avt_mclk                   lcc_avt_pclk                   lcc_avt_riva_bt_clk           "
  print " lcc_avt_riva_fm_clk            lcc_codec_i2s_mic_bit_clk      lcc_codec_i2s_spkr_bit_clk    "
  print " lcc_core_csr_hclk              lcc_dml_hclk                   lcc_ebus_hclk                 "
  print " lcc_fab_lpb_hclk               lcc_ibus_hclk                  lcc_lpaif_csr_hclk            "
  print " lcc_lpb_fab_hclk               lcc_lpm_hclk                   lcc_mi2s_bit_clk              "
  print " lcc_midi_clk                   lcc_midi_hclk                  lcc_pcm_clk                   "
  print " lcc_q6_fracdiv_clk             lcc_q6_func_clk                lcc_q6_jtag_clk               "
  print " lcc_q6_slp_clk                 lcc_q6_tcxo_clk                lcc_q6ss_hclk                 "
  print " lcc_security_hclk              lcc_slimbus_core_clk           lcc_slimbus_hclk              "
  print " lcc_spare_i2s_mic_bit_clk      lcc_spare_i2s_spkr_bit_clk    "
  print ""
  print "MMSS:"
  print " axi_s0_clk                     axi_s0_fclk                    cc_amp_ahb_clk                "
  print " cc_apu_ahb_clk                 cc_axi_s1_clk                  cc_axi_s1_fclk                "
  print " cc_axi_s2_clk                  cc_axi_s2_fclk                 cc_axi_s3_fclk                "
  print " cc_cam0clk_po                  cc_cam1clk_po                  cc_csi0_clk                   "
  print " cc_csi0_phy_clk                cc_csi1_clk                    cc_csi1_phy_clk               "
  print " cc_csi_ahb_clk                 cc_csi_pix_clk                 cc_csi_rdi_clk                "
  print " cc_csi_vfe_clk                 cc_csiphy0_timer_clk           cc_csiphy1_timer_clk          "
  print " cc_dsi1_byte_clk               cc_dsi1_clk                    cc_dsi1_esc_clk               "
  print " cc_dsi1_m_ahb_clk              cc_dsi1_pixel_clk              cc_dsi1_s_ahb_clk             "
  print " cc_dsi2_byte_clk               cc_dsi2_clk                    cc_dsi2_esc_clk               "
  print " cc_dsi2_m_ahb_clk              cc_dsi2_pixel_clk              cc_dsi2_s_ahb_clk             "
  print " cc_fab_ahb_clk                 cc_fab_core_clk                cc_fab_msp_axi_clk            "
  print " cc_gfx2d0_ahb_clk              cc_gfx2d0_clk                  cc_gfx2d1_ahb_clk             "
  print " cc_gfx2d1_clk                  cc_gfx3d_ahb_clk               cc_gfx3d_clk                  "
  print " cc_gmem_axi_clk                cc_hdmi_app_clk                cc_hdmi_m_ahb_clk             "
  print " cc_hdmi_ref_clk                cc_hdmi_s_ahb_clk              cc_hdmi_tv_clk                "
  print " cc_ijpeg_ahb_clk               cc_ijpeg_axi_clk               cc_ijpeg_clk                  "
  print " cc_imem_ahb_clk                cc_imem_axi_clk                cc_jpegd_ahb_clk              "
  print " cc_jpegd_axi_clk               cc_jpegd_clk                   cc_lut_mdp_clk                "
  print " cc_mdp_ahb_clk                 cc_mdp_axi_clk                 cc_mdp_clk                    "
  print " cc_mdp_tv_clk                  cc_mdp_vsync_clk               cc_mmss_fpb_aon_clk           "
  print " cc_mmss_fpb_clk                cc_rot_ahb_clk                 cc_rot_axi_clk                "
  print " cc_rot_clk                     cc_smmu_ahb_clk                cc_tv_dac_clk                 "
  print " cc_tv_enc_ahb_clk              cc_tv_enc_clk                  cc_vcodec_ahb_clk             "
  print " cc_vcodec_axi_A_clk            cc_vcodec_axi_B_clk            cc_vcodec_axi_clk             "
  print " cc_vcodec_clk                  cc_vcodec_pclk                 cc_vfe_ahb_clk                "
  print " cc_vfe_axi_clk                 cc_vfe_clk                     cc_vpe_ahb_clk                "
  print " cc_vpe_axi_clk                 cc_vpe_clk                     dsi_ref_clk                   "
  print ""
  print "RIVA:"
  print " ahb_main_hs_clk                ahb_main_ls_clk                cc_bt_clk                     "
  print " cc_ccpu_clk                    cc_fm_clk                      cc_wlan_phy_1_clk             "
  print " cc_wlan_phy_2_clk              cc_wlan_rfif_clk               phy_adc_hs_clk                "
  print " phy_adc_ls_clk                 phy_dac_hs_clk                 phy_dac_ls_clk                "
  print " root3_120_clk                  slp_clk                        tck_clk                       "
  print " tcxo_clk                      "
  print ""
  print "APCS:"
  print " sys_apcsqsb_clk               apcc_sysl2leaf_clk             apc0_sysleaf_clk               "
  print " apc1_sysleaf_clk              sys_apcsahb_clk                sys_apcsref_clk                "
  print " sys_apcspisleep_clk           apb_apccdbg_clk                atb_apcc_clk                   "
  print ""
  print "NAV:"
  print " nav_main_clk                   nav_adc1_clk                   nav_adc2_clk                  "
  print " nav_rsref_clk                 "
  return


Print_All:

  gosub Print_Clk_Info_Line adm0_clk_raw
  gosub Print_Clk_Info_Line adm0_pbus_hclk
  gosub Print_Clk_Info_Line afab_axi_s0_fclk
  gosub Print_Clk_Info_Line afab_axi_s1_fclk
  gosub Print_Clk_Info_Line afab_axi_s2_fclk
  gosub Print_Clk_Info_Line afab_axi_s3_fclk
  gosub Print_Clk_Info_Line afab_axi_s4_fclk
  gosub Print_Clk_Info_Line afab_core_clk
  gosub Print_Clk_Info_Line afab_ebi1_ch1_aclk
  gosub Print_Clk_Info_Line afab_ebi1_s_aclk
  gosub Print_Clk_Info_Line afab_kpss_m0_aclk
  gosub Print_Clk_Info_Line afab_kpss_m1_aclk
  gosub Print_Clk_Info_Line afab_sfab_m0_aclk
  gosub Print_Clk_Info_Line afab_sfab_m1_aclk
  gosub Print_Clk_Info_Line afab_sfab_s_aclk
  gosub Print_Clk_Info_Line afab_smpss_s_aclk
  gosub Print_Clk_Info_Line bbrx_ssbi_clk
  gosub Print_Clk_Info_Line cc_ce1_core_clk
  gosub Print_Clk_Info_Line cc_ce1_hclk
  gosub Print_Clk_Info_Line cc_ce2_core_clk
  gosub Print_Clk_Info_Line cc_ce2_hclk
  gosub Print_Clk_Info_Line cc_gsbi10_hclk
  gosub Print_Clk_Info_Line cc_gsbi10_qup_apps_clk
  gosub Print_Clk_Info_Line cc_gsbi10_uart_apps_clk
  gosub Print_Clk_Info_Line cc_gsbi11_hclk
  gosub Print_Clk_Info_Line cc_gsbi11_qup_apps_clk
  gosub Print_Clk_Info_Line cc_gsbi11_qup_apps_clk
  gosub Print_Clk_Info_Line cc_gsbi11_uart_apps_clk
  gosub Print_Clk_Info_Line cc_gsbi12_hclk
  gosub Print_Clk_Info_Line cc_gsbi12_hclk
  gosub Print_Clk_Info_Line cc_gsbi12_qup_apps_clk
  gosub Print_Clk_Info_Line cc_gsbi12_qup_apps_clk
  gosub Print_Clk_Info_Line cc_gsbi12_uart_apps_clk
  gosub Print_Clk_Info_Line cc_gsbi1_hclk
  gosub Print_Clk_Info_Line cc_gsbi1_qup_apps_clk
  gosub Print_Clk_Info_Line cc_gsbi1_uart_apps_clk
  gosub Print_Clk_Info_Line cc_gsbi2_hclk
  gosub Print_Clk_Info_Line cc_gsbi2_qup_apps_clk
  gosub Print_Clk_Info_Line cc_gsbi2_uart_apps_clk
  gosub Print_Clk_Info_Line cc_gsbi3_hclk
  gosub Print_Clk_Info_Line cc_gsbi3_qup_apps_clk
  gosub Print_Clk_Info_Line cc_gsbi3_uart_apps_clk
  gosub Print_Clk_Info_Line cc_gsbi4_hclk
  gosub Print_Clk_Info_Line cc_gsbi4_qup_apps_clk
  gosub Print_Clk_Info_Line cc_gsbi4_uart_apps_clk
  gosub Print_Clk_Info_Line cc_gsbi5_hclk
  gosub Print_Clk_Info_Line cc_gsbi5_qup_apps_clk
  gosub Print_Clk_Info_Line cc_gsbi5_uart_apps_clk
  gosub Print_Clk_Info_Line cc_gsbi6_hclk
  gosub Print_Clk_Info_Line cc_gsbi6_qup_apps_clk
  gosub Print_Clk_Info_Line cc_gsbi6_uart_apps_clk
  gosub Print_Clk_Info_Line cc_gsbi7_hclk
  gosub Print_Clk_Info_Line cc_gsbi7_qup_apps_clk
  gosub Print_Clk_Info_Line cc_gsbi7_uart_apps_clk
  gosub Print_Clk_Info_Line cc_gsbi8_hclk
  gosub Print_Clk_Info_Line cc_gsbi8_qup_apps_clk
  gosub Print_Clk_Info_Line cc_gsbi8_uart_apps_clk
  gosub Print_Clk_Info_Line cc_gsbi9_hclk
  gosub Print_Clk_Info_Line cc_gsbi9_qup_apps_clk
  gosub Print_Clk_Info_Line cc_gsbi9_uart_apps_clk
  gosub Print_Clk_Info_Line cc_mss_q6fw_jtag_clk
  gosub Print_Clk_Info_Line cc_mss_q6sw_jtag_clk
  gosub Print_Clk_Info_Line cc_mss_s_hclk
  gosub Print_Clk_Info_Line cc_mss_slp_clk
  gosub Print_Clk_Info_Line cc_pmic_arb0_hclk
  gosub Print_Clk_Info_Line cc_pmic_arb1_hclk
  gosub Print_Clk_Info_Line cc_pmic_ssbi2_clk
  gosub Print_Clk_Info_Line cc_q6fw_core_clk
  gosub Print_Clk_Info_Line cc_q6sw_core_clk
  gosub Print_Clk_Info_Line cc_qdss_at_clk
  gosub Print_Clk_Info_Line cc_qdss_hclk
  gosub Print_Clk_Info_Line cc_qdss_pclkdbg_clk
  gosub Print_Clk_Info_Line cc_qdss_stm_clk
  gosub Print_Clk_Info_Line cc_qdss_traceclkin_clk
  gosub Print_Clk_Info_Line cc_qdss_tsctr_clk
  gosub Print_Clk_Info_Line cc_sdc1_apps_clk
  gosub Print_Clk_Info_Line cc_sdc1_hclk
  gosub Print_Clk_Info_Line cc_sdc2_apps_clk
  gosub Print_Clk_Info_Line cc_sdc2_hclk
  gosub Print_Clk_Info_Line cc_sdc3_apps_clk
  gosub Print_Clk_Info_Line cc_sdc3_hclk
  gosub Print_Clk_Info_Line cc_sdc4_apps_clk
  gosub Print_Clk_Info_Line cc_sdc4_hclk
  gosub Print_Clk_Info_Line cc_sdc5_apps_clk
  gosub Print_Clk_Info_Line cc_sdc5_hclk
  gosub Print_Clk_Info_Line cc_sfab_mss_m_aclk
  gosub Print_Clk_Info_Line cc_sfab_mss_q6fw_aclk
  gosub Print_Clk_Info_Line cc_sfab_mss_q6sw_aclk
  gosub Print_Clk_Info_Line cc_sfab_mss_s_hclk
  gosub Print_Clk_Info_Line cc_usb_fs1_hclk
  gosub Print_Clk_Info_Line cc_usb_fs1_system_clk
  gosub Print_Clk_Info_Line cc_usb_fs1_xcvr_fs_clk
  gosub Print_Clk_Info_Line cc_usb_fs2_hclk
  gosub Print_Clk_Info_Line cc_usb_fs2_system_clk
  gosub Print_Clk_Info_Line cc_usb_fs2_xcvr_fs_clk
  gosub Print_Clk_Info_Line cc_usb_hs1_hclk
  gosub Print_Clk_Info_Line cc_usb_hs1_xcvr_fs_clk
  gosub Print_Clk_Info_Line ce1_sleep_clk
  gosub Print_Clk_Info_Line cfpb0_c0_hclk
  gosub Print_Clk_Info_Line cfpb0_c1_hclk
  gosub Print_Clk_Info_Line cfpb0_d0_hclk
  gosub Print_Clk_Info_Line cfpb0_d1_hclk
  gosub Print_Clk_Info_Line cfpb0_hclk
  gosub Print_Clk_Info_Line cfpb1_hclk
  gosub Print_Clk_Info_Line cfpb2_hclk
  gosub Print_Clk_Info_Line cfpb_master_hclk
  gosub Print_Clk_Info_Line cfpb_master_nohwgate_hclk
  gosub Print_Clk_Info_Line cfpb_splitter_hclk
  gosub Print_Clk_Info_Line ddr_clk
  gosub Print_Clk_Info_Line dfab_a2_hclk
  gosub Print_Clk_Info_Line dfab_arb0_hclk
  gosub Print_Clk_Info_Line dfab_arb1_hclk
  gosub Print_Clk_Info_Line dfab_core_clk
  gosub Print_Clk_Info_Line dfab_sfab_m_aclk
  gosub Print_Clk_Info_Line dfab_sfab_s_aclk
  gosub Print_Clk_Info_Line dfab_sway0_hclk
  gosub Print_Clk_Info_Line dfab_sway1_hclk
  gosub Print_Clk_Info_Line dma_bam_hclk
  gosub Print_Clk_Info_Line ebi1_ch0_ca_xo_src
  gosub Print_Clk_Info_Line ebi1_ch0_cc_dbg_hs_clk
  gosub Print_Clk_Info_Line ebi1_ch0_dq_xo_src
  gosub Print_Clk_Info_Line ebi1_ch1_ca_xo_src
  gosub Print_Clk_Info_Line ebi1_ch1_cc_dbg_hs_clk
  gosub Print_Clk_Info_Line ebi1_ch1_dq_xo_src
  gosub Print_Clk_Info_Line ebi1_clk_src
  gosub Print_Clk_Info_Line ebi1_xo_src
  gosub Print_Clk_Info_Line gp0_clk
  gosub Print_Clk_Info_Line gp1_clk
  gosub Print_Clk_Info_Line gp2_clk
  gosub Print_Clk_Info_Line cc_gsbi10_sim_clk_src
  gosub Print_Clk_Info_Line cc_gsbi11_sim_clk_src
  gosub Print_Clk_Info_Line cc_gsbi12_sim_clk_src
  gosub Print_Clk_Info_Line cc_gsbi1_sim_clk_src
  gosub Print_Clk_Info_Line cc_gsbi2_sim_clk_src
  gosub Print_Clk_Info_Line cc_gsbi3_sim_clk_src
  gosub Print_Clk_Info_Line cc_gsbi4_sim_clk_src
  gosub Print_Clk_Info_Line cc_gsbi5_sim_clk_src
  gosub Print_Clk_Info_Line cc_gsbi6_sim_clk_src
  gosub Print_Clk_Info_Line cc_gsbi7_sim_clk_src
  gosub Print_Clk_Info_Line cc_gsbi8_sim_clk_src
  gosub Print_Clk_Info_Line cc_gsbi9_sim_clk_src
  gosub Print_Clk_Info_Line imem0_aclk
  gosub Print_Clk_Info_Line low_speed_debug_clock
  gosub Print_Clk_Info_Line lpass_cc_dbg_hs_in_clk
  gosub Print_Clk_Info_Line lpass_cc_dbg_ls_in_clk
  gosub Print_Clk_Info_Line lpass_cxo_src
  gosub Print_Clk_Info_Line lpass_mxo_src
  gosub Print_Clk_Info_Line lpass_pxo_src
  gosub Print_Clk_Info_Line lpass_q6_cc_dbg_hs_in_clk
  gosub Print_Clk_Info_Line lpass_q6_cc_dbg_ls_in_clk
  gosub Print_Clk_Info_Line mmfab_sync_src
  gosub Print_Clk_Info_Line mmss_cc_dbg_hs_in_clk
  gosub Print_Clk_Info_Line mmss_cc_dbg_ls_in_clk
  gosub Print_Clk_Info_Line mmss_mxo_src
  gosub Print_Clk_Info_Line mmss_pxo_src
  gosub Print_Clk_Info_Line mpm_hclk
  gosub Print_Clk_Info_Line mss_dbg_hs_clk
  gosub Print_Clk_Info_Line mss_dbg_ls_clk
  gosub Print_Clk_Info_Line mss_xpu_clk
  gosub Print_Clk_Info_Line pcie_aclk
  gosub Print_Clk_Info_Line pdm_clk
  gosub Print_Clk_Info_Line pdm_xo4_clk
  gosub Print_Clk_Info_Line cc_pmem_aclk
  gosub Print_Clk_Info_Line ppss_hclk
  gosub Print_Clk_Info_Line ppss_proc_clk
  gosub Print_Clk_Info_Line ppss_timer0_clk
  gosub Print_Clk_Info_Line ppss_timer1_clk
  gosub Print_Clk_Info_Line prng_clk
  gosub Print_Clk_Info_Line q6fw_cc_dbg_hs_clk
  gosub Print_Clk_Info_Line q6fw_cc_dbg_ls_clk
  gosub Print_Clk_Info_Line q6sw_cc_dbg_hs_clk
  gosub Print_Clk_Info_Line q6sw_cc_dbg_ls_clk
  gosub Print_Clk_Info_Line ring_osc_clk
  gosub Print_Clk_Info_Line riva_cc_dbg_clk_hs
  gosub Print_Clk_Info_Line riva_cc_dbg_clk_ls
  gosub Print_Clk_Info_Line rpm_bus_hclk
  gosub Print_Clk_Info_Line rpm_msg_ram_hclk
  gosub Print_Clk_Info_Line rpm_proc_clk
  gosub Print_Clk_Info_Line rpm_sleep_clk
  gosub Print_Clk_Info_Line rpm_timer_clk
  gosub Print_Clk_Info_Line sc_aclk
  gosub Print_Clk_Info_Line sc_cc_dbg_ls_clk
  gosub Print_Clk_Info_Line sc_dbg_clk
  gosub Print_Clk_Info_Line sc_dbg_hs0_clk
  gosub Print_Clk_Info_Line sc_dbg_hs1_clk
  gosub Print_Clk_Info_Line sc_dbg_hs2_clk
  gosub Print_Clk_Info_Line sc_hclk
  gosub Print_Clk_Info_Line sc_l2_clk
  gosub Print_Clk_Info_Line sc_xo_src
  gosub Print_Clk_Info_Line sec_ctrl_acc_clk
  gosub Print_Clk_Info_Line sec_ctrl_clk
  gosub Print_Clk_Info_Line sfab_adm0_m0_aclk
  gosub Print_Clk_Info_Line sfab_adm0_m1_aclk
  gosub Print_Clk_Info_Line sfab_adm0_m2_hclk
  gosub Print_Clk_Info_Line sfab_afab_m_aclk
  gosub Print_Clk_Info_Line sfab_afab_s0_aclk
  gosub Print_Clk_Info_Line sfab_afab_s1_aclk
  gosub Print_Clk_Info_Line sfab_ahb_s0_fclk
  gosub Print_Clk_Info_Line sfab_ahb_s1_fclk
  gosub Print_Clk_Info_Line sfab_ahb_s2_fclk
  gosub Print_Clk_Info_Line sfab_ahb_s3_fclk
  gosub Print_Clk_Info_Line sfab_ahb_s4_fclk
  gosub Print_Clk_Info_Line sfab_ahb_s5_fclk
  gosub Print_Clk_Info_Line sfab_ahb_s6_fclk
  gosub Print_Clk_Info_Line sfab_axi_s0_fclk
  gosub Print_Clk_Info_Line sfab_axi_s1_fclk
  gosub Print_Clk_Info_Line sfab_axi_s2_fclk
  gosub Print_Clk_Info_Line sfab_axi_s3_fclk
  gosub Print_Clk_Info_Line sfab_axi_s4_fclk
  gosub Print_Clk_Info_Line sfab_cfpb_m_hclk
  gosub Print_Clk_Info_Line sfab_cfpb_s_hclk
  gosub Print_Clk_Info_Line sfab_core_clk
  gosub Print_Clk_Info_Line sfab_dfab_s_aclk
  gosub Print_Clk_Info_Line sfab_lpass_q6_aclk
  gosub Print_Clk_Info_Line sfab_sfpb_m_hclk
  gosub Print_Clk_Info_Line sfab_sfpb_s_hclk
  gosub Print_Clk_Info_Line sfab_smpss_s_hclk
  gosub Print_Clk_Info_Line sfab_usb3_m_aclk
  gosub Print_Clk_Info_Line sfpb_hclk
  gosub Print_Clk_Info_Line sfpb_nohwgate_hclk
  gosub Print_Clk_Info_Line sic_hclk
  gosub Print_Clk_Info_Line slimbus_hclk
  gosub Print_Clk_Info_Line slimbus_xo_src
  gosub Print_Clk_Info_Line spdm_cfg_hclk
  gosub Print_Clk_Info_Line spdm_cy_port0_clk
  gosub Print_Clk_Info_Line spdm_cy_port1_clk
  gosub Print_Clk_Info_Line spdm_cy_port2_clk
  gosub Print_Clk_Info_Line spdm_cy_port3_clk
  gosub Print_Clk_Info_Line spdm_cy_port4_clk
  gosub Print_Clk_Info_Line spdm_cy_port5_clk
  gosub Print_Clk_Info_Line spdm_cy_port6_clk
  gosub Print_Clk_Info_Line spdm_cy_port7_clk
  gosub Print_Clk_Info_Line spdm_ff_clk
  gosub Print_Clk_Info_Line spdm_mstr_hclk
  gosub Print_Clk_Info_Line sps_tic_hclk
  gosub Print_Clk_Info_Line tlmm_clk
  gosub Print_Clk_Info_Line tlmm_hclk
  gosub Print_Clk_Info_Line tsif_hclk_raw
  gosub Print_Clk_Info_Line tsif_inactivity_timers_clk
  gosub Print_Clk_Info_Line tsif_ref_clk
  gosub Print_Clk_Info_Line tssc_clk
  gosub Print_Clk_Info_Line usb_hs2_hclk
  gosub Print_Clk_Info_Line usb_hs2_system_clk
  gosub Print_Clk_Info_Line usb_hs2_xcvr_fs_clk
  gosub Print_Clk_Info_Line voltage_sensor_debug_clock
  gosub Print_Clk_Info_Line lcc_ahb_hclk
  gosub Print_Clk_Info_Line lcc_aif_hclk
  gosub Print_Clk_Info_Line lcc_avt_hclk
  gosub Print_Clk_Info_Line lcc_avt_mclk
  gosub Print_Clk_Info_Line lcc_avt_pclk
  gosub Print_Clk_Info_Line lcc_avt_riva_bt_clk
  gosub Print_Clk_Info_Line lcc_avt_riva_fm_clk
  gosub Print_Clk_Info_Line lcc_codec_i2s_mic_bit_clk
  gosub Print_Clk_Info_Line lcc_codec_i2s_spkr_bit_clk
  gosub Print_Clk_Info_Line lcc_core_csr_hclk
  gosub Print_Clk_Info_Line lcc_dml_hclk
  gosub Print_Clk_Info_Line lcc_ebus_hclk
  gosub Print_Clk_Info_Line lcc_fab_lpb_hclk
  gosub Print_Clk_Info_Line lcc_ibus_hclk
  gosub Print_Clk_Info_Line lcc_lpaif_csr_hclk
  gosub Print_Clk_Info_Line lcc_lpb_fab_hclk
  gosub Print_Clk_Info_Line lcc_lpm_hclk
  gosub Print_Clk_Info_Line lcc_mi2s_bit_clk
  gosub Print_Clk_Info_Line lcc_midi_clk
  gosub Print_Clk_Info_Line lcc_midi_hclk
  gosub Print_Clk_Info_Line lcc_pcm_clk
  gosub Print_Clk_Info_Line lcc_q6_fracdiv_clk
  gosub Print_Clk_Info_Line lcc_q6_func_clk
  gosub Print_Clk_Info_Line lcc_q6_jtag_clk
  gosub Print_Clk_Info_Line lcc_q6_slp_clk
  gosub Print_Clk_Info_Line lcc_q6_tcxo_clk
  gosub Print_Clk_Info_Line lcc_q6ss_hclk
  gosub Print_Clk_Info_Line lcc_security_hclk
  gosub Print_Clk_Info_Line lcc_slimbus_core_clk
  gosub Print_Clk_Info_Line lcc_slimbus_hclk
  gosub Print_Clk_Info_Line lcc_spare_i2s_mic_bit_clk
  gosub Print_Clk_Info_Line lcc_spare_i2s_spkr_bit_clk
  gosub Print_Clk_Info_Line axi_s0_clk
  gosub Print_Clk_Info_Line axi_s0_fclk
  gosub Print_Clk_Info_Line cc_amp_ahb_clk
  gosub Print_Clk_Info_Line cc_apu_ahb_clk
  gosub Print_Clk_Info_Line cc_axi_s1_clk
  gosub Print_Clk_Info_Line cc_axi_s1_fclk
  gosub Print_Clk_Info_Line cc_axi_s2_clk
  gosub Print_Clk_Info_Line cc_axi_s2_fclk
  gosub Print_Clk_Info_Line cc_axi_s3_fclk
  gosub Print_Clk_Info_Line cc_cam0clk_po
  gosub Print_Clk_Info_Line cc_cam1clk_po
  gosub Print_Clk_Info_Line cc_csi0_clk
  gosub Print_Clk_Info_Line cc_csi0_phy_clk
  gosub Print_Clk_Info_Line cc_csi1_clk
  gosub Print_Clk_Info_Line cc_csi1_phy_clk
  gosub Print_Clk_Info_Line cc_csi_ahb_clk
  gosub Print_Clk_Info_Line cc_csi_pix_clk
  gosub Print_Clk_Info_Line cc_csi_rdi_clk
  gosub Print_Clk_Info_Line cc_csi_vfe_clk
  gosub Print_Clk_Info_Line cc_csiphy0_timer_clk
  gosub Print_Clk_Info_Line cc_csiphy1_timer_clk
  gosub Print_Clk_Info_Line cc_dsi1_byte_clk
  gosub Print_Clk_Info_Line cc_dsi1_clk
  gosub Print_Clk_Info_Line cc_dsi1_esc_clk
  gosub Print_Clk_Info_Line cc_dsi1_m_ahb_clk
  gosub Print_Clk_Info_Line cc_dsi1_pixel_clk
  gosub Print_Clk_Info_Line cc_dsi1_s_ahb_clk
  gosub Print_Clk_Info_Line cc_dsi2_byte_clk
  gosub Print_Clk_Info_Line cc_dsi2_clk
  gosub Print_Clk_Info_Line cc_dsi2_esc_clk
  gosub Print_Clk_Info_Line cc_dsi2_m_ahb_clk
  gosub Print_Clk_Info_Line cc_dsi2_pixel_clk
  gosub Print_Clk_Info_Line cc_dsi2_s_ahb_clk
  gosub Print_Clk_Info_Line cc_fab_ahb_clk
  gosub Print_Clk_Info_Line cc_fab_core_clk
  gosub Print_Clk_Info_Line cc_fab_msp_axi_clk
  gosub Print_Clk_Info_Line cc_gfx2d0_ahb_clk
  gosub Print_Clk_Info_Line cc_gfx2d0_clk
  gosub Print_Clk_Info_Line cc_gfx2d1_ahb_clk
  gosub Print_Clk_Info_Line cc_gfx2d1_clk
  gosub Print_Clk_Info_Line cc_gfx3d_ahb_clk
  gosub Print_Clk_Info_Line cc_gfx3d_clk
  gosub Print_Clk_Info_Line cc_gmem_axi_clk
  gosub Print_Clk_Info_Line cc_hdmi_app_clk
  gosub Print_Clk_Info_Line cc_hdmi_m_ahb_clk
  gosub Print_Clk_Info_Line cc_hdmi_ref_clk
  gosub Print_Clk_Info_Line cc_hdmi_s_ahb_clk
  gosub Print_Clk_Info_Line cc_hdmi_tv_clk
  gosub Print_Clk_Info_Line cc_ijpeg_ahb_clk
  gosub Print_Clk_Info_Line cc_ijpeg_axi_clk
  gosub Print_Clk_Info_Line cc_ijpeg_clk
  gosub Print_Clk_Info_Line cc_imem_ahb_clk
  gosub Print_Clk_Info_Line cc_imem_axi_clk
  gosub Print_Clk_Info_Line cc_jpegd_ahb_clk
  gosub Print_Clk_Info_Line cc_jpegd_axi_clk
  gosub Print_Clk_Info_Line cc_jpegd_clk
  gosub Print_Clk_Info_Line cc_lut_mdp_clk
  gosub Print_Clk_Info_Line cc_mdp_ahb_clk
  gosub Print_Clk_Info_Line cc_mdp_axi_clk
  gosub Print_Clk_Info_Line cc_mdp_clk
  gosub Print_Clk_Info_Line cc_mdp_tv_clk
  gosub Print_Clk_Info_Line cc_mdp_vsync_clk
  gosub Print_Clk_Info_Line cc_mmss_fpb_aon_clk
  gosub Print_Clk_Info_Line cc_mmss_fpb_clk
  gosub Print_Clk_Info_Line cc_rot_ahb_clk
  gosub Print_Clk_Info_Line cc_rot_axi_clk
  gosub Print_Clk_Info_Line cc_rot_clk
  gosub Print_Clk_Info_Line cc_smmu_ahb_clk
  gosub Print_Clk_Info_Line cc_tv_dac_clk
  gosub Print_Clk_Info_Line cc_tv_enc_ahb_clk
  gosub Print_Clk_Info_Line cc_tv_enc_clk
  gosub Print_Clk_Info_Line cc_vcodec_ahb_clk
  gosub Print_Clk_Info_Line cc_vcodec_axi_A_clk
  gosub Print_Clk_Info_Line cc_vcodec_axi_B_clk
  gosub Print_Clk_Info_Line cc_vcodec_axi_clk
  gosub Print_Clk_Info_Line cc_vcodec_clk
  gosub Print_Clk_Info_Line cc_vcodec_pclk
  gosub Print_Clk_Info_Line cc_vfe_ahb_clk
  gosub Print_Clk_Info_Line cc_vfe_axi_clk
  gosub Print_Clk_Info_Line cc_vfe_clk
  gosub Print_Clk_Info_Line cc_vpe_ahb_clk
  gosub Print_Clk_Info_Line cc_vpe_axi_clk
  gosub Print_Clk_Info_Line cc_vpe_clk
  gosub Print_Clk_Info_Line dsi_ref_clk
  gosub Print_Clk_Info_Line ahb_main_hs_clk
  gosub Print_Clk_Info_Line ahb_main_ls_clk
  gosub Print_Clk_Info_Line cc_bt_clk
  gosub Print_Clk_Info_Line cc_ccpu_clk
  gosub Print_Clk_Info_Line cc_fm_clk
  gosub Print_Clk_Info_Line cc_wlan_phy_1_clk
  gosub Print_Clk_Info_Line cc_wlan_phy_2_clk
  gosub Print_Clk_Info_Line cc_wlan_rfif_clk
  gosub Print_Clk_Info_Line phy_adc_hs_clk
  gosub Print_Clk_Info_Line phy_adc_ls_clk
  gosub Print_Clk_Info_Line phy_dac_hs_clk
  gosub Print_Clk_Info_Line phy_dac_ls_clk
  gosub Print_Clk_Info_Line root3_120_clk
  gosub Print_Clk_Info_Line slp_clk
  gosub Print_Clk_Info_Line tck_clk
  gosub Print_Clk_Info_Line tcxo_clk
  gosub Print_Clk_Info_Line nav_main_clk
  gosub Print_Clk_Info_Line nav_adc1_clk
  gosub Print_Clk_Info_Line nav_adc2_clk
  gosub Print_Clk_Info_Line nav_rsref_clk
  gosub Print_Clk_Info_Line sys_apcsqsb_clk
  gosub Print_Clk_Info_Line apcc_sysl2leaf_clk
  gosub Print_Clk_Info_Line apc0_sysleaf_clk
  gosub Print_Clk_Info_Line apc1_sysleaf_clk
  gosub Print_Clk_Info_Line sys_apcsahb_clk
  gosub Print_Clk_Info_Line sys_apcsref_clk
  gosub Print_Clk_Info_Line sys_apcspisleep_clk
  gosub Print_Clk_Info_Line apb_apccdbg_clk
  gosub Print_Clk_Info_Line atb_apcc_clk
  return


Print_All_SS:

  if ("&choice"=="top_all")
  (
    gosub Print_Clk_Info_Line adm0_clk_raw
    gosub Print_Clk_Info_Line adm0_pbus_hclk
    gosub Print_Clk_Info_Line afab_axi_s0_fclk
    gosub Print_Clk_Info_Line afab_axi_s1_fclk
    gosub Print_Clk_Info_Line afab_axi_s2_fclk
    gosub Print_Clk_Info_Line afab_axi_s3_fclk
    gosub Print_Clk_Info_Line afab_axi_s4_fclk
    gosub Print_Clk_Info_Line afab_core_clk
    gosub Print_Clk_Info_Line afab_ebi1_ch1_aclk
    gosub Print_Clk_Info_Line afab_ebi1_s_aclk
    gosub Print_Clk_Info_Line afab_kpss_m0_aclk
    gosub Print_Clk_Info_Line afab_kpss_m1_aclk
    gosub Print_Clk_Info_Line afab_sfab_m0_aclk
    gosub Print_Clk_Info_Line afab_sfab_m1_aclk
    gosub Print_Clk_Info_Line afab_sfab_s_aclk
    gosub Print_Clk_Info_Line afab_smpss_s_aclk
    gosub Print_Clk_Info_Line bbrx_ssbi_clk
    gosub Print_Clk_Info_Line cc_ce1_core_clk
    gosub Print_Clk_Info_Line cc_ce1_hclk
    gosub Print_Clk_Info_Line cc_ce2_core_clk
    gosub Print_Clk_Info_Line cc_ce2_hclk
    gosub Print_Clk_Info_Line cc_gsbi10_hclk
    gosub Print_Clk_Info_Line cc_gsbi10_qup_apps_clk
    gosub Print_Clk_Info_Line cc_gsbi10_uart_apps_clk
    gosub Print_Clk_Info_Line cc_gsbi11_hclk
    gosub Print_Clk_Info_Line cc_gsbi11_qup_apps_clk
    gosub Print_Clk_Info_Line cc_gsbi11_qup_apps_clk
    gosub Print_Clk_Info_Line cc_gsbi11_uart_apps_clk
    gosub Print_Clk_Info_Line cc_gsbi12_hclk
    gosub Print_Clk_Info_Line cc_gsbi12_hclk
    gosub Print_Clk_Info_Line cc_gsbi12_qup_apps_clk
    gosub Print_Clk_Info_Line cc_gsbi12_qup_apps_clk
    gosub Print_Clk_Info_Line cc_gsbi12_uart_apps_clk
    gosub Print_Clk_Info_Line cc_gsbi1_hclk
    gosub Print_Clk_Info_Line cc_gsbi1_qup_apps_clk
    gosub Print_Clk_Info_Line cc_gsbi1_uart_apps_clk
    gosub Print_Clk_Info_Line cc_gsbi2_hclk
    gosub Print_Clk_Info_Line cc_gsbi2_qup_apps_clk
    gosub Print_Clk_Info_Line cc_gsbi2_uart_apps_clk
    gosub Print_Clk_Info_Line cc_gsbi3_hclk
    gosub Print_Clk_Info_Line cc_gsbi3_qup_apps_clk
    gosub Print_Clk_Info_Line cc_gsbi3_uart_apps_clk
    gosub Print_Clk_Info_Line cc_gsbi4_hclk
    gosub Print_Clk_Info_Line cc_gsbi4_qup_apps_clk
    gosub Print_Clk_Info_Line cc_gsbi4_uart_apps_clk
    gosub Print_Clk_Info_Line cc_gsbi5_hclk
    gosub Print_Clk_Info_Line cc_gsbi5_qup_apps_clk
    gosub Print_Clk_Info_Line cc_gsbi5_uart_apps_clk
    gosub Print_Clk_Info_Line cc_gsbi6_hclk
    gosub Print_Clk_Info_Line cc_gsbi6_qup_apps_clk
    gosub Print_Clk_Info_Line cc_gsbi6_uart_apps_clk
    gosub Print_Clk_Info_Line cc_gsbi7_hclk
    gosub Print_Clk_Info_Line cc_gsbi7_qup_apps_clk
    gosub Print_Clk_Info_Line cc_gsbi7_uart_apps_clk
    gosub Print_Clk_Info_Line cc_gsbi8_hclk
    gosub Print_Clk_Info_Line cc_gsbi8_qup_apps_clk
    gosub Print_Clk_Info_Line cc_gsbi8_uart_apps_clk
    gosub Print_Clk_Info_Line cc_gsbi9_hclk
    gosub Print_Clk_Info_Line cc_gsbi9_qup_apps_clk
    gosub Print_Clk_Info_Line cc_gsbi9_uart_apps_clk
    gosub Print_Clk_Info_Line cc_mss_q6fw_jtag_clk
    gosub Print_Clk_Info_Line cc_mss_q6sw_jtag_clk
    gosub Print_Clk_Info_Line cc_mss_s_hclk
    gosub Print_Clk_Info_Line cc_mss_slp_clk
    gosub Print_Clk_Info_Line cc_pmic_arb0_hclk
    gosub Print_Clk_Info_Line cc_pmic_arb1_hclk
    gosub Print_Clk_Info_Line cc_pmic_ssbi2_clk
    gosub Print_Clk_Info_Line cc_q6fw_core_clk
    gosub Print_Clk_Info_Line cc_q6sw_core_clk
    gosub Print_Clk_Info_Line cc_qdss_at_clk
    gosub Print_Clk_Info_Line cc_qdss_hclk
    gosub Print_Clk_Info_Line cc_qdss_pclkdbg_clk
    gosub Print_Clk_Info_Line cc_qdss_stm_clk
    gosub Print_Clk_Info_Line cc_qdss_traceclkin_clk
    gosub Print_Clk_Info_Line cc_qdss_tsctr_clk
    gosub Print_Clk_Info_Line cc_sdc1_apps_clk
    gosub Print_Clk_Info_Line cc_sdc1_hclk
    gosub Print_Clk_Info_Line cc_sdc2_apps_clk
    gosub Print_Clk_Info_Line cc_sdc2_hclk
    gosub Print_Clk_Info_Line cc_sdc3_apps_clk
    gosub Print_Clk_Info_Line cc_sdc3_hclk
    gosub Print_Clk_Info_Line cc_sdc4_apps_clk
    gosub Print_Clk_Info_Line cc_sdc4_hclk
    gosub Print_Clk_Info_Line cc_sdc5_apps_clk
    gosub Print_Clk_Info_Line cc_sdc5_hclk
    gosub Print_Clk_Info_Line cc_sfab_mss_m_aclk
    gosub Print_Clk_Info_Line cc_sfab_mss_q6fw_aclk
    gosub Print_Clk_Info_Line cc_sfab_mss_q6sw_aclk
    gosub Print_Clk_Info_Line cc_sfab_mss_s_hclk
    gosub Print_Clk_Info_Line cc_usb_fs1_hclk
    gosub Print_Clk_Info_Line cc_usb_fs1_system_clk
    gosub Print_Clk_Info_Line cc_usb_fs1_xcvr_fs_clk
    gosub Print_Clk_Info_Line cc_usb_fs2_hclk
    gosub Print_Clk_Info_Line cc_usb_fs2_system_clk
    gosub Print_Clk_Info_Line cc_usb_fs2_xcvr_fs_clk
    gosub Print_Clk_Info_Line cc_usb_hs1_hclk
    gosub Print_Clk_Info_Line cc_usb_hs1_xcvr_fs_clk
    gosub Print_Clk_Info_Line ce1_sleep_clk
    gosub Print_Clk_Info_Line cfpb0_c0_hclk
    gosub Print_Clk_Info_Line cfpb0_c1_hclk
    gosub Print_Clk_Info_Line cfpb0_d0_hclk
    gosub Print_Clk_Info_Line cfpb0_d1_hclk
    gosub Print_Clk_Info_Line cfpb0_hclk
    gosub Print_Clk_Info_Line cfpb1_hclk
    gosub Print_Clk_Info_Line cfpb2_hclk
    gosub Print_Clk_Info_Line cfpb_master_hclk
    gosub Print_Clk_Info_Line cfpb_master_nohwgate_hclk
    gosub Print_Clk_Info_Line cfpb_splitter_hclk
    gosub Print_Clk_Info_Line ddr_clk
    gosub Print_Clk_Info_Line dfab_a2_hclk
    gosub Print_Clk_Info_Line dfab_arb0_hclk
    gosub Print_Clk_Info_Line dfab_arb1_hclk
    gosub Print_Clk_Info_Line dfab_core_clk
    gosub Print_Clk_Info_Line dfab_sfab_m_aclk
    gosub Print_Clk_Info_Line dfab_sfab_s_aclk
    gosub Print_Clk_Info_Line dfab_sway0_hclk
    gosub Print_Clk_Info_Line dfab_sway1_hclk
    gosub Print_Clk_Info_Line dma_bam_hclk
    gosub Print_Clk_Info_Line ebi1_ch0_ca_xo_src
    gosub Print_Clk_Info_Line ebi1_ch0_cc_dbg_hs_clk
    gosub Print_Clk_Info_Line ebi1_ch0_dq_xo_src
    gosub Print_Clk_Info_Line ebi1_ch1_ca_xo_src
    gosub Print_Clk_Info_Line ebi1_ch1_cc_dbg_hs_clk
    gosub Print_Clk_Info_Line ebi1_ch1_dq_xo_src
    gosub Print_Clk_Info_Line ebi1_clk_src
    gosub Print_Clk_Info_Line ebi1_xo_src
    gosub Print_Clk_Info_Line gp0_clk
    gosub Print_Clk_Info_Line gp1_clk
    gosub Print_Clk_Info_Line gp2_clk
    gosub Print_Clk_Info_Line cc_gsbi10_sim_clk_src
    gosub Print_Clk_Info_Line cc_gsbi11_sim_clk_src
    gosub Print_Clk_Info_Line cc_gsbi12_sim_clk_src
    gosub Print_Clk_Info_Line cc_gsbi1_sim_clk_src
    gosub Print_Clk_Info_Line cc_gsbi2_sim_clk_src
    gosub Print_Clk_Info_Line cc_gsbi3_sim_clk_src
    gosub Print_Clk_Info_Line cc_gsbi4_sim_clk_src
    gosub Print_Clk_Info_Line cc_gsbi5_sim_clk_src
    gosub Print_Clk_Info_Line cc_gsbi6_sim_clk_src
    gosub Print_Clk_Info_Line cc_gsbi7_sim_clk_src
    gosub Print_Clk_Info_Line cc_gsbi8_sim_clk_src
    gosub Print_Clk_Info_Line cc_gsbi9_sim_clk_src
    gosub Print_Clk_Info_Line imem0_aclk
    gosub Print_Clk_Info_Line low_speed_debug_clock
    gosub Print_Clk_Info_Line lpass_cc_dbg_hs_in_clk
    gosub Print_Clk_Info_Line lpass_cc_dbg_ls_in_clk
    gosub Print_Clk_Info_Line lpass_cxo_src
    gosub Print_Clk_Info_Line lpass_mxo_src
    gosub Print_Clk_Info_Line lpass_pxo_src
    gosub Print_Clk_Info_Line lpass_q6_cc_dbg_hs_in_clk
    gosub Print_Clk_Info_Line lpass_q6_cc_dbg_ls_in_clk
    gosub Print_Clk_Info_Line mmfab_sync_src
    gosub Print_Clk_Info_Line mmss_cc_dbg_hs_in_clk
    gosub Print_Clk_Info_Line mmss_cc_dbg_ls_in_clk
    gosub Print_Clk_Info_Line mmss_mxo_src
    gosub Print_Clk_Info_Line mmss_pxo_src
    gosub Print_Clk_Info_Line mpm_hclk
    gosub Print_Clk_Info_Line mss_dbg_hs_clk
    gosub Print_Clk_Info_Line mss_dbg_ls_clk
    gosub Print_Clk_Info_Line mss_xpu_clk
    gosub Print_Clk_Info_Line pcie_aclk
    gosub Print_Clk_Info_Line pdm_clk
    gosub Print_Clk_Info_Line pdm_xo4_clk
    gosub Print_Clk_Info_Line cc_pmem_aclk
    gosub Print_Clk_Info_Line ppss_hclk
    gosub Print_Clk_Info_Line ppss_proc_clk
    gosub Print_Clk_Info_Line ppss_timer0_clk
    gosub Print_Clk_Info_Line ppss_timer1_clk
    gosub Print_Clk_Info_Line prng_clk
    gosub Print_Clk_Info_Line q6fw_cc_dbg_hs_clk
    gosub Print_Clk_Info_Line q6fw_cc_dbg_ls_clk
    gosub Print_Clk_Info_Line q6sw_cc_dbg_hs_clk
    gosub Print_Clk_Info_Line q6sw_cc_dbg_ls_clk
    gosub Print_Clk_Info_Line ring_osc_clk
    gosub Print_Clk_Info_Line riva_cc_dbg_clk_hs
    gosub Print_Clk_Info_Line riva_cc_dbg_clk_ls
    gosub Print_Clk_Info_Line rpm_bus_hclk
    gosub Print_Clk_Info_Line rpm_msg_ram_hclk
    gosub Print_Clk_Info_Line rpm_proc_clk
    gosub Print_Clk_Info_Line rpm_sleep_clk
    gosub Print_Clk_Info_Line rpm_timer_clk
    gosub Print_Clk_Info_Line sc_aclk
    gosub Print_Clk_Info_Line sc_cc_dbg_ls_clk
    gosub Print_Clk_Info_Line sc_dbg_clk
    gosub Print_Clk_Info_Line sc_dbg_hs0_clk
    gosub Print_Clk_Info_Line sc_dbg_hs1_clk
    gosub Print_Clk_Info_Line sc_dbg_hs2_clk
    gosub Print_Clk_Info_Line sc_hclk
    gosub Print_Clk_Info_Line sc_l2_clk
    gosub Print_Clk_Info_Line sc_xo_src
    gosub Print_Clk_Info_Line sec_ctrl_acc_clk
    gosub Print_Clk_Info_Line sec_ctrl_clk
    gosub Print_Clk_Info_Line sfab_adm0_m0_aclk
    gosub Print_Clk_Info_Line sfab_adm0_m1_aclk
    gosub Print_Clk_Info_Line sfab_adm0_m2_hclk
    gosub Print_Clk_Info_Line sfab_afab_m_aclk
    gosub Print_Clk_Info_Line sfab_afab_s0_aclk
    gosub Print_Clk_Info_Line sfab_afab_s1_aclk
    gosub Print_Clk_Info_Line sfab_ahb_s0_fclk
    gosub Print_Clk_Info_Line sfab_ahb_s1_fclk
    gosub Print_Clk_Info_Line sfab_ahb_s2_fclk
    gosub Print_Clk_Info_Line sfab_ahb_s3_fclk
    gosub Print_Clk_Info_Line sfab_ahb_s4_fclk
    gosub Print_Clk_Info_Line sfab_ahb_s5_fclk
    gosub Print_Clk_Info_Line sfab_ahb_s6_fclk
    gosub Print_Clk_Info_Line sfab_axi_s0_fclk
    gosub Print_Clk_Info_Line sfab_axi_s1_fclk
    gosub Print_Clk_Info_Line sfab_axi_s2_fclk
    gosub Print_Clk_Info_Line sfab_axi_s3_fclk
    gosub Print_Clk_Info_Line sfab_axi_s4_fclk
    gosub Print_Clk_Info_Line sfab_cfpb_m_hclk
    gosub Print_Clk_Info_Line sfab_cfpb_s_hclk
    gosub Print_Clk_Info_Line sfab_core_clk
    gosub Print_Clk_Info_Line sfab_dfab_s_aclk
    gosub Print_Clk_Info_Line sfab_lpass_q6_aclk
    gosub Print_Clk_Info_Line sfab_sfpb_m_hclk
    gosub Print_Clk_Info_Line sfab_sfpb_s_hclk
    gosub Print_Clk_Info_Line sfab_smpss_s_hclk
    gosub Print_Clk_Info_Line sfab_usb3_m_aclk
    gosub Print_Clk_Info_Line sfpb_hclk
    gosub Print_Clk_Info_Line sfpb_nohwgate_hclk
    gosub Print_Clk_Info_Line sic_hclk
    gosub Print_Clk_Info_Line slimbus_hclk
    gosub Print_Clk_Info_Line slimbus_xo_src
    gosub Print_Clk_Info_Line spdm_cfg_hclk
    gosub Print_Clk_Info_Line spdm_cy_port0_clk
    gosub Print_Clk_Info_Line spdm_cy_port1_clk
    gosub Print_Clk_Info_Line spdm_cy_port2_clk
    gosub Print_Clk_Info_Line spdm_cy_port3_clk
    gosub Print_Clk_Info_Line spdm_cy_port4_clk
    gosub Print_Clk_Info_Line spdm_cy_port5_clk
    gosub Print_Clk_Info_Line spdm_cy_port6_clk
    gosub Print_Clk_Info_Line spdm_cy_port7_clk
    gosub Print_Clk_Info_Line spdm_ff_clk
    gosub Print_Clk_Info_Line spdm_mstr_hclk
    gosub Print_Clk_Info_Line sps_tic_hclk
    gosub Print_Clk_Info_Line tlmm_clk
    gosub Print_Clk_Info_Line tlmm_hclk
    gosub Print_Clk_Info_Line tsif_hclk_raw
    gosub Print_Clk_Info_Line tsif_inactivity_timers_clk
    gosub Print_Clk_Info_Line tsif_ref_clk
    gosub Print_Clk_Info_Line tssc_clk
    gosub Print_Clk_Info_Line usb_hs2_hclk
    gosub Print_Clk_Info_Line usb_hs2_system_clk
    gosub Print_Clk_Info_Line usb_hs2_xcvr_fs_clk
    gosub Print_Clk_Info_Line voltage_sensor_debug_clock
    &choice_handled=1
    return
  )
  if ("&choice"=="lpass_all")
  (
    gosub Print_Clk_Info_Line lcc_ahb_hclk
    gosub Print_Clk_Info_Line lcc_aif_hclk
    gosub Print_Clk_Info_Line lcc_avt_hclk
    gosub Print_Clk_Info_Line lcc_avt_mclk
    gosub Print_Clk_Info_Line lcc_avt_pclk
    gosub Print_Clk_Info_Line lcc_avt_riva_bt_clk
    gosub Print_Clk_Info_Line lcc_avt_riva_fm_clk
    gosub Print_Clk_Info_Line lcc_codec_i2s_mic_bit_clk
    gosub Print_Clk_Info_Line lcc_codec_i2s_spkr_bit_clk
    gosub Print_Clk_Info_Line lcc_core_csr_hclk
    gosub Print_Clk_Info_Line lcc_dml_hclk
    gosub Print_Clk_Info_Line lcc_ebus_hclk
    gosub Print_Clk_Info_Line lcc_fab_lpb_hclk
    gosub Print_Clk_Info_Line lcc_ibus_hclk
    gosub Print_Clk_Info_Line lcc_lpaif_csr_hclk
    gosub Print_Clk_Info_Line lcc_lpb_fab_hclk
    gosub Print_Clk_Info_Line lcc_lpm_hclk
    gosub Print_Clk_Info_Line lcc_mi2s_bit_clk
    gosub Print_Clk_Info_Line lcc_midi_clk
    gosub Print_Clk_Info_Line lcc_midi_hclk
    gosub Print_Clk_Info_Line lcc_pcm_clk
    gosub Print_Clk_Info_Line lcc_q6_fracdiv_clk
    gosub Print_Clk_Info_Line lcc_q6_func_clk
    gosub Print_Clk_Info_Line lcc_q6_jtag_clk
    gosub Print_Clk_Info_Line lcc_q6_slp_clk
    gosub Print_Clk_Info_Line lcc_q6_tcxo_clk
    gosub Print_Clk_Info_Line lcc_q6ss_hclk
    gosub Print_Clk_Info_Line lcc_security_hclk
    gosub Print_Clk_Info_Line lcc_slimbus_core_clk
    gosub Print_Clk_Info_Line lcc_slimbus_hclk
    gosub Print_Clk_Info_Line lcc_spare_i2s_mic_bit_clk
    gosub Print_Clk_Info_Line lcc_spare_i2s_spkr_bit_clk
    &choice_handled=1
    return
  )
  if ("&choice"=="mmss_all")
  (
    gosub Print_Clk_Info_Line axi_s0_clk
    gosub Print_Clk_Info_Line axi_s0_fclk
    gosub Print_Clk_Info_Line cc_amp_ahb_clk
    gosub Print_Clk_Info_Line cc_apu_ahb_clk
    gosub Print_Clk_Info_Line cc_axi_s1_clk
    gosub Print_Clk_Info_Line cc_axi_s1_fclk
    gosub Print_Clk_Info_Line cc_axi_s2_clk
    gosub Print_Clk_Info_Line cc_axi_s2_fclk
    gosub Print_Clk_Info_Line cc_axi_s3_fclk
    gosub Print_Clk_Info_Line cc_cam0clk_po
    gosub Print_Clk_Info_Line cc_cam1clk_po
    gosub Print_Clk_Info_Line cc_csi0_clk
    gosub Print_Clk_Info_Line cc_csi0_phy_clk
    gosub Print_Clk_Info_Line cc_csi1_clk
    gosub Print_Clk_Info_Line cc_csi1_phy_clk
    gosub Print_Clk_Info_Line cc_csi_ahb_clk
    gosub Print_Clk_Info_Line cc_csi_pix_clk
    gosub Print_Clk_Info_Line cc_csi_rdi_clk
    gosub Print_Clk_Info_Line cc_csi_vfe_clk
    gosub Print_Clk_Info_Line cc_csiphy0_timer_clk
    gosub Print_Clk_Info_Line cc_csiphy1_timer_clk
    gosub Print_Clk_Info_Line cc_dsi1_byte_clk
    gosub Print_Clk_Info_Line cc_dsi1_clk
    gosub Print_Clk_Info_Line cc_dsi1_esc_clk
    gosub Print_Clk_Info_Line cc_dsi1_m_ahb_clk
    gosub Print_Clk_Info_Line cc_dsi1_pixel_clk
    gosub Print_Clk_Info_Line cc_dsi1_s_ahb_clk
    gosub Print_Clk_Info_Line cc_dsi2_byte_clk
    gosub Print_Clk_Info_Line cc_dsi2_clk
    gosub Print_Clk_Info_Line cc_dsi2_esc_clk
    gosub Print_Clk_Info_Line cc_dsi2_m_ahb_clk
    gosub Print_Clk_Info_Line cc_dsi2_pixel_clk
    gosub Print_Clk_Info_Line cc_dsi2_s_ahb_clk
    gosub Print_Clk_Info_Line cc_fab_ahb_clk
    gosub Print_Clk_Info_Line cc_fab_core_clk
    gosub Print_Clk_Info_Line cc_fab_msp_axi_clk
    gosub Print_Clk_Info_Line cc_gfx2d0_ahb_clk
    gosub Print_Clk_Info_Line cc_gfx2d0_clk
    gosub Print_Clk_Info_Line cc_gfx2d1_ahb_clk
    gosub Print_Clk_Info_Line cc_gfx2d1_clk
    gosub Print_Clk_Info_Line cc_gfx3d_ahb_clk
    gosub Print_Clk_Info_Line cc_gfx3d_clk
    gosub Print_Clk_Info_Line cc_gmem_axi_clk
    gosub Print_Clk_Info_Line cc_hdmi_app_clk
    gosub Print_Clk_Info_Line cc_hdmi_m_ahb_clk
    gosub Print_Clk_Info_Line cc_hdmi_ref_clk
    gosub Print_Clk_Info_Line cc_hdmi_s_ahb_clk
    gosub Print_Clk_Info_Line cc_hdmi_tv_clk
    gosub Print_Clk_Info_Line cc_ijpeg_ahb_clk
    gosub Print_Clk_Info_Line cc_ijpeg_axi_clk
    gosub Print_Clk_Info_Line cc_ijpeg_clk
    gosub Print_Clk_Info_Line cc_imem_ahb_clk
    gosub Print_Clk_Info_Line cc_imem_axi_clk
    gosub Print_Clk_Info_Line cc_jpegd_ahb_clk
    gosub Print_Clk_Info_Line cc_jpegd_axi_clk
    gosub Print_Clk_Info_Line cc_jpegd_clk
    gosub Print_Clk_Info_Line cc_lut_mdp_clk
    gosub Print_Clk_Info_Line cc_mdp_ahb_clk
    gosub Print_Clk_Info_Line cc_mdp_axi_clk
    gosub Print_Clk_Info_Line cc_mdp_clk
    gosub Print_Clk_Info_Line cc_mdp_tv_clk
    gosub Print_Clk_Info_Line cc_mdp_vsync_clk
    gosub Print_Clk_Info_Line cc_mmss_fpb_aon_clk
    gosub Print_Clk_Info_Line cc_mmss_fpb_clk
    gosub Print_Clk_Info_Line cc_rot_ahb_clk
    gosub Print_Clk_Info_Line cc_rot_axi_clk
    gosub Print_Clk_Info_Line cc_rot_clk
    gosub Print_Clk_Info_Line cc_smmu_ahb_clk
    gosub Print_Clk_Info_Line cc_tv_dac_clk
    gosub Print_Clk_Info_Line cc_tv_enc_ahb_clk
    gosub Print_Clk_Info_Line cc_tv_enc_clk
    gosub Print_Clk_Info_Line cc_vcodec_ahb_clk
    gosub Print_Clk_Info_Line cc_vcodec_axi_A_clk
    gosub Print_Clk_Info_Line cc_vcodec_axi_B_clk
    gosub Print_Clk_Info_Line cc_vcodec_axi_clk
    gosub Print_Clk_Info_Line cc_vcodec_clk
    gosub Print_Clk_Info_Line cc_vcodec_pclk
    gosub Print_Clk_Info_Line cc_vfe_ahb_clk
    gosub Print_Clk_Info_Line cc_vfe_axi_clk
    gosub Print_Clk_Info_Line cc_vfe_clk
    gosub Print_Clk_Info_Line cc_vpe_ahb_clk
    gosub Print_Clk_Info_Line cc_vpe_axi_clk
    gosub Print_Clk_Info_Line cc_vpe_clk
    gosub Print_Clk_Info_Line dsi_ref_clk
    &choice_handled=1
    return
  )
  if ("&choice"=="riva_all")
  (
    gosub Print_Clk_Info_Line ahb_main_hs_clk
    gosub Print_Clk_Info_Line ahb_main_ls_clk
    gosub Print_Clk_Info_Line cc_bt_clk
    gosub Print_Clk_Info_Line cc_ccpu_clk
    gosub Print_Clk_Info_Line cc_fm_clk
    gosub Print_Clk_Info_Line cc_wlan_phy_1_clk
    gosub Print_Clk_Info_Line cc_wlan_phy_2_clk
    gosub Print_Clk_Info_Line cc_wlan_rfif_clk
    gosub Print_Clk_Info_Line phy_adc_hs_clk
    gosub Print_Clk_Info_Line phy_adc_ls_clk
    gosub Print_Clk_Info_Line phy_dac_hs_clk
    gosub Print_Clk_Info_Line phy_dac_ls_clk
    gosub Print_Clk_Info_Line root3_120_clk
    gosub Print_Clk_Info_Line slp_clk
    gosub Print_Clk_Info_Line tck_clk
    gosub Print_Clk_Info_Line tcxo_clk
    &choice_handled=1
    return
  )
  if ("&choice"=="apcs_all")
  (
    gosub Print_Clk_Info_Line sys_apcsqsb_clk
    gosub Print_Clk_Info_Line apcc_sysl2leaf_clk
    gosub Print_Clk_Info_Line apc0_sysleaf_clk
    gosub Print_Clk_Info_Line apc1_sysleaf_clk
    gosub Print_Clk_Info_Line sys_apcsahb_clk
    gosub Print_Clk_Info_Line sys_apcsref_clk
    gosub Print_Clk_Info_Line sys_apcspisleep_clk
    gosub Print_Clk_Info_Line apb_apccdbg_clk
    gosub Print_Clk_Info_Line atb_apcc_clk
    &choice_handled=1
    return
  )
  if ("&choice"=="nav_all")
  (
    gosub Print_Clk_Info_Line nav_main_clk
    gosub Print_Clk_Info_Line nav_adc1_clk
    gosub Print_Clk_Info_Line nav_adc2_clk
    gosub Print_Clk_Info_Line nav_rsref_clk
    return
  )
  return


Find_Clock:

  ENTRY  &clk

  if "&clk"=="adm0_clk_raw"
  (
    &clk_test=&CLK_TEST_ADM0_CLK_RAW
    &is_on=2
  )
  else if "&clk"=="adm0_pbus_hclk"
  (
    &clk_test=&CLK_TEST_ADM0_PBUS_HCLK
    &is_on=2
  )
  else if "&clk"=="afab_axi_s0_fclk"
  (
    &clk_test=&CLK_TEST_AFAB_AXI_S0_FCLK
    &is_on=2
  )
  else if "&clk"=="afab_axi_s1_fclk"
  (
    &clk_test=&CLK_TEST_AFAB_AXI_S1_FCLK
    &is_on=2
  )
  else if "&clk"=="afab_axi_s2_fclk"
  (
    &clk_test=&CLK_TEST_AFAB_AXI_S2_FCLK
    &is_on=2
  )
  else if "&clk"=="afab_axi_s3_fclk"
  (
    &clk_test=&CLK_TEST_AFAB_AXI_S3_FCLK
    &is_on=2
  )
  else if "&clk"=="afab_axi_s4_fclk"
  (
    &clk_test=&CLK_TEST_AFAB_AXI_S4_FCLK
    &is_on=2
  )
  else if "&clk"=="afab_core_clk"
  (
    &clk_test=&CLK_TEST_AFAB_CORE_CLK
    &is_on=2
  )
  else if "&clk"=="afab_ebi1_ch1_aclk"
  (
    &clk_test=&CLK_TEST_AFAB_EBI1_CH1_ACLK
    &is_on=2
  )
  else if "&clk"=="afab_ebi1_s_aclk"
  (
    &clk_test=&CLK_TEST_AFAB_EBI1_S_ACLK
    &is_on=2
  )
  else if "&clk"=="afab_kpss_m0_aclk"
  (
    &clk_test=&CLK_TEST_AFAB_KPSS_M0_ACLK
    &is_on=2
  )
  else if "&clk"=="afab_kpss_m1_aclk"
  (
    &clk_test=&CLK_TEST_AFAB_KPSS_M1_ACLK
    &is_on=2
  )
  else if "&clk"=="afab_sfab_m0_aclk"
  (
    &clk_test=&CLK_TEST_AFAB_SFAB_M0_ACLK
    &is_on=2
  )
  else if "&clk"=="afab_sfab_m1_aclk"
  (
    &clk_test=&CLK_TEST_AFAB_SFAB_M1_ACLK
    &is_on=2
  )
  else if "&clk"=="afab_sfab_s_aclk"
  (
    &clk_test=&CLK_TEST_AFAB_SFAB_S_ACLK
    &is_on=2
  )
  else if "&clk"=="afab_smpss_s_aclk"
  (
    &clk_test=&CLK_TEST_AFAB_SMPSS_S_ACLK
    &is_on=2
  )
  else if "&clk"=="bbrx_ssbi_clk"
  (
    &clk_test=&CLK_TEST_BBRX_SSBI_CLK
    &is_on=2
  )
  else if "&clk"=="cc_ce1_core_clk"
  (
    &clk_test=&CLK_TEST_CE1_CORE_CLK
    &clk_reg="CE1_CORE_CLK_CTL"
    if (data.long(a:&HWIO_CLK_HALT_CFPB_STATEC_PHYS)&(&HWIO_CLK_HALT_CFPB_STATEC_CE1_CORE_CLK_BMSK))==0
    (
      &is_on=1
    )
  )
  else if "&clk"=="cc_ce1_hclk"
  (
    &clk_test=&CLK_TEST_CE1_HCLK
    &clk_reg="CE1_HCLK_CTL"
    if (data.long(a:&HWIO_CLK_HALT_CFPB_STATEC_PHYS)&(&HWIO_CLK_HALT_CFPB_STATEC_CE1_HCLK_BMSK))==0
    (
      &is_on=1
    )
  )
  else if "&clk"=="cc_ce2_core_clk"
  (
    &clk_test=&CLK_TEST_CE2_CORE_CLK
    &clk_reg="CE2_CORE_CLK_CTL"
    if (data.long(a:&HWIO_CLK_HALT_CFPB_STATEB_PHYS)&(&HWIO_CLK_HALT_CFPB_STATEB_CE2_CORE_CLK_BMSK))==0
    (
      &is_on=1
    )
  )
  else if "&clk"=="cc_ce2_hclk"
  (
    &clk_test=&CLK_TEST_CE2_HCLK
    &clk_reg="CE2_HCLK_CTL"
    if (data.long(a:&HWIO_CLK_HALT_CFPB_STATEC_PHYS)&(&HWIO_CLK_HALT_CFPB_STATEC_CE2_HCLK_BMSK))==0
    (
      &is_on=1
    )
  )
  else if "&clk"=="cc_gsbi10_hclk"
  (
    &clk_test=&CLK_TEST_GSBI10_HCLK
    &clk_reg="GSBIn_HCLK_CTL[10]"
    if (data.long(a:&HWIO_CLK_HALT_CFPB_STATEB_PHYS)&(&HWIO_CLK_HALT_CFPB_STATEB_GSBI10_HCLK_BMSK))==0
    (
      &is_on=1
    )
  )
  else if "&clk"=="cc_gsbi10_qup_apps_clk"
  (
    &clk_test=&CLK_TEST_GSBI10_QUP_APPS_CLK
    &clk_reg="GSBIn_QUP_APPS_NS[10]"
    if (data.long(a:&HWIO_CLK_HALT_CFPB_STATEB_PHYS)&(&HWIO_CLK_HALT_CFPB_STATEB_GSBI10_QUP_APPS_CLK_BMSK))==0
    (
      &is_on=1
    )
  )
  else if "&clk"=="cc_gsbi10_uart_apps_clk"
  (
    &clk_test=&CLK_TEST_GSBI10_UART_APPS_CLK
    &clk_reg="GSBIn_UART_APPS_NS[10]"
    if (data.long(a:&HWIO_CLK_HALT_CFPB_STATEB_PHYS)&(&HWIO_CLK_HALT_CFPB_STATEB_GSBI10_UART_APPS_CLK_BMSK))==0
    (
      &is_on=1
    )
  )
  else if "&clk"=="cc_gsbi11_hclk"
  (
    &clk_test=&CLK_TEST_GSBI11_HCLK
    &clk_reg="GSBIn_HCLK_CTL[11]"
    if (data.long(a:&HWIO_CLK_HALT_CFPB_STATEC_PHYS)&(&HWIO_CLK_HALT_CFPB_STATEC_GSBI11_HCLK_BMSK))==0
    (
      &is_on=1
    )
  )
  else if "&clk"=="cc_gsbi11_qup_apps_clk"
  (
    &clk_test=&CLK_TEST_GSBI11_QUP_APPS_CLK
    &clk_reg="GSBIn_QUP_APPS_NS[11]"
    if (data.long(a:&HWIO_CLK_HALT_CFPB_STATEC_PHYS)&(&HWIO_CLK_HALT_CFPB_STATEC_GSBI11_QUP_APPS_CLK_BMSK))==0
    (
      &is_on=1
    )
  )
  else if "&clk"=="cc_gsbi11_qup_apps_clk"
  (
    &clk_test=&CLK_TEST_GSBI11_QUP_APPS_CLK
    &clk_reg="GSBIn_QUP_APPS_NS[11]"
    if (data.long(a:&HWIO_CLK_HALT_CFPB_STATEC_PHYS)&(&HWIO_CLK_HALT_CFPB_STATEC_GSBI11_QUP_APPS_CLK_BMSK))==0
    (
      &is_on=1
    )
  )
  else if "&clk"=="cc_gsbi11_uart_apps_clk"
  (
    &clk_test=&CLK_TEST_GSBI11_UART_APPS_CLK
    &clk_reg="GSBIn_UART_APPS_NS[11]"
    if (data.long(a:&HWIO_CLK_HALT_CFPB_STATEC_PHYS)&(&HWIO_CLK_HALT_CFPB_STATEC_GSBI11_UART_APPS_CLK_BMSK))==0
    (
      &is_on=1
    )
  )
  else if "&clk"=="cc_gsbi12_hclk"
  (
    &clk_test=&CLK_TEST_GSBI12_HCLK
    &clk_reg="GSBIn_HCLK_CTL[12]"
    if (data.long(a:&HWIO_CLK_HALT_CFPB_STATEC_PHYS)&(&HWIO_CLK_HALT_CFPB_STATEC_GSBI12_HCLK_BMSK))==0
    (
      &is_on=1
    )
  )
  else if "&clk"=="cc_gsbi12_hclk"
  (
    &clk_test=&CLK_TEST_GSBI12_HCLK
    &clk_reg="GSBIn_HCLK_CTL[12]"
    if (data.long(a:&HWIO_CLK_HALT_CFPB_STATEC_PHYS)&(&HWIO_CLK_HALT_CFPB_STATEC_GSBI12_HCLK_BMSK))==0
    (
      &is_on=1
    )
  )
  else if "&clk"=="cc_gsbi12_qup_apps_clk"
  (
    &clk_test=&CLK_TEST_GSBI12_QUP_APPS_CLK
    &clk_reg="GSBIn_QUP_APPS_NS[12]"
    if (data.long(a:&HWIO_CLK_HALT_CFPB_STATEC_PHYS)&(&HWIO_CLK_HALT_CFPB_STATEC_GSBI12_QUP_APPS_CLK_BMSK))==0
    (
      &is_on=1
    )
  )
  else if "&clk"=="cc_gsbi12_qup_apps_clk"
  (
    &clk_test=&CLK_TEST_GSBI12_QUP_APPS_CLK
    &clk_reg="GSBIn_QUP_APPS_NS[12]"
    if (data.long(a:&HWIO_CLK_HALT_CFPB_STATEC_PHYS)&(&HWIO_CLK_HALT_CFPB_STATEC_GSBI12_QUP_APPS_CLK_BMSK))==0
    (
      &is_on=1
    )
  )
  else if "&clk"=="cc_gsbi12_uart_apps_clk"
  (
    &clk_test=&CLK_TEST_GSBI12_UART_APPS_CLK
    &clk_reg="GSBIn_UART_APPS_NS[12]"
    if (data.long(a:&HWIO_CLK_HALT_CFPB_STATEC_PHYS)&(&HWIO_CLK_HALT_CFPB_STATEC_GSBI12_UART_APPS_CLK_BMSK))==0
    (
      &is_on=1
    )
  )
  else if "&clk"=="cc_gsbi1_hclk"
  (
    &clk_test=&CLK_TEST_GSBI1_HCLK
    &clk_reg="GSBIn_HCLK_CTL[1]"
    if (data.long(a:&HWIO_CLK_HALT_CFPB_STATEA_PHYS)&(&HWIO_CLK_HALT_CFPB_STATEA_GSBI1_HCLK_BMSK))==0
    (
      &is_on=1
    )
  )
  else if "&clk"=="cc_gsbi1_qup_apps_clk"
  (
    &clk_test=&CLK_TEST_GSBI1_QUP_APPS_CLK
    &clk_reg="GSBIn_QUP_APPS_NS[1]"
    if (data.long(a:&HWIO_CLK_HALT_CFPB_STATEA_PHYS)&(&HWIO_CLK_HALT_CFPB_STATEA_GSBI1_QUP_APPS_CLK_BMSK))==0
    (
      &is_on=1
    )
  )
  else if "&clk"=="cc_gsbi1_uart_apps_clk"
  (
    &clk_test=&CLK_TEST_GSBI1_UART_APPS_CLK
    &clk_reg="GSBIn_UART_APPS_NS[1]"
    if (data.long(a:&HWIO_CLK_HALT_CFPB_STATEA_PHYS)&(&HWIO_CLK_HALT_CFPB_STATEA_GSBI1_UART_APPS_CLK_BMSK))==0
    (
      &is_on=1
    )
  )
  else if "&clk"=="cc_gsbi2_hclk"
  (
    &clk_test=&CLK_TEST_GSBI2_HCLK
    &clk_reg="GSBIn_HCLK_CTL[2]"
    if (data.long(a:&HWIO_CLK_HALT_CFPB_STATEA_PHYS)&(&HWIO_CLK_HALT_CFPB_STATEA_GSBI2_HCLK_BMSK))==0
    (
      &is_on=1
    )
  )
  else if "&clk"=="cc_gsbi2_qup_apps_clk"
  (
    &clk_test=&CLK_TEST_GSBI2_QUP_APPS_CLK
    &clk_reg="GSBIn_QUP_APPS_NS[2]"
    if (data.long(a:&HWIO_CLK_HALT_CFPB_STATEA_PHYS)&(&HWIO_CLK_HALT_CFPB_STATEA_GSBI2_QUP_APPS_CLK_BMSK))==0
    (
      &is_on=1
    )
  )
  else if "&clk"=="cc_gsbi2_uart_apps_clk"
  (
    &clk_test=&CLK_TEST_GSBI2_UART_APPS_CLK
    &clk_reg="GSBIn_UART_APPS_NS[2]"
    if (data.long(a:&HWIO_CLK_HALT_CFPB_STATEA_PHYS)&(&HWIO_CLK_HALT_CFPB_STATEA_GSBI2_UART_APPS_CLK_BMSK))==0
    (
      &is_on=1
    )
  )
  else if "&clk"=="cc_gsbi3_hclk"
  (
    &clk_test=&CLK_TEST_GSBI3_HCLK
    &clk_reg="GSBIn_HCLK_CTL[3]"
    if (data.long(a:&HWIO_CLK_HALT_CFPB_STATEA_PHYS)&(&HWIO_CLK_HALT_CFPB_STATEA_GSBI3_HCLK_BMSK))==0
    (
      &is_on=1
    )
  )
  else if "&clk"=="cc_gsbi3_qup_apps_clk"
  (
    &clk_test=&CLK_TEST_GSBI3_QUP_APPS_CLK
    &clk_reg="GSBIn_QUP_APPS_NS[3]"
    if (data.long(a:&HWIO_CLK_HALT_CFPB_STATEA_PHYS)&(&HWIO_CLK_HALT_CFPB_STATEA_GSBI3_QUP_APPS_CLK_BMSK))==0
    (
      &is_on=1
    )
  )
  else if "&clk"=="cc_gsbi3_uart_apps_clk"
  (
    &clk_test=&CLK_TEST_GSBI3_UART_APPS_CLK
    &clk_reg="GSBIn_UART_APPS_NS[3]"
    if (data.long(a:&HWIO_CLK_HALT_CFPB_STATEA_PHYS)&(&HWIO_CLK_HALT_CFPB_STATEA_GSBI3_UART_APPS_CLK_BMSK))==0
    (
      &is_on=1
    )
  )
  else if "&clk"=="cc_gsbi4_hclk"
  (
    &clk_test=&CLK_TEST_GSBI4_HCLK
    &clk_reg="GSBIn_HCLK_CTL[4]"
    if (data.long(a:&HWIO_CLK_HALT_CFPB_STATEB_PHYS)&(&HWIO_CLK_HALT_CFPB_STATEB_GSBI4_HCLK_BMSK))==0
    (
      &is_on=1
    )
  )
  else if "&clk"=="cc_gsbi4_qup_apps_clk"
  (
    &clk_test=&CLK_TEST_GSBI4_QUP_APPS_CLK
    &clk_reg="GSBIn_QUP_APPS_NS[4]"
    if (data.long(a:&HWIO_CLK_HALT_CFPB_STATEB_PHYS)&(&HWIO_CLK_HALT_CFPB_STATEB_GSBI4_QUP_APPS_CLK_BMSK))==0
    (
      &is_on=1
    )
  )
  else if "&clk"=="cc_gsbi4_uart_apps_clk"
  (
    &clk_test=&CLK_TEST_GSBI4_UART_APPS_CLK
    &clk_reg="GSBIn_UART_APPS_NS[4]"
    if (data.long(a:&HWIO_CLK_HALT_CFPB_STATEB_PHYS)&(&HWIO_CLK_HALT_CFPB_STATEB_GSBI4_UART_APPS_CLK_BMSK))==0
    (
      &is_on=1
    )
  )
  else if "&clk"=="cc_gsbi5_hclk"
  (
    &clk_test=&CLK_TEST_GSBI5_HCLK
    &clk_reg="GSBIn_HCLK_CTL[5]"
    if (data.long(a:&HWIO_CLK_HALT_CFPB_STATEB_PHYS)&(&HWIO_CLK_HALT_CFPB_STATEB_GSBI5_HCLK_BMSK))==0
    (
      &is_on=1
    )
  )
  else if "&clk"=="cc_gsbi5_qup_apps_clk"
  (
    &clk_test=&CLK_TEST_GSBI5_QUP_APPS_CLK
    &clk_reg="GSBIn_QUP_APPS_NS[5]"
    if (data.long(a:&HWIO_CLK_HALT_CFPB_STATEB_PHYS)&(&HWIO_CLK_HALT_CFPB_STATEB_GSBI5_QUP_APPS_CLK_BMSK))==0
    (
      &is_on=1
    )
  )
  else if "&clk"=="cc_gsbi5_uart_apps_clk"
  (
    &clk_test=&CLK_TEST_GSBI5_UART_APPS_CLK
    &clk_reg="GSBIn_UART_APPS_NS[5]"
    if (data.long(a:&HWIO_CLK_HALT_CFPB_STATEB_PHYS)&(&HWIO_CLK_HALT_CFPB_STATEB_GSBI5_UART_APPS_CLK_BMSK))==0
    (
      &is_on=1
    )
  )
  else if "&clk"=="cc_gsbi6_hclk"
  (
    &clk_test=&CLK_TEST_GSBI6_HCLK
    &clk_reg="GSBIn_HCLK_CTL[6]"
    if (data.long(a:&HWIO_CLK_HALT_CFPB_STATEB_PHYS)&(&HWIO_CLK_HALT_CFPB_STATEB_GSBI6_HCLK_BMSK))==0
    (
      &is_on=1
    )
  )
  else if "&clk"=="cc_gsbi6_qup_apps_clk"
  (
    &clk_test=&CLK_TEST_GSBI6_QUP_APPS_CLK
    &clk_reg="GSBIn_QUP_APPS_NS[6]"
    if (data.long(a:&HWIO_CLK_HALT_CFPB_STATEB_PHYS)&(&HWIO_CLK_HALT_CFPB_STATEB_GSBI6_QUP_APPS_CLK_BMSK))==0
    (
      &is_on=1
    )
  )
  else if "&clk"=="cc_gsbi6_uart_apps_clk"
  (
    &clk_test=&CLK_TEST_GSBI6_UART_APPS_CLK
    &clk_reg="GSBIn_UART_APPS_NS[6]"
    if (data.long(a:&HWIO_CLK_HALT_CFPB_STATEB_PHYS)&(&HWIO_CLK_HALT_CFPB_STATEB_GSBI6_UART_APPS_CLK_BMSK))==0
    (
      &is_on=1
    )
  )
  else if "&clk"=="cc_gsbi7_hclk"
  (
    &clk_test=&CLK_TEST_GSBI7_HCLK
    &clk_reg="GSBIn_HCLK_CTL[7]"
    if (data.long(a:&HWIO_CLK_HALT_CFPB_STATEB_PHYS)&(&HWIO_CLK_HALT_CFPB_STATEB_GSBI7_HCLK_BMSK))==0
    (
      &is_on=1
    )
  )
  else if "&clk"=="cc_gsbi7_qup_apps_clk"
  (
    &clk_test=&CLK_TEST_GSBI7_QUP_APPS_CLK
    &clk_reg="GSBIn_QUP_APPS_NS[7]"
    if (data.long(a:&HWIO_CLK_HALT_CFPB_STATEB_PHYS)&(&HWIO_CLK_HALT_CFPB_STATEB_GSBI7_QUP_APPS_CLK_BMSK))==0
    (
      &is_on=1
    )
  )
  else if "&clk"=="cc_gsbi7_uart_apps_clk"
  (
    &clk_test=&CLK_TEST_GSBI7_UART_APPS_CLK
    &clk_reg="GSBIn_UART_APPS_NS[7]"
    if (data.long(a:&HWIO_CLK_HALT_CFPB_STATEB_PHYS)&(&HWIO_CLK_HALT_CFPB_STATEB_GSBI7_UART_APPS_CLK_BMSK))==0
    (
      &is_on=1
    )
  )
  else if "&clk"=="cc_gsbi8_hclk"
  (
    &clk_test=&CLK_TEST_GSBI8_HCLK
    &clk_reg="GSBIn_HCLK_CTL[8]"
    if (data.long(a:&HWIO_CLK_HALT_CFPB_STATEB_PHYS)&(&HWIO_CLK_HALT_CFPB_STATEB_GSBI8_HCLK_BMSK))==0
    (
      &is_on=1
    )
  )
  else if "&clk"=="cc_gsbi8_qup_apps_clk"
  (
    &clk_test=&CLK_TEST_GSBI8_QUP_APPS_CLK
    &clk_reg="GSBIn_QUP_APPS_NS[8]"
    if (data.long(a:&HWIO_CLK_HALT_CFPB_STATEB_PHYS)&(&HWIO_CLK_HALT_CFPB_STATEB_GSBI8_QUP_APPS_CLK_BMSK))==0
    (
      &is_on=1
    )
  )
  else if "&clk"=="cc_gsbi8_uart_apps_clk"
  (
    &clk_test=&CLK_TEST_GSBI8_UART_APPS_CLK
    &clk_reg="GSBIn_UART_APPS_NS[8]"
    if (data.long(a:&HWIO_CLK_HALT_CFPB_STATEB_PHYS)&(&HWIO_CLK_HALT_CFPB_STATEB_GSBI8_UART_APPS_CLK_BMSK))==0
    (
      &is_on=1
    )
  )
  else if "&clk"=="cc_gsbi9_hclk"
  (
    &clk_test=&CLK_TEST_GSBI9_HCLK
    &clk_reg="GSBIn_HCLK_CTL[9]"
    if (data.long(a:&HWIO_CLK_HALT_CFPB_STATEB_PHYS)&(&HWIO_CLK_HALT_CFPB_STATEB_GSBI9_HCLK_BMSK))==0
    (
      &is_on=1
    )
  )
  else if "&clk"=="cc_gsbi9_qup_apps_clk"
  (
    &clk_test=&CLK_TEST_GSBI9_QUP_APPS_CLK
    &clk_reg="GSBIn_QUP_APPS_NS[9]"
    if (data.long(a:&HWIO_CLK_HALT_CFPB_STATEB_PHYS)&(&HWIO_CLK_HALT_CFPB_STATEB_GSBI9_QUP_APPS_CLK_BMSK))==0
    (
      &is_on=1
    )
  )
  else if "&clk"=="cc_gsbi9_uart_apps_clk"
  (
    &clk_test=&CLK_TEST_GSBI9_UART_APPS_CLK
    &clk_reg="GSBIn_UART_APPS_NS[9]"
    if (data.long(a:&HWIO_CLK_HALT_CFPB_STATEB_PHYS)&(&HWIO_CLK_HALT_CFPB_STATEB_GSBI9_UART_APPS_CLK_BMSK))==0
    (
      &is_on=1
    )
  )
  else if "&clk"=="cc_mss_q6fw_jtag_clk"
  (
    &clk_test=&CLK_TEST_MSS_Q6FW_JTAG_CLK
    &clk_reg="MSS_Q6FW_JTAG_CLK_CTL"
    if (data.long(a:&HWIO_CLK_HALT_MSS_KPSS_MISC_STATE_PHYS)&(&HWIO_CLK_HALT_MSS_KPSS_MISC_STATE_MSS_Q6FW_JTAG_CLK_BMSK))==0
    (
      &is_on=1
    )
  )
  else if "&clk"=="cc_mss_q6sw_jtag_clk"
  (
    &clk_test=&CLK_TEST_MSS_Q6SW_JTAG_CLK
    &clk_reg="MSS_Q6SW_JTAG_CLK_CTL"
    if (data.long(a:&HWIO_CLK_HALT_MSS_KPSS_MISC_STATE_PHYS)&(&HWIO_CLK_HALT_MSS_KPSS_MISC_STATE_MSS_Q6SW_JTAG_CLK_BMSK))==0
    (
      &is_on=1
    )
  )
  else if "&clk"=="cc_mss_s_hclk"
  (
    &clk_test=&CLK_TEST_MSS_S_HCLK
    &clk_reg="MSS_S_HCLK_CTL"
    if (data.long(a:&HWIO_CLK_HALT_MSS_KPSS_MISC_STATE_PHYS)&(&HWIO_CLK_HALT_MSS_KPSS_MISC_STATE_MSS_S_HCLK_BMSK))==0
    (
      &is_on=1
    )
  )
  else if "&clk"=="cc_mss_slp_clk"
  (
    &clk_test=&CLK_TEST_MSS_SLP_CLK
    &clk_reg="MSS_SLP_CLK_CTL"
    if (data.long(a:&HWIO_CLK_HALT_MSS_KPSS_MISC_STATE_PHYS)&(&HWIO_CLK_HALT_MSS_KPSS_MISC_STATE_MSS_SLP_CLK_BMSK))==0
    (
      &is_on=1
    )
  )
  else if "&clk"=="cc_pmic_arb0_hclk"
  (
    &clk_test=&CLK_TEST_PMIC_ARB0_HCLK
    &clk_reg="PROC_CLK_BRANCH_ENA_VOTE"
    if (data.long(a:&HWIO_CLK_HALT_SFPB_MISC_STATE_PHYS)&(&HWIO_CLK_HALT_SFPB_MISC_STATE_PMIC_ARB0_HCLK_BMSK))==0
    (
      &is_on=1
    )
  )
  else if "&clk"=="cc_pmic_arb1_hclk"
  (
    &clk_test=&CLK_TEST_PMIC_ARB1_HCLK
    &clk_reg="PROC_CLK_BRANCH_ENA_VOTE"
    if (data.long(a:&HWIO_CLK_HALT_SFPB_MISC_STATE_PHYS)&(&HWIO_CLK_HALT_SFPB_MISC_STATE_PMIC_ARB1_HCLK_BMSK))==0
    (
      &is_on=1
    )
  )
  else if "&clk"=="cc_pmic_ssbi2_clk"
  (
    &clk_test=&CLK_TEST_PMIC_SSBI2_CLK
    &clk_reg="PROC_CLK_BRANCH_ENA_VOTE"
    if (data.long(a:&HWIO_CLK_HALT_SFPB_MISC_STATE_PHYS)&(&HWIO_CLK_HALT_SFPB_MISC_STATE_PMIC_SSBI2_CLK_BMSK))==0
    (
      &is_on=1
    )
  )
  else if "&clk"=="cc_q6fw_core_clk"
  (
    &clk_test=&CLK_TEST_Q6FW_CLK_SRC
    &clk_reg="Q6FW_CLK_SRC_CTL"
    if (data.long(a:&HWIO_FW_QDSP6SS_GFMUX_STATUS_PHYS)&(&HWIO_FW_QDSP6SS_GFMUX_STATUS_SEL_STATUS_BMSK))!=0
    (
      &is_on=1
    )
  )
  else if "&clk"=="cc_q6sw_core_clk"
  (
    &clk_test=&CLK_TEST_Q6SW_CLK_SRC
    &clk_reg="Q6SW_CLK_SRC_CTL"
    if (data.long(a:&HWIO_SW_QDSP6SS_GFMUX_STATUS_PHYS)&(&HWIO_SW_QDSP6SS_GFMUX_STATUS_SEL_STATUS_BMSK))!=0
    (
      &is_on=1
    )
  )
  else if "&clk"=="cc_qdss_at_clk"
  (
    &clk_test=&CLK_TEST_QDSS_AT_CLK
    &clk_reg="QDSS_AT_CLK_NS"
    if (data.long(a:&HWIO_CLK_HALT_MSS_KPSS_MISC_STATE_PHYS)&(&HWIO_CLK_HALT_MSS_KPSS_MISC_STATE_QDSS_AT_CLK_BMSK))==0
    (
      &is_on=1
    )
  )
  else if "&clk"=="cc_qdss_hclk"
  (
    &clk_test=&CLK_TEST_QDSS_HCLK
    &clk_reg="QDSS_HCLK_CTL"
    if (data.long(a:&HWIO_CLK_HALT_SFPB_MISC_STATE_PHYS)&(&HWIO_CLK_HALT_SFPB_MISC_STATE_QDSS_HCLK_BMSK))==0
    (
      &is_on=1
    )
  )
  else if "&clk"=="cc_qdss_pclkdbg_clk"
  (
    &clk_test=&CLK_TEST_QDSS_PCLKDBG_CLK
    &clk_reg="QDSS_AT_CLK_NS"
    if (data.long(a:&HWIO_CLK_HALT_MSS_KPSS_MISC_STATE_PHYS)&(&HWIO_CLK_HALT_MSS_KPSS_MISC_STATE_QDSS_PCLKDBG_CLK_BMSK))==0
    (
      &is_on=1
    )
  )
  else if "&clk"=="cc_qdss_stm_clk"
  (
    &clk_test=&CLK_TEST_QDSS_STM_CLK
    &clk_reg="QDSS_STM_CLK_CTL"
    if (data.long(a:&HWIO_CLK_HALT_AFAB_SFAB_STATEB_PHYS)&(&HWIO_CLK_HALT_AFAB_SFAB_STATEB_QDSS_STM_CLK_BMSK))==0
    (
      &is_on=1
    )
  )
  else if "&clk"=="cc_qdss_traceclkin_clk"
  (
    &clk_test=&CLK_TEST_QDSS_TRACECLKIN_CLK
    &clk_reg="QDSS_TRACECLKIN_CTL"
    if (data.long(a:&HWIO_CLK_HALT_MSS_KPSS_MISC_STATE_PHYS)&(&HWIO_CLK_HALT_MSS_KPSS_MISC_STATE_QDSS_TRACECLKIN_CLK_BMSK))==0
    (
      &is_on=1
    )
  )
  else if "&clk"=="cc_qdss_tsctr_clk"
  (
    &clk_test=&CLK_TEST_QDSS_TSCTR_CLK
    &clk_reg="QDSS_TSCTR_CTL"
    if (data.long(a:&HWIO_CLK_HALT_MSS_KPSS_MISC_STATE_PHYS)&(&HWIO_CLK_HALT_MSS_KPSS_MISC_STATE_QDSS_TSCTR_CLK_BMSK))==0
    (
      &is_on=1
    )
  )
  else if "&clk"=="cc_sdc1_apps_clk"
  (
    &clk_test=&CLK_TEST_SDC1_APPS_CLK
    &clk_reg="SDCn_APPS_CLK_NS[1]"
    if (data.long(a:&HWIO_CLK_HALT_DFAB_STATE_PHYS)&(&HWIO_CLK_HALT_DFAB_STATE_SDC1_APPS_CLK_BMSK))==0
    (
      &is_on=1
    )
  )
  else if "&clk"=="cc_sdc1_hclk"
  (
    &clk_test=&CLK_TEST_SDC1_HCLK
    &clk_reg="SDCn_HCLK_CTL[1]"
    if (data.long(a:&HWIO_CLK_HALT_DFAB_STATE_PHYS)&(&HWIO_CLK_HALT_DFAB_STATE_SDC1_HCLK_BMSK))==0
    (
      &is_on=1
    )
  )
  else if "&clk"=="cc_sdc2_apps_clk"
  (
    &clk_test=&CLK_TEST_SDC2_APPS_CLK
    &clk_reg="SDCn_APPS_CLK_NS[2]"
    if (data.long(a:&HWIO_CLK_HALT_DFAB_STATE_PHYS)&(&HWIO_CLK_HALT_DFAB_STATE_SDC2_APPS_CLK_BMSK))==0
    (
      &is_on=1
    )
  )
  else if "&clk"=="cc_sdc2_hclk"
  (
    &clk_test=&CLK_TEST_SDC2_HCLK
    &clk_reg="SDCn_HCLK_CTL[2]"
    if (data.long(a:&HWIO_CLK_HALT_DFAB_STATE_PHYS)&(&HWIO_CLK_HALT_DFAB_STATE_SDC2_HCLK_BMSK))==0
    (
      &is_on=1
    )
  )
  else if "&clk"=="cc_sdc3_apps_clk"
  (
    &clk_test=&CLK_TEST_SDC3_APPS_CLK
    &clk_reg="SDCn_APPS_CLK_NS[3]"
    if (data.long(a:&HWIO_CLK_HALT_DFAB_STATE_PHYS)&(&HWIO_CLK_HALT_DFAB_STATE_SDC3_APPS_CLK_BMSK))==0
    (
      &is_on=1
    )
  )
  else if "&clk"=="cc_sdc3_hclk"
  (
    &clk_test=&CLK_TEST_SDC3_HCLK
    &clk_reg="SDCn_HCLK_CTL[3]"
    if (data.long(a:&HWIO_CLK_HALT_DFAB_STATE_PHYS)&(&HWIO_CLK_HALT_DFAB_STATE_SDC3_HCLK_BMSK))==0
    (
      &is_on=1
    )
  )
  else if "&clk"=="cc_sdc4_apps_clk"
  (
    &clk_test=&CLK_TEST_SDC4_APPS_CLK
    &clk_reg="SDCn_APPS_CLK_NS[4]"
    if (data.long(a:&HWIO_CLK_HALT_DFAB_STATE_PHYS)&(&HWIO_CLK_HALT_DFAB_STATE_SDC4_APPS_CLK_BMSK))==0
    (
      &is_on=1
    )
  )
  else if "&clk"=="cc_sdc4_hclk"
  (
    &clk_test=&CLK_TEST_SDC4_HCLK
    &clk_reg="SDCn_HCLK_CTL[4]"
    if (data.long(a:&HWIO_CLK_HALT_DFAB_STATE_PHYS)&(&HWIO_CLK_HALT_DFAB_STATE_SDC4_HCLK_BMSK))==0
    (
      &is_on=1
    )
  )
  else if "&clk"=="cc_sdc5_apps_clk"
  (
    &clk_test=&CLK_TEST_SDC5_APPS_CLK
    &clk_reg="SDCn_APPS_CLK_NS[5]"
    if (data.long(a:&HWIO_CLK_HALT_DFAB_STATE_PHYS)&(&HWIO_CLK_HALT_DFAB_STATE_SDC5_APPS_CLK_BMSK))==0
    (
      &is_on=1
    )
  )
  else if "&clk"=="cc_sdc5_hclk"
  (
    &clk_test=&CLK_TEST_SDC5_HCLK
    &clk_reg="SDCn_HCLK_CTL[5]"
    if (data.long(a:&HWIO_CLK_HALT_DFAB_STATE_PHYS)&(&HWIO_CLK_HALT_DFAB_STATE_SDC5_HCLK_BMSK))==0
    (
      &is_on=1
    )
  )
  else if "&clk"=="cc_sfab_mss_m_aclk"
  (
    &clk_test=&CLK_TEST_SFAB_MSS_M_ACLK
    &clk_reg="SFAB_MSS_M_ACLK_CTL"
    if (data.long(a:&HWIO_CLK_HALT_AFAB_SFAB_STATEB_PHYS)&(&HWIO_CLK_HALT_AFAB_SFAB_STATEB_SFAB_MSS_M_ACLK_BMSK))==0
    (
      &is_on=1
    )
  )
  else if "&clk"=="cc_sfab_mss_q6fw_aclk"
  (
    &clk_test=&CLK_TEST_SFAB_MSS_Q6_FW_ACLK
    &clk_reg="SFAB_MSS_Q6_FW_ACLK_CTL"
    if (data.long(a:&HWIO_CLK_HALT_AFAB_SFAB_STATEB_PHYS)&(&HWIO_CLK_HALT_AFAB_SFAB_STATEB_SFAB_MSS_Q6_FW_ACLK_BMSK))==0
    (
      &is_on=1
    )
  )
  else if "&clk"=="cc_sfab_mss_q6sw_aclk"
  (
    &clk_test=&CLK_TEST_SFAB_MSS_Q6_SW_ACLK
    &clk_reg="SFAB_MSS_Q6_SW_ACLK_CTL"
    if (data.long(a:&HWIO_CLK_HALT_AFAB_SFAB_STATEB_PHYS)&(&HWIO_CLK_HALT_AFAB_SFAB_STATEB_SFAB_MSS_Q6_SW_ACLK_BMSK))==0
    (
      &is_on=1
    )
  )
  else if "&clk"=="cc_sfab_mss_s_hclk"
  (
    &clk_test=&CLK_TEST_SFAB_MSS_S_HCLK
    &clk_reg="SFAB_MSS_S_HCLK_CTL"
    if (data.long(a:&HWIO_CLK_HALT_AFAB_SFAB_STATEA_PHYS)&(&HWIO_CLK_HALT_AFAB_SFAB_STATEA_SFAB_MSS_S_HCLK_BMSK))==0
    (
      &is_on=1
    )
  )
  else if "&clk"=="cc_usb_fs1_hclk"
  (
    &clk_test=&CLK_TEST_USB_FS1_HCLK
    &clk_reg="USB_FS1_HCLK_CTL"
    if (data.long(a:&HWIO_CLK_HALT_CFPB_STATEA_PHYS)&(&HWIO_CLK_HALT_CFPB_STATEA_USB_FS1_HCLK_BMSK))==0
    (
      &is_on=1
    )
  )
  else if "&clk"=="cc_usb_fs1_system_clk"
  (
    &clk_test=&CLK_TEST_USB_FS1_SYSTEM_CLK
    &clk_reg="USB_FS1_SYSTEM_CLK_CTL"
    if (data.long(a:&HWIO_CLK_HALT_CFPB_STATEA_PHYS)&(&HWIO_CLK_HALT_CFPB_STATEA_USB_FS1_SYSTEM_CLK_BMSK))==0
    (
      &is_on=1
    )
  )
  else if "&clk"=="cc_usb_fs1_xcvr_fs_clk"
  (
    &clk_test=&CLK_TEST_USB_FS1_XCVR_FS_CLK
    &clk_reg="USB_FS1_XCVR_FS_CLK_NS"
    if (data.long(a:&HWIO_CLK_HALT_CFPB_STATEA_PHYS)&(&HWIO_CLK_HALT_CFPB_STATEA_USB_FS1_XCVR_FS_CLK_BMSK))==0
    (
      &is_on=1
    )
  )
  else if "&clk"=="cc_usb_fs2_hclk"
  (
    &clk_test=&CLK_TEST_USB_FS2_HCLK
    &clk_reg="USB_FS2_HCLK_CTL"
    if (data.long(a:&HWIO_CLK_HALT_CFPB_STATEA_PHYS)&(&HWIO_CLK_HALT_CFPB_STATEA_USB_FS2_HCLK_BMSK))==0
    (
      &is_on=1
    )
  )
  else if "&clk"=="cc_usb_fs2_system_clk"
  (
    &clk_test=&CLK_TEST_USB_FS2_SYSTEM_CLK
    &clk_reg="USB_FS2_SYSTEM_CLK_CTL"
    if (data.long(a:&HWIO_CLK_HALT_CFPB_STATEA_PHYS)&(&HWIO_CLK_HALT_CFPB_STATEA_USB_FS2_SYSTEM_CLK_BMSK))==0
    (
      &is_on=1
    )
  )
  else if "&clk"=="cc_usb_fs2_xcvr_fs_clk"
  (
    &clk_test=&CLK_TEST_USB_FS2_XCVR_FS_CLK
    &clk_reg="USB_FS2_XCVR_FS_CLK_NS"
    if (data.long(a:&HWIO_CLK_HALT_CFPB_STATEA_PHYS)&(&HWIO_CLK_HALT_CFPB_STATEA_USB_FS2_XCVR_FS_CLK_BMSK))==0
    (
      &is_on=1
    )
  )
  else if "&clk"=="cc_usb_hs1_hclk"
  (
    &clk_test=&CLK_TEST_USB_HS1_HCLK
    &clk_reg="USB_HS1_HCLK_CTL"
    if (data.long(a:&HWIO_CLK_HALT_DFAB_STATE_PHYS)&(&HWIO_CLK_HALT_DFAB_STATE_USB_HS1_HCLK_BMSK))==0
    (
      &is_on=1
    )
  )
  else if "&clk"=="cc_usb_hs1_xcvr_fs_clk"
  (
    &clk_test=&CLK_TEST_USB_HS1_XCVR_FS_CLK
    &clk_reg="USB_HS1_XCVR_FS_CLK_NS"
    if (data.long(a:&HWIO_CLK_HALT_DFAB_STATE_PHYS)&(&HWIO_CLK_HALT_DFAB_STATE_USB_HS1_XCVR_FS_CLK_BMSK))==0
    (
      &is_on=1
    )
  )
  else if "&clk"=="ce1_sleep_clk"
  (
    &clk_test=&CLK_TEST_CE1_SLEEP_CLK
    &is_on=2
  )
  else if "&clk"=="cfpb0_c0_hclk"
  (
    &clk_test=&CLK_TEST_CFPB0_C0_HCLK
    &is_on=2
  )
  else if "&clk"=="cfpb0_c1_hclk"
  (
    &clk_test=&CLK_TEST_CFPB0_C1_HCLK
    &is_on=2
  )
  else if "&clk"=="cfpb0_d0_hclk"
  (
    &clk_test=&CLK_TEST_CFPB0_D0_HCLK
    &is_on=2
  )
  else if "&clk"=="cfpb0_d1_hclk"
  (
    &clk_test=&CLK_TEST_CFPB0_D1_HCLK
    &is_on=2
  )
  else if "&clk"=="cfpb0_hclk"
  (
    &clk_test=&CLK_TEST_CFPB0_HCLK
    &is_on=2
  )
  else if "&clk"=="cfpb1_hclk"
  (
    &clk_test=&CLK_TEST_CFPB1_HCLK
    &is_on=2
  )
  else if "&clk"=="cfpb2_hclk"
  (
    &clk_test=&CLK_TEST_CFPB2_HCLK
    &is_on=2
  )
  else if "&clk"=="cfpb_master_hclk"
  (
    &clk_test=&CLK_TEST_CFPB_MASTER_HCLK
    &is_on=2
  )
  else if "&clk"=="cfpb_master_nohwgate_hclk"
  (
    &clk_test=&CLK_TEST_CFPB_MASTER_NOHWGATE_HCLK
    &is_on=2
  )
  else if "&clk"=="cfpb_splitter_hclk"
  (
    &clk_test=&CLK_TEST_CFPB_SPLITTER_HCLK
    &is_on=2
  )
  else if "&clk"=="ddr_clk"
  (
    &clk_test=&CLK_TEST_DDR_CLK
    &is_on=2
  )
  else if "&clk"=="dfab_a2_hclk"
  (
    &clk_test=&CLK_TEST_DFAB_A2_HCLK
    &is_on=2
  )
  else if "&clk"=="dfab_arb0_hclk"
  (
    &clk_test=&CLK_TEST_DFAB_ARB0_HCLK
    &is_on=2
  )
  else if "&clk"=="dfab_arb1_hclk"
  (
    &clk_test=&CLK_TEST_DFAB_ARB1_HCLK
    &is_on=2
  )
  else if "&clk"=="dfab_core_clk"
  (
    &clk_test=&CLK_TEST_DFAB_CORE_CLK
    &is_on=2
  )
  else if "&clk"=="dfab_sfab_m_aclk"
  (
    &clk_test=&CLK_TEST_DFAB_SFAB_M_ACLK
    &is_on=2
  )
  else if "&clk"=="dfab_sfab_s_aclk"
  (
    &clk_test=&CLK_TEST_DFAB_SFAB_S_ACLK
    &is_on=2
  )
  else if "&clk"=="dfab_sway0_hclk"
  (
    &clk_test=&CLK_TEST_DFAB_SWAY0_HCLK
    &is_on=2
  )
  else if "&clk"=="dfab_sway1_hclk"
  (
    &clk_test=&CLK_TEST_DFAB_SWAY1_HCLK
    &is_on=2
  )
  else if "&clk"=="dma_bam_hclk"
  (
    &clk_test=&CLK_TEST_DMA_BAM_HCLK
    &is_on=2
  )
  else if "&clk"=="ebi1_ch0_ca_xo_src"
  (
    &clk_test=&CLK_TEST_EBI1_CH0_CA_XO_SRC
    &is_on=2
  )
  else if "&clk"=="ebi1_ch0_cc_dbg_hs_clk"
  (
    &clk_test=&CLK_TEST_EBI1_CH0_CC_DBG_HS_CLK
    &is_on=2
  )
  else if "&clk"=="ebi1_ch0_dq_xo_src"
  (
    &clk_test=&CLK_TEST_EBI1_CH0_DQ_XO_SRC
    &is_on=2
  )
  else if "&clk"=="ebi1_ch1_ca_xo_src"
  (
    &clk_test=&CLK_TEST_EBI1_CH1_CA_XO_SRC
    &is_on=2
  )
  else if "&clk"=="ebi1_ch1_cc_dbg_hs_clk"
  (
    &clk_test=&CLK_TEST_EBI1_CH1_CC_DBG_HS_CLK
    &is_on=2
  )
  else if "&clk"=="ebi1_ch1_dq_xo_src"
  (
    &clk_test=&CLK_TEST_EBI1_CH1_DQ_XO_SRC
    &is_on=2
  )
  else if "&clk"=="ebi1_clk_src"
  (
    &clk_test=&CLK_TEST_EBI1_CLK_SRC
    &is_on=2
  )
  else if "&clk"=="ebi1_xo_src"
  (
    &clk_test=&CLK_TEST_EBI1_XO_SRC
    &is_on=2
  )
  else if "&clk"=="gp0_clk"
  (
    &clk_test=&CLK_TEST_GP0_CLK
    &is_on=2
  )
  else if "&clk"=="gp1_clk"
  (
    &clk_test=&CLK_TEST_GP1_CLK
    &is_on=2
  )
  else if "&clk"=="gp2_clk"
  (
    &clk_test=&CLK_TEST_GP2_CLK
    &is_on=2
  )
  else if "&clk"=="cc_gsbi10_sim_clk_src"
  (
    &clk_test=&CLK_TEST_GSBI10_SIM_CLK_SRC
    &clk_reg="GSBIn_SIM_CLK_CTL[10]"
    if (data.long(a:&HWIO_CLK_HALT_CFPB_STATEB_PHYS)&(&HWIO_CLK_HALT_CFPB_STATEB_GSBI10_SIM_CLK_SRC_BMSK))==0
    (
      &is_on=1
    )
  )
  else if "&clk"=="cc_gsbi11_sim_clk_src"
  (
    &clk_test=&CLK_TEST_GSBI11_SIM_CLK_SRC
    &clk_reg="GSBIn_SIM_CLK_CTL[11]"
    if (data.long(a:&HWIO_CLK_HALT_CFPB_STATEC_PHYS)&(&HWIO_CLK_HALT_CFPB_STATEC_GSBI11_SIM_CLK_SRC_BMSK))==0
    (
      &is_on=1
    )
  )
  else if "&clk"=="cc_gsbi12_sim_clk_src"
  (
    &clk_test=&CLK_TEST_GSBI12_SIM_CLK_SRC
    &clk_reg="GSBIn_SIM_CLK_CTL[12]"
    if (data.long(a:&HWIO_CLK_HALT_CFPB_STATEC_PHYS)&(&HWIO_CLK_HALT_CFPB_STATEC_GSBI12_SIM_CLK_SRC_BMSK))==0
    (
      &is_on=1
    )
  )
  else if "&clk"=="cc_gsbi1_sim_clk_src"
  (
    &clk_test=&CLK_TEST_GSBI1_SIM_CLK_SRC
    &clk_reg="GSBIn_SIM_CLK_CTL[1]"
    if (data.long(a:&HWIO_CLK_HALT_CFPB_STATEA_PHYS)&(&HWIO_CLK_HALT_CFPB_STATEA_GSBI1_SIM_CLK_SRC_BMSK))==0
    (
      &is_on=1
    )
  )
  else if "&clk"=="cc_gsbi2_sim_clk_src"
  (
    &clk_test=&CLK_TEST_GSBI2_SIM_CLK_SRC
    &clk_reg="GSBIn_SIM_CLK_CTL[2]"
    if (data.long(a:&HWIO_CLK_HALT_CFPB_STATEA_PHYS)&(&HWIO_CLK_HALT_CFPB_STATEA_GSBI2_SIM_CLK_SRC_BMSK))==0
    (
      &is_on=1
    )
  )
  else if "&clk"=="cc_gsbi3_sim_clk_src"
  (
    &clk_test=&CLK_TEST_GSBI3_SIM_CLK_SRC
    &clk_reg="GSBIn_SIM_CLK_CTL[3]"
    if (data.long(a:&HWIO_CLK_HALT_CFPB_STATEA_PHYS)&(&HWIO_CLK_HALT_CFPB_STATEA_GSBI3_SIM_CLK_SRC_BMSK))==0
    (
      &is_on=1
    )
  )
  else if "&clk"=="cc_gsbi4_sim_clk_src"
  (
    &clk_test=&CLK_TEST_GSBI4_SIM_CLK_SRC
    &clk_reg="GSBIn_SIM_CLK_CTL[4]"
    if (data.long(a:&HWIO_CLK_HALT_CFPB_STATEB_PHYS)&(&HWIO_CLK_HALT_CFPB_STATEB_GSBI4_SIM_CLK_SRC_BMSK))==0
    (
      &is_on=1
    )
  )
  else if "&clk"=="cc_gsbi5_sim_clk_src"
  (
    &clk_test=&CLK_TEST_GSBI5_SIM_CLK_SRC
    &clk_reg="GSBIn_SIM_CLK_CTL[5]"
    if (data.long(a:&HWIO_CLK_HALT_CFPB_STATEB_PHYS)&(&HWIO_CLK_HALT_CFPB_STATEB_GSBI5_SIM_CLK_SRC_BMSK))==0
    (
      &is_on=1
    )
  )
  else if "&clk"=="cc_gsbi6_sim_clk_src"
  (
    &clk_test=&CLK_TEST_GSBI6_SIM_CLK_SRC
    &clk_reg="GSBIn_SIM_CLK_CTL[6]"
    if (data.long(a:&HWIO_CLK_HALT_CFPB_STATEB_PHYS)&(&HWIO_CLK_HALT_CFPB_STATEB_GSBI6_SIM_CLK_SRC_BMSK))==0
    (
      &is_on=1
    )
  )
  else if "&clk"=="cc_gsbi7_sim_clk_src"
  (
    &clk_test=&CLK_TEST_GSBI7_SIM_CLK_SRC
    &clk_reg="GSBIn_SIM_CLK_CTL[7]"
    if (data.long(a:&HWIO_CLK_HALT_CFPB_STATEB_PHYS)&(&HWIO_CLK_HALT_CFPB_STATEB_GSBI7_SIM_CLK_SRC_BMSK))==0
    (
      &is_on=1
    )
  )
  else if "&clk"=="cc_gsbi8_sim_clk_src"
  (
    &clk_test=&CLK_TEST_GSBI8_SIM_CLK_SRC
    &clk_reg="GSBIn_SIM_CLK_CTL[8]"
    if (data.long(a:&HWIO_CLK_HALT_CFPB_STATEB_PHYS)&(&HWIO_CLK_HALT_CFPB_STATEB_GSBI8_SIM_CLK_SRC_BMSK))==0
    (
      &is_on=1
    )
  )
  else if "&clk"=="cc_gsbi9_sim_clk_src"
  (
    &clk_test=&CLK_TEST_GSBI9_SIM_CLK_SRC
    &clk_reg="GSBIn_SIM_CLK_CTL[9]"
    if (data.long(a:&HWIO_CLK_HALT_CFPB_STATEB_PHYS)&(&HWIO_CLK_HALT_CFPB_STATEB_GSBI9_SIM_CLK_SRC_BMSK))==0
    (
      &is_on=1
    )
  )
  else if "&clk"=="imem0_aclk"
  (
    &clk_test=&CLK_TEST_IMEM0_ACLK
    &is_on=2
  )
  else if "&clk"=="low_speed_debug_clock"
  (
    &clk_test=&CLK_TEST_LOW_SPEED_DEBUG_CLOCK
    &is_on=2
  )
  else if "&clk"=="lpass_cc_dbg_hs_in_clk"
  (
    &clk_test=&CLK_TEST_LPASS_CC_DBG_HS_IN_CLK
    &is_on=2
  )
  else if "&clk"=="lpass_cc_dbg_ls_in_clk"
  (
    &clk_test=&CLK_TEST_LPASS_CC_DBG_LS_IN_CLK
    &is_on=2
  )
  else if "&clk"=="lpass_cxo_src"
  (
    &clk_test=&CLK_TEST_LPASS_CXO_SRC
    &is_on=2
  )
  else if "&clk"=="lpass_mxo_src"
  (
    &clk_test=&CLK_TEST_LPASS_MXO_SRC
    &is_on=2
  )
  else if "&clk"=="lpass_pxo_src"
  (
    &clk_test=&CLK_TEST_LPASS_PXO_SRC
    &is_on=2
  )
  else if "&clk"=="lpass_q6_cc_dbg_hs_in_clk"
  (
    &clk_test=&CLK_TEST_LPASS_Q6_CC_DBG_HS_IN_CLK
    &is_on=2
  )
  else if "&clk"=="lpass_q6_cc_dbg_ls_in_clk"
  (
    &clk_test=&CLK_TEST_LPASS_Q6_CC_DBG_LS_IN_CLK
    &is_on=2
  )
  else if "&clk"=="mmfab_sync_src"
  (
    &clk_test=&CLK_TEST_MMFAB_SYNC_SRC
    &is_on=2
  )
  else if "&clk"=="mmss_cc_dbg_hs_in_clk"
  (
    &clk_test=&CLK_TEST_MMSS_CC_DBG_HS_IN_CLK
    &is_on=2
  )
  else if "&clk"=="mmss_cc_dbg_ls_in_clk"
  (
    &clk_test=&CLK_TEST_MMSS_CC_DBG_LS_IN_CLK
    &is_on=2
  )
  else if "&clk"=="mmss_mxo_src"
  (
    &clk_test=&CLK_TEST_MMSS_MXO_SRC
    &is_on=2
  )
  else if "&clk"=="mmss_pxo_src"
  (
    &clk_test=&CLK_TEST_MMSS_PXO_SRC
    &is_on=2
  )
  else if "&clk"=="mpm_hclk"
  (
    &clk_test=&CLK_TEST_MPM_HCLK
    &is_on=2
  )
  else if "&clk"=="mss_dbg_hs_clk"
  (
    &clk_test=&CLK_TEST_MSS_DBG_HS_CLK
    &is_on=2
  )
  else if "&clk"=="mss_dbg_ls_clk"
  (
    &clk_test=&CLK_TEST_MSS_DBG_LS_CLK
    &is_on=2
  )
  else if "&clk"=="mss_xpu_clk"
  (
    &clk_test=&CLK_TEST_MSS_XPU_CLK
    &is_on=2
  )
  else if "&clk"=="pcie_aclk"
  (
    &clk_test=&CLK_TEST_PCIE_ACLK
    &is_on=2
  )
  else if "&clk"=="pdm_clk"
  (
    &clk_test=&CLK_TEST_PDM_CLK
    &is_on=2
  )
  else if "&clk"=="pdm_xo4_clk"
  (
    &clk_test=&CLK_TEST_PDM_XO4_CLK
    &is_on=2
  )
  else if "&clk"=="cc_pmem_aclk"
  (
    &clk_test=&CLK_TEST_PMEM_ACLK
    &clk_reg="PMEM_ACLK_CTL"
    if (data.long(a:&HWIO_CLK_HALT_DFAB_STATE_PHYS)&(&HWIO_CLK_HALT_DFAB_STATE_PMEM_ACLK_BMSK))==0
    (
      &is_on=1
    )
  )
  else if "&clk"=="ppss_hclk"
  (
    &clk_test=&CLK_TEST_PPSS_HCLK
    &is_on=2
  )
  else if "&clk"=="ppss_proc_clk"
  (
    &clk_test=&CLK_TEST_PPSS_PROC_CLK
    &is_on=2
  )
  else if "&clk"=="ppss_timer0_clk"
  (
    &clk_test=&CLK_TEST_PPSS_TIMER0_CLK
    &is_on=2
  )
  else if "&clk"=="ppss_timer1_clk"
  (
    &clk_test=&CLK_TEST_PPSS_TIMER1_CLK
    &is_on=2
  )
  else if "&clk"=="prng_clk"
  (
    &clk_test=&CLK_TEST_PRNG_CLK
    &is_on=2
  )
  else if "&clk"=="q6fw_cc_dbg_hs_clk"
  (
    &clk_test=&CLK_TEST_Q6FW_CC_DBG_HS_CLK
    &is_on=2
  )
  else if "&clk"=="q6fw_cc_dbg_ls_clk"
  (
    &clk_test=&CLK_TEST_Q6FW_CC_DBG_LS_CLK
    &is_on=2
  )
  else if "&clk"=="q6sw_cc_dbg_hs_clk"
  (
    &clk_test=&CLK_TEST_Q6SW_CC_DBG_HS_CLK
    &is_on=2
  )
  else if "&clk"=="q6sw_cc_dbg_ls_clk"
  (
    &clk_test=&CLK_TEST_Q6SW_CC_DBG_LS_CLK
    &is_on=2
  )
  else if "&clk"=="ring_osc_clk"
  (
    &clk_test=&CLK_TEST_RING_OSC_CLK
    &is_on=2
  )
  else if "&clk"=="riva_cc_dbg_clk_hs"
  (
    &clk_test=&CLK_TEST_RIVA_CC_DBG_CLK_HS
    &is_on=2
  )
  else if "&clk"=="riva_cc_dbg_clk_ls"
  (
    &clk_test=&CLK_TEST_RIVA_CC_DBG_CLK_LS
    &is_on=2
  )
  else if "&clk"=="rpm_bus_hclk"
  (
    &clk_test=&CLK_TEST_RPM_BUS_HCLK
    &is_on=2
  )
  else if "&clk"=="rpm_msg_ram_hclk"
  (
    &clk_test=&CLK_TEST_RPM_MSG_RAM_HCLK
    &is_on=2
  )
  else if "&clk"=="rpm_proc_clk"
  (
    &clk_test=&CLK_TEST_RPM_PROC_CLK
    &is_on=2
  )
  else if "&clk"=="rpm_sleep_clk"
  (
    &clk_test=&CLK_TEST_RPM_SLEEP_CLK
    &is_on=2
  )
  else if "&clk"=="rpm_timer_clk"
  (
    &clk_test=&CLK_TEST_RPM_TIMER_CLK
    &is_on=2
  )
  else if "&clk"=="sc_aclk"
  (
    &clk_test=&CLK_TEST_SC_ACLK
    &is_on=2
  )
  else if "&clk"=="sc_cc_dbg_ls_clk"
  (
    &clk_test=&CLK_TEST_SC_CC_DBG_LS_CLK
    &is_on=2
  )
  else if "&clk"=="sc_dbg_clk"
  (
    &clk_test=&CLK_TEST_SC_DBG_CLK
    &is_on=2
  )
  else if "&clk"=="sc_dbg_hs0_clk"
  (
    &clk_test=&CLK_TEST_SC_DBG_HS0_CLK
    &is_on=2
  )
  else if "&clk"=="sc_dbg_hs1_clk"
  (
    &clk_test=&CLK_TEST_SC_DBG_HS1_CLK
    &is_on=2
  )
  else if "&clk"=="sc_dbg_hs2_clk"
  (
    &clk_test=&CLK_TEST_SC_DBG_HS2_CLK
    &is_on=2
  )
  else if "&clk"=="sc_hclk"
  (
    &clk_test=&CLK_TEST_SC_HCLK
    &is_on=2
  )
  else if "&clk"=="sc_l2_clk"
  (
    &clk_test=&CLK_TEST_SC_L2_CLK
    &is_on=2
  )
  else if "&clk"=="sc_xo_src"
  (
    &clk_test=&CLK_TEST_SC_XO_SRC
    &is_on=2
  )
  else if "&clk"=="sec_ctrl_acc_clk"
  (
    &clk_test=&CLK_TEST_SEC_CTRL_ACC_CLK
    &is_on=2
  )
  else if "&clk"=="sec_ctrl_clk"
  (
    &clk_test=&CLK_TEST_SEC_CTRL_CLK
    &is_on=2
  )
  else if "&clk"=="sfab_adm0_m0_aclk"
  (
    &clk_test=&CLK_TEST_SFAB_ADM0_M0_ACLK
    &is_on=2
  )
  else if "&clk"=="sfab_adm0_m1_aclk"
  (
    &clk_test=&CLK_TEST_SFAB_ADM0_M1_ACLK
    &is_on=2
  )
  else if "&clk"=="sfab_adm0_m2_hclk"
  (
    &clk_test=&CLK_TEST_SFAB_ADM0_M2_HCLK
    &is_on=2
  )
  else if "&clk"=="sfab_afab_m_aclk"
  (
    &clk_test=&CLK_TEST_SFAB_AFAB_M_ACLK
    &is_on=2
  )
  else if "&clk"=="sfab_afab_s0_aclk"
  (
    &clk_test=&CLK_TEST_SFAB_AFAB_S0_ACLK
    &is_on=2
  )
  else if "&clk"=="sfab_afab_s1_aclk"
  (
    &clk_test=&CLK_TEST_SFAB_AFAB_S1_ACLK
    &is_on=2
  )
  else if "&clk"=="sfab_ahb_s0_fclk"
  (
    &clk_test=&CLK_TEST_SFAB_AHB_S0_FCLK
    &is_on=2
  )
  else if "&clk"=="sfab_ahb_s1_fclk"
  (
    &clk_test=&CLK_TEST_SFAB_AHB_S1_FCLK
    &is_on=2
  )
  else if "&clk"=="sfab_ahb_s2_fclk"
  (
    &clk_test=&CLK_TEST_SFAB_AHB_S2_FCLK
    &is_on=2
  )
  else if "&clk"=="sfab_ahb_s3_fclk"
  (
    &clk_test=&CLK_TEST_SFAB_AHB_S3_FCLK
    &is_on=2
  )
  else if "&clk"=="sfab_ahb_s4_fclk"
  (
    &clk_test=&CLK_TEST_SFAB_AHB_S4_FCLK
    &is_on=2
  )
  else if "&clk"=="sfab_ahb_s5_fclk"
  (
    &clk_test=&CLK_TEST_SFAB_AHB_S5_FCLK
    &is_on=2
  )
  else if "&clk"=="sfab_ahb_s6_fclk"
  (
    &clk_test=&CLK_TEST_SFAB_AHB_S6_FCLK
    &is_on=2
  )
  else if "&clk"=="sfab_axi_s0_fclk"
  (
    &clk_test=&CLK_TEST_SFAB_AXI_S0_FCLK
    &is_on=2
  )
  else if "&clk"=="sfab_axi_s1_fclk"
  (
    &clk_test=&CLK_TEST_SFAB_AXI_S1_FCLK
    &is_on=2
  )
  else if "&clk"=="sfab_axi_s2_fclk"
  (
    &clk_test=&CLK_TEST_SFAB_AXI_S2_FCLK
    &is_on=2
  )
  else if "&clk"=="sfab_axi_s3_fclk"
  (
    &clk_test=&CLK_TEST_SFAB_AXI_S3_FCLK
    &is_on=2
  )
  else if "&clk"=="sfab_axi_s4_fclk"
  (
    &clk_test=&CLK_TEST_SFAB_AXI_S4_FCLK
    &is_on=2
  )
  else if "&clk"=="sfab_cfpb_m_hclk"
  (
    &clk_test=&CLK_TEST_SFAB_CFPB_M_HCLK
    &is_on=2
  )
  else if "&clk"=="sfab_cfpb_s_hclk"
  (
    &clk_test=&CLK_TEST_SFAB_CFPB_S_HCLK
    &is_on=2
  )
  else if "&clk"=="sfab_core_clk"
  (
    &clk_test=&CLK_TEST_SFAB_CORE_CLK
    &is_on=2
  )
  else if "&clk"=="sfab_dfab_s_aclk"
  (
    &clk_test=&CLK_TEST_SFAB_DFAB_S_ACLK
    &is_on=2
  )
  else if "&clk"=="sfab_lpass_q6_aclk"
  (
    &clk_test=&CLK_TEST_SFAB_LPASS_Q6_ACLK
    &is_on=2
  )
  else if "&clk"=="sfab_sfpb_m_hclk"
  (
    &clk_test=&CLK_TEST_SFAB_SFPB_M_HCLK
    &is_on=2
  )
  else if "&clk"=="sfab_sfpb_s_hclk"
  (
    &clk_test=&CLK_TEST_SFAB_SFPB_S_HCLK
    &is_on=2
  )
  else if "&clk"=="sfab_smpss_s_hclk"
  (
    &clk_test=&CLK_TEST_SFAB_SMPSS_S_HCLK
    &is_on=2
  )
  else if "&clk"=="sfab_usb3_m_aclk"
  (
    &clk_test=&CLK_TEST_SFAB_USB3_M_ACLK
    &is_on=2
  )
  else if "&clk"=="sfpb_hclk"
  (
    &clk_test=&CLK_TEST_SFPB_HCLK
    &is_on=2
  )
  else if "&clk"=="sfpb_nohwgate_hclk"
  (
    &clk_test=&CLK_TEST_SFPB_NOHWGATE_HCLK
    &is_on=2
  )
  else if "&clk"=="sic_hclk"
  (
    &clk_test=&CLK_TEST_SIC_HCLK
    &is_on=2
  )
  else if "&clk"=="slimbus_hclk"
  (
    &clk_test=&CLK_TEST_SLIMBUS_HCLK
    &is_on=2
  )
  else if "&clk"=="slimbus_xo_src"
  (
    &clk_test=&CLK_TEST_SLIMBUS_XO_SRC
    &is_on=2
  )
  else if "&clk"=="spdm_cfg_hclk"
  (
    &clk_test=&CLK_TEST_SPDM_CFG_HCLK
    &is_on=2
  )
  else if "&clk"=="spdm_cy_port0_clk"
  (
    &clk_test=&CLK_TEST_SPDM_CY_PORT0_CLK
    &is_on=2
  )
  else if "&clk"=="spdm_cy_port1_clk"
  (
    &clk_test=&CLK_TEST_SPDM_CY_PORT1_CLK
    &is_on=2
  )
  else if "&clk"=="spdm_cy_port2_clk"
  (
    &clk_test=&CLK_TEST_SPDM_CY_PORT2_CLK
    &is_on=2
  )
  else if "&clk"=="spdm_cy_port3_clk"
  (
    &clk_test=&CLK_TEST_SPDM_CY_PORT3_CLK
    &is_on=2
  )
  else if "&clk"=="spdm_cy_port4_clk"
  (
    &clk_test=&CLK_TEST_SPDM_CY_PORT4_CLK
    &is_on=2
  )
  else if "&clk"=="spdm_cy_port5_clk"
  (
    &clk_test=&CLK_TEST_SPDM_CY_PORT5_CLK
    &is_on=2
  )
  else if "&clk"=="spdm_cy_port6_clk"
  (
    &clk_test=&CLK_TEST_SPDM_CY_PORT6_CLK
    &is_on=2
  )
  else if "&clk"=="spdm_cy_port7_clk"
  (
    &clk_test=&CLK_TEST_SPDM_CY_PORT7_CLK
    &is_on=2
  )
  else if "&clk"=="spdm_ff_clk"
  (
    &clk_test=&CLK_TEST_SPDM_FF_CLK
    &is_on=2
  )
  else if "&clk"=="spdm_mstr_hclk"
  (
    &clk_test=&CLK_TEST_SPDM_MSTR_HCLK
    &is_on=2
  )
  else if "&clk"=="sps_tic_hclk"
  (
    &clk_test=&CLK_TEST_SPS_TIC_HCLK
    &is_on=2
  )
  else if "&clk"=="tlmm_clk"
  (
    &clk_test=&CLK_TEST_TLMM_CLK
    &is_on=2
  )
  else if "&clk"=="tlmm_hclk"
  (
    &clk_test=&CLK_TEST_TLMM_HCLK
    &is_on=2
  )
  else if "&clk"=="tsif_hclk_raw"
  (
    &clk_test=&CLK_TEST_TSIF_HCLK_RAW
    &is_on=2
  )
  else if "&clk"=="tsif_inactivity_timers_clk"
  (
    &clk_test=&CLK_TEST_TSIF_INACTIVITY_TIMERS_CLK
    &is_on=2
  )
  else if "&clk"=="tsif_ref_clk"
  (
    &clk_test=&CLK_TEST_TSIF_REF_CLK
    &is_on=2
  )
  else if "&clk"=="tssc_clk"
  (
    &clk_test=&CLK_TEST_TSSC_CLK
    &is_on=2
  )
  else if "&clk"=="usb_hs2_hclk"
  (
    &clk_test=&CLK_TEST_USB_HS2_HCLK
    &is_on=2
  )
  else if "&clk"=="usb_hs2_system_clk"
  (
    &clk_test=&CLK_TEST_USB_HS2_SYSTEM_CLK
    &is_on=2
  )
  else if "&clk"=="usb_hs2_xcvr_fs_clk"
  (
    &clk_test=&CLK_TEST_USB_HS2_XCVR_FS_CLK
    &is_on=2
  )
  else if "&clk"=="voltage_sensor_debug_clock"
  (
    &clk_test=&CLK_TEST_VOLTAGE_SENSOR_DEBUG_CLOCK
    &is_on=2
  )
  else if "&clk"=="lcc_ahb_hclk"
  (
    &clk_test=&CLK_LPASS_TEST_LCC_AHB_HCLK
    &is_on=2
  )
  else if "&clk"=="lcc_aif_hclk"
  (
    &clk_test=&CLK_LPASS_TEST_LCC_AIF_HCLK
    &is_on=2
  )
  else if "&clk"=="lcc_avt_hclk"
  (
    &clk_test=&CLK_LPASS_TEST_LCC_AVT_HCLK
    &is_on=2
  )
  else if "&clk"=="lcc_avt_mclk"
  (
    &clk_test=&CLK_LPASS_TEST_LCC_AVT_MCLK
    &is_on=2
  )
  else if "&clk"=="lcc_avt_pclk"
  (
    &clk_test=&CLK_LPASS_TEST_LCC_AVT_PCLK
    &is_on=2
  )
  else if "&clk"=="lcc_avt_riva_bt_clk"
  (
    &clk_test=&CLK_LPASS_TEST_LCC_AVT_RIVA_BT_CLK
    &is_on=2
  )
  else if "&clk"=="lcc_avt_riva_fm_clk"
  (
    &clk_test=&CLK_LPASS_TEST_LCC_AVT_RIVA_FM_CLK
    &is_on=2
  )
  else if "&clk"=="lcc_codec_i2s_mic_bit_clk"
  (
    &clk_test=&CLK_LPASS_TEST_LCC_CODEC_I2S_MIC_BIT_CLK
    &is_on=2
  )
  else if "&clk"=="lcc_codec_i2s_spkr_bit_clk"
  (
    &clk_test=&CLK_LPASS_TEST_LCC_CODEC_I2S_SPKR_BIT_CLK
    &is_on=2
  )
  else if "&clk"=="lcc_core_csr_hclk"
  (
    &clk_test=&CLK_LPASS_TEST_LCC_CORE_CSR_HCLK
    &is_on=2
  )
  else if "&clk"=="lcc_dml_hclk"
  (
    &clk_test=&CLK_LPASS_TEST_LCC_DML_HCLK
    &is_on=2
  )
  else if "&clk"=="lcc_ebus_hclk"
  (
    &clk_test=&CLK_LPASS_TEST_LCC_EBUS_HCLK
    &is_on=2
  )
  else if "&clk"=="lcc_fab_lpb_hclk"
  (
    &clk_test=&CLK_LPASS_TEST_LCC_FAB_LPB_HCLK
    &is_on=2
  )
  else if "&clk"=="lcc_ibus_hclk"
  (
    &clk_test=&CLK_LPASS_TEST_LCC_IBUS_HCLK
    &is_on=2
  )
  else if "&clk"=="lcc_lpaif_csr_hclk"
  (
    &clk_test=&CLK_LPASS_TEST_LCC_LPAIF_CSR_HCLK
    &is_on=2
  )
  else if "&clk"=="lcc_lpb_fab_hclk"
  (
    &clk_test=&CLK_LPASS_TEST_LCC_LPB_FAB_HCLK
    &is_on=2
  )
  else if "&clk"=="lcc_lpm_hclk"
  (
    &clk_test=&CLK_LPASS_TEST_LCC_LPM_HCLK
    &is_on=2
  )
  else if "&clk"=="lcc_mi2s_bit_clk"
  (
    &clk_test=&CLK_LPASS_TEST_LCC_MI2S_BIT_CLK
    &is_on=2
  )
  else if "&clk"=="lcc_midi_clk"
  (
    &clk_test=&CLK_LPASS_TEST_LCC_MIDI_CLK
    &is_on=2
  )
  else if "&clk"=="lcc_midi_hclk"
  (
    &clk_test=&CLK_LPASS_TEST_LCC_MIDI_HCLK
    &is_on=2
  )
  else if "&clk"=="lcc_pcm_clk"
  (
    &clk_test=&CLK_LPASS_TEST_LCC_PCM_CLK
    &is_on=2
  )
  else if "&clk"=="lcc_q6_fracdiv_clk"
  (
    &clk_test=&CLK_LPASS_TEST_LCC_Q6_FRACDIV_CLK
    &is_on=2
  )
  else if "&clk"=="lcc_q6_func_clk"
  (
    &clk_test=&CLK_LPASS_TEST_LCC_Q6_FUNC_CLK
    &is_on=2
  )
  else if "&clk"=="lcc_q6_jtag_clk"
  (
    &clk_test=&CLK_LPASS_TEST_LCC_Q6_JTAG_CLK
    &is_on=2
  )
  else if "&clk"=="lcc_q6_slp_clk"
  (
    &clk_test=&CLK_LPASS_TEST_LCC_Q6_SLP_CLK
    &is_on=2
  )
  else if "&clk"=="lcc_q6_tcxo_clk"
  (
    &clk_test=&CLK_LPASS_TEST_LCC_Q6_TCXO_CLK
    &is_on=2
  )
  else if "&clk"=="lcc_q6ss_hclk"
  (
    &clk_test=&CLK_LPASS_TEST_LCC_Q6SS_HCLK
    &is_on=2
  )
  else if "&clk"=="lcc_security_hclk"
  (
    &clk_test=&CLK_LPASS_TEST_LCC_SECURITY_HCLK
    &is_on=2
  )
  else if "&clk"=="lcc_slimbus_core_clk"
  (
    &clk_test=&CLK_LPASS_TEST_LCC_SLIMBUS_CORE_CLK
    &is_on=2
  )
  else if "&clk"=="lcc_slimbus_hclk"
  (
    &clk_test=&CLK_LPASS_TEST_LCC_SLIMBUS_HCLK
    &is_on=2
  )
  else if "&clk"=="lcc_spare_i2s_mic_bit_clk"
  (
    &clk_test=&CLK_LPASS_TEST_LCC_SPARE_I2S_MIC_BIT_CLK
    &is_on=2
  )
  else if "&clk"=="lcc_spare_i2s_spkr_bit_clk"
  (
    &clk_test=&CLK_LPASS_TEST_LCC_SPARE_I2S_SPKR_BIT_CLK
    &is_on=2
  )
  else if "&clk"=="axi_s0_clk"
  (
    &clk_test=&CLK_MMSS_TEST_AXI_S0_CLK
    &is_on=2
  )
  else if "&clk"=="axi_s0_fclk"
  (
    &clk_test=&CLK_MMSS_TEST_AXI_S0_FCLK
    &is_on=2
  )
  else if "&clk"=="cc_amp_ahb_clk"
  (
    &clk_test=&CLK_MMSS_TEST_AMP_AHB_CLK
    &clk_reg="MMSS_AHB_EN"
    if (data.long(a:&HWIO_MMSS_DBG_BUS_VEC_F_PHYS)&(&HWIO_MMSS_DBG_BUS_VEC_F_AMP_AHB_CLK_OFF_BMSK))==0
    (
      &is_on=1
    )
  )
  else if "&clk"=="cc_apu_ahb_clk"
  (
    &clk_test=&CLK_MMSS_TEST_APU_AHB_CLK
    &clk_reg="MMSS_AHB_EN"
    if (data.long(a:&HWIO_MMSS_DBG_BUS_VEC_F_PHYS)&(&HWIO_MMSS_DBG_BUS_VEC_F_APU_AHB_CLK_OFF_BMSK))==0
    (
      &is_on=1
    )
  )
  else if "&clk"=="cc_axi_s1_clk"
  (
    &clk_test=&CLK_MMSS_TEST_AXI_S1_CLK
    &clk_reg="MMSS_SAXI_EN"
    if (data.long(a:&HWIO_MMSS_DBG_BUS_VEC_E_PHYS)&(&HWIO_MMSS_DBG_BUS_VEC_E_AXI_S1_CLK_OFF_BMSK))==0
    (
      &is_on=1
    )
  )
  else if "&clk"=="cc_axi_s1_fclk"
  (
    &clk_test=&CLK_MMSS_TEST_AXI_S1_FCLK
    &clk_reg="MMSS_SAXI_EN"
    if (data.long(a:&HWIO_MMSS_DBG_BUS_VEC_E_PHYS)&(&HWIO_MMSS_DBG_BUS_VEC_E_AXI_S1_FCLK_CLK_OFF_BMSK))==0
    (
      &is_on=1
    )
  )
  else if "&clk"=="cc_axi_s2_clk"
  (
    &clk_test=&CLK_MMSS_TEST_AXI_S2_CLK
    &clk_reg="MMSS_SAXI_EN"
    if (data.long(a:&HWIO_MMSS_DBG_BUS_VEC_E_PHYS)&(&HWIO_MMSS_DBG_BUS_VEC_E_AXI_S2_CLK_OFF_BMSK))==0
    (
      &is_on=1
    )
  )
  else if "&clk"=="cc_axi_s2_fclk"
  (
    &clk_test=&CLK_MMSS_TEST_AXI_S2_FCLK
    &clk_reg="MMSS_SAXI_EN"
    if (data.long(a:&HWIO_MMSS_DBG_BUS_VEC_E_PHYS)&(&HWIO_MMSS_DBG_BUS_VEC_E_AXI_S2_FCLK_CLK_OFF_BMSK))==0
    (
      &is_on=1
    )
  )
  else if "&clk"=="cc_axi_s3_fclk"
  (
    &clk_test=&CLK_MMSS_TEST_AXI_S3_FCLK
    &clk_reg="MMSS_SAXI_EN"
    if (data.long(a:&HWIO_MMSS_DBG_BUS_VEC_E_PHYS)&(&HWIO_MMSS_DBG_BUS_VEC_E_AXI_S3_FCLK_CLK_OFF_BMSK))==0
    (
      &is_on=1
    )
  )
  else if "&clk"=="cc_cam0clk_po"
  (
    &clk_test=&CLK_MMSS_TEST_CAMCLK0_PO
    &clk_reg="MMSS_CAMCLK0_CC"
    if (data.long(a:&HWIO_MMSS_DBG_BUS_VEC_I_PHYS)&(&HWIO_MMSS_DBG_BUS_VEC_I_CAMCLK0_PO_CLK_OFF_BMSK))==0
    (
      &is_on=1
    )
  )
  else if "&clk"=="cc_cam1clk_po"
  (
    &clk_test=&CLK_MMSS_TEST_CAMCLK1_PO
    &clk_reg="MMSS_CAMCLK1_CC"
    if (data.long(a:&HWIO_MMSS_DBG_BUS_VEC_I_PHYS)&(&HWIO_MMSS_DBG_BUS_VEC_I_CAMCLK1_PO_CLK_OFF_BMSK))==0
    (
      &is_on=1
    )
  )
  else if "&clk"=="cc_csi0_clk"
  (
    &clk_test=&CLK_MMSS_TEST_CSI0_CLK
    &clk_reg="MMSS_CSI0_CC"
    if (data.long(a:&HWIO_MMSS_DBG_BUS_VEC_B_PHYS)&(&HWIO_MMSS_DBG_BUS_VEC_B_CSI0_CLK_OFF_BMSK))==0
    (
      &is_on=1
    )
  )
  else if "&clk"=="cc_csi0_phy_clk"
  (
    &clk_test=&CLK_MMSS_TEST_CSIPHY0_CLK
    &clk_reg="MMSS_CSI0_CC"
    if (data.long(a:&HWIO_MMSS_DBG_BUS_VEC_I_PHYS)&(&HWIO_MMSS_DBG_BUS_VEC_I_CSIPHY0_CLK_OFF_BMSK))==0
    (
      &is_on=1
    )
  )
  else if "&clk"=="cc_csi1_clk"
  (
    &clk_test=&CLK_MMSS_TEST_CSI1_CLK
    &clk_reg="MMSS_CSI1_CC"
    if (data.long(a:&HWIO_MMSS_DBG_BUS_VEC_B_PHYS)&(&HWIO_MMSS_DBG_BUS_VEC_B_CSI1_CLK_OFF_BMSK))==0
    (
      &is_on=1
    )
  )
  else if "&clk"=="cc_csi1_phy_clk"
  (
    &clk_test=&CLK_MMSS_TEST_CSIPHY1_CLK
    &clk_reg="MMSS_CSI1_CC"
    if (data.long(a:&HWIO_MMSS_DBG_BUS_VEC_I_PHYS)&(&HWIO_MMSS_DBG_BUS_VEC_I_CSIPHY1_CLK_OFF_BMSK))==0
    (
      &is_on=1
    )
  )
  else if "&clk"=="cc_csi_ahb_clk"
  (
    &clk_test=&CLK_MMSS_TEST_CSI_AHB_CLK
    &clk_reg="MMSS_AHB_EN"
    if (data.long(a:&HWIO_MMSS_DBG_BUS_VEC_F_PHYS)&(&HWIO_MMSS_DBG_BUS_VEC_F_CSI_AHB_CLK_OFF_BMSK))==0
    (
      &is_on=1
    )
  )
  else if "&clk"=="cc_csi_pix_clk"
  (
    &clk_test=&CLK_MMSS_TEST_CSI_PIX_CLK
    &clk_reg="MMSS_MISC_CC"
    &is_on=2
  )
  else if "&clk"=="cc_csi_rdi_clk"
  (
    &clk_test=&CLK_MMSS_TEST_CSI_RDI_CLK
    &clk_reg="MMSS_MISC_CC"
    &is_on=2
  )
  else if "&clk"=="cc_csi_vfe_clk"
  (
    &clk_test=&CLK_MMSS_TEST_CSI_VFE_CLK
    &clk_reg="MMSS_VFE_CC"
    if (data.long(a:&HWIO_MMSS_DBG_BUS_VEC_B_PHYS)&(&HWIO_MMSS_DBG_BUS_VEC_B_CSI_VFE_CLK_OFF_BMSK))==0
    (
      &is_on=1
    )
  )
  else if "&clk"=="cc_csiphy0_timer_clk"
  (
    &clk_test=&CLK_MMSS_TEST_CSIPHY0_TIMER_CLK
    &clk_reg="MMSS_CSIPHYTIMER_CC"
    if (data.long(a:&HWIO_MMSS_DBG_BUS_VEC_I_PHYS)&(&HWIO_MMSS_DBG_BUS_VEC_I_CSI0PHYTIMER_CLKOFF_BMSK))==0
    (
      &is_on=1
    )
  )
  else if "&clk"=="cc_csiphy1_timer_clk"
  (
    &clk_test=&CLK_MMSS_TEST_CSIPHY1_TIMER_CLK
    &clk_reg="MMSS_CSIPHYTIMER_CC"
    if (data.long(a:&HWIO_MMSS_DBG_BUS_VEC_I_PHYS)&(&HWIO_MMSS_DBG_BUS_VEC_I_CSI1PHYTIMER_CLKOFF_BMSK))==0
    (
      &is_on=1
    )
  )
  else if "&clk"=="cc_dsi1_byte_clk"
  (
    &clk_test=&CLK_MMSS_TEST_DSI1_BYTE_CLK
    &clk_reg="MMSS_DSI1_BYTE_CC"
    if (data.long(a:&HWIO_MMSS_DBG_BUS_VEC_B_PHYS)&(&HWIO_MMSS_DBG_BUS_VEC_B_DSI1_BYTE_CLK_OFF_BMSK))==0
    (
      &is_on=1
    )
  )
  else if "&clk"=="cc_dsi1_clk"
  (
    &clk_test=&CLK_MMSS_TEST_DSI1_CLK
    &clk_reg="MMSS_DSI_CC"
    if (data.long(a:&HWIO_MMSS_DBG_BUS_VEC_C_PHYS)&(&HWIO_MMSS_DBG_BUS_VEC_C_DSI1_CLK_OFF_BMSK))==0
    (
      &is_on=1
    )
  )
  else if "&clk"=="cc_dsi1_esc_clk"
  (
    &clk_test=&CLK_MMSS_TEST_DSI1_ESC_CLK
    &clk_reg="MMSS_DSI1_ESC_CC"
    if (data.long(a:&HWIO_MMSS_DBG_BUS_VEC_I_PHYS)&(&HWIO_MMSS_DBG_BUS_VEC_I_DSI1_ESC_CLK_OFF_BMSK))==0
    (
      &is_on=1
    )
  )
  else if "&clk"=="cc_dsi1_m_ahb_clk"
  (
    &clk_test=&CLK_MMSS_TEST_DSI1_M_AHB_CLK
    &clk_reg="MMSS_AHB_EN"
    if (data.long(a:&HWIO_MMSS_DBG_BUS_VEC_F_PHYS)&(&HWIO_MMSS_DBG_BUS_VEC_F_DSI1_M_AHB_CLK_OFF_BMSK))==0
    (
      &is_on=1
    )
  )
  else if "&clk"=="cc_dsi1_pixel_clk"
  (
    &clk_test=&CLK_MMSS_TEST_MDP_DSI1_PCLK
    &clk_reg="MMSS_DSI_PIXEL_CC"
    if (data.long(a:&HWIO_MMSS_DBG_BUS_VEC_C_PHYS)&(&HWIO_MMSS_DBG_BUS_VEC_C_DSI1_PIXEL_CLK_OFF_BMSK))==0
    (
      &is_on=1
    )
  )
  else if "&clk"=="cc_dsi1_s_ahb_clk"
  (
    &clk_test=&CLK_MMSS_TEST_DSI1_S_AHB_CLK
    &clk_reg="MMSS_AHB_EN"
    if (data.long(a:&HWIO_MMSS_DBG_BUS_VEC_F_PHYS)&(&HWIO_MMSS_DBG_BUS_VEC_F_DSI1_S_AHB_CLK_OFF_BMSK))==0
    (
      &is_on=1
    )
  )
  else if "&clk"=="cc_dsi2_byte_clk"
  (
    &clk_test=&CLK_MMSS_TEST_DSI2_BYTE_CLK
    &clk_reg="MMSS_DSI2_BYTE_CC"
    if (data.long(a:&HWIO_MMSS_DBG_BUS_VEC_B_PHYS)&(&HWIO_MMSS_DBG_BUS_VEC_B_DSI2_BYTE_CLK_OFF_BMSK))==0
    (
      &is_on=1
    )
  )
  else if "&clk"=="cc_dsi2_clk"
  (
    &clk_test=&CLK_MMSS_TEST_DSI2_CLK
    &clk_reg="MMSS_DSI2_CC"
    if (data.long(a:&HWIO_MMSS_DBG_BUS_VEC_C_PHYS)&(&HWIO_MMSS_DBG_BUS_VEC_C_DSI2_CLK_OFF_BMSK))==0
    (
      &is_on=1
    )
  )
  else if "&clk"=="cc_dsi2_esc_clk"
  (
    &clk_test=&CLK_MMSS_TEST_DSI2_ESC_CLK
    &clk_reg="MMSS_DSI2_ESC_CC"
    if (data.long(a:&HWIO_MMSS_DBG_BUS_VEC_I_PHYS)&(&HWIO_MMSS_DBG_BUS_VEC_I_DSI2_ESC_CLK_OFF_BMSK))==0
    (
      &is_on=1
    )
  )
  else if "&clk"=="cc_dsi2_m_ahb_clk"
  (
    &clk_test=&CLK_MMSS_TEST_DSI2_M_AHB_CLK
    &clk_reg="MMSS_AHB_EN"
    if (data.long(a:&HWIO_MMSS_DBG_BUS_VEC_E_PHYS)&(&HWIO_MMSS_DBG_BUS_VEC_E_DSI2_M_AHB_CLK_OFF_BMSK))==0
    (
      &is_on=1
    )
  )
  else if "&clk"=="cc_dsi2_pixel_clk"
  (
    &clk_test=&CLK_MMSS_TEST_MDP_DSI2_PCLK
    &clk_reg="MMSS_DSI2_PIXEL_CC"
    if (data.long(a:&HWIO_MMSS_DBG_BUS_VEC_C_PHYS)&(&HWIO_MMSS_DBG_BUS_VEC_C_DSI2_PIXEL_CLK_OFF_BMSK))==0
    (
      &is_on=1
    )
  )
  else if "&clk"=="cc_dsi2_s_ahb_clk"
  (
    &clk_test=&CLK_MMSS_TEST_DSI2_S_AHB_CLK
    &clk_reg="MMSS_AHB_EN"
    if (data.long(a:&HWIO_MMSS_DBG_BUS_VEC_F_PHYS)&(&HWIO_MMSS_DBG_BUS_VEC_F_DSI2_S_AHB_CLK_OFF_BMSK))==0
    (
      &is_on=1
    )
  )
  else if "&clk"=="cc_fab_ahb_clk"
  (
    &clk_test=&CLK_MMSS_TEST_FAB_AHB_CLK
    &clk_reg="MMSS_AHB_EN"
    if (data.long(a:&HWIO_MMSS_DBG_BUS_VEC_F_PHYS)&(&HWIO_MMSS_DBG_BUS_VEC_F_FAB_AHB_CLK_OFF_BMSK))==0
    (
      &is_on=1
    )
  )
  else if "&clk"=="cc_fab_core_clk"
  (
    &clk_test=&CLK_MMSS_TEST_FAB_CORE_CLK
    &clk_reg="MMSS_AXI_NS"
    if (data.long(a:&HWIO_MMSS_DBG_BUS_VEC_E_PHYS)&(&HWIO_MMSS_DBG_BUS_VEC_E_FAB_CORE_CLK_OFF_BMSK))==0
    (
      &is_on=1
    )
  )
  else if "&clk"=="cc_fab_msp_axi_clk"
  (
    &clk_test=&CLK_MMSS_TEST_FAB_MSP_AXI_CLK
    &clk_reg="MMSS_MAXI_EN"
    if (data.long(a:&HWIO_MMSS_DBG_BUS_VEC_E_PHYS)&(&HWIO_MMSS_DBG_BUS_VEC_E_FAB_MSP_AXI_CLK_OFF_BMSK))==0
    (
      &is_on=1
    )
  )
  else if "&clk"=="cc_gfx2d0_ahb_clk"
  (
    &clk_test=&CLK_MMSS_TEST_GFX2D0_AHB_CLK
    &clk_reg="MMSS_AHB_EN"
    if (data.long(a:&HWIO_MMSS_DBG_BUS_VEC_F_PHYS)&(&HWIO_MMSS_DBG_BUS_VEC_F_GFX2D0_AHB_CLK_OFF_BMSK))==0
    (
      &is_on=1
    )
  )
  else if "&clk"=="cc_gfx2d0_clk"
  (
    &clk_test=&CLK_MMSS_TEST_GFX2D0_CLK
    &clk_reg="MMSS_GFX2D0_CC"
    if (data.long(a:&HWIO_MMSS_DBG_BUS_VEC_A_PHYS)&(&HWIO_MMSS_DBG_BUS_VEC_A_GFX2D0_CLK_OFF_BMSK))==0
    (
      &is_on=1
    )
  )
  else if "&clk"=="cc_gfx2d1_ahb_clk"
  (
    &clk_test=&CLK_MMSS_TEST_GFX2D1_AHB_CLK
    &clk_reg="MMSS_AHB_EN"
    if (data.long(a:&HWIO_MMSS_DBG_BUS_VEC_F_PHYS)&(&HWIO_MMSS_DBG_BUS_VEC_F_GFX2D1_AHB_CLK_OFF_BMSK))==0
    (
      &is_on=1
    )
  )
  else if "&clk"=="cc_gfx2d1_clk"
  (
    &clk_test=&CLK_MMSS_TEST_GFX2D1_CLK
    &clk_reg="MMSS_GFX2D1_CC"
    if (data.long(a:&HWIO_MMSS_DBG_BUS_VEC_A_PHYS)&(&HWIO_MMSS_DBG_BUS_VEC_A_GFX2D1_CLK_OFF_BMSK))==0
    (
      &is_on=1
    )
  )
  else if "&clk"=="cc_gfx3d_ahb_clk"
  (
    &clk_test=&CLK_MMSS_TEST_GFX3D_AHB_CLK
    &clk_reg="MMSS_AHB_EN"
    if (data.long(a:&HWIO_MMSS_DBG_BUS_VEC_F_PHYS)&(&HWIO_MMSS_DBG_BUS_VEC_F_GFX3D_AHB_CLK_OFF_BMSK))==0
    (
      &is_on=1
    )
  )
  else if "&clk"=="cc_gfx3d_clk"
  (
    &clk_test=&CLK_MMSS_TEST_GFX3D_CLK
    &clk_reg="MMSS_GFX3D_CC"
    if (data.long(a:&HWIO_MMSS_DBG_BUS_VEC_A_PHYS)&(&HWIO_MMSS_DBG_BUS_VEC_A_GFX3D_CLK_OFF_BMSK))==0
    (
      &is_on=1
    )
  )
  else if "&clk"=="cc_gmem_axi_clk"
  (
    &clk_test=&CLK_MMSS_TEST_GMEM_AXI_CLK
    &clk_reg="MMSS_MAXI_EN"
    if (data.long(a:&HWIO_MMSS_DBG_BUS_VEC_E_PHYS)&(&HWIO_MMSS_DBG_BUS_VEC_E_GMEM_AXI_CLK_OFF_BMSK))==0
    (
      &is_on=1
    )
  )
  else if "&clk"=="cc_hdmi_app_clk"
  (
    &clk_test=&CLK_MMSS_TEST_HDMI_APP_CLK
    &clk_reg="MMSS_MISC_CC2"
    if (data.long(a:&HWIO_MMSS_DBG_BUS_VEC_B_PHYS)&(&HWIO_MMSS_DBG_BUS_VEC_B_HDMI_APP_CLK_OFF_BMSK))==0
    (
      &is_on=1
    )
  )
  else if "&clk"=="cc_hdmi_m_ahb_clk"
  (
    &clk_test=&CLK_MMSS_TEST_HDMI_M_AHB_CLK
    &clk_reg="MMSS_AHB_EN"
    if (data.long(a:&HWIO_MMSS_DBG_BUS_VEC_F_PHYS)&(&HWIO_MMSS_DBG_BUS_VEC_F_HDMI_M_AHB_CLK_OFF_BMSK))==0
    (
      &is_on=1
    )
  )
  else if "&clk"=="cc_hdmi_ref_clk"
  (
    &clk_test=&CLK_MMSS_TEST_HDMI_REF_CLK
    &is_on=2
  )
  else if "&clk"=="cc_hdmi_s_ahb_clk"
  (
    &clk_test=&CLK_MMSS_TEST_HDMI_S_AHB_CLK
    &clk_reg="MMSS_AHB_EN"
    if (data.long(a:&HWIO_MMSS_DBG_BUS_VEC_F_PHYS)&(&HWIO_MMSS_DBG_BUS_VEC_F_HDMI_S_AHB_CLK_OFF_BMSK))==0
    (
      &is_on=1
    )
  )
  else if "&clk"=="cc_hdmi_tv_clk"
  (
    &clk_test=&CLK_MMSS_TEST_HDMI_TV_CLK
    &clk_reg="MMSS_TV_CC"
    if (data.long(a:&HWIO_MMSS_DBG_BUS_VEC_D_PHYS)&(&HWIO_MMSS_DBG_BUS_VEC_D_HDMI_TV_CLK_OFF_BMSK))==0
    (
      &is_on=1
    )
  )
  else if "&clk"=="cc_ijpeg_ahb_clk"
  (
    &clk_test=&CLK_MMSS_TEST_IJPEG_AHB_CLK
    &clk_reg="MMSS_AHB_EN"
    if (data.long(a:&HWIO_MMSS_DBG_BUS_VEC_F_PHYS)&(&HWIO_MMSS_DBG_BUS_VEC_F_IJPEG_AHB_CLK_OFF_BMSK))==0
    (
      &is_on=1
    )
  )
  else if "&clk"=="cc_ijpeg_axi_clk"
  (
    &clk_test=&CLK_MMSS_TEST_IJPEG_AXI_CLK
    &clk_reg="MMSS_MAXI_EN"
    if (data.long(a:&HWIO_MMSS_DBG_BUS_VEC_E_PHYS)&(&HWIO_MMSS_DBG_BUS_VEC_E_IJPEG_AXI_CLK_OFF_BMSK))==0
    (
      &is_on=1
    )
  )
  else if "&clk"=="cc_ijpeg_clk"
  (
    &clk_test=&CLK_MMSS_TEST_IJPEG_CLK
    &clk_reg="MMSS_IJPEG_CC"
    if (data.long(a:&HWIO_MMSS_DBG_BUS_VEC_A_PHYS)&(&HWIO_MMSS_DBG_BUS_VEC_A_IJPEG_CLK_OFF_BMSK))==0
    (
      &is_on=1
    )
  )
  else if "&clk"=="cc_imem_ahb_clk"
  (
    &clk_test=&CLK_MMSS_TEST_IMEM_AHB_CLK
    &clk_reg="MMSS_AHB_EN"
    if (data.long(a:&HWIO_MMSS_DBG_BUS_VEC_F_PHYS)&(&HWIO_MMSS_DBG_BUS_VEC_F_IMEM_AHB_CLK_OFF_BMSK))==0
    (
      &is_on=1
    )
  )
  else if "&clk"=="cc_imem_axi_clk"
  (
    &clk_test=&CLK_MMSS_TEST_IMEM_AXI_CLK
    &clk_reg="MMSS_MAXI_EN"
    if (data.long(a:&HWIO_MMSS_DBG_BUS_VEC_E_PHYS)&(&HWIO_MMSS_DBG_BUS_VEC_E_IMEM_AXI_CLK_OFF_BMSK))==0
    (
      &is_on=1
    )
  )
  else if "&clk"=="cc_jpegd_ahb_clk"
  (
    &clk_test=&CLK_MMSS_TEST_JPEGD_AHB_CLK
    &clk_reg="MMSS_AHB_EN"
    if (data.long(a:&HWIO_MMSS_DBG_BUS_VEC_F_PHYS)&(&HWIO_MMSS_DBG_BUS_VEC_F_JPEGD_AHB_CLK_OFF_BMSK))==0
    (
      &is_on=1
    )
  )
  else if "&clk"=="cc_jpegd_axi_clk"
  (
    &clk_test=&CLK_MMSS_TEST_JPEGD_AXI_CLK
    &clk_reg="MMSS_MAXI_EN"
    if (data.long(a:&HWIO_MMSS_DBG_BUS_VEC_E_PHYS)&(&HWIO_MMSS_DBG_BUS_VEC_E_JPEGD_AXI_CLK_OFF_BMSK))==0
    (
      &is_on=1
    )
  )
  else if "&clk"=="cc_jpegd_clk"
  (
    &clk_test=&CLK_MMSS_TEST_JPEGD_CLK
    &clk_reg="MMSS_JPEGD_CC"
    if (data.long(a:&HWIO_MMSS_DBG_BUS_VEC_A_PHYS)&(&HWIO_MMSS_DBG_BUS_VEC_A_JPEGD_CLK_OFF_BMSK))==0
    (
      &is_on=1
    )
  )
  else if "&clk"=="cc_lut_mdp_clk"
  (
    &clk_test=&CLK_MMSS_TEST_LUT_MDP_CLK
    &clk_reg="MMSS_MDP_LUT_CC"
    if (data.long(a:&HWIO_MMSS_DBG_BUS_VEC_I_PHYS)&(&HWIO_MMSS_DBG_BUS_VEC_I_LUT_MDP_CLK_OFF_BMSK))==0
    (
      &is_on=1
    )
  )
  else if "&clk"=="cc_mdp_ahb_clk"
  (
    &clk_test=&CLK_MMSS_TEST_MDP_AHB_CLK
    &clk_reg="MMSS_AHB_EN"
    if (data.long(a:&HWIO_MMSS_DBG_BUS_VEC_F_PHYS)&(&HWIO_MMSS_DBG_BUS_VEC_F_MDP_AHB_CLK_OFF_BMSK))==0
    (
      &is_on=1
    )
  )
  else if "&clk"=="cc_mdp_axi_clk"
  (
    &clk_test=&CLK_MMSS_TEST_MDP_AXI_CLK
    &clk_reg="MMSS_MAXI_EN"
    if (data.long(a:&HWIO_MMSS_DBG_BUS_VEC_E_PHYS)&(&HWIO_MMSS_DBG_BUS_VEC_E_MDP_AXI_CLK_OFF_BMSK))==0
    (
      &is_on=1
    )
  )
  else if "&clk"=="cc_mdp_clk"
  (
    &clk_test=&CLK_MMSS_TEST_MDP_CLK
    &clk_reg="MMSS_MDP_CC"
    if (data.long(a:&HWIO_MMSS_DBG_BUS_VEC_C_PHYS)&(&HWIO_MMSS_DBG_BUS_VEC_C_MDP_CLK_OFF_BMSK))==0
    (
      &is_on=1
    )
  )
  else if "&clk"=="cc_mdp_tv_clk"
  (
    &clk_test=&CLK_MMSS_TEST_MDP_TV_CLK
    &clk_reg="MMSS_TV_CC"
    if (data.long(a:&HWIO_MMSS_DBG_BUS_VEC_D_PHYS)&(&HWIO_MMSS_DBG_BUS_VEC_D_MDP_TV_CLK_OFF_BMSK))==0
    (
      &is_on=1
    )
  )
  else if "&clk"=="cc_mdp_vsync_clk"
  (
    &clk_test=&CLK_MMSS_TEST_MDP_VSYNC_CLK
    &clk_reg="MMSS_MISC_CC"
    if (data.long(a:&HWIO_MMSS_DBG_BUS_VEC_B_PHYS)&(&HWIO_MMSS_DBG_BUS_VEC_B_MDP_VSYNC_CLK_OFF_BMSK))==0
    (
      &is_on=1
    )
  )
  else if "&clk"=="cc_mmss_fpb_aon_clk"
  (
    &clk_test=&CLK_MMSS_TEST_MMSS_FPB_ALWAYS_ON_CLK
    &clk_reg="MMSS_DBG_BUS_VEC_H"
    if (data.long(a:&HWIO_MMSS_DBG_BUS_VEC_H_PHYS)&(&HWIO_MMSS_DBG_BUS_VEC_H_MMSS_FPB_ALWAYS_ON_CLK_OFF_BMSK))==0
    (
      &is_on=1
    )
  )
  else if "&clk"=="cc_mmss_fpb_clk"
  (
    &clk_test=&CLK_MMSS_TEST_MMSS_FPB_CLK
    &clk_reg="MMSS_AHB_EN"
    if (data.long(a:&HWIO_MMSS_DBG_BUS_VEC_F_PHYS)&(&HWIO_MMSS_DBG_BUS_VEC_F_MMSS_FPB_CLK_OFF_BMSK))==0
    (
      &is_on=1
    )
  )
  else if "&clk"=="cc_rot_ahb_clk"
  (
    &clk_test=&CLK_MMSS_TEST_ROT_AHB_CLK
    &clk_reg="MMSS_AHB_EN"
    if (data.long(a:&HWIO_MMSS_DBG_BUS_VEC_F_PHYS)&(&HWIO_MMSS_DBG_BUS_VEC_F_ROT_AHB_CLK_OFF_BMSK))==0
    (
      &is_on=1
    )
  )
  else if "&clk"=="cc_rot_axi_clk"
  (
    &clk_test=&CLK_MMSS_TEST_ROT_AXI_CLK
    &clk_reg="MMSS_MAXI_EN2"
    if (data.long(a:&HWIO_MMSS_DBG_BUS_VEC_E_PHYS)&(&HWIO_MMSS_DBG_BUS_VEC_E_ROT_AXI_CLK_OFF_BMSK))==0
    (
      &is_on=1
    )
  )
  else if "&clk"=="cc_rot_clk"
  (
    &clk_test=&CLK_MMSS_TEST_ROT_CLK
    &clk_reg="MMSS_ROT_CC"
    if (data.long(a:&HWIO_MMSS_DBG_BUS_VEC_C_PHYS)&(&HWIO_MMSS_DBG_BUS_VEC_C_ROT_CLK_OFF_BMSK))==0
    (
      &is_on=1
    )
  )
  else if "&clk"=="cc_smmu_ahb_clk"
  (
    &clk_test=&CLK_MMSS_TEST_SMMU_AHB_CLK
    &clk_reg="MMSS_AHB_EN"
    if (data.long(a:&HWIO_MMSS_DBG_BUS_VEC_F_PHYS)&(&HWIO_MMSS_DBG_BUS_VEC_F_SMMU_AHB_CLK_OFF_BMSK))==0
    (
      &is_on=1
    )
  )
  else if "&clk"=="cc_tv_dac_clk"
  (
    &clk_test=&CLK_MMSS_TEST_TV_DAC_CLK
    &clk_reg="MMSS_TV_CC"
    if (data.long(a:&HWIO_MMSS_DBG_BUS_VEC_D_PHYS)&(&HWIO_MMSS_DBG_BUS_VEC_D_TV_DAC_CLK_OFF_BMSK))==0
    (
      &is_on=1
    )
  )
  else if "&clk"=="cc_tv_enc_ahb_clk"
  (
    &clk_test=&CLK_MMSS_TEST_TV_ENC_AHB_CLK
    &clk_reg="MMSS_AHB_EN"
    if (data.long(a:&HWIO_MMSS_DBG_BUS_VEC_F_PHYS)&(&HWIO_MMSS_DBG_BUS_VEC_F_TV_ENC_AHB_CLK_OFF_BMSK))==0
    (
      &is_on=1
    )
  )
  else if "&clk"=="cc_tv_enc_clk"
  (
    &clk_test=&CLK_MMSS_TEST_TV_ENC_CLK
    &clk_reg="MMSS_TV_CC"
    if (data.long(a:&HWIO_MMSS_DBG_BUS_VEC_D_PHYS)&(&HWIO_MMSS_DBG_BUS_VEC_D_TV_ENC_CLK_OFF_BMSK))==0
    (
      &is_on=1
    )
  )
  else if "&clk"=="cc_vcodec_ahb_clk"
  (
    &clk_test=&CLK_MMSS_TEST_VCODEC_AHB_CLK
    &clk_reg="MMSS_AHB_EN"
    if (data.long(a:&HWIO_MMSS_DBG_BUS_VEC_F_PHYS)&(&HWIO_MMSS_DBG_BUS_VEC_F_VCODEC_AHB_CLK_OFF_BMSK))==0
    (
      &is_on=1
    )
  )
  else if "&clk"=="cc_vcodec_axi_A_clk"
  (
    &clk_test=&CLK_MMSS_TEST_VCODEC_A_AXI_CLK
    &clk_reg="MMSS_MAXI_EN4"
    if (data.long(a:&HWIO_MMSS_DBG_BUS_VEC_I_PHYS)&(&HWIO_MMSS_DBG_BUS_VEC_I_VCODEC_AXI_A_CLK_OFF_BMSK))==0
    (
      &is_on=1
    )
  )
  else if "&clk"=="cc_vcodec_axi_B_clk"
  (
    &clk_test=&CLK_MMSS_TEST_VCODEC_B_AXI_CLK
    &clk_reg="MMSS_MAXI_EN4"
    if (data.long(a:&HWIO_MMSS_DBG_BUS_VEC_I_PHYS)&(&HWIO_MMSS_DBG_BUS_VEC_I_VCODEC_AXI_B_CLK_OFF_BMSK))==0
    (
      &is_on=1
    )
  )
  else if "&clk"=="cc_vcodec_axi_clk"
  (
    &clk_test=&CLK_MMSS_TEST_VCODEC_AXI_CLK
    &clk_reg="MMSS_MAXI_EN"
    if (data.long(a:&HWIO_MMSS_DBG_BUS_VEC_E_PHYS)&(&HWIO_MMSS_DBG_BUS_VEC_E_VCODEC_AXI_CLK_OFF_BMSK))==0
    (
      &is_on=1
    )
  )
  else if "&clk"=="cc_vcodec_clk"
  (
    &clk_test=&CLK_MMSS_TEST_VCODEC_CLK
    &clk_reg="MMSS_VCODEC_CC"
    if (data.long(a:&HWIO_MMSS_DBG_BUS_VEC_C_PHYS)&(&HWIO_MMSS_DBG_BUS_VEC_C_VCODEC_CLK_OFF_BMSK))==0
    (
      &is_on=1
    )
  )
  else if "&clk"=="cc_vcodec_pclk"
  (
    &clk_test=&CLK_MMSS_TEST_VCODEC_PCLK
    &clk_reg="MMSS_VCODEC_CC"
    if (data.long(a:&HWIO_MMSS_DBG_BUS_VEC_C_PHYS)&(&HWIO_MMSS_DBG_BUS_VEC_C_VCODEC_CLK_OFF_BMSK))==0
    (
      &is_on=1
    )
  )
  else if "&clk"=="cc_vfe_ahb_clk"
  (
    &clk_test=&CLK_MMSS_TEST_VFE_AHB_CLK
    &clk_reg="MMSS_AHB_EN"
    if (data.long(a:&HWIO_MMSS_DBG_BUS_VEC_F_PHYS)&(&HWIO_MMSS_DBG_BUS_VEC_F_VFE_AHB_CLK_OFF_BMSK))==0
    (
      &is_on=1
    )
  )
  else if "&clk"=="cc_vfe_axi_clk"
  (
    &clk_test=&CLK_MMSS_TEST_VFE_AXI_CLK
    &clk_reg="MMSS_MAXI_EN"
    if (data.long(a:&HWIO_MMSS_DBG_BUS_VEC_E_PHYS)&(&HWIO_MMSS_DBG_BUS_VEC_E_VFE_AXI_CLK_OFF_BMSK))==0
    (
      &is_on=1
    )
  )
  else if "&clk"=="cc_vfe_clk"
  (
    &clk_test=&CLK_MMSS_TEST_VFE_CLK
    &clk_reg="MMSS_VFE_CC"
    if (data.long(a:&HWIO_MMSS_DBG_BUS_VEC_B_PHYS)&(&HWIO_MMSS_DBG_BUS_VEC_B_VFE_CLK_OFF_BMSK))==0
    (
      &is_on=1
    )
  )
  else if "&clk"=="cc_vpe_ahb_clk"
  (
    &clk_test=&CLK_MMSS_TEST_VPE_AHB_CLK
    &clk_reg="MMSS_AHB_EN"
    if (data.long(a:&HWIO_MMSS_DBG_BUS_VEC_F_PHYS)&(&HWIO_MMSS_DBG_BUS_VEC_F_VPE_AHB_CLK_OFF_BMSK))==0
    (
      &is_on=1
    )
  )
  else if "&clk"=="cc_vpe_axi_clk"
  (
    &clk_test=&CLK_MMSS_TEST_VPE_AXI_CLK
    &clk_reg="MMSS_MAXI_EN2"
    if (data.long(a:&HWIO_MMSS_DBG_BUS_VEC_E_PHYS)&(&HWIO_MMSS_DBG_BUS_VEC_E_VPE_AXI_CLK_OFF_BMSK))==0
    (
      &is_on=1
    )
  )
  else if "&clk"=="cc_vpe_clk"
  (
    &clk_test=&CLK_MMSS_TEST_VPE_CLK
    &clk_reg="MMSS_VPE_CC"
    if (data.long(a:&HWIO_MMSS_DBG_BUS_VEC_A_PHYS)&(&HWIO_MMSS_DBG_BUS_VEC_A_VPE_CLK_OFF_BMSK))==0
    (
      &is_on=1
    )
  )
  else if "&clk"=="dsi_ref_clk"
  (
    &clk_test=&CLK_MMSS_TEST_DSI_REF_CLK
    &is_on=2
  )
  else if "&clk"=="ahb_main_hs_clk"
  (
    &clk_test=&CLK_RIVA_TEST_AHB_MAIN_HS_CLK
    &is_on=2
  )
  else if "&clk"=="ahb_main_ls_clk"
  (
    &clk_test=&CLK_RIVA_TEST_AHB_MAIN_LS_CLK
    &is_on=2
  )
  else if "&clk"=="cc_bt_clk"
  (
    &clk_test=&CLK_RIVA_TEST_BT_CLK
    &clk_reg="PMU_CLK_ROOT5"
    if (data.long(a:&HWIO_PMU_CLK_ROOT5_PHYS)&(&HWIO_PMU_CLK_ROOT5_CLK_ENA_BMSK))!=0
    (
      &is_on=1
    )
  )
  else if "&clk"=="cc_ccpu_clk"
  (
    &clk_test=&CLK_RIVA_TEST_ROOT3_CLK
    &clk_reg="PMU_CLK_ROOT3"
    if (data.long(a:&HWIO_PMU_CLK_ROOT3_PHYS)&(&HWIO_PMU_CLK_ROOT3_CLK_ENA_BMSK))!=0
    (
      &is_on=1
    )
  )
  else if "&clk"=="cc_fm_clk"
  (
    &clk_test=&CLK_RIVA_TEST_BT_FM_CLK
    &clk_reg="PMU_CLK_ROOT6"
    if (data.long(a:&HWIO_PMU_CLK_ROOT6_PHYS)&(&HWIO_PMU_CLK_ROOT6_CLK_ENA_BMSK))!=0
    (
      &is_on=1
    )
  )
  else if "&clk"=="cc_wlan_phy_1_clk"
  (
    &clk_test=&CLK_RIVA_TEST_ROOT1_CLK
    &clk_reg="PMU_CLK_ROOT1"
    if (data.long(a:&HWIO_PMU_CLK_ROOT1_PHYS)&(&HWIO_PMU_CLK_ROOT1_CLK_ENA_BMSK))!=0
    (
      &is_on=1
    )
  )
  else if "&clk"=="cc_wlan_phy_2_clk"
  (
    &clk_test=&CLK_RIVA_TEST_ROOT2_CLK
    &clk_reg="PMU_CLK_ROOT2"
    if (data.long(a:&HWIO_PMU_CLK_ROOT2_PHYS)&(&HWIO_PMU_CLK_ROOT2_CLK_ENA_BMSK))!=0
    (
      &is_on=1
    )
  )
  else if "&clk"=="cc_wlan_rfif_clk"
  (
    &clk_test=&CLK_RIVA_TEST_PHY_RFIF_CLK
    &clk_reg="PMU_CLK_ROOT4"
    if (data.long(a:&HWIO_PMU_CLK_ROOT4_PHYS)&(&HWIO_PMU_CLK_ROOT4_CLK_ENA_BMSK))!=0
    (
      &is_on=1
    )
  )
  else if "&clk"=="phy_adc_hs_clk"
  (
    &clk_test=&CLK_RIVA_TEST_PHY_ADC_HS_CLK
    &is_on=2
  )
  else if "&clk"=="phy_adc_ls_clk"
  (
    &clk_test=&CLK_RIVA_TEST_PHY_ADC_LS_CLK
    &is_on=2
  )
  else if "&clk"=="phy_dac_hs_clk"
  (
    &clk_test=&CLK_RIVA_TEST_PHY_DAC_HS_CLK
    &is_on=2
  )
  else if "&clk"=="phy_dac_ls_clk"
  (
    &clk_test=&CLK_RIVA_TEST_PHY_DAC_LS_CLK
    &is_on=2
  )
  else if "&clk"=="root3_120_clk"
  (
    &clk_test=&CLK_RIVA_TEST_ROOT3_120_CLK
    &is_on=2
  )
  else if "&clk"=="slp_clk"
  (
    &clk_test=&CLK_RIVA_TEST_SLP_CLK
    &is_on=2
  )
  else if "&clk"=="tck_clk"
  (
    &clk_test=&CLK_RIVA_TEST_TCK_CLK
    &is_on=2
  )
  else if "&clk"=="tcxo_clk"
  (
    &clk_test=&CLK_RIVA_TEST_TCXO_CLK
    &is_on=2
  )
  else if "&clk"=="sys_apcsqsb_clk"
  (
    &clk_test=&CLK_APCS_TEST_SYS_APCSQSB_CLK
    &is_on=2
  )
  else if "&clk"=="apcc_sysl2leaf_clk"
  (
    &clk_test=&CLK_APCS_TEST_APCC_SYSL2LEAF_CLK
    &is_on=2
  )
  else if "&clk"=="apc0_sysleaf_clk"
  (
    &clk_test=&CLK_APCS_TEST_APC0_SYSLEAF_CLK
    &is_on=2
  )
  else if "&clk"=="apc1_sysleaf_clk"
  (
    &clk_test=&CLK_APCS_TEST_APC1_SYSLEAF_CLK
    &is_on=2
  )
  else if "&clk"=="sys_apcsahb_clk"
  (
    &clk_test=&CLK_APCS_TEST_SYS_APCSAHB_CLK
    &is_on=2
  )
  else if "&clk"=="sys_apcsref_clk"
  (
    &clk_test=&CLK_APCS_TEST_SYS_APCSREF_CLK
    &is_on=2
  )
  else if "&clk"=="sys_apcspisleep_clk"
  (
    &clk_test=&CLK_APCS_TEST_SYS_APCSPISLEEP_CLK
    &is_on=2
  )
  else if "&clk"=="apb_apccdbg_clk"
  (
    &clk_test=&CLK_APCS_TEST_APB_APCCDBG_CLK
    &is_on=2
  )
  else if "&clk"=="atb_apcc_clk"
  (
    &clk_test=&CLK_APCS_TEST_ATB_APCC_CLK
    &is_on=2
  )
  else if "&clk"=="nav_main_clk"
  (
    &clk_test=&CLK_MSS_TEST_NAV_MAIN_CLK
    &is_on=2
  )
  else if "&clk"=="nav_adc1_clk"
  (
    &clk_test=&CLK_MSS_TEST_NAV_ADC1_CLK
    &is_on=2
  )
  else if "&clk"=="nav_adc2_clk"
  (
    &clk_test=&CLK_MSS_TEST_NAV_ADC2_CLK
    &is_on=2
  )
  else if "&clk"=="nav_rsref_clk"
  (
    &clk_test=&CLK_MSS_TEST_NAV_RSREF_CLK
    &is_on=2
  )
  else
  (
    &is_on=3
  )

  return



;****************************************************************
;Filename : DSP_load_memorydump_crashman.cmm
;****************************************************************

ENTRY &Target_Name &ramdumpfile &OutputPath &ADSP_BUILDROOT &CurrentDirectory &Customer_Elf_Path &BinaryLength &adspstartadd &choice1 &DumpCheckFlag &slpi &Qube_pa_guestos_click &dspaddr_align &cdsp_flag

global &ramdumpstartadd
global &choice
global &CurrentDirectory
global &ADSP_BUILDROOT
global &Target_Name
global &pgt_flag

&pgt_flag="False"


global &OutputPath_Qurt
global &OutputPath_temp
global &OutputPath_ulog

area.close
winclear
reset
&OutputPath_temp="&OutputPath"
&OutputPath_Qurt="&OutputPath"
&OutputPath_ulog="&OutputPath"
area.create Crashman
area.open Crashman &OutputPath_temp\areainfo.txt
WINPOS 0% 0. 50% 103% 0. 0. Crashman
area.view Crashman 
area.select Crashman

if "&slpi"==""
(
    &slpi="False"
)
if "&Qube_pa_guestos_click"==""
(
    &Qube_pa_guestos_click=&adspstartadd
)


sys.u

print "##########################################################################################################################"
print "############                Crashman Process logs                                                             ############"
print "##########################################################################################################################"
print 
print 

;OPEN #1 "&OutputPath_temp\version_check.txt" /READ
;READ #1 %line &Python_version
;READ #1 %line &Perl_version
;READ #1 %line &Crashman_version
;print "&Crashman_version"
;print "&Python_version "
;print "&Perl_version"
;print 

;version_start:
;read #1 %line &linelst 
;&Endstring=string.mid("&linelst", 0, 0xe)
;if "&Endstring"=="VersionFileEnd"
;(
;    goto version_done_reading
;)
;print %ERROR "&linelst"
;goto version_start
;version_done_reading:

;CLOSE #1 



print "Dump file Provided   :   &ramdumpfile "
print "ADSP build Provided  :   &ADSP_BUILDROOT "
print "Elf path provided    :   &Customer_Elf_Path"
print "Target Name Provided :   &Target_Name"
print "Output Folder        :   &OutputPath"
print "Cdsp_Flag            :   &cdsp_flag"
print "Current Dir          :   &CurrentDirectory"

;OPEN #1 "&OutputPath_temp\binarylength.txt" /READ
;READ #1 %line &BinaryLength
;CLOSE #1 

;OPEN #1 "&OutputPath_temp\adspstartaddr.txt" /READ
;READ #1 %line &adspstartadd 
;CLOSE #1

if (&BinaryLength>52428800)
(
    &ramdumpstartadd=0x00000000
)
else 
(
    &ramdumpstartadd=&adspstartadd
)

print "##########################"
print "ADSP Start Address: &adspstartadd"
if (&adspstartadd==0)
(
    print " Only LPASS dumps detected "
    print "PLEASE ENTERT ADSP image START ADDRESS: (eg: 0x00000000)" 
    print " "
    print " "
    print " "
    print " "
    enter &adspstartadd 
) 

&choice=&choice1

;;;do &CurrentDirectory\DSP_connect_memdump_MPD.cmm &ramdumpfile &UniqueNumber &ramdumpstartadd &adspstartadd &OutputPath &ADSP_BUILDROOT &Target_Name &CurrentDirectory &Customer_Elf_Path
;;entry &dspfile &UniqueNumber &dumpaddr &dspaddr &OutputPath &ADSP_BUILDROOT &Target_Name &CurrentDirectory &openDSPpath &smdfile &smdaddr 
;&dspfile=&ramdumpfile
&dumpaddr=&ramdumpstartadd
&dspaddr=&adspstartadd
;&openDSPpath=&Customer_Elf_Path
global &Qube_va_guestos
global &Qube_pa_guestos
global &ELF
global &SensorsELF
global &AudioELF

TOOLBAR ON
STATUSBAR ON

;----------------------------------------------------------------------------
; Set the desired CPU
;----------------------------------------------------------------------------
if ("&Target_Name"=="8994")
(
    print "If HexagonV56 is not available, please update trace version to support HexagonV56 for 8994"
    sys.cpu HexagonV56
    print "Please ignore the above message as V56 seems to be supported."
)
else if ("&Target_Name"=="8992")
(
    print "If HexagonV56 is not available, please update trace version to support HexagonV56 for 8992"
    sys.cpu HexagonV56
    print "Please ignore the above message as V56 seems to be supported."
)
else if ("&Target_Name"=="8952")
(
    print "If HexagonV56 is not available, please update trace version to support HexagonV56 for 8952"
    sys.cpu HexagonV56
    print "Please ignore the above message as V56 seems to be supported."
)
else if ("&Target_Name"=="8953")
(
    print "If HexagonV56 is not available, please update trace version to support HexagonV56 for 8953"
    sys.cpu HexagonV56
    print "Please ignore the above message as V56 seems to be supported."
)
else if ("&Target_Name"=="8937")
(
    print "If HexagonV56 is not available, please update trace version to support HexagonV56 for 8937"
    sys.cpu HexagonV56
    print "Please ignore the above message as V56 seems to be supported."
)
else if ("&Target_Name"=="8976")
(
    print "If HexagonV56 is not available, please update trace version to support HexagonV56 for 8976"
    sys.cpu HexagonV56
    print "Please ignore the above message as V56 seems to be supported."
)
else if ("&Target_Name"=="8996")
(
    print "If HexagonV60 is not available, please update trace version to support HexagonV60 for 8996"
    sys.cpu HexagonV60
    print "Please ignore the above message as V60 seems to be supported."
)
else if ("&Target_Name"=="8998")
(
    print "If HexagonV62 is not available, please update trace version to support HexagonV62 for 8998"
    sys.cpu HexagonV62
    print "Please ignore the above message as V62 seems to be supported."
)
else if ("&Target_Name"=="660")
(
    if ("&cdsp_flag"=="True")
    (
        print "If HexagonV60 is not available, please update trace version to support HexagonV60 for 660"
        sys.cpu HexagonV60
        print "Please ignore the above message as V60 seems to be supported."
    )    
    else
    (
        print "If HexagonV62 is not available, please update trace version to support HexagonV62 for 660"
        sys.cpu HexagonV62
        print "Please ignore the above message as V62 seems to be supported."
    )
)
else if ("&Target_Name"=="670")
(
    if ("&cdsp_flag"=="True")
    (
        print "If HexagonV65 is not available, please update trace version to support HexagonV65 for 670"
        sys.cpu HexagonV65
        print "Please ignore the above message as V65 seems to be supported."
    )    
    else
    (
        print "If HexagonV65 is not available, please update trace version to support HexagonV65 for 670"
        sys.cpu HexagonV65
        print "Please ignore the above message as V65 seems to be supported."
    )
)
else if ("&Target_Name"=="845")
(
    if ("&cdsp_flag"=="True")
    (
        print "If HexagonV65 is not available, please update trace version to support HexagonV65 for 845"
        sys.cpu HexagonV65
        print "Please ignore the above message as V65 seems to be supported."
    )    
    else
    (
        print "If HexagonV65 is not available, please update trace version to support HexagonV65 for 845"
        sys.cpu HexagonV65
        print "Please ignore the above message as V65 seems to be supported."
    )
)
else
(
    sys.cpu HexagonV5
)
sys.up
global &TCM_BASE

&TCM_BASE=0xfe400000
;----------------------------------------------------------------------------
; Attach to the Virtio simulation
;----------------------------------------------------------------------------
print "##########################"
print "Loading Binary : &ramdumpfile"
&command="python &CurrentDirectory\LPMPath.py &ramdumpfile &OutputPath"
OS.Hidden &command
if "&dumpaddr"==""
(
   exit
)
else 
(
    if &choice==1
    (
        if OS.FILE(.\build\ms\M8x10AAAAAAAAQ1234.elf)
        (
            ;--------If 8x10 load complete Ram dump . This is required due to SMMU-------
            d.load.binary &ramdumpfile a:&dumpaddr
        )
        else
        (
            if (&dumpaddr==0)
            (
                
                &dspaddr_temp=(&dspaddr)&0x7FFFFFFF
                if "&dspaddr_align"==""
                (
                    &dspaddr_temp=(&dspaddr)&0x7FFFFFFF
                )
                else                
                (
                    &dspaddr_temp=&dspaddr_align
                )

                if OS.FILE(&ADSP_BUILDROOT\build\ms\M8996AAAAAAAAQ1234.elf)
                (
                    d.load.binary &ramdumpfile a:&dspaddr++0x02300000 /SKIP (&dspaddr_temp)
                )
                else if ("&Target_Name"=="8996")||("&Target_Name"=="8998")
                (
                    d.load.binary &ramdumpfile a:&dspaddr++0x02300000 /SKIP (&dspaddr_temp)
                )
                else if ("&Target_Name"=="8976")
                (
                    d.load.binary &ramdumpfile a:&dspaddr++0x01800000 /SKIP (&dspaddr_temp)
                )
                else if ("&Target_Name"=="8952")
                (
                    d.load.binary &ramdumpfile a:&dspaddr++0x01800000 /SKIP (&dspaddr_temp)
                )
                else if ("&Target_Name"=="8953")
                (
                    d.load.binary &ramdumpfile a:&dspaddr++0x01800000 /SKIP (&dspaddr_temp)
                )
                else if ("&Target_Name"=="8937")
                (
                    d.load.binary &ramdumpfile a:&dspaddr++0x01800000 /SKIP (&dspaddr_temp)
                )
				else if ("&Target_Name"=="660")
				(
					if ("&cdsp_flag"=="True")
					(
						d.load.binary &ramdumpfile a:&dspaddr++0x0A00000 /SKIP (&dspaddr_temp)
					)
					else
					(
						d.load.binary &ramdumpfile a:&dspaddr++0x02800000 /SKIP (&dspaddr_temp)
					)
				)
				else if ("&Target_Name"=="670")
				(
					if ("&cdsp_flag"=="True")
					(
						d.load.binary &ramdumpfile a:&dspaddr++0x0A00000 /SKIP (&dspaddr_temp)
					)
					else
					(
						d.load.binary &ramdumpfile a:&dspaddr++0x02800000 /SKIP (&dspaddr_temp)
					)
				)
				else if ("&Target_Name"=="845")
				(
					if ("&cdsp_flag"=="True")
					(
						d.load.binary &ramdumpfile a:&dspaddr++0x0A00000 /SKIP (&dspaddr_temp)
					)
					else
					(
						d.load.binary &ramdumpfile a:&dspaddr++0x02300000 /SKIP (&dspaddr_temp)
					)
				)
                else
                (
                    d.load.binary &ramdumpfile a:&dspaddr++0x01800000 /SKIP &dspaddr
                )
                ;----------------Only taking care of 8x26 and 8974 smem regions	
                ;----------------8x26, 8974 ,8084 - 0xfa00000	
                ;----------------8994 - cc0_0000
                ;----------------8x10 - 0xd900000
                ;----------------9x35- 1100000
            )
            else
            (
                d.load.binary &ramdumpfile a:&dumpaddr
            )
        )
    )
    else if &choice==2
    (
        d.load.elf &ramdumpfile 
    )
    else
    (
        print %ERROR "!!!!!!!!!!!Invalid Choice! Dump is not Loaded!!!!!!!!!!!!!"
        exit
    )
)
print "Loading DDRCS0.BIN Binary Done"
OPEN #1 "&OutputPath_temp\LPMPath.txt" /READ
READ #1 %line &LPMPath
CLOSE #1
cd &LPMPath
if OS.FILE(.\LPM.bin)
(
    d.load.binary LPM.bin a:0xfe090000 /noclear
)
if ("&cdsp_flag"=="True")
(
    &file="&OutputPath\Cdsp_Dump.bin"
    if OS.FILE("&file")
    (
        RM "&file"
    )    
    d.save.binary &OutputPath\Cdsp_Dump.bin a:&dspaddr++0x0A00000
    print "Save Cdsp_Dump.bin Done"
)
else
(
    &file="&OutputPath\Adsp_Dump.bin"
    if OS.FILE("&file")
    (
        RM "&file"
    )    
    d.save.binary &OutputPath\Adsp_Dump.bin a:&dspaddr++0x02800000
    print "Save Adsp_Dump.bin Done"
)

local &command
cd &ADSP_BUILDROOT
print "##########################"
if "&dspaddr"==""
(
    &dspaddr=&dumpaddr
)

;----------------------------------------------------------------------------
; Print banner
;----------------------------------------------------------------------------
&UniqueNumber="NotGiven"
&command="perl &CurrentDirectory\Compare.pl &OutputPath_temp &UniqueNumber"
Os.Hidden &command
OPEN #1 "&OutputPath_temp\Compare.txt" /READ
READ #1 %line &CompareFlag2
CLOSE #1
if (&CompareFlag2==1)
(
    print "&UniqueNumber &Target_Name Dumps: &ramdumpfile"
    title "&UniqueNumber &Target_Name Dumps: &ramdumpfile"
)
else
(
    print "&Target_Name Dumps: &ramdumpfile"
    title "&Target_Name Dumps: &ramdumpfile"
)
;----------------------------------------------------------------------------
;Recall and Define History File
;----------------------------------------------------------------------------
autostore , history

sYmbol.SourcePath.reset

;----------------------------------------------------------------------------
; load DSP Image
;----------------------------------------------------------------------------
cd &ADSP_BUILDROOT
print "##########################"
if ("&Target_Name"=="660")
(
    if ("&cdsp_flag"=="True")
    (
        if OS.FILE(.\build\ms\ROOT_660.cdsp.prodQ.elf)||OS.FILE(&Customer_Elf_Path\ROOT_660.cdsp.prodQ.elf) 
        (
            &ELF="ROOT_660"
            if OS.FILE(&Customer_Elf_Path\ROOT_660.cdsp.prodQ.elf) 
            (
                print "660 Loading ELF: &Customer_Elf_Path\ROOT_660.cdsp.prodQ.elf"
                d.load.elf &Customer_Elf_Path\ROOT_660.cdsp.prodQ.elf /NOCODE /NOREG /NOCLEAR /NOMAP /strippart "adsp_proc" /sourcepath "."
                print "660 Loading ELF Done"
            )
            else
            (
                print "660 Loading ELF: .\build\ms\ROOT_660.cdsp.prodQ.elf"
                d.load.elf .\build\ms\ROOT_660.cdsp.prodQ.elf /NOCODE /NOREG /NOCLEAR /NOMAP /strippart "adsp_proc" /sourcepath "."
                print "660 Loading ELF Done"
            )	
        )
    )
    else
    (
        if OS.FILE(.\build\ms\ROOT_660.adsp.prodQ.elf)||OS.FILE(&Customer_Elf_Path\ROOT_660.adsp.prodQ.elf) 
        (
            &ELF="ROOT_660"
            if OS.FILE(&Customer_Elf_Path\ROOT_660.adsp.prodQ.elf) 
            (
                print "660 Loading ELF: &Customer_Elf_Path\ROOT_660.adsp.prodQ.elf"
                d.load.elf &Customer_Elf_Path\ROOT_660.adsp.prodQ.elf /NOCODE /NOREG /NOCLEAR /NOMAP /strippart "adsp_proc" /sourcepath "."
                &SensorsELF="ROOT_660"
                print "660 Loading ELF Done"
                if OS.FILE(&Customer_Elf_Path\SENSOR_660.adsp.prodQ.elf)
                (
                    print "660 Loading ELF: &Customer_Elf_Path\SENSOR_660.adsp.prodQ.elf"
                    d.load.elf &Customer_Elf_Path\SENSOR_660.adsp.prodQ.elf /NOCODE /NOREG /NOCLEAR /NOMAP /strippart "adsp_proc" /sourcepath "."
                    &SensorsELF="SENSOR_660"
                    print "660 Loading ELF Done"
                )
                &AudioELF="ROOT_660"
                if OS.FILE(&Customer_Elf_Path\AUDIO_660.adsp.prodQ.elf)
                (
                    print "660 Loading ELF: &Customer_Elf_Path\AUDIO_660.adsp.prodQ.elf"
                    d.load.elf &Customer_Elf_Path\AUDIO_660.adsp.prodQ.elf /NOCODE /NOREG /NOCLEAR /NOMAP /strippart "adsp_proc" /sourcepath "."
                    &AudioELF="AUDIO_660"
                    print "660 Loading ELF Done"
                )
            )
            else
            (
                print "660 Loading ELF: .\build\ms\ROOT_660.adsp.prodQ.elf"
                d.load.elf .\build\ms\ROOT_660.adsp.prodQ.elf /NOCODE /NOREG /NOCLEAR /NOMAP /strippart "adsp_proc" /sourcepath "."
                &SensorsELF="ROOT_660"
                print "660 Loading ELF Done"
                if OS.FILE(.\build\ms\SENSOR_660.adsp.prodQ.elf)
                (
                    print "660 Loading ELF: .\build\ms\SENSOR_660.adsp.prodQ.elf"
                    d.load.elf .\build\ms\SENSOR_660.adsp.prodQ.elf /NOCODE /NOREG /NOCLEAR /NOMAP /strippart "adsp_proc" /sourcepath "."
                    &SensorsELF="SENSOR_660"
                    print "660 Loading ELF Done"
                )
                &AudioELF="ROOT_660"
                if OS.FILE(.\build\ms\AUDIO_660.adsp.prodQ.elf)
                (
                    print "660 Loading ELF: .\build\ms\AUDIO_660.adsp.prodQ.elf"
                    d.load.elf .\build\ms\AUDIO_660.adsp.prodQ.elf /NOCODE /NOREG /NOCLEAR /NOMAP /strippart "adsp_proc" /sourcepath "."
                    &AudioELF="AUDIO_660"
                    print "660 Loading ELF Done"
                )
            )	
        )
    )
)
else if ("&Target_Name"=="670")
(
    if ("&cdsp_flag"=="True")
    (
        if OS.FILE(.\build\ms\ROOT_670.cdsp.prodQ.elf)||OS.FILE(&openDSPpath\ROOT_670.cdsp.prodQ.elf) 
        (
            &ELF="ROOT_670"
            if OS.FILE(&openDSPpath\ROOT_670.cdsp.prodQ.elf) 
            (
                print "670 Loading ELF: &openDSPpath\ROOT_670.cdsp.prodQ.elf"
                d.load.elf &openDSPpath\ROOT_670.cdsp.prodQ.elf /NOCODE /NOREG /NOCLEAR /NOMAP /strippart "adsp_proc" /sourcepath "."
                print "670 Loading ELF Done"
            )
            else
            (
                print "670 Loading ELF: .\build\ms\ROOT_670.cdsp.prodQ.elf"
                d.load.elf .\build\ms\ROOT_670.cdsp.prodQ.elf /NOCODE /NOREG /NOCLEAR /NOMAP /strippart "adsp_proc" /sourcepath "."
                print "670 Loading ELF Done"
            )	
        )
    )
    else
    (
        if OS.FILE(.\build\ms\ROOT_670.adsp.prodQ.elf)||OS.FILE(&openDSPpath\ROOT_670.adsp.prodQ.elf) 
        (
            &ELF="ROOT_670"
            if OS.FILE(&openDSPpath\ROOT_670.adsp.prodQ.elf) 
            (
                print "670 Loading ELF: &openDSPpath\ROOT_670.adsp.prodQ.elf"
                d.load.elf &openDSPpath\ROOT_670.adsp.prodQ.elf /NOCODE /NOREG /NOCLEAR /NOMAP /strippart "adsp_proc" /sourcepath "."
                &SensorsELF="ROOT_670"
                print "670 Loading ELF Done"
                if OS.FILE(&openDSPpath\SENSOR_670.adsp.prodQ.elf)
                (
                    print "670 Loading ELF: &openDSPpath\SENSOR_670.adsp.prodQ.elf"
                    d.load.elf &openDSPpath\SENSOR_670.adsp.prodQ.elf /NOCODE /NOREG /NOCLEAR /NOMAP /strippart "adsp_proc" /sourcepath "."
                    &SensorsELF="SENSOR_670"
                    print "670 Loading ELF Done"
                )
                &AudioELF="ROOT_670"
                if OS.FILE(&openDSPpath\AUDIO_670.adsp.prodQ.elf)
                (
                    print "670 Loading ELF: &openDSPpath\AUDIO_670.adsp.prodQ.elf"
                    d.load.elf &openDSPpath\AUDIO_670.adsp.prodQ.elf /NOCODE /NOREG /NOCLEAR /NOMAP /strippart "adsp_proc" /sourcepath "."
                    &AudioELF="AUDIO_670"
                    print "670 Loading ELF Done"
                )
            )
            else
            (
                print "670 Loading ELF: .\build\ms\ROOT_670.adsp.prodQ.elf"
                d.load.elf .\build\ms\ROOT_670.adsp.prodQ.elf /NOCODE /NOREG /NOCLEAR /NOMAP /strippart "adsp_proc" /sourcepath "."
                &SensorsELF="ROOT_670"
                print "670 Loading ELF Done"
                if OS.FILE(.\build\ms\SENSOR_670.adsp.prodQ.elf)
                (
                    print "670 Loading ELF: .\build\ms\SENSOR_670.adsp.prodQ.elf"
                    d.load.elf .\build\ms\SENSOR_670.adsp.prodQ.elf /NOCODE /NOREG /NOCLEAR /NOMAP /strippart "adsp_proc" /sourcepath "."
                    &SensorsELF="SENSOR_670"
                    print "670 Loading ELF Done"
                )
                &AudioELF="ROOT_670"
                if OS.FILE(.\build\ms\AUDIO_670.adsp.prodQ.elf)
                (
                    print "670 Loading ELF: .\build\ms\AUDIO_670.adsp.prodQ.elf"
                    d.load.elf .\build\ms\AUDIO_670.adsp.prodQ.elf /NOCODE /NOREG /NOCLEAR /NOMAP /strippart "adsp_proc" /sourcepath "."
                    &AudioELF="AUDIO_670"
                    print "670 Loading ELF Done"
                )
            )	
        )
    )
)
else if ("&Target_Name"=="845")
(
    if ("&cdsp_flag"=="True")
    (
        if OS.FILE(.\build\ms\ROOT_845.cdsp.prodQ.elf)||OS.FILE(&Customer_Elf_Path\ROOT_845.cdsp.prodQ.elf) 
        (
            if OS.FILE(&Customer_Elf_Path\ROOT_845.cdsp.prodQ.elf) 
            (
                print "845 Loading ELF: &Customer_Elf_Path\ROOT_845.cdsp.prodQ.elf"
                d.load.elf &Customer_Elf_Path\ROOT_845.cdsp.prodQ.elf /NOCODE /NOREG /NOCLEAR /NOMAP /strippart "adsp_proc" /sourcepath "."
                print "845 Loading ELF Done"
            )
            else
            (
                print "845 Loading ELF: .\build\ms\ROOT_845.cdsp.prodQ.elf"
                d.load.elf .\build\ms\ROOT_845.cdsp.prodQ.elf /NOCODE /NOREG /NOCLEAR /NOMAP /strippart "adsp_proc" /sourcepath "."
                print "845 Loading ELF Done"
            )	
        )
    )
    else
    (
        if OS.FILE(.\build\ms\ROOT_845.adsp.prodQ.elf)||OS.FILE(&Customer_Elf_Path\ROOT_845.adsp.prodQ.elf) 
        (
            if OS.FILE(&Customer_Elf_Path\ROOT_845.adsp.prodQ.elf) 
            (
                print "845 Loading ELF: &Customer_Elf_Path\ROOT_845.adsp.prodQ.elf"
                d.load.elf &Customer_Elf_Path\ROOT_845.adsp.prodQ.elf /NOCODE /NOREG /NOCLEAR /NOMAP /strippart "adsp_proc" /sourcepath "."
                &SensorsELF="ROOT_845.adsp.prodQ"
                print "845 Loading ELF Done"
                if OS.FILE(&Customer_Elf_Path\SENSOR_845.adsp.prodQ.elf)
                (
                    print "845 Loading ELF: &Customer_Elf_Path\SENSOR_845.adsp.prodQ.elf"
                    d.load.elf &Customer_Elf_Path\SENSOR_845.adsp.prodQ.elf /NOCODE /NOREG /NOCLEAR /NOMAP /strippart "adsp_proc" /sourcepath "."
                    &SensorsELF="SENSOR_845.adsp.prodQ"
                    print "845 Loading ELF Done"
                )
                &AudioELF="ROOT_845.adsp.prodQ"
                if OS.FILE(&Customer_Elf_Path\AUDIO_845.adsp.prodQ.elf)
                (
                    print "845 Loading ELF: &Customer_Elf_Path\AUDIO_845.adsp.prodQ.elf"
                    d.load.elf &Customer_Elf_Path\AUDIO_845.adsp.prodQ.elf /NOCODE /NOREG /NOCLEAR /NOMAP /strippart "adsp_proc" /sourcepath "."
                    &AudioELF="AUDIO_845.adsp.prodQ"
                    print "845 Loading ELF Done"
                )
            )
            else
            (
                print "845 Loading ELF: .\build\ms\ROOT_845.adsp.prodQ.elf"
                d.load.elf .\build\ms\ROOT_845.adsp.prodQ.elf /NOCODE /NOREG /NOCLEAR /NOMAP /strippart "adsp_proc" /sourcepath "."
                &SensorsELF="ROOT_845.adsp.prodQ"
                print "845 Loading ELF Done"
                if OS.FILE(.\build\ms\SENSOR_845.adsp.prodQ.elf)
                (
                    print "845 Loading ELF: .\build\ms\SENSOR_845.adsp.prodQ.elf"
                    d.load.elf .\build\ms\SENSOR_845.adsp.prodQ.elf /NOCODE /NOREG /NOCLEAR /NOMAP /strippart "adsp_proc" /sourcepath "."
                    &SensorsELF="SENSOR_845.adsp.prodQ"
                    print "845 Loading ELF Done"
                )
                &AudioELF="ROOT_845.adsp.prodQ"
                if OS.FILE(.\build\ms\AUDIO_845.adsp.prodQ.elf)
                (
                    print "845 Loading ELF: .\build\ms\AUDIO_845.adsp.prodQ.elf"
                    d.load.elf .\build\ms\AUDIO_845.adsp.prodQ.elf /NOCODE /NOREG /NOCLEAR /NOMAP /strippart "adsp_proc" /sourcepath "."
                    &AudioELF="AUDIO_845.adsp.prodQ"
                    print "845 Loading ELF Done"
                )
            )	
        )
    )
)
else if ("&Target_Name"=="8976")
(
    if OS.FILE(.\build\ms\M8976AAAAAAAAQ1234.elf)
    (
        if OS.FILE(&Customer_Elf_Path\M8976AAAAAAAAQ1234.elf) 
        (
            print "8976 Loading ELF: &Customer_Elf_Path\M8976AAAAAAAAQ1234.elf"
            d.load.elf &Customer_Elf_Path\M8976AAAAAAAAQ1234.elf /NOCODE /NOREG /NOCLEAR /NOMAP /strippart "adsp_proc" /sourcepath "."
            &ELF="M8976AAAAAAAAQ1234"
            print "8976 Loading ELF Done"
            if OS.FILE(&Customer_Elf_Path\M8976AAAAAAAAQ1234_SENSOR.elf)
            (
                print "8976 Loading ELF: &Customer_Elf_Path\M8976AAAAAAAAQ1234_SENSOR.elf"
                d.load.elf &Customer_Elf_Path\M8976AAAAAAAAQ1234_SENSOR.elf /NOCODE /NOREG /NOCLEAR /NOMAP /strippart "adsp_proc" /sourcepath "."
                &SensorsELF="M8976AAAAAAAAQ1234_Sensor"
                print "8976 Loading ELF Done"
            )
            &AudioELF="M8976AAAAAAAAQ1234"
            if OS.FILE(&Customer_Elf_Path\M8976AAAAAAAAQ1234_AUDIO.elf)
            (
                print "8976 Loading ELF: &Customer_Elf_Path\M8976AAAAAAAAQ1234_AUDIO.elf"
                d.load.elf &Customer_Elf_Path\M8976AAAAAAAAQ1234_AUDIO.elf /NOCODE /NOREG /NOCLEAR /NOMAP /strippart "adsp_proc" /sourcepath "."
                &AudioELF="M8976AAAAAAAAQ1234_AUDIO"
                print "8976 Loading ELF Done"
            )
        )
        else
        (
            print "8976 Loading ELF: .\build\ms\M8976AAAAAAAAQ1234.elf"
            d.load.elf .\build\ms\M8976AAAAAAAAQ1234.elf /NOCODE /NOREG /NOCLEAR /NOMAP /strippart "adsp_proc" /sourcepath "."
            &ELF="M8976AAAAAAAAQ1234"
            print "8976 Loading ELF Done"
            if OS.FILE(.\build\ms\M8976AAAAAAAAQ1234_SENSOR.elf)
            (
                print "8976 Loading ELF: .\build\ms\M8976AAAAAAAAQ1234_SENSOR.elf"
                d.load.elf .\build\ms\M8976AAAAAAAAQ1234_SENSOR.elf /NOCODE /NOREG /NOCLEAR /NOMAP /strippart "adsp_proc" /sourcepath "."
                &SensorsELF="M8976AAAAAAAAQ1234_Sensor"
                print "8976 Loading ELF Done"
            )
            &AudioELF="M8976AAAAAAAAQ1234"
            if OS.FILE(.\build\ms\M8976AAAAAAAAQ1234_AUDIO.elf)
            (
                print "8976 Loading ELF: .\build\ms\M8976AAAAAAAAQ1234_AUDIO.elf"
                d.load.elf .\build\ms\M8976AAAAAAAAQ1234_AUDIO.elf /NOCODE /NOREG /NOCLEAR /NOMAP /strippart "adsp_proc" /sourcepath "."
                &AudioELF="M8976AAAAAAAAQ1234_AUDIO"
                print "8976 Loading ELF Done"
            )
        )	
    )
)    
else if ("&Target_Name"=="8952")
(
    if OS.FILE(.\build\ms\M8952AAAAAAAAQ1234.elf)
    (
        if OS.FILE(&Customer_Elf_Path\M8952AAAAAAAAQ1234.elf) 
        (
            print "8952 Loading ELF: &Customer_Elf_Path\M8952AAAAAAAAQ1234.elf"
            d.load.elf &Customer_Elf_Path\M8952AAAAAAAAQ1234.elf /NOCODE /NOREG /NOCLEAR /NOMAP /strippart "adsp_proc" /sourcepath "."
            &ELF="M8952AAAAAAAAQ1234"
            print "8952 Loading ELF Done"
            if OS.FILE(&Customer_Elf_Path\M8952AAAAAAAAQ1234_SENSOR.elf)
            (
                print "8952 Loading ELF: &Customer_Elf_Path\M8952AAAAAAAAQ1234_SENSOR.elf"
                d.load.elf &Customer_Elf_Path\M8952AAAAAAAAQ1234_SENSOR.elf /NOCODE /NOREG /NOCLEAR /NOMAP /strippart "adsp_proc" /sourcepath "."
                &SensorsELF="M8952AAAAAAAAQ1234_Sensor"
                print "8952 Loading ELF Done"
            )
            &AudioELF="M8952AAAAAAAAQ1234"
            if OS.FILE(&Customer_Elf_Path\M8952AAAAAAAAQ1234_AUDIO.elf)
            (
                print "8952 Loading ELF: &Customer_Elf_Path\M8952AAAAAAAAQ1234_AUDIO.elf"
                d.load.elf &Customer_Elf_Path\M8952AAAAAAAAQ1234_AUDIO.elf /NOCODE /NOREG /NOCLEAR /NOMAP /strippart "adsp_proc" /sourcepath "."
                &AudioELF="M8952AAAAAAAAQ1234_AUDIO"
                print "8952 Loading ELF Done"
            )
        )
        else
        (
            print "8952 Loading ELF: .\build\ms\M8952AAAAAAAAQ1234.elf"
            d.load.elf .\build\ms\M8952AAAAAAAAQ1234.elf /NOCODE /NOREG /NOCLEAR /NOMAP /strippart "adsp_proc" /sourcepath "."
            &ELF="M8952AAAAAAAAQ1234"
            print "8952 Loading ELF Done"
            if OS.FILE(.\build\ms\M8952AAAAAAAAQ1234_SENSOR.elf)
            (
                print "8952 Loading ELF: .\build\ms\M8952AAAAAAAAQ1234_SENSOR.elf"
                d.load.elf .\build\ms\M8952AAAAAAAAQ1234_SENSOR.elf /NOCODE /NOREG /NOCLEAR /NOMAP /strippart "adsp_proc" /sourcepath "."
                &SensorsELF="M8952AAAAAAAAQ1234_Sensor"
                print "8952 Loading ELF Done"
            )
            &AudioELF="M8952AAAAAAAAQ1234"
            if OS.FILE(.\build\ms\M8952AAAAAAAAQ1234_AUDIO.elf)
            (
                print "8952 Loading ELF: .\build\ms\M8952AAAAAAAAQ1234_AUDIO.elf"
                d.load.elf .\build\ms\M8952AAAAAAAAQ1234_AUDIO.elf /NOCODE /NOREG /NOCLEAR /NOMAP /strippart "adsp_proc" /sourcepath "."
                &AudioELF="M8952AAAAAAAAQ1234_AUDIO"
                print "8952 Loading ELF Done"
            )
        )	
    )
)    
else if ("&Target_Name"=="8953")
(
    if OS.FILE(.\build\ms\M8953AAAAAAAAQ1234.elf)
    (
        if OS.FILE(&Customer_Elf_Path\M8953AAAAAAAAQ1234.elf) 
        (
            print "8953 Loading ELF: &Customer_Elf_Path\M8953AAAAAAAAQ1234.elf"
            d.load.elf &Customer_Elf_Path\M8953AAAAAAAAQ1234.elf /NOCODE /NOREG /NOCLEAR /NOMAP /strippart "adsp_proc" /sourcepath "."
            &ELF="M8953AAAAAAAAQ1234"
            print "8953 Loading ELF Done"
            if OS.FILE(&Customer_Elf_Path\M8953AAAAAAAAQ1234_SENSOR.elf)
            (
                print "8953 Loading ELF: &Customer_Elf_Path\M8953AAAAAAAAQ1234_SENSOR.elf"
                d.load.elf &Customer_Elf_Path\M8953AAAAAAAAQ1234_SENSOR.elf /NOCODE /NOREG /NOCLEAR /NOMAP /strippart "adsp_proc" /sourcepath "."
                &SensorsELF="M8953AAAAAAAAQ1234_Sensor"
                print "8953 Loading ELF Done"
            )
            &AudioELF="M8953AAAAAAAAQ1234"
            if OS.FILE(&Customer_Elf_Path\M8953AAAAAAAAQ1234_AUDIO.elf)
            (
                print "8953 Loading ELF: &Customer_Elf_Path\M8953AAAAAAAAQ1234_AUDIO.elf"
                d.load.elf &Customer_Elf_Path\M8953AAAAAAAAQ1234_AUDIO.elf /NOCODE /NOREG /NOCLEAR /NOMAP /strippart "adsp_proc" /sourcepath "."
                &AudioELF="M8953AAAAAAAAQ1234_AUDIO"
                print "8953 Loading ELF Done"
            )
        )
        else
        (
            print "8953 Loading ELF: .\build\ms\M8953AAAAAAAAQ1234.elf"
            d.load.elf .\build\ms\M8953AAAAAAAAQ1234.elf /NOCODE /NOREG /NOCLEAR /NOMAP /strippart "adsp_proc" /sourcepath "."
            &ELF="M8953AAAAAAAAQ1234"
            print "8953 Loading ELF Done"
            if OS.FILE(.\build\ms\M8953AAAAAAAAQ1234_SENSOR.elf)
            (
                print "8953 Loading ELF: .\build\ms\M8953AAAAAAAAQ1234_SENSOR.elf"
                d.load.elf .\build\ms\M8953AAAAAAAAQ1234_SENSOR.elf /NOCODE /NOREG /NOCLEAR /NOMAP /strippart "adsp_proc" /sourcepath "."
                &SensorsELF="M8953AAAAAAAAQ1234_Sensor"
                print "8953 Loading ELF Done"
            )
            &AudioELF="M8953AAAAAAAAQ1234"
            if OS.FILE(.\build\ms\M8953AAAAAAAAQ1234_AUDIO.elf)
            (
                print "8953 Loading ELF: .\build\ms\M8953AAAAAAAAQ1234_AUDIO.elf"
                d.load.elf .\build\ms\M8953AAAAAAAAQ1234_AUDIO.elf /NOCODE /NOREG /NOCLEAR /NOMAP /strippart "adsp_proc" /sourcepath "."
                &AudioELF="M895AAAAAAAAQ1234_AUDIO"
                print "8953 Loading ELF Done"
            )
        )	
    )
)    
else if ("&Target_Name"=="8937")
(
    if OS.FILE(.\build\ms\M8937AAAAAAAAQ1234.elf)
    (
        if OS.FILE(&Customer_Elf_Path\M8937AAAAAAAAQ1234.elf) 
        (
            print "8937 Loading ELF: &Customer_Elf_Path\M8937AAAAAAAAQ1234.elf"
            d.load.elf &Customer_Elf_Path\M8937AAAAAAAAQ1234.elf /NOCODE /NOREG /NOCLEAR /NOMAP /strippart "adsp_proc" /sourcepath "."
            &ELF="M8937AAAAAAAAQ1234"
            print "8937 Loading ELF Done"
            if OS.FILE(&Customer_Elf_Path\M8937AAAAAAAAQ1234_SENSOR.elf)
            (
                print "8937 Loading ELF: &Customer_Elf_Path\M8937AAAAAAAAQ1234_SENSOR.elf"
                d.load.elf &Customer_Elf_Path\M8937AAAAAAAAQ1234_SENSOR.elf /NOCODE /NOREG /NOCLEAR /NOMAP /strippart "adsp_proc" /sourcepath "."
                &SensorsELF="M8937AAAAAAAAQ1234_Sensor"
                print "8937 Loading ELF Done"
            )
            &AudioELF="M8937AAAAAAAAQ1234"
            if OS.FILE(&Customer_Elf_Path\M8937AAAAAAAAQ1234_AUDIO.elf)
            (
                print "8937 Loading ELF: &Customer_Elf_Path\M8937AAAAAAAAQ1234_AUDIO.elf"
                d.load.elf &Customer_Elf_Path\M8937AAAAAAAAQ1234_AUDIO.elf /NOCODE /NOREG /NOCLEAR /NOMAP /strippart "adsp_proc" /sourcepath "."
                &AudioELF="M8937AAAAAAAAQ1234_AUDIO"
                print "8937 Loading ELF Done"
            )
        )
        else
        (
            print "8937 Loading ELF: .\build\ms\M8937AAAAAAAAQ1234.elf"
            d.load.elf .\build\ms\M8937AAAAAAAAQ1234.elf /NOCODE /NOREG /NOCLEAR /NOMAP /strippart "adsp_proc" /sourcepath "."
            &ELF="M8937AAAAAAAAQ1234"
            print "8937 Loading ELF Done"
            if OS.FILE(.\build\ms\M8937AAAAAAAAQ1234_SENSOR.elf)
            (
                print "8937 Loading ELF: .\build\ms\M8937AAAAAAAAQ1234_SENSOR.elf"
                d.load.elf .\build\ms\M8937AAAAAAAAQ1234_SENSOR.elf /NOCODE /NOREG /NOCLEAR /NOMAP /strippart "adsp_proc" /sourcepath "."
                &SensorsELF="M8937AAAAAAAAQ1234_Sensor"
                print "8937 Loading ELF Done"
            )
            &AudioELF="M8937AAAAAAAAQ1234"
            if OS.FILE(.\build\ms\M8937AAAAAAAAQ1234_AUDIO.elf)
            (
                print "8937 Loading ELF: .\build\ms\M8937AAAAAAAAQ1234_AUDIO.elf"
                d.load.elf .\build\ms\M8937AAAAAAAAQ1234_AUDIO.elf /NOCODE /NOREG /NOCLEAR /NOMAP /strippart "adsp_proc" /sourcepath "."
                &AudioELF="M8937AAAAAAAAQ1234_AUDIO"
                print "8937 Loading ELF Done"
            )
        )	
    )
)    
else if OS.FILE(.\build\ms\M8974AAAAAAAAQ1234.elf)
(
    if OS.FILE(&Customer_Elf_Path\M8974AAAAAAAAQ1234.elf) 
    (
        print "8974 Loading ELF: &Customer_Elf_Path\M8974AAAAAAAAQ1234.elf"
        d.load.elf &Customer_Elf_Path\M8974AAAAAAAAQ1234.elf /NOCODE /NOREG /NOCLEAR /NOMAP /strippart "adsp_proc" /sourcepath "."
        &ELF="M8974AAAAAAAAQ1234"
        print "8974 Loading ELF Done"
        if OS.FILE(&Customer_Elf_Path\M8974AAAAAAAAQ1234_SENSOR.elf) 
        (
            print "8974 Loading ELF: &Customer_Elf_Path\M8974AAAAAAAAQ1234_SENSOR.elf"
            d.load.elf &Customer_Elf_Path\M8974AAAAAAAAQ1234_SENSOR.elf /NOCODE /NOREG /NOCLEAR /NOMAP /strippart "adsp_proc" /sourcepath "."
            &SensorsELF="M8974AAAAAAAAQ1234_SENSOR"
            print "8974 Loading ELF Done"
        )
    )
    else
    (
        print "8974 Loading ELF: .\build\ms\M8974AAAAAAAAQ1234.elf"
        d.load.elf .\build\ms\M8974AAAAAAAAQ1234.elf /NOCODE /NOREG /NOCLEAR /NOMAP /strippart "adsp_proc" /sourcepath "."
        &ELF="M8974AAAAAAAAQ1234"
        print "8974 Loading ELF Done"
        if OS.FILE(.\build\ms\M8974AAAAAAAAQ1234_SENSOR.elf) 
        (
            print "8974 Loading ELF: .\build\ms\M8974AAAAAAAAQ1234_SENSOR.elf"
            d.load.elf .\build\ms\M8974AAAAAAAAQ1234_SENSOR.elf /NOCODE /NOREG /NOCLEAR /NOMAP /strippart "adsp_proc" /sourcepath "."
            &SensorsELF="M8974AAAAAAAAQ1234_SENSOR"
            print "8974 Loading ELF Done"
        )
    )	
)
else if OS.FILE(.\build\ms\M8x26AAAAAAAAQ1234.elf)
(
	if OS.FILE(&Customer_Elf_Path\M8x26AAAAAAAAQ1234.elf) 
    (
        print "8x26 Loading ELF: &Customer_Elf_Path\M8x26AAAAAAAAQ1234.elf"
        d.load.elf &Customer_Elf_Path\M8x26AAAAAAAAQ1234.elf /NOCODE /NOREG /NOCLEAR /NOMAP /strippart "adsp_proc" /sourcepath "."
        &ELF="M8x26AAAAAAAAQ1234"
        print "8x26 Loading ELF Done"
        if OS.FILE(&Customer_Elf_Path\M8x26AAAAAAAAQ1234_SENSOR.elf) 
        (
            print "8x26 Loading ELF: &Customer_Elf_Path\M8x26AAAAAAAAQ1234_SENSOR.elf"
            d.load.elf &Customer_Elf_Path\M8x26AAAAAAAAQ1234_SENSOR.elf /NOCODE /NOREG /NOCLEAR /NOMAP /strippart "adsp_proc" /sourcepath "."
            &SensorsELF="M8x26AAAAAAAAQ1234_SENSOR"
            print "8x26 Loading ELF Done"
        )
    )
    else
    (
        print "8x26 Loading ELF: .\build\ms\M8x26AAAAAAAAQ1234.elf"
        d.load.elf .\build\ms\M8x26AAAAAAAAQ1234.elf /NOCODE /NOREG /NOCLEAR /NOMAP /strippart "adsp_proc" /sourcepath "."
        &ELF="M8x26AAAAAAAAQ1234"
        print "8x26 Loading ELF Done"
        if OS.FILE(&Customer_Elf_Path\M8x26AAAAAAAAQ1234_SENSOR.elf) 
        (
            print "8x26 Loading ELF: .\build\ms\M8x26AAAAAAAAQ1234_SENSOR.elf"
            d.load.elf .\build\ms\M8x26AAAAAAAAQ1234_SENSOR.elf /NOCODE /NOREG /NOCLEAR /NOMAP /strippart "adsp_proc" /sourcepath "."
            &SensorsELF="M8x26AAAAAAAAQ1234_SENSOR"
            print "8x26 Loading ELF Done"
        )
    )	
)
else if OS.FILE(.\build\ms\M8x10AAAAAAAAQ1234.elf)
(
	if OS.FILE(&Customer_Elf_Path\M8x10AAAAAAAAQ1234.elf) 
    (
        print "8x10 Loading ELF: &Customer_Elf_Path\M8x10AAAAAAAAQ1234.elf"
        d.load.elf &Customer_Elf_Path\M8x10AAAAAAAAQ1234.elf /NOCODE /NOREG /NOCLEAR /NOMAP /strippart "adsp_proc" /sourcepath "."
        &ELF="M8x10AAAAAAAAQ1234"
        print "8x10 Loading ELF Done"
    )
    else
    (
        print "8x10 Loading ELF: .\build\ms\M8x10AAAAAAAAQ1234.elf"
        d.load.elf .\build\ms\M8x10AAAAAAAAQ1234.elf /NOCODE /NOREG /NOCLEAR /NOMAP /strippart "adsp_proc" /sourcepath "."
        &ELF="M8x10AAAAAAAAQ1234"
        print "8x10 Loading ELF Done"
    )	
)
else if OS.FILE(.\build\ms\M8084AAAAAAAAQ1234.elf)
(
	if OS.FILE(&Customer_Elf_Path\M8084AAAAAAAAQ1234.elf) 
    (
        print "8084 Loading ELF: &Customer_Elf_Path\M8084AAAAAAAAQ1234.elf"
        d.load.elf &Customer_Elf_Path\M8084AAAAAAAAQ1234.elf /NOCODE /NOREG /NOCLEAR /NOMAP /strippart "adsp_proc" /sourcepath "."
        &ELF="M8084AAAAAAAAQ1234"
        print "8084 Loading ELF Done"
        if OS.FILE(&Customer_Elf_Path\M8084AAAAAAAAQ1234_SENSOR.elf) 
        (
            print "8084 Loading ELF: &Customer_Elf_Path\M8084AAAAAAAAQ1234_SENSOR.elf"
            d.load.elf &Customer_Elf_Path\M8084AAAAAAAAQ1234_SENSOR.elf /NOCODE /NOREG /NOCLEAR /NOMAP /strippart "adsp_proc" /sourcepath "."
            &SensorsELF="M8084AAAAAAAAQ1234_SENSOR"
            print "8084 Loading ELF Done"
        )
    )
    else
    (
        print "8084 Loading ELF: .\build\ms\M8084AAAAAAAAQ1234.elf"
        d.load.elf .\build\ms\M8084AAAAAAAAQ1234.elf /NOCODE /NOREG /NOCLEAR /NOMAP /strippart "adsp_proc" /sourcepath "."
        &ELF="M8084AAAAAAAAQ1234"
        print "8084 Loading ELF Done"
        if OS.FILE(.\build\ms\M8084AAAAAAAAQ1234_SENSOR.elf) 
        (
            print "8084 Loading ELF: .\build\ms\M8084AAAAAAAAQ1234_SENSOR.elf"
            d.load.elf .\build\ms\M8084AAAAAAAAQ1234_SENSOR.elf /NOCODE /NOREG /NOCLEAR /NOMAP /strippart "adsp_proc" /sourcepath "."
            &SensorsELF="M8084AAAAAAAAQ1234_SENSOR"
            print "8084 Loading ELF Done"
        )
    )	
)
else if OS.FILE(.\build\ms\M8994AAAAAAAAQ1234.elf)
(
	if OS.FILE(&Customer_Elf_Path\M8994AAAAAAAAQ1234.elf) 
    (
        print "8994 Loading ELF: &Customer_Elf_Path\M8994AAAAAAAAQ1234.elf"
        d.load.elf &Customer_Elf_Path\M8994AAAAAAAAQ1234.elf /NOCODE /NOREG /NOCLEAR /NOMAP /strippart "adsp_proc" /sourcepath "."
        &ELF="M8994AAAAAAAAQ1234"
        print "8994 Loading ELF Done"
        if OS.FILE(&Customer_Elf_Path\M8994AAAAAAAAQ1234_SENSOR.elf)
        (
            print "8994 Loading ELF: &Customer_Elf_Path\M8994AAAAAAAAQ1234_SENSOR.elf"
            d.load.elf &Customer_Elf_Path\M8994AAAAAAAAQ1234_SENSOR.elf /NOCODE /NOREG /NOCLEAR /NOMAP /strippart "adsp_proc" /sourcepath "."
            &SensorsELF="M8994AAAAAAAAQ1234_Sensor"
            print "8994 Loading ELF Done"
        )
        &AudioELF="M8994AAAAAAAAQ1234"
        if OS.FILE(&Customer_Elf_Path\M8994AAAAAAAAQ1234_AUDIO.elf)
        (
            print "8994 Loading ELF: &Customer_Elf_Path\M8994AAAAAAAAQ1234_AUDIO.elf"
            d.load.elf &Customer_Elf_Path\M8994AAAAAAAAQ1234_AUDIO.elf /NOCODE /NOREG /NOCLEAR /NOMAP /strippart "adsp_proc" /sourcepath "."
            &AudioELF="M8994AAAAAAAAQ1234_AUDIO"
            print "8994 Loading ELF Done"
        )
    )
    else
    (
        print "8994 Loading ELF: .\build\ms\M8994AAAAAAAAQ1234.elf"
        d.load.elf .\build\ms\M8994AAAAAAAAQ1234.elf /NOCODE /NOREG /NOCLEAR /NOMAP /strippart "adsp_proc" /sourcepath "."
        &ELF="M8994AAAAAAAAQ1234"
        print "8994 Loading ELF Done"
        if OS.FILE(.\build\ms\M8994AAAAAAAAQ1234_SENSOR.elf)
        (
            print "8994 Loading ELF: .\build\ms\M8994AAAAAAAAQ1234_SENSOR.elf"
            d.load.elf .\build\ms\M8994AAAAAAAAQ1234_SENSOR.elf /NOCODE /NOREG /NOCLEAR /NOMAP /strippart "adsp_proc" /sourcepath "."
            &SensorsELF="M8994AAAAAAAAQ1234_Sensor"
            print "8994 Loading ELF Done"
        )
        &AudioELF="M8994AAAAAAAAQ1234"
        if OS.FILE(.\build\ms\M8994AAAAAAAAQ1234_AUDIO.elf)
        (
            print "8994 Loading ELF: .\build\ms\M8994AAAAAAAAQ1234_AUDIO.elf"
            d.load.elf .\build\ms\M8994AAAAAAAAQ1234_AUDIO.elf /NOCODE /NOREG /NOCLEAR /NOMAP /strippart "adsp_proc" /sourcepath "."
            &AudioELF="M8994AAAAAAAAQ1234_AUDIO"
            print "8994 Loading ELF Done"
        )
    )	
)
else if OS.FILE(.\build\ms\M8992AAAAAAAAQ1234.elf)
(
	if OS.FILE(&Customer_Elf_Path\M8992AAAAAAAAQ1234.elf) 
    (
        print "8992 Loading ELF: &Customer_Elf_Path\M8992AAAAAAAAQ1234.elf"
        d.load.elf &Customer_Elf_Path\M8992AAAAAAAAQ1234.elf /NOCODE /NOREG /NOCLEAR /NOMAP /strippart "adsp_proc" /sourcepath "."
        &ELF="M8992AAAAAAAAQ1234"
        print "8992 Loading ELF Done"
        if OS.FILE(&Customer_Elf_Path\M8992AAAAAAAAQ1234_SENSOR.elf)
        (
            print "8992 Loading ELF: &Customer_Elf_Path\M8992AAAAAAAAQ1234_SENSOR.elf"
            d.load.elf &Customer_Elf_Path\M8992AAAAAAAAQ1234_SENSOR.elf /NOCODE /NOREG /NOCLEAR /NOMAP /strippart "adsp_proc" /sourcepath "."
            &SensorsELF="M8992AAAAAAAAQ1234_Sensor"
            print "8992 Loading ELF Done"
        )
        &AudioELF="M8992AAAAAAAAQ1234"
        if OS.FILE(&Customer_Elf_Path\M8992AAAAAAAAQ1234_AUDIO.elf)
        (
            print "8992 Loading ELF: &Customer_Elf_Path\M8992AAAAAAAAQ1234_AUDIO.elf"
            d.load.elf &Customer_Elf_Path\M8992AAAAAAAAQ1234_AUDIO.elf /NOCODE /NOREG /NOCLEAR /NOMAP /strippart "adsp_proc" /sourcepath "."
            &AudioELF="M8992AAAAAAAAQ1234_AUDIO"
            print "8992 Loading ELF Done"
        )
    )
    else
    (
        print "8992 Loading ELF: .\build\ms\M8992AAAAAAAAQ1234.elf"
        d.load.elf .\build\ms\M8992AAAAAAAAQ1234.elf /NOCODE /NOREG /NOCLEAR /NOMAP /strippart "adsp_proc" /sourcepath "."
        &ELF="M8992AAAAAAAAQ1234"
        print "8992 Loading ELF Done"
        if OS.FILE(.\build\ms\M8992AAAAAAAAQ1234_SENSOR.elf)
        (
            print "8992 Loading ELF: .\build\ms\M8992AAAAAAAAQ1234_SENSOR.elf"
            d.load.elf .\build\ms\M8992AAAAAAAAQ1234_SENSOR.elf /NOCODE /NOREG /NOCLEAR /NOMAP /strippart "adsp_proc" /sourcepath "."
            &SensorsELF="M8992AAAAAAAAQ1234_Sensor"
            print "8992 Loading ELF Done"
        )
        &AudioELF="M8992AAAAAAAAQ1234"
        if OS.FILE(.\build\ms\M8992AAAAAAAAQ1234_AUDIO.elf)
        (
            print "8992 Loading ELF: .\build\ms\M8992AAAAAAAAQ1234_AUDIO.elf"
            d.load.elf .\build\ms\M8992AAAAAAAAQ1234_AUDIO.elf /NOCODE /NOREG /NOCLEAR /NOMAP /strippart "adsp_proc" /sourcepath "."
            &AudioELF="M8992AAAAAAAAQ1234_AUDIO"
            print "8992 Loading ELF Done"
        )
    )	
)
else if OS.FILE(.\build\ms\M8952AAAAAAAAQ1234.elf)
(
	if OS.FILE(&Customer_Elf_Path\M8952AAAAAAAAQ1234.elf) 
    (
        print "8952 Loading ELF: &Customer_Elf_Path\M8952AAAAAAAAQ1234.elf"
        d.load.elf &Customer_Elf_Path\M8952AAAAAAAAQ1234.elf /NOCODE /NOREG /NOCLEAR /NOMAP /strippart "adsp_proc" /sourcepath "."
        &ELF="M8952AAAAAAAAQ1234"
        print "8952 Loading ELF Done"
        if OS.FILE(&Customer_Elf_Path\M8952AAAAAAAAQ1234_SENSOR.elf)
        (
            print "8952 Loading ELF: &Customer_Elf_Path\M8952AAAAAAAAQ1234_SENSOR.elf"
            d.load.elf &Customer_Elf_Path\M8952AAAAAAAAQ1234_SENSOR.elf /NOCODE /NOREG /NOCLEAR /NOMAP /strippart "adsp_proc" /sourcepath "."
            &SensorsELF="M8952AAAAAAAAQ1234_Sensor"
            print "8952 Loading ELF Done"
        )
        &AudioELF="M8952AAAAAAAAQ1234"
        if OS.FILE(&Customer_Elf_Path\M8952AAAAAAAAQ1234_AUDIO.elf)
        (
            print "8952 Loading ELF: &Customer_Elf_Path\M8952AAAAAAAAQ1234_AUDIO.elf"
            d.load.elf &Customer_Elf_Path\M8952AAAAAAAAQ1234_AUDIO.elf /NOCODE /NOREG /NOCLEAR /NOMAP /strippart "adsp_proc" /sourcepath "."
            &AudioELF="M8952AAAAAAAAQ1234_AUDIO"
            print "8952 Loading ELF Done"
        )
    )
    else
    (
        print "8952 Loading ELF: .\build\ms\M8952AAAAAAAAQ1234.elf"
        d.load.elf .\build\ms\M8952AAAAAAAAQ1234.elf /NOCODE /NOREG /NOCLEAR /NOMAP /strippart "adsp_proc" /sourcepath "."
        &ELF="M8952AAAAAAAAQ1234"
        print "8952 Loading ELF Done"
        if OS.FILE(.\build\ms\M8952AAAAAAAAQ1234_SENSOR.elf)
        (
            print "8952 Loading ELF: .\build\ms\M8952AAAAAAAAQ1234_SENSOR.elf"
            d.load.elf .\build\ms\M8952AAAAAAAAQ1234_SENSOR.elf /NOCODE /NOREG /NOCLEAR /NOMAP /strippart "adsp_proc" /sourcepath "."
            &SensorsELF="M8952AAAAAAAAQ1234_Sensor"
            print "8952 Loading ELF Done"
        )
        &AudioELF="M8952AAAAAAAAQ1234"
        if OS.FILE(.\build\ms\M8952AAAAAAAAQ1234_AUDIO.elf)
        (
            print "8952 Loading ELF: .\build\ms\M8952AAAAAAAAQ1234_AUDIO.elf"
            d.load.elf .\build\ms\M8952AAAAAAAAQ1234_AUDIO.elf /NOCODE /NOREG /NOCLEAR /NOMAP /strippart "adsp_proc" /sourcepath "."
            &AudioELF="M8952AAAAAAAAQ1234_AUDIO"
            print "8952 Loading ELF Done"
        )
    )	
)
else if OS.FILE(.\build\ms\M8953AAAAAAAAQ1234.elf)
(
	if OS.FILE(&Customer_Elf_Path\M8953AAAAAAAAQ1234.elf) 
    (
        print "8953 Loading ELF: &Customer_Elf_Path\M8953AAAAAAAAQ1234.elf"
        d.load.elf &Customer_Elf_Path\M8953AAAAAAAAQ1234.elf /NOCODE /NOREG /NOCLEAR /NOMAP /strippart "adsp_proc" /sourcepath "."
        &ELF="M8953AAAAAAAAQ1234"
        print "8953 Loading ELF Done"
        if OS.FILE(&Customer_Elf_Path\M8953AAAAAAAAQ1234_SENSOR.elf)
        (
            print "8953 Loading ELF: &Customer_Elf_Path\M8953AAAAAAAAQ1234_SENSOR.elf"
            d.load.elf &Customer_Elf_Path\M8953AAAAAAAAQ1234_SENSOR.elf /NOCODE /NOREG /NOCLEAR /NOMAP /strippart "adsp_proc" /sourcepath "."
            &SensorsELF="M8953AAAAAAAAQ1234_Sensor"
            print "8953 Loading ELF Done"
        )
        &AudioELF="M8953AAAAAAAAQ1234"
        if OS.FILE(&Customer_Elf_Path\M8953AAAAAAAAQ1234_AUDIO.elf)
        (
            print "8953 Loading ELF: &Customer_Elf_Path\M8953AAAAAAAAQ1234_AUDIO.elf"
            d.load.elf &Customer_Elf_Path\M8953AAAAAAAAQ1234_AUDIO.elf /NOCODE /NOREG /NOCLEAR /NOMAP /strippart "adsp_proc" /sourcepath "."
            &AudioELF="M8953AAAAAAAAQ1234_AUDIO"
            print "8953 Loading ELF Done"
        )
    )
    else
    (
        print "8953 Loading ELF: .\build\ms\M8953AAAAAAAAQ1234.elf"
        d.load.elf .\build\ms\M8953AAAAAAAAQ1234.elf /NOCODE /NOREG /NOCLEAR /NOMAP /strippart "adsp_proc" /sourcepath "."
        &ELF="M8953AAAAAAAAQ1234"
        print "8953 Loading ELF Done"
        if OS.FILE(.\build\ms\M8953AAAAAAAAQ1234_SENSOR.elf)
        (
            print "8953 Loading ELF: .\build\ms\M8953AAAAAAAAQ1234_SENSOR.elf"
            d.load.elf .\build\ms\M8953AAAAAAAAQ1234_SENSOR.elf /NOCODE /NOREG /NOCLEAR /NOMAP /strippart "adsp_proc" /sourcepath "."
            &SensorsELF="M8953AAAAAAAAQ1234_Sensor"
            print "8953 Loading ELF Done"
        )
        &AudioELF="M8953AAAAAAAAQ1234"
        if OS.FILE(.\build\ms\M8953AAAAAAAAQ1234_AUDIO.elf)
        (
            print "8953 Loading ELF: .\build\ms\M8953AAAAAAAAQ1234_AUDIO.elf"
            d.load.elf .\build\ms\M8953AAAAAAAAQ1234_AUDIO.elf /NOCODE /NOREG /NOCLEAR /NOMAP /strippart "adsp_proc" /sourcepath "."
            &AudioELF="M8953AAAAAAAAQ1234_AUDIO"
            print "8953 Loading ELF Done"
        )
    )	
)
else if OS.FILE(.\build\ms\M8937AAAAAAAAQ1234.elf)
(
	if OS.FILE(&Customer_Elf_Path\M8937AAAAAAAAQ1234.elf) 
    (
        print "8937 Loading ELF: &Customer_Elf_Path\M8937AAAAAAAAQ1234.elf"
        d.load.elf &Customer_Elf_Path\M8937AAAAAAAAQ1234.elf /NOCODE /NOREG /NOCLEAR /NOMAP /strippart "adsp_proc" /sourcepath "."
        &ELF="M8937AAAAAAAAQ1234"
        print "8937 Loading ELF Done"
        if OS.FILE(&Customer_Elf_Path\M8937AAAAAAAAQ1234_SENSOR.elf)
        (
            print "8937 Loading ELF: &Customer_Elf_Path\M8937AAAAAAAAQ1234_SENSOR.elf"
            d.load.elf &Customer_Elf_Path\M8937AAAAAAAAQ1234_SENSOR.elf /NOCODE /NOREG /NOCLEAR /NOMAP /strippart "adsp_proc" /sourcepath "."
            &SensorsELF="M8937AAAAAAAAQ1234_Sensor"
            print "8937 Loading ELF Done"
        )
        &AudioELF="M8937AAAAAAAAQ1234"
        if OS.FILE(&Customer_Elf_Path\M8937AAAAAAAAQ1234_AUDIO.elf)
        (
            print "8937 Loading ELF: &Customer_Elf_Path\M8937AAAAAAAAQ1234_AUDIO.elf"
            d.load.elf &Customer_Elf_Path\M8937AAAAAAAAQ1234_AUDIO.elf /NOCODE /NOREG /NOCLEAR /NOMAP /strippart "adsp_proc" /sourcepath "."
            &AudioELF="M8937AAAAAAAAQ1234_AUDIO"
            print "8937 Loading ELF Done"
        )
    )
    else
    (
        print "8937 Loading ELF: .\build\ms\M8937AAAAAAAAQ1234.elf"
        d.load.elf .\build\ms\M8937AAAAAAAAQ1234.elf /NOCODE /NOREG /NOCLEAR /NOMAP /strippart "adsp_proc" /sourcepath "."
        &ELF="M8937AAAAAAAAQ1234"
        print "8937 Loading ELF Done"
        if OS.FILE(.\build\ms\M8937AAAAAAAAQ1234_SENSOR.elf)
        (
            print "8937 Loading ELF: .\build\ms\M8937AAAAAAAAQ1234_SENSOR.elf"
            d.load.elf .\build\ms\M8937AAAAAAAAQ1234_SENSOR.elf /NOCODE /NOREG /NOCLEAR /NOMAP /strippart "adsp_proc" /sourcepath "."
            &SensorsELF="M8937AAAAAAAAQ1234_Sensor"
            print "8937 Loading ELF Done"
        )
        &AudioELF="M8937AAAAAAAAQ1234"
        if OS.FILE(.\build\ms\M8937AAAAAAAAQ1234_AUDIO.elf)
        (
            print "8937 Loading ELF: .\build\ms\M8937AAAAAAAAQ1234_AUDIO.elf"
            d.load.elf .\build\ms\M8937AAAAAAAAQ1234_AUDIO.elf /NOCODE /NOREG /NOCLEAR /NOMAP /strippart "adsp_proc" /sourcepath "."
            &AudioELF="M8937AAAAAAAAQ1234_AUDIO"
            print "8937 Loading ELF Done"
        )
    )	
)
else if OS.FILE(.\build\ms\M8976AAAAAAAAQ1234.elf)
(
	if OS.FILE(&Customer_Elf_Path\M8976AAAAAAAAQ1234.elf) 
    (
        print "8976 Loading ELF: &Customer_Elf_Path\M8976AAAAAAAAQ1234.elf"
        d.load.elf &Customer_Elf_Path\M8976AAAAAAAAQ1234.elf /NOCODE /NOREG /NOCLEAR /NOMAP /strippart "adsp_proc" /sourcepath "."
        &ELF="M8976AAAAAAAAQ1234"
        print "8976 Loading ELF Done"
        if OS.FILE(&Customer_Elf_Path\M8976AAAAAAAAQ1234_SENSOR.elf)
        (
            print "8976 Loading ELF: &Customer_Elf_Path\M8976AAAAAAAAQ1234_SENSOR.elf"
            d.load.elf &Customer_Elf_Path\M8976AAAAAAAAQ1234_SENSOR.elf /NOCODE /NOREG /NOCLEAR /NOMAP /strippart "adsp_proc" /sourcepath "."
            &SensorsELF="M8976AAAAAAAAQ1234_Sensor"
            print "8976 Loading ELF Done"
        )
        &AudioELF="M8976AAAAAAAAQ1234"
        if OS.FILE(&Customer_Elf_Path\M8976AAAAAAAAQ1234_AUDIO.elf)
        (
            print "8976 Loading ELF: &Customer_Elf_Path\M8976AAAAAAAAQ1234_AUDIO.elf"
            d.load.elf &Customer_Elf_Path\M8976AAAAAAAAQ1234_AUDIO.elf /NOCODE /NOREG /NOCLEAR /NOMAP /strippart "adsp_proc" /sourcepath "."
            &AudioELF="M8976AAAAAAAAQ1234_AUDIO"
            print "8976 Loading ELF Done"
        )
    )
    else
    (
        print "8976 Loading ELF: .\build\ms\M8976AAAAAAAAQ1234.elf"
        d.load.elf .\build\ms\M8976AAAAAAAAQ1234.elf /NOCODE /NOREG /NOCLEAR /NOMAP /strippart "adsp_proc" /sourcepath "."
        &ELF="M8976AAAAAAAAQ1234"
        print "8976 Loading ELF Done"
        if OS.FILE(.\build\ms\M8976AAAAAAAAQ1234_SENSOR.elf)
        (
            print "8976 Loading ELF: .\build\ms\M8976AAAAAAAAQ1234_SENSOR.elf"
            d.load.elf .\build\ms\M8976AAAAAAAAQ1234_SENSOR.elf /NOCODE /NOREG /NOCLEAR /NOMAP /strippart "adsp_proc" /sourcepath "."
            &SensorsELF="M8976AAAAAAAAQ1234_Sensor"
            print "8976 Loading ELF Done"
        )
        &AudioELF="M8976AAAAAAAAQ1234"
        if OS.FILE(.\build\ms\M8976AAAAAAAAQ1234_AUDIO.elf)
        (
            print "8976 Loading ELF: .\build\ms\M8976AAAAAAAAQ1234_AUDIO.elf"
            d.load.elf .\build\ms\M8976AAAAAAAAQ1234_AUDIO.elf /NOCODE /NOREG /NOCLEAR /NOMAP /strippart "adsp_proc" /sourcepath "."
            &AudioELF="M8976AAAAAAAAQ1234_AUDIO"
            print "8976 Loading ELF Done"
        )
    )	
)
else if OS.FILE(.\build\ms\M9x25AAAAAAAAAQ1234.elf)
(
	if OS.FILE(&Customer_Elf_Path\M9x25AAAAAAAAAQ1234.elf) 
    (
        print "9x25 Loading ELF: &Customer_Elf_Path\M9x25AAAAAAAAAQ1234.elf"
        d.load.elf &Customer_Elf_Path\M9x25AAAAAAAAAQ1234.elf /NOCODE /NOREG /NOCLEAR /NOMAP /strippart "adsp_proc" /sourcepath "."
        &ELF="M9x25AAAAAAAAAQ1234"
        print "9x25 Loading ELF Done"
    )
    else
    (
        print "9x25 Loading ELF: .\build\ms\M9x25AAAAAAAAAQ1234.elf"
        d.load.elf .\build\ms\M9x25AAAAAAAAAQ1234.elf /NOCODE /NOREG /NOCLEAR /NOMAP /strippart "adsp_proc" /sourcepath "."
        &ELF="M9x25AAAAAAAAAQ1234"
        print "9x25 Loading ELF Done"
    )	
)
else if OS.FILE(.\build\ms\M9x35AAAAAAAAQ1234.elf)
(
	if OS.FILE(&Customer_Elf_Path\M9x35AAAAAAAAQ1234.elf) 
    (
        print "9x35 Loading ELF: &Customer_Elf_Path\M9x35AAAAAAAAQ1234.elf"
        d.load.elf &Customer_Elf_Path\M9x35AAAAAAAAQ1234.elf /NOCODE /NOREG /NOCLEAR /NOMAP /strippart "adsp_proc" /sourcepath "."
        &ELF="M9x35AAAAAAAAQ1234"
        print "9x35 Loading ELF Done"
    )
    else
    (
        print "9x35 Loading ELF: .\build\ms\M9x35AAAAAAAAQ1234.elf"
        d.load.elf .\build\ms\M9x35AAAAAAAAQ1234.elf /NOCODE /NOREG /NOCLEAR /NOMAP /strippart "adsp_proc" /sourcepath "."
        &ELF="M9x35AAAAAAAAQ1234"
        print "9x35 Loading ELF Done"
    )	
)
else if OS.FILE(.\build\ms\M8996AAAAAAAAQ1234.elf)
(
    if "&slpi"=="True"
    (
        if OS.FILE(&Customer_Elf_Path\M8996AAAAAAAAQ1234.elf) 
        (
            print "8996 Loading ELF: &Customer_Elf_Path\M8996AAAAAAAAQ1234.elf"
            d.load.elf &Customer_Elf_Path\M8996AAAAAAAAQ1234.elf /NOCODE /NOREG /NOCLEAR /NOMAP /strippart "slpi_proc" /sourcepath "."        
            &ELF="M8996AAAAAAAAQ1234"
            print "8996 Loading ELF Done"
            &AudioELF="M8996AAAAAAAAQ1234"
            if OS.FILE(&Customer_Elf_Path\M8996AAAAAAAAQ1234_SENSOR.elf)
            (
                print "8996 Loading ELF: &Customer_Elf_Path\M8996AAAAAAAAQ1234_SENSOR.elf"
                d.load.elf &Customer_Elf_Path\M8996AAAAAAAAQ1234_SENSOR.elf /NOCODE /NOREG /NOCLEAR /NOMAP /strippart "slpi_proc" /sourcepath "."
                &AudioELF="M8996AAAAAAAAQ1234_SENSOR"
                print "8996 Loading ELF Done"
            )
        )
        else
        (
            print "8996 Loading ELF: .\build\ms\M8996AAAAAAAAQ1234.elf"
            d.load.elf .\build\ms\M8996AAAAAAAAQ1234.elf /NOCODE /NOREG /NOCLEAR /NOMAP /strippart "slpi_proc" /sourcepath "."        
            &ELF="M8996AAAAAAAAQ1234"
            print "8996 Loading ELF Done"
            &AudioELF="M8996AAAAAAAAQ1234"
            if OS.FILE(.\build\ms\M8996AAAAAAAAQ1234_SENSOR.elf)
            (
                print "8996 Loading ELF: .\build\ms\M8996AAAAAAAAQ1234_SENSOR.elf"
                d.load.elf .\build\ms\M8996AAAAAAAAQ1234_SENSOR.elf /NOCODE /NOREG /NOCLEAR /NOMAP /strippart "slpi_proc" /sourcepath "."
                &AudioELF="M8996AAAAAAAAQ1234_SENSOR"
                print "8996 Loading ELF Done"
            )
        )
    )
    else
    (
        if OS.FILE(&Customer_Elf_Path\M8996AAAAAAAAQ1234.elf) 
        (
            print "8996 Loading ELF: &Customer_Elf_Path\M8996AAAAAAAAQ1234.elf"
            d.load.elf &Customer_Elf_Path\M8996AAAAAAAAQ1234.elf /NOCODE /NOREG /NOCLEAR /NOMAP /strippart "adsp_proc" /sourcepath "."        
            &ELF="M8996AAAAAAAAQ1234"
            print "8996 Loading ELF Done"
            &AudioELF="M8996AAAAAAAAQ1234"
            if OS.FILE(&Customer_Elf_Path\M8996AAAAAAAAQ1234_AUDIO.elf)
            (
                print "8996 Loading ELF: &Customer_Elf_Path\M8996AAAAAAAAQ1234_AUDIO.elf"
                d.load.elf &Customer_Elf_Path\M8996AAAAAAAAQ1234_AUDIO.elf /NOCODE /NOREG /NOCLEAR /NOMAP /strippart "adsp_proc" /sourcepath "."
                &AudioELF="M8996AAAAAAAAQ1234_AUDIO"
                print "8996 Loading ELF Done"
            )
        )
        else
        (
            print "8996 Loading ELF: .\build\ms\M8996AAAAAAAAQ1234.elf"
            d.load.elf .\build\ms\M8996AAAAAAAAQ1234.elf /NOCODE /NOREG /NOCLEAR /NOMAP /strippart "adsp_proc" /sourcepath "."        
            &ELF="M8996AAAAAAAAQ1234"
            print "8996 Loading ELF Done"
            &AudioELF="M8996AAAAAAAAQ1234"
            if OS.FILE(.\build\ms\M8996AAAAAAAAQ1234_AUDIO.elf)
            (
                print "8996 Loading ELF: .\build\ms\M8996AAAAAAAAQ1234_AUDIO.elf"
                d.load.elf .\build\ms\M8996AAAAAAAAQ1234_AUDIO.elf /NOCODE /NOREG /NOCLEAR /NOMAP /strippart "adsp_proc" /sourcepath "."
                &AudioELF="M8996AAAAAAAAQ1234_AUDIO"
                print "8996 Loading ELF Done"
            )
        )
    )
)
else if OS.FILE(.\build\ms\M8998AAAAAAAAQ1234.elf)
(
    if "&slpi"=="True"
    (
        if OS.FILE(&Customer_Elf_Path\M8998AAAAAAAAQ1234.elf) 
        (
            print "8998 Loading ELF: &Customer_Elf_Path\M8998AAAAAAAAQ1234.elf"
            d.load.elf &Customer_Elf_Path\M8998AAAAAAAAQ1234.elf /NOCODE /NOREG /NOCLEAR /NOMAP /strippart "slpi_proc" /sourcepath "."        
            &ELF="M8998AAAAAAAAQ1234"
            print "8998 Loading ELF Done"
            &AudioELF="M8998AAAAAAAAQ1234"
            if OS.FILE(&Customer_Elf_Path\M8998AAAAAAAAQ1234_SENSOR.elf)
            (
                print "8998 Loading ELF: &Customer_Elf_Path\M8998AAAAAAAAQ1234_SENSOR.elf"
                d.load.elf &Customer_Elf_Path\M8998AAAAAAAAQ1234_SENSOR.elf /NOCODE /NOREG /NOCLEAR /NOMAP /strippart "slpi_proc" /sourcepath "."
                &AudioELF="M8998AAAAAAAAQ1234_SENSOR"
                print "8998 Loading ELF Done"
            )
        )
        else
        (
            print "8998 Loading ELF: .\build\ms\M8998AAAAAAAAQ1234.elf"
            d.load.elf .\build\ms\M8998AAAAAAAAQ1234.elf /NOCODE /NOREG /NOCLEAR /NOMAP /strippart "slpi_proc" /sourcepath "."        
            &ELF="M8998AAAAAAAAQ1234"
            print "8998 Loading ELF Done"
            &AudioELF="M8998AAAAAAAAQ1234"
            if OS.FILE(.\build\ms\M8998AAAAAAAAQ1234_SENSOR.elf)
            (
                print "8998 Loading ELF: .\build\ms\M8998AAAAAAAAQ1234_SENSOR.elf"
                d.load.elf .\build\ms\M8998AAAAAAAAQ1234_SENSOR.elf /NOCODE /NOREG /NOCLEAR /NOMAP /strippart "slpi_proc" /sourcepath "."
                &AudioELF="M8998AAAAAAAAQ1234_SENSOR"
                print "8998 Loading ELF Done"
            )
        )
    )
    else
    (
        if OS.FILE(&Customer_Elf_Path\M8998AAAAAAAAQ1234.elf) 
        (
            print "8998 Loading ELF: &Customer_Elf_Path\M8998AAAAAAAAQ1234.elf"
            d.load.elf &Customer_Elf_Path\M8998AAAAAAAAQ1234.elf /NOCODE /NOREG /NOCLEAR /NOMAP /strippart "adsp_proc" /sourcepath "."        
            &ELF="M8998AAAAAAAAQ1234"
            print "8998 Loading ELF Done"
            &AudioELF="M8998AAAAAAAAQ1234"
            if OS.FILE(&Customer_Elf_Path\M8998AAAAAAAAQ1234_AUDIO.elf)
            (
                print "8998 Loading ELF: &Customer_Elf_Path\M8998AAAAAAAAQ1234_AUDIO.elf"
                d.load.elf &Customer_Elf_Path\M8998AAAAAAAAQ1234_AUDIO.elf /NOCODE /NOREG /NOCLEAR /NOMAP /strippart "adsp_proc" /sourcepath "."
                &AudioELF="M8998AAAAAAAAQ1234_AUDIO"
                print "8998 Loading ELF Done"
            )
        )
        else
        (
            print "8998 Loading ELF: .\build\ms\M8998AAAAAAAAQ1234.elf"
            d.load.elf .\build\ms\M8998AAAAAAAAQ1234.elf /NOCODE /NOREG /NOCLEAR /NOMAP /strippart "adsp_proc" /sourcepath "."        
            &ELF="M8998AAAAAAAAQ1234"
            print "8998 Loading ELF Done"
            &AudioELF="M8998AAAAAAAAQ1234"
            if OS.FILE(.\build\ms\M8998AAAAAAAAQ1234_AUDIO.elf)
            (
                print "8998 Loading ELF: .\build\ms\M8998AAAAAAAAQ1234_AUDIO.elf"
                d.load.elf .\build\ms\M8998AAAAAAAAQ1234_AUDIO.elf /NOCODE /NOREG /NOCLEAR /NOMAP /strippart "adsp_proc" /sourcepath "."
                &AudioELF="M8998AAAAAAAAQ1234_AUDIO"
                print "8998 Loading ELF Done"
            )
        )
    )
)
&check_path="&CurrentDirectory"
&pgt_flag="False"
if OS.FILE(&ADSP_BUILDROOT\core\kernel\qurt\build\adsp_link\&Target_Name\install\ADSPv56MP\debugger\T32\qurt_model.t32)
(
    &check_path="&ADSP_BUILDROOT\core\kernel\qurt\build\adsp_link\&Target_Name\install\ADSPv56MP\debugger\T32"
    &pgt_flag="True"
)
else if OS.FILE(&ADSP_BUILDROOT\core\kernel\qurt\osam\build\T32\generic\qurt_model.t32)
(
    &check_path="&ADSP_BUILDROOT\core\kernel\qurt\osam\build\T32\generic"
    &pgt_flag="True"
)
else if OS.FILE(&ADSP_BUILDROOT\core\kernel\qurt\build\core_libs\qdsp6\AAAAAAAA\install\ADSPv56MP\debugger\T32\qurt_model.t32)
(
    &check_path="&ADSP_BUILDROOT\core\kernel\qurt\build\core_libs\qdsp6\AAAAAAAA\install\ADSPv56MP\debugger\T32"
    &pgt_flag="True"
)
else if OS.FILE(&ADSP_BUILDROOT\core\kernel\qurt\build\adsp_link\qdsp6\AAAAAAAA\install\ADSPv60MP\debugger\T32\qurt_model.t32)
(
    &check_path="&ADSP_BUILDROOT\core\kernel\qurt\build\adsp_link\qdsp6\AAAAAAAA\install\ADSPv60MP\debugger\T32"
    &pgt_flag="True"
)
else if OS.FILE(&ADSP_BUILDROOT\core\kernel\qurt\build\adsp_link\qdsp6\AAAAAAAA\install\ADSPv56MP\debugger\T32\qurt_model.t32)
(
    &check_path="&ADSP_BUILDROOT\core\kernel\qurt\build\adsp_link\qdsp6\AAAAAAAA\install\ADSPv56MP\debugger\T32"
    &pgt_flag="True"
)
else if OS.FILE(&ADSP_BUILDROOT\core\kernel\qurt\build\slpi_root\qdsp6\AAAAAAAA\install\sensorsv60_v1\debugger\T32\qurt_model.t32)
(
    &check_path="&ADSP_BUILDROOT\core\kernel\qurt\build\slpi_root\qdsp6\AAAAAAAA\install\sensorsv60_v1\debugger\T32"
    &pgt_flag="True"
)
else if OS.FILE(&ADSP_BUILDROOT\core\kernel\qurt\build\ssc_slpi_user\qdsp6\AAAAAAAA\install\sensorsv60\debugger\T32\qurt_model.t32)
(
    &check_path="&ADSP_BUILDROOT\core\kernel\qurt\build\ssc_slpi_user\qdsp6\AAAAAAAA\install\sensorsv60\debugger\T32"
    &pgt_flag="True"
)
else if OS.FILE(&ADSP_BUILDROOT\core\kernel\qurt\osam\bin\T32\generic\qurt_model.t32)
(
    &check_path="&ADSP_BUILDROOT\core\kernel\qurt\osam\bin\T32\generic"
    &pgt_flag="True"
)
else if OS.FILE(&ADSP_BUILDROOT\core\kernel\qurt\build\adsp_link\qdsp6\660.adsp.prod\install\ADSPv62MP_SL\debugger\T32\qurt_model.t32)
(
    &check_path="&ADSP_BUILDROOT\core\kernel\qurt\build\adsp_link\qdsp6\660.adsp.prod\install\ADSPv62MP_SL\debugger\T32"
    &pgt_flag="True"
)
else if OS.FILE(&ADSP_BUILDROOT\core\kernel\qurt\build\adsp_link\qdsp6\670.adsp.prod\install\ADSPv62MP_SL\debugger\T32\qurt_model.t32)
(
    &check_path="&ADSP_BUILDROOT\core\kernel\qurt\build\adsp_link\qdsp6\670.adsp.prod\install\ADSPv62MP_SL\debugger\T32"
    &pgt_flag="True"
)
else
(
    &name_conv="qurt_model"
    &command="python &CurrentDirectory\targetname_elfname.py &Target_Name &OutputPath_temp\elfname1.txt &OutputPath_temp\sensorelfname1.txt &name_conv &ADSP_BUILDROOT  False &cdsp_flag"
    Os.Hidden &command
    if OS.FILE(&OutputPath_temp\elfname1.txt)
    (
        OPEN #1 "&OutputPath_temp\elfname1.txt" /READ
        READ #1 %line &elfname
        CLOSE #1
        else if OS.FILE(&elfname\qurt_model.t32)
        (
            &check_path="&elfname"
            &pgt_flag="True"
        )
    )
)

print "##########################"
if ("&slpi"=="True")
(
    // initialize the variables first0x00c00078
    mmu.off
    mmu.reset
    &Qube_va_guestos=0xf0100000
    &Qube_pa_guestos=&dspaddr
    if (Y.EXIST(\\M8996AAAAAAAAQ1234\Global\start))
    (
       &Qube_va_guestos=address.offset(\\M8996AAAAAAAAQ1234\Global\start)
    )
    if (Y.EXIST(\\M8998AAAAAAAAQ1234\Global\start))
    (
       &Qube_va_guestos=address.offset(\\M8998AAAAAAAAQ1234\Global\start)
    )
    print "DSP SensorPD1 address virtual=&Qube_va_guestos  physical=0x" &Qube_pa_guestos
	print "mmu.create &Qube_va_guestos--(&Qube_va_guestos+0x1900000) &Qube_pa_guestos--(&Qube_pa_guestos+0x1900000)"
	
    mmu.create &Qube_va_guestos--(&Qube_va_guestos+0x1900000) &Qube_pa_guestos--(&Qube_pa_guestos+0x1900000)

    mmu.on
    
    TASK.CONFIG &check_path\qurt_model.t32
    MENU.ReProgram &check_path\qurt_model.men
    
    printer.file &OutputPath_temp\DSP_pgt.txt
    printer.filetype ASCII 
    printer.size 0xfa, 0xfa
    ext.maxvsize 1000000
    wp.task.pgt 
    
)
else if ("&Target_Name"=="660")
(
    mmu.off
    mmu.reset
    &Qube_va_guestos=address.offset(\\ROOT_660\Global\start)
    &Qube_pa_guestos=&dspaddr
    &Qube_va_island=0xf0000000
    
    mmu.create &Qube_va_guestos++0x2300000 &Qube_pa_guestos++0x2300000
    mmu.on
    task.config &check_path\qurt_model.t32
    menu.rp &check_path\qurt_model.men

    mmu.create 0xF0000000--0xF0010000 0xFE400000
    PER.Set REG:0x12 %Long 0x9
    DATA.COPY y.range(qurt_tcm_dump) a:&TCM_BASE
    mmu.create &Qube_va_island--(&Qube_va_island+0x80000) &TCM_BASE
    printer.file &OutputPath_temp\DSP_pgt.txt
    printer.filetype ASCII 
    printer.size 0xfa, 0xfa
    ext.maxvsize 1000000
    wp.task.pgt
    mmu.delete &Qube_va_island--(&Qube_va_island+0x80000)
    mmu.on
)
else if ("&Target_Name"=="670")
(
    mmu.off
    mmu.reset
    &Qube_va_guestos=address.offset(\\ROOT_670\Global\start)
    &Qube_pa_guestos=&dspaddr
    &Qube_va_island=0xf0000000
    
    mmu.create &Qube_va_guestos++0x2300000 &Qube_pa_guestos++0x2300000
    mmu.on
    task.config &check_path\qurt_model.t32
    menu.rp &check_path\qurt_model.men

    mmu.create 0xF0000000--0xF0010000 0xFE400000
    PER.Set REG:0x12 %Long 0x9
    DATA.COPY y.range(qurt_tcm_dump) a:&TCM_BASE
    mmu.create &Qube_va_island--(&Qube_va_island+0x80000) &TCM_BASE
    printer.file &OutputPath_temp\DSP_pgt.txt
    printer.filetype ASCII 
    printer.size 0xfa, 0xfa
    ext.maxvsize 1000000
    wp.task.pgt
    mmu.delete &Qube_va_island--(&Qube_va_island+0x80000)
    mmu.on
)
else if ("&Target_Name"=="845")
(
    mmu.off
    mmu.reset
    &Qube_va_guestos=address.offset(\\ROOT_845\Global\start)
    &Qube_pa_guestos=&dspaddr
    &Qube_va_island=0xf0000000
    
    mmu.create &Qube_va_guestos++0x2300000 &Qube_pa_guestos++0x2300000
    mmu.on
    task.config &check_path\qurt_model.t32
    menu.rp &check_path\qurt_model.men

    mmu.create 0xF0000000--0xF0010000 0xFE400000
    PER.Set REG:0x12 %Long 0x9
    DATA.COPY y.range(qurt_tcm_dump) a:&TCM_BASE
    mmu.create &Qube_va_island--(&Qube_va_island+0x80000) &TCM_BASE
    printer.file &OutputPath_temp\DSP_pgt.txt
    printer.filetype ASCII 
    printer.size 0xfa, 0xfa
    ext.maxvsize 1000000
    wp.task.pgt
    mmu.delete &Qube_va_island--(&Qube_va_island+0x80000)
    mmu.on
)
else if ("&Target_Name"=="8994")
(
    mmu.off
    mmu.reset
    &Qube_va_guestos=address.offset(start)
    &Qube_pa_guestos=&dspaddr
    &Qube_va_island=0xf0000000
    
    mmu.create &Qube_va_guestos++0x1800000 &Qube_pa_guestos++0x1800000
    mmu.on
    task.config &check_path\qurt_model.t32
    menu.rp &check_path\qurt_model.men

    mmu.create 0xF0000000--0xF0010000 0xFE400000
    // turn on mmu
    PER.Set REG:0x12 %Long 0x9
    DATA.COPY y.range(qurt_tcm_dump) a:&TCM_BASE
    mmu.create &Qube_va_island--(&Qube_va_island+0x80000) &TCM_BASE
    ;dialog.message "Loaded Page TABLES00"
    // write task.pgt out
    printer.file &OutputPath_temp\DSP_pgt.txt
    printer.filetype ASCII 
    printer.size 0xfa, 0xfa
    ext.maxvsize 1000000
    wp.task.pgt
    ;dialog.message "Loaded Page TABLES11"
    // remove forced mmu
    mmu.delete &Qube_va_island--(&Qube_va_island+0x80000)
    mmu.on
)
else if ("&Target_Name"=="8992")
(
    mmu.off
    mmu.reset
    &Qube_va_guestos=address.offset(start)
    &Qube_pa_guestos=&dspaddr
    &Qube_va_island=0xf0000000

    mmu.create &Qube_va_guestos++0x1800000 &Qube_pa_guestos++0x1800000
    mmu.on
    
    task.config &check_path\qurt_model.t32
    menu.rp &check_path\qurt_model.men

    mmu.create 0xF0000000--0xF0010000 0xFE400000
    // turn on mmu
    PER.Set REG:0x12 %Long 0x9
    DATA.COPY y.range(qurt_tcm_dump) a:&TCM_BASE
    mmu.create &Qube_va_island--(&Qube_va_island+0x80000) &TCM_BASE
    ;dialog.message "Loaded Page TABLES00"
    // write task.pgt out
    printer.file &OutputPath_temp\DSP_pgt.txt
    printer.filetype ASCII 
    printer.size 0xfa, 0xfa
    ext.maxvsize 1000000
    wp.task.pgt
    ;dialog.message "Loaded Page TABLES11"
    // remove forced mmu
    mmu.delete &Qube_va_island--(&Qube_va_island+0x80000)
    ;dialog.message "Loaded Page TABLES1"
    mmu.on
)
else if ("&Target_Name"=="8952")
(
    mmu.off
    mmu.reset
    &Qube_va_guestos=address.offset(start)
    &Qube_pa_guestos=&dspaddr
    &Qube_va_island=0xf0000000
    
    mmu.create &Qube_va_guestos++0x1800000 &Qube_pa_guestos++0x1800000
    mmu.on

    task.config &check_path\qurt_model.t32
    menu.rp &check_path\qurt_model.men

    mmu.create 0xF0000000--0xF0010000 0xFE400000
    // turn on mmu
    PER.Set REG:0x12 %Long 0x9
    DATA.COPY y.range(qurt_tcm_dump) a:&TCM_BASE
    mmu.create &Qube_va_island--(&Qube_va_island+0x80000) &TCM_BASE
    ;dialog.message "Loaded Page TABLES00"
    // write task.pgt out
    printer.file &OutputPath_temp\DSP_pgt.txt
    printer.filetype ASCII 
    printer.size 0xfa, 0xfa
    ext.maxvsize 1000000
    wp.task.pgt
    ;dialog.message "Loaded Page TABLES11"
    // remove forced mmu
    mmu.delete &Qube_va_island--(&Qube_va_island+0x80000)
    mmu.on
)
else if ("&Target_Name"=="8953")
(
    mmu.off
    mmu.reset
    &Qube_va_guestos=address.offset(start)
    &Qube_pa_guestos=&dspaddr
    &Qube_va_island=0xf0000000
    
    mmu.create &Qube_va_guestos++0x1800000 &Qube_pa_guestos++0x1800000
    mmu.on

    task.config &check_path\qurt_model.t32
    menu.rp &check_path\qurt_model.men

    mmu.create 0xF0000000--0xF0010000 0xFE400000
    // turn on mmu
    PER.Set REG:0x12 %Long 0x9
    DATA.COPY y.range(qurt_tcm_dump) a:&TCM_BASE
    mmu.create &Qube_va_island--(&Qube_va_island+0x80000) &TCM_BASE
    ;dialog.message "Loaded Page TABLES00"
    // write task.pgt out
    printer.file &OutputPath_temp\DSP_pgt.txt
    printer.filetype ASCII 
    printer.size 0xfa, 0xfa
    ext.maxvsize 1000000
    wp.task.pgt
    ;dialog.message "Loaded Page TABLES11"
    // remove forced mmu
    mmu.delete &Qube_va_island--(&Qube_va_island+0x80000)
    mmu.on
)
else if ("&Target_Name"=="8937")
(
    mmu.off
    mmu.reset
    &Qube_va_guestos=address.offset(start)
    &Qube_pa_guestos=&dspaddr
    &Qube_va_island=0xf0000000
    
    mmu.create &Qube_va_guestos++0x1800000 &Qube_pa_guestos++0x1800000
    mmu.on

    task.config &check_path\qurt_model.t32
    menu.rp &check_path\qurt_model.men

    mmu.create 0xF0000000--0xF0010000 0xFE400000
    // turn on mmu
    PER.Set REG:0x12 %Long 0x9
    DATA.COPY y.range(qurt_tcm_dump) a:&TCM_BASE
    mmu.create &Qube_va_island--(&Qube_va_island+0x80000) &TCM_BASE
    ;dialog.message "Loaded Page TABLES00"
    // write task.pgt out
    printer.file &OutputPath_temp\DSP_pgt.txt
    printer.filetype ASCII 
    printer.size 0xfa, 0xfa
    ext.maxvsize 1000000
    wp.task.pgt
    ;dialog.message "Loaded Page TABLES11"
    // remove forced mmu
    mmu.delete &Qube_va_island--(&Qube_va_island+0x80000)
    mmu.on
)
else if ("&Target_Name"=="8976")
(
    mmu.off
    mmu.reset
    &Qube_va_guestos=address.offset(start)
    &Qube_pa_guestos=&dspaddr
    &Qube_va_island=0xf0000000

    mmu.create &Qube_va_guestos++0x1800000 &Qube_pa_guestos++0x1800000
    mmu.on

    task.config &check_path\qurt_model.t32
    menu.rp &check_path\qurt_model.men

    mmu.create 0xF0000000--0xF0010000 0xFE400000
    // turn on mmu
    PER.Set REG:0x12 %Long 0x9
    DATA.COPY y.range(qurt_tcm_dump) a:&TCM_BASE
    mmu.create &Qube_va_island--(&Qube_va_island+0x80000) &TCM_BASE
    ;dialog.message "Loaded Page TABLES00"
    // write task.pgt out
    printer.file &OutputPath_temp\DSP_pgt.txt
    printer.filetype ASCII 
    printer.size 0xfa, 0xfa
    ext.maxvsize 1000000
    wp.task.pgt
    ;dialog.message "Loaded Page TABLES11"
    // remove forced mmu
    mmu.delete &Qube_va_island--(&Qube_va_island+0x80000)
    mmu.on
)
else if ("&Target_Name"=="8996")||("&Target_Name"=="8998")
(
    // initialize the variables first0x00c00078
    &Qube_pa_userpd1=0x07600000
    &matchAddr=0x07600000
    data.find A:0x07500000--0x077fffff %LONG %LE 0x7800c000
    if found()
    (    
        &matchAddr=(address.offset(track.address())-4)
        print "USER PD start address found 0x" &matchAddr
    )

    ;&Qube_va_guestos=address.offset(start);
    &Qube_pa_guestos=&dspaddr
    &Qube_va_userpd1=0xb0000000
    &Qube_pa_userpd1=0x8d400000
    print "DSP UserPD1 address virtual=0xf0000000  physical=0x" &Qube_pa_guestos

	
	
    if OS.FILE(&OutputPath_temp\VA.txt)
    (
        OPEN #1 "&OutputPath_temp\VA.txt" /READ
        READ #1 %line &VA 
        CLOSE #1
        mmu.create &VA--(&VA+0x2300000) &Qube_pa_guestos--(&Qube_pa_guestos+0x2300000)
        mmu.format Blast QURTK_pagetables &VA--(&VA+0xffffff) &Qube_pa_guestos
    )
    else
    (
        mmu.create 0xf0000000--(0xf0000000+0x2300000) &Qube_pa_guestos--(&Qube_pa_guestos+0x2300000)
        mmu.format Blast QURTK_pagetables 0xf0000000--(0xf0000000+0xffffff) &Qube_pa_guestos
        mmu.create 0xf1000000--(0xf1000000+0x2300000) &Qube_pa_guestos--(&Qube_pa_guestos+0x2300000)
        mmu.format Blast QURTK_pagetables 0xf1000000--(0xf1000000+0xffffff) &Qube_pa_guestos
    )

    mmu.on
    mmu.autoscan on
    mmu.tablewalk on

    ; LOAD RTOS AWARENESS MODULE
    TASK.CONFIG &check_path\qurt_model.t32
    MENU.ReProgram &check_path\qurt_model.men
    // write task.pgt out
    printer.file &OutputPath_temp\DSP_pgt.txt
    printer.filetype ASCII 
    printer.size 0xfa, 0xfa
    ext.maxvsize 1000000
    wp.task.pgt
)
else
(
    // initialize the variables first0x00c00078
    &Qube_pa_userpd1=0x07600000
    &matchAddr=0x07600000
    data.find A:0x07500000--0x077fffff %LONG %LE 0x7800c000
    if found()
    (    
        &matchAddr=(address.offset(track.address())-4)
        print "USER PD start address found 0x" &matchAddr
    )

    &Qube_va_guestos=address.offset(start);
    &Qube_pa_guestos=&dspaddr
    print "DSP guest OS address vritual=0x" &Qube_va_guestos " physical=0x" &Qube_pa_guestos
    &Qube_va_userpd1=0x2da00000
    &Qube_pa_userpd1=&matchAddr
    print "DSP UserPD1 address vritual=0x" &Qube_va_userpd1 " physical=0x" &Qube_pa_userpd1

    mmu.create &Qube_va_guestos--(&Qube_va_guestos+0x1300000) &Qube_pa_guestos--(&Qube_pa_guestos+0x1300000)
    mmu.format Blast QURTK_pagetables &Qube_va_guestos--(&Qube_va_guestos+0xffffff) &Qube_pa_guestos
    if ("&ELF"!="M8x10AAAAAAAAQ1234")
    (
        mmu.create &Qube_va_userpd1--(&Qube_va_userpd1+0x500000) &Qube_pa_userpd1--(&Qube_pa_userpd1+0x500000)
    )
    mmu.on
    mmu.autoscan on
    mmu.tablewalk on

    ; LOAD RTOS AWARENESS MODULE
    TASK.CONFIG &CurrentDirectory\qurt_model.t32
    MENU.ReProgram &CurrentDirectory\qurt_model.men
    // write task.pgt out
    printer.file &OutputPath_temp\DSP_pgt.txt
    printer.filetype ASCII 
    printer.size 0xfa, 0xfa
    ext.maxvsize 1000000
    wp.task.pgt
)


;mmu.create 0xf0000000--(0xf0000000+0xFFFFF) &Qube_pa_guestos_click--(&Qube_pa_guestos_click+0xFFFFF)
&Qube_va_guestos="None"
if ("&slpi"=="True")
(
    if (Y.EXIST(\\M8996AAAAAAAAQ1234\Global\start))
    (
       &Qube_va_guestos=address.offset(\\M8996AAAAAAAAQ1234\Global\start)
    )
    if (Y.EXIST(\\M8998AAAAAAAAQ1234\Global\start))
    (
       &Qube_va_guestos=address.offset(\\M8998AAAAAAAAQ1234\Global\start)
    )
    if (Y.EXIST(\\M8998AAAAAAAAQ1234_v1\Global\start))
    (
       &Qube_va_guestos=address.offset(\\M8998AAAAAAAAQ1234_v1\Global\start)
    )
    if (Y.EXIST(\\M8998AAAAAAAAQ1234_v2\Global\start))
    (
       &Qube_va_guestos=address.offset(\\M8998AAAAAAAAQ1234_v2\Global\start)
    )
)
if (Y.EXIST(\\ROOT_660\Global\start))
(
   &Qube_va_guestos=address.offset(\\ROOT_660\Global\start)
)
if (Y.EXIST(\\ROOT_670\Global\start))
(
   &Qube_va_guestos=address.offset(\\ROOT_670\Global\start)
)
if (Y.EXIST(\\ROOT_845\Global\_start))
(
   &Qube_va_guestos=address.offset(\\ROOT_845\Global\_start)
)
&cache_flush_offset=address.offset(QURTK_flush_cache_status)
&cmd1="python &CurrentDirectory\SlpiCheck.py &Target_Name &OutputPath_temp &slpi &Qube_va_guestos &cache_flush_offset"
OS.hidden &cmd1
&dsp_pgt_flag=0
if OS.FILE(&OutputPath_temp\No_DSP_pgt.txt)
(
    OPEN #1 "&OutputPath_temp\No_DSP_pgt.txt" /READ
    READ #1 %line &dsp_pgt_flag 
    CLOSE #1
)
if OS.FILE(&OutputPath_temp\DSP_pgt_startaddr.txt)
(
    OPEN #1 "&OutputPath_temp\DSP_pgt_startaddr.txt" /READ
    READ #1 %line &address 
    CLOSE #1

    if OS.FILE(&OutputPath_temp\DSP_pgt_startaddr_f000.txt)
    (
        OPEN #1 "&OutputPath_temp\DSP_pgt_startaddr_f000.txt" /READ
        READ #1 %line &Qube_pa_guestos 
        CLOSE #1
        if ("&Qube_va_guestos"!="None")
        (
            &Qube_va_guestos=(&Qube_va_guestos)&0xFFEFFFFF
            mmu.create &Qube_va_guestos--(&Qube_va_guestos+0xFFFFF) &Qube_pa_guestos--(&Qube_pa_guestos+0xFFFFF)
        )
        else
        (
            mmu.create 0xf0000000--(0xf0000000+0xFFFFF) &Qube_pa_guestos--(&Qube_pa_guestos+0xFFFFF)
        )    
    )
    if (&adspstartadd!=&address)
    (
        if (&BinaryLength<52428800)
        (
            &adspstartadd=&address
            &ramdumpstartadd=&address
            print "Re-Detecting ADSP Start Address: &adspstartadd"
            ;do &CurrentDirectory\DSP_connect_memdump_MPD.cmm &ramdumpfile &UniqueNumber &ramdumpstartadd &adspstartadd &OutputPath &ADSP_BUILDROOT &Target_Name &CurrentDirectory &Customer_Elf_Path
        )
    )
)    
if OS.FILE(&OutputPath_temp\DSP_pgt_startaddr_f000.txt)
(
    OPEN #1 "&OutputPath_temp\DSP_pgt_startaddr_f000.txt" /READ
    READ #1 %line &Qube_pa_guestos 
    CLOSE #1
    mmu.create 0xf0000000--(0xf0000000+0xFFFFF) &Qube_pa_guestos--(&Qube_pa_guestos+0xFFFFF)
)    
if ("&slpi"=="True")
(
    do &CurrentDirectory\load_QURTK_TLB_dump.cmm
)
;This Mapping is finding our cache flush status address range and getting from pagetables
if OS.FILE(&OutputPath_temp\DSP_pgt_startaddr_cf.txt)
(
    OPEN #1 "&OutputPath_temp\DSP_pgt_startaddr_cf.txt" /READ
    READ #1 %line &Qube_pa_guestos 
    READ #1 %line &Qube_va_guestos 
    CLOSE #1
    mmu.create &Qube_va_guestos--(&Qube_va_guestos+0xFFFFF) &Qube_pa_guestos--(&Qube_pa_guestos+0xFFFFF)
)

;;;Cache Flush Check
Var.NEWLOCAL long \QURT_system_state_var
&pe=address.offset(var.address(QURT_system_state))
&t= data.long(D:&pe)
var.set \QURT_system_state_var=&t
&SystemStateFlag=v.value(\QURT_system_state_var)

if (&SystemStateFlag!=0x1B)&&(&SystemStateFlag!=0xB)&&(&SystemStateFlag!=0x24)
(
    if "&asha"!="True"
    (
        dialog.message "QURT_system_state = &SystemStateFlag. Cache may not be flushed in such state"
    )    
    print %ERROR "QURT_system_state = &SystemStateFlag. Cache may not be flushed in such state"
)

Var.NEWLOCAL long \QURTK_flush_cache_status_var
&pe=address.offset(var.address(QURTK_flush_cache_status))
&t= data.long(D:&pe)
var.set \QURTK_flush_cache_status_var=&t
&FlushFlag=v.value(\QURTK_flush_cache_status_var)
if (&FlushFlag==1)
(
)
else if (&FlushFlag==2)
(
    print "cache is flushed except the following information: L2VIC interrupt table and TCM dump are not flushed"
    ;dialog.message "cache is flushed except the following information: L2VIC interrupt table and TCM dump are not flushed"
)
else if (&FlushFlag==3)
(
    print "Receive External NMI (watchdog) while handling a FATAL exception"
    ;dialog.message "Receive External NMI (watchdog) while handling a FATAL exception"
)
else if (&FlushFlag==5)
(
    ;print "Crashscope is considering 5 as valid."
    &FlushFlag=3
)
else
(
    
    if Y.EXIST(QURTK_abnormal_reset_dump_status)
    (
        Var.NEWLOCAL long \QURTK_abnormal_reset_dump_status_var
        &pe=address.offset(var.address(QURTK_abnormal_reset_dump_status))
        &t= data.long(D:&pe)
        var.set \QURTK_abnormal_reset_dump_status_var=&t
        &abnormal_reset_Flag=v.value(\QURTK_abnormal_reset_dump_status_var)
        
        if (&FlushFlag==4)&&(&abnormal_reset_Flag==7)
        (
            print %ERROR "Dumps are Cache Flushed as SDI got triggerred. Note that if ADSP is in power collapse mode then dumps may not be reliable."
            &FlushFlag=3
            &check_FlushFlag=4
        )
        else
        (
            if (&SystemStateFlag!=0x1B)&&(&SystemStateFlag!=0xB)&&(&SystemStateFlag!=0x24)
            (
                print %ERROR "Dumps provided are not Cache Flushed - Level2 of validating Dumps Failed with QURTK_flush_cache_status:&FlushFlag"
            )
            else
            (
                &FlushFlag=3
            )
        )
    )
    else
    (
        if (&SystemStateFlag!=0x1B)&&(&SystemStateFlag!=0xB)&&(&SystemStateFlag!=0x24)
        (
            print %ERROR "Dumps provided are not Cache Flushed - Level2 of validating Dumps Failed with QURTK_flush_cache_status:&FlushFlag"
        )
        else
        (
            &FlushFlag=3
        )
    )
    
)
;Cache Flush Status Checking in Python Script
Var.NEWLOCAL long \QURTK_flush_cache_status_var
&pe=address.offset(var.address(QURTK_flush_cache_status))
&t= data.long(D:&pe)
var.set \QURTK_flush_cache_status_var=&t

&CacheFlushFlag=v.value(\QURTK_flush_cache_status_var)


&tem="CacheFlushStatus"
&cmd="python &CurrentDirectory\CacheStatusAnalysis.py &tem &OutputPath &FlushFlag &check_FlushFlag"
Os.Hidden &cmd
&tem="UpdateSystemStateMacro"
&cmd="python &CurrentDirectory\CacheStatusAnalysis.py &tem &OutputPath &SystemStateFlag"
Os.Hidden &cmd
&tem="QurtSytemState"
&cmd="python &CurrentDirectory\CacheStatusAnalysis.py &tem &OutputPath &SystemStateFlag &FlushFlag"
Os.Hidden &cmd

;Updated Cache status in to a seperate file for DSPAnalysis python file
printer.file &OutputPath_temp\flush_cache_py.txt
printer.filetype ascii
printer.size 0xfa,0xfa
wp.v.v QURTK_flush_cache_status
OPEN #1 "&OutputPath_temp\flush_cache_py.txt" /WRITE
WRITE #1 &FlushFlag
CLOSE #1 

;***************************
;;;Cache Flush Check End
;***************************

cd &CurrentDirectory
;******************************************************
;;;Loading page tables
;******************************************************
if ("&pgt_flag"=="True")
(
        if ("&slpi"=="True")
        (
            do &CurrentDirectory\DSP_load_pagetables_8994.cmm &OutputPath
        )
        else if ("&Target_Name"=="8994")
        (
            do &CurrentDirectory\DSP_load_pagetables_8994.cmm &OutputPath
        )    
        else if ("&Target_Name"=="8992")
        (
            do &CurrentDirectory\DSP_load_pagetables_8994.cmm &OutputPath
        )    
        else if ("&Target_Name"=="8952")
        (
            do &CurrentDirectory\DSP_load_pagetables_8994.cmm &OutputPath
        )    
        else if ("&Target_Name"=="8953")
        (
            do &CurrentDirectory\DSP_load_pagetables_8994.cmm &OutputPath
        )    
        else if ("&Target_Name"=="8937")
        (
            do &CurrentDirectory\DSP_load_pagetables_8994.cmm &OutputPath
        )    
        else if ("&Target_Name"=="8976")
        (
            do &CurrentDirectory\DSP_load_pagetables_8994.cmm &OutputPath
        )    
        else if ("&Target_Name"=="8996")
        (
            do &CurrentDirectory\DSP_load_pagetables_8994.cmm &OutputPath
        )    
        else if ("&Target_Name"=="8998")
        (
            do &CurrentDirectory\DSP_load_pagetables_8994.cmm &OutputPath
        )
        else if ("&Target_Name"=="660")
        (
            do &CurrentDirectory\DSP_load_pagetables_8994.cmm &OutputPath
        )
        else if ("&Target_Name"=="670")
        (
            do &CurrentDirectory\DSP_load_pagetables_8994.cmm &OutputPath
        )    
        else if ("&Target_Name"=="845")
        (
            do &CurrentDirectory\DSP_load_pagetables_8994.cmm &OutputPath
        )    
        else
        (
            do &CurrentDirectory\DSP_load_pagetables.cmm &OutputPath
        )
)    
else
(
    do &CurrentDirectory\DSP_load_pagetables.cmm &OutputPath
)
print "Loaded page tables"
printer.file &OutputPath\Crashman_Log.txt
printer.filetype ascii
printer.size 0xfa,0xfa
wp.area.view Crashman
;***************************
;;;Loading page tables End
;***************************

;******************************************************
;;;Run analy_qurt_error
;******************************************************
if ((&FlushFlag==1)||(&FlushFlag==2)||(&FlushFlag==3))
(
    area.select Crashman
    print "Processing analy_qurt_error.cmm Script"
    printer.file &OutputPath\Crashman_Log.txt
    printer.filetype ascii
    printer.size 0xfa,0xfa
    wp.area.view Crashman
    do &CurrentDirectory\analy_qurt_error.cmm
    WINclear TOP
    area.select Crashman
    print "Processing analy_qurt_error.cmm Script Done"
    printer.file &OutputPath\Crashman_Log.txt
    printer.filetype ascii
    printer.size 0xfa,0xfa
    wp.area.view Crashman
    printer.file &OutputPath\Area_IO.txt
    printer.filetype ascii
    printer.size 0xfa,0xfa
    wp.Area IO
)
else
(
    ;Running analy qurt error script only when dumps are cache flushed inorder not to be stopped in cmm 
)    
;***************************
;;;Run analy_qurt_error End
;***************************

;******************************************************
;;;Update Callstack
;******************************************************
if ((&FlushFlag==1)||(&FlushFlag==2)||(&FlushFlag==3))
(
    do &CurrentDirectory\callstack_analysis.cmm &OutputPath &Target_Name &slpi
)
else
(
    ;Running analy qurt error script only when dumps are cache flushed inorder not to be stopped in cmm 
)    

;************************
;;;Update Callstack End
;************************
area.select Crashman
print "Loading Dumps. Done"
printer.file &OutputPath\Crashman_Log.txt
printer.filetype ascii
printer.size 0xfa,0xfa
wp.area.view Crashman

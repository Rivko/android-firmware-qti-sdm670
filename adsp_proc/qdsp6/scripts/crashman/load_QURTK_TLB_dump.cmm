
IF (Y.EXIST(QURTK_tlb_dump))
(
        &tlb_idx=0
        // 128 entries in the TLB for QDSP6V5A,H,128_A
        REPEAT 128
        (
                &val0=V.VALUE(((unsigned int *)&QURTK_tlb_dump)[2*&tlb_idx])
                &val1=V.VALUE(((unsigned int *)&QURTK_tlb_dump)[2*&tlb_idx+1])
                MMU.SET TLB &tlb_idx &val0 &val1
                &tlb_idx=&tlb_idx+1
        )
)

MMU.ON
MMU.TLB.SCAN


entry &loc &Target_Name
&OutputPath_temp="&loc\temp"

ON ERROR JUMPTO coredump_end
printer.open &OutputPath_temp\SWFatal_Error.txt

if ("&Target_Name"=="660")
(
    if y.exist(\\ROOT_660\Global\coredump)
    (
        wp.v.v %STRING  \\ROOT_660\Global\coredump.err.message
        wp.v.v %STRING  \\ROOT_660\Global\coredump.err.aux_msg
        wp.v.v %STRING  \\ROOT_660\Global\coredump.err.filename
        wp.v.v %decimal \\ROOT_660\Global\coredump.err.param
    )
    else
    (
        wp.v.v %STRING coredump.err.message
        wp.v.v %STRING coredump.err.aux_msg
        wp.v.v %STRING coredump.err.filename
        wp.v.v %decimal coredump.err.param
    )
    
)
else if ("&Target_Name"=="845")
(
    if y.exist(\\ROOT_845\Global\coredump)
    (
        wp.v.v %STRING  \\ROOT_845\Global\coredump.err.message
        wp.v.v %STRING  \\ROOT_845\Global\coredump.err.aux_msg
        wp.v.v %STRING  \\ROOT_845\Global\coredump.err.filename
        wp.v.v %decimal \\ROOT_845\Global\coredump.err.param
    )
    else
    (
        &getelfname=""
        &getelfnamesymbol=""
            
        if OS.FILE("&OutputPath_temp\getelfname.txt")
        (
            OPEN #1 "&OutputPath_temp\getelfname.txt" /READ
            READ #1 %line &getelfname
            READ #1 %line &getelfnamesymbol
            CLOSE #1
        )
        wp.v.v %STRING  \\&getelfnamesymbol\Global\coredump.err.message
        wp.v.v %STRING  \\&getelfnamesymbol\Global\coredump.err.aux_msg
        wp.v.v %STRING  \\&getelfnamesymbol\Global\coredump.err.filename
        wp.v.v %decimal \\&getelfnamesymbol\Global\coredump.err.param
    )
    
)
else if ("&Target_Name"=="8994")
(
    if y.exist(\\M8994AAAAAAAAQ1234\Global\coredump)
    (
        wp.v.v %STRING  \\M8994AAAAAAAAQ1234\Global\coredump.err.message
        wp.v.v %STRING  \\M8994AAAAAAAAQ1234\Global\coredump.err.aux_msg
        wp.v.v %STRING  \\M8994AAAAAAAAQ1234\Global\coredump.err.filename
        wp.v.v %decimal \\M8994AAAAAAAAQ1234\Global\coredump.err.param
    )
    else
    (
        wp.v.v %STRING coredump.err.message
        wp.v.v %STRING coredump.err.aux_msg
        wp.v.v %STRING coredump.err.filename
        wp.v.v %decimal coredump.err.param
    )
    
)
else if ("&Target_Name"=="8996")
(
    if y.exist(\\M8996AAAAAAAAQ1234\Global\coredump)
    (
        wp.v.v %STRING  \\M8996AAAAAAAAQ1234\Global\coredump.err.message
        wp.v.v %STRING  \\M8996AAAAAAAAQ1234\Global\coredump.err.aux_msg
        wp.v.v %STRING  \\M8996AAAAAAAAQ1234\Global\coredump.err.filename
        wp.v.v %decimal \\M8996AAAAAAAAQ1234\Global\coredump.err.param
    )
    else
    (
        wp.v.v %STRING coredump.err.message
        wp.v.v %STRING coredump.err.aux_msg
        wp.v.v %STRING coredump.err.filename
        wp.v.v %decimal coredump.err.param
    )
    
)
else if ("&Target_Name"=="8998")
(
    if y.exist(\\M8998AAAAAAAAQ1234\Global\coredump)
    (
        wp.v.v %STRING  \\M8998AAAAAAAAQ1234\Global\coredump.err.message
        wp.v.v %STRING  \\M8998AAAAAAAAQ1234\Global\coredump.err.aux_msg
        wp.v.v %STRING  \\M8998AAAAAAAAQ1234\Global\coredump.err.filename
        wp.v.v %decimal \\M8998AAAAAAAAQ1234\Global\coredump.err.param
    )
    else if y.exist(\\M8998AAAAAAAAQ1234_v1\Global\coredump)
    (
        wp.v.v %STRING  \\M8998AAAAAAAAQ1234_v1\Global\coredump.err.message
        wp.v.v %STRING  \\M8998AAAAAAAAQ1234_v1\Global\coredump.err.aux_msg
        wp.v.v %STRING  \\M8998AAAAAAAAQ1234_v1\Global\coredump.err.filename
        wp.v.v %decimal \\M8998AAAAAAAAQ1234_v1\Global\coredump.err.param
    )
    else if y.exist(\\M8998AAAAAAAAQ1234_v2\Global\coredump)
    (
        wp.v.v %STRING  \\M8998AAAAAAAAQ1234_v2\Global\coredump.err.message
        wp.v.v %STRING  \\M8998AAAAAAAAQ1234_v2\Global\coredump.err.aux_msg
        wp.v.v %STRING  \\M8998AAAAAAAAQ1234_v2\Global\coredump.err.filename
        wp.v.v %decimal \\M8998AAAAAAAAQ1234_v2\Global\coredump.err.param
    )
    else
    (
        wp.v.v %STRING coredump.err.message
        wp.v.v %STRING coredump.err.aux_msg
        wp.v.v %STRING coredump.err.filename
        wp.v.v %decimal coredump.err.param
    )
    
)
else if ("&Target_Name"=="8974")
(
    if y.exist(\\M8974AAAAAAAAQ1234\Global\coredump)
    (
        wp.v.v %STRING  \\M8974AAAAAAAAQ1234\Global\coredump.err.message
        wp.v.v %STRING  \\M8974AAAAAAAAQ1234\Global\coredump.err.aux_msg
        wp.v.v %STRING  \\M8974AAAAAAAAQ1234\Global\coredump.err.filename
        wp.v.v %decimal \\M8974AAAAAAAAQ1234\Global\coredump.err.param
    )
    else
    (
        wp.v.v %STRING coredump.err.message
        wp.v.v %STRING coredump.err.aux_msg
        wp.v.v %STRING coredump.err.filename
        wp.v.v %decimal coredump.err.param
    )
    
)
else if ("&Target_Name"=="8992")
(
    if y.exist(\\M8992AAAAAAAAQ1234\Global\coredump)
    (
        wp.v.v %STRING  \\M8992AAAAAAAAQ1234\Global\coredump.err.message
        wp.v.v %STRING  \\M8992AAAAAAAAQ1234\Global\coredump.err.aux_msg
        wp.v.v %STRING  \\M8992AAAAAAAAQ1234\Global\coredump.err.filename
        wp.v.v %decimal \\M8992AAAAAAAAQ1234\Global\coredump.err.param
    )
    else
    (
        wp.v.v %STRING coredump.err.message
        wp.v.v %STRING coredump.err.aux_msg
        wp.v.v %STRING coredump.err.filename
        wp.v.v %decimal coredump.err.param
    )
    
)
else if ("&Target_Name"=="8952")
(
    if y.exist(\\M8952AAAAAAAAQ1234\Global\coredump)
    (
        wp.v.v %STRING  \\M8952AAAAAAAAQ1234\Global\coredump.err.message
        wp.v.v %STRING  \\M8952AAAAAAAAQ1234\Global\coredump.err.aux_msg
        wp.v.v %STRING  \\M8952AAAAAAAAQ1234\Global\coredump.err.filename
        wp.v.v %decimal \\M8952AAAAAAAAQ1234\Global\coredump.err.param
    )
    else
    (
        wp.v.v %STRING coredump.err.message
        wp.v.v %STRING coredump.err.aux_msg
        wp.v.v %STRING coredump.err.filename
        wp.v.v %decimal coredump.err.param
    )
    
)
else if ("&Target_Name"=="8953")
(
    if y.exist(\\M8953AAAAAAAAQ1234\Global\coredump)
    (
        wp.v.v %STRING  \\M8953AAAAAAAAQ1234\Global\coredump.err.message
        wp.v.v %STRING  \\M8953AAAAAAAAQ1234\Global\coredump.err.aux_msg
        wp.v.v %STRING  \\M8953AAAAAAAAQ1234\Global\coredump.err.filename
        wp.v.v %decimal \\M8953AAAAAAAAQ1234\Global\coredump.err.param
    )
    else
    (
        wp.v.v %STRING coredump.err.message
        wp.v.v %STRING coredump.err.aux_msg
        wp.v.v %STRING coredump.err.filename
        wp.v.v %decimal coredump.err.param
    )
    
)
else if ("&Target_Name"=="8937")
(
    if y.exist(\\M8937AAAAAAAAQ1234\Global\coredump)
    (
        wp.v.v %STRING  \\M8937AAAAAAAAQ1234\Global\coredump.err.message
        wp.v.v %STRING  \\M8937AAAAAAAAQ1234\Global\coredump.err.aux_msg
        wp.v.v %STRING  \\M8937AAAAAAAAQ1234\Global\coredump.err.filename
        wp.v.v %decimal \\M8937AAAAAAAAQ1234\Global\coredump.err.param
    )
    else
    (
        wp.v.v %STRING coredump.err.message
        wp.v.v %STRING coredump.err.aux_msg
        wp.v.v %STRING coredump.err.filename
        wp.v.v %decimal coredump.err.param
    )
    
)
else if ("&Target_Name"=="8x26")
(
    if y.exist(\\M8x26AAAAAAAAQ1234\Global\coredump)
    (
        wp.v.v %STRING  \\M8x26AAAAAAAAQ1234\Global\coredump.err.message
        wp.v.v %STRING  \\M8x26AAAAAAAAQ1234\Global\coredump.err.aux_msg
        wp.v.v %STRING  \\M8x26AAAAAAAAQ1234\Global\coredump.err.filename
        wp.v.v %decimal \\M8x26AAAAAAAAQ1234\Global\coredump.err.param
    )
    else
    (
        wp.v.v %STRING coredump.err.message
        wp.v.v %STRING coredump.err.aux_msg
        wp.v.v %STRING coredump.err.filename
        wp.v.v %decimal coredump.err.param
    )
    
)
else if ("&Target_Name"=="8084")
(
    if y.exist(\\M8084AAAAAAAAQ1234\Global\coredump)
    (
        wp.v.v %STRING  \\M8084AAAAAAAAQ1234\Global\coredump.err.message
        wp.v.v %STRING  \\M8084AAAAAAAAQ1234\Global\coredump.err.aux_msg
        wp.v.v %STRING  \\M8084AAAAAAAAQ1234\Global\coredump.err.filename
        wp.v.v %decimal \\M084AAAAAAAAAQ1234\Global\coredump.err.param
    )
    else
    (
        wp.v.v %STRING coredump.err.message
        wp.v.v %STRING coredump.err.aux_msg
        wp.v.v %STRING coredump.err.filename
        wp.v.v %decimal coredump.err.param
    )
    
)
else if ("&Target_Name"=="8610")
(
    if y.exist(\\M8610AAAAAAAAQ1234\Global\coredump)
    (
        wp.v.v %STRING  \\M8610AAAAAAAAQ1234\Global\coredump.err.message
        wp.v.v %STRING  \\M8610AAAAAAAAQ1234\Global\coredump.err.aux_msg
        wp.v.v %STRING  \\M8610AAAAAAAAQ1234\Global\coredump.err.filename
        wp.v.v %decimal \\M0610AAAAAAAAQ1234\Global\coredump.err.param
    )
    else
    (
        wp.v.v %STRING coredump.err.message
        wp.v.v %STRING coredump.err.aux_msg
        wp.v.v %STRING coredump.err.filename
        wp.v.v %decimal coredump.err.param
    )
    
)
else if ("&Target_Name"=="9x35")
(
    if y.exist(\\M9x35AAAAAAAAQ1234\Global\coredump)
    (
        wp.v.v %STRING  \\M9x35AAAAAAAAQ1234\Global\coredump.err.message
        wp.v.v %STRING  \\M9x35AAAAAAAAQ1234\Global\coredump.err.aux_msg
        wp.v.v %STRING  \\M9x35AAAAAAAAQ1234\Global\coredump.err.filename
        wp.v.v %decimal \\M9x35AAAAAAAAQ1234\Global\coredump.err.param
    )
    else
    (
        wp.v.v %STRING coredump.err.message
        wp.v.v %STRING coredump.err.aux_msg
        wp.v.v %STRING coredump.err.filename
        wp.v.v %decimal coredump.err.param
    )
    
)
else if ("&Target_Name"=="9x25")
(
    if y.exist(\\M9x25AAAAAAAAQ1234\Global\coredump)
    (
        wp.v.v %STRING  \\M9x25AAAAAAAAQ1234\Global\coredump.err.message
        wp.v.v %STRING  \\M9x25AAAAAAAAQ1234\Global\coredump.err.aux_msg
        wp.v.v %STRING  \\M9x25AAAAAAAAQ1234\Global\coredump.err.filename
        wp.v.v %decimal \\M9x25AAAAAAAAQ1234\Global\coredump.err.param
    )
    else
    (
        wp.v.v %STRING coredump.err.message
        wp.v.v %STRING coredump.err.aux_msg
        wp.v.v %STRING coredump.err.filename
        wp.v.v %decimal coredump.err.param
    )
    
)
else
(
    wp.v.v %STRING coredump.err.message
    wp.v.v %STRING coredump.err.aux_msg
    wp.v.v %STRING coredump.err.filename
    wp.v.v %decimal coredump.err.param
)    
printer.file.close
&tem="UpdateCoreDumpInfo"
&cmd="python &CurrentDirectory\CacheStatusAnalysis.py &tem &loc"
Os.Hidden &cmd

enddo

coredump_end:
do &CurrentDirectory\cmm_error.cmm "coredump_analysis.cmm"
enddo
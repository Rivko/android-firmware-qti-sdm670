entry &loc &Target_Name &CurrentDirectory &ADSP_BUILDROOT
(
    ON ERROR JUMPTO memory_end
    cd &CurrentDirectory
    if OS.DIR(&loc\Def_Heap)
    (
        print "Def_Heap diretory already exists"
    )
    else 
    (
        mkdir &loc\Def_Heap
    )

&OutputPath_temp="&loc\temp"
&getelfname=""
&getelfnamesymbol=""
&getelfname_sensor=""
&getelfname_sensorsymbol=""
&getelfname_audio=""
&getelfname_audiosymbol=""
    
if OS.FILE("&OutputPath_temp\getelfname.txt")
(
    OPEN #1 "&OutputPath_temp\getelfname.txt" /READ
    READ #1 %line &getelfname
    READ #1 %line &getelfnamesymbol
    CLOSE #1
)
if OS.FILE("&OutputPath_temp\getelfname_sensor.txt")
(
    OPEN #1 "&OutputPath_temp\getelfname_sensor.txt" /READ
    READ #1 %line &getelfname_sensor
    READ #1 %line &getelfname_sensorsymbol
    CLOSE #1
)
if OS.FILE("&OutputPath_temp\getelfname_audio.txt")
(
    OPEN #1 "&OutputPath_temp\getelfname_audio.txt" /READ
    READ #1 %line &getelfname_audio
    READ #1 %line &getelfname_audiosymbol
    CLOSE #1
)

    if OS.DIR(&loc\Def_Heap_forSensors_img)
    (
        print " Def_Heap_forSensors_img diretory already exists"
    )
    else 
    (
        mkdir &loc\Def_Heap_forSensors_img
    )

    if ("&slpi"=="True")
    (
        printer.file &OutputPath_Qurt\Heap_Analysis_GuestOS.txt
        printer.filetype ascii
        printer.size 0xfa,0xfa
        if Y.EXIST(\\&getelfnamesymbol\Global\amss_mem_heap)
        (
            do &CurrentDirectory\memheap2_heapWalker_Latest.cmm \\&getelfnamesymbol\Global\amss_mem_heap &loc\Def_Heap
        )
        if Y.EXIST(\\M8996AAAAAAAAQ1234\Global\amss_mem_heap)
        (
            do &CurrentDirectory\memheap2_heapWalker_Latest.cmm \\M8996AAAAAAAAQ1234\Global\amss_mem_heap &loc\Def_Heap
        )
        if Y.EXIST(\\M8998AAAAAAAAQ1234\Global\amss_mem_heap)
        (
            do &CurrentDirectory\memheap2_heapWalker_Latest.cmm \\M8998AAAAAAAAQ1234\Global\amss_mem_heap &loc\Def_Heap
        )
        if Y.EXIST(\\M8998AAAAAAAAQ1234_v1\Global\amss_mem_heap)
        (
            do &CurrentDirectory\memheap2_heapWalker_Latest.cmm \\M8998AAAAAAAAQ1234_v1\Global\amss_mem_heap &loc\Def_Heap
        )
        if Y.EXIST(\\M8998AAAAAAAAQ1234_v2\Global\amss_mem_heap)
        (
            do &CurrentDirectory\memheap2_heapWalker_Latest.cmm \\M8998AAAAAAAAQ1234_v2\Global\amss_mem_heap &loc\Def_Heap
        )
        wp.area ST
        WINclear TOP

        printer.file &OutputPath_Qurt\Heap_Analysis_Sensors.txt
        printer.filetype ascii
        printer.size 0xfa,0xfa
        if Y.EXIST(\\&getelfname_sensorsymbol\Global\amss_mem_heap)
        (
            do &CurrentDirectory\memheap2_heapWalker_Latest.cmm \\&getelfname_sensorsymbol\Global\amss_mem_heap &loc\Def_Heap_forSensors_img
        )
        if Y.EXIST(\\M8996AAAAAAAAQ1234_SENSOR\Global\amss_mem_heap)
        (
            do &CurrentDirectory\memheap2_heapWalker_Latest.cmm \\M8996AAAAAAAAQ1234_SENSOR\Global\amss_mem_heap &loc\Def_Heap_forSensors_img
        )
        if Y.EXIST(\\M8998AAAAAAAAQ1234_SENSOR\Global\amss_mem_heap)
        (
            do &CurrentDirectory\memheap2_heapWalker_Latest.cmm \\M8998AAAAAAAAQ1234_SENSOR\Global\amss_mem_heap &loc\Def_Heap_forSensors_img
        )
        if Y.EXIST(\\M8998AAAAAAAAQ1234_SENSOR_v1\Global\amss_mem_heap)
        (
            do &CurrentDirectory\memheap2_heapWalker_Latest.cmm \\M8998AAAAAAAAQ1234_SENSOR_v1\Global\amss_mem_heap &loc\Def_Heap_forSensors_img
        )
        if Y.EXIST(\\M8998AAAAAAAAQ1234_SENSOR_v2\Global\amss_mem_heap)
        (
            do &CurrentDirectory\memheap2_heapWalker_Latest.cmm \\M8998AAAAAAAAQ1234_SENSOR_v2\Global\amss_mem_heap &loc\Def_Heap_forSensors_img
        )
        wp.area ST
        WINclear TOP
        
        printer.file &OutputPath_Qurt\Heap_Analysis_sns_def_heap_state.txt
        printer.filetype ascii
        printer.size 0xfa,0xfa
        do &CurrentDirectory\memheap2_heapWalker_Latest.cmm sns_def_heap_state &loc\Def_Heap
        wp.area ST
        WINclear TOP

        printer.file &OutputPath_Qurt\Heap_Analysis_sns_sensors_heap_state.txt
        printer.filetype ascii
        printer.size 0xfa,0xfa
        do &CurrentDirectory\memheap2_heapWalker_Latest.cmm sns_sensors_heap_state &loc\Def_Heap_forSensors_img
        wp.area ST
        WINclear TOP
        
        printer.file &OutputPath_Qurt\Heap_Analysis_QURT.txt
        printer.filetype ascii
        printer.size 0xfa,0xfa
        do &CurrentDirectory\heapwalker.cmm qurtos_heap_struct &OutputPath_Qurt &CurrentDirectory
        wp.area ST
        WINclear TOP
        printer.file &OutputPath_Qurt\Heap_Analysis_QURTISLAND.txt
        printer.filetype ascii
        printer.size 0xfa,0xfa
        do &CurrentDirectory\heapwalker_island.cmm qurtos_island_heap_ptr &OutputPath_Qurt &CurrentDirectory 
        wp.area ST
        WINclear TOP
    )
    else if ("&Target_Name"=="8x10")
    (
        printer.file &OutputPath_Qurt\Heap_Analysis_GuestOS.txt
        printer.filetype ascii
        printer.size 0xfa,0xfa
        do &CurrentDirectory\memheap2_heapWalker.cmm default_heap_state &loc\Def_Heap
        wp.area ST
        WINclear TOP
    )
    else if ("&Target_Name"=="8610")
    (
        printer.file &OutputPath_Qurt\Heap_Analysis_GuestOS.txt
        printer.filetype ascii
        printer.size 0xfa,0xfa
        ;cd qdsp6\scripts\msm8974
        do &CurrentDirectory\memheap2_heapWalker.cmm default_heap_state &loc\Def_Heap
        wp.area ST
        WINclear TOP
    )
    else if ("&Target_Name"=="8x26")
    (
        printer.file &OutputPath_Qurt\Heap_Analysis_GuestOS.txt
        printer.filetype ascii
        printer.size 0xfa,0xfa
        do &CurrentDirectory\memheap2_heapWalker.cmm \\M8x26AAAAAAAAQ1234\memory_wrappers\default_heap_state &loc\Def_Heap
        wp.area ST
        WINclear TOP
        printer.file &OutputPath_Qurt\Heap_Analysis_Sensors.txt
        printer.filetype ascii
        printer.size 0xfa,0xfa
        do &CurrentDirectory\memheap2_heapWalker.cmm \\M8x26AAAAAAAAQ1234_SENSOR\memory_wrappers\default_heap_state &loc\Def_Heap_forSensors_img
        wp.area ST
        WINclear TOP
    )
    else if ("&Target_Name"=="8926")
    (
        printer.file &OutputPath_Qurt\Heap_Analysis_GuestOS.txt
        printer.filetype ascii
        printer.size 0xfa,0xfa
        do &CurrentDirectory\memheap2_heapWalker.cmm \\M8x26AAAAAAAAQ1234\memory_wrappers\default_heap_state &loc\Def_Heap
        wp.area ST
        WINclear TOP
        printer.file &OutputPath_Qurt\Heap_Analysis_Sensors.txt
        printer.filetype ascii
        printer.size 0xfa,0xfa
        do &CurrentDirectory\memheap2_heapWalker.cmm \\M8x26AAAAAAAAQ1234_SENSOR\memory_wrappers\default_heap_state &loc\Def_Heap_forSensors_img
        wp.area ST
        WINclear TOP
    )
    else if ("&Target_Name"=="8084")
    (
        printer.file &OutputPath_Qurt\Heap_Analysis_GuestOS.txt
        printer.filetype ascii
        printer.size 0xfa,0xfa
        do &CurrentDirectory\memheap2_heapWalker.cmm \\M8084AAAAAAAAQ1234\memory_wrappers\default_heap_state &loc\Def_Heap
        wp.area ST
        WINclear TOP
        printer.file &OutputPath_Qurt\Heap_Analysis_Sensors.txt
        printer.filetype ascii
        printer.size 0xfa,0xfa
        do &CurrentDirectory\memheap2_heapWalker.cmm \\M8084AAAAAAAAQ1234_SENSOR\memory_wrappers\default_heap_state &loc\Def_Heap_forSensors_img
        wp.area ST
        WINclear TOP
    )
    else if ("&Target_Name"=="8626")
    (
        printer.file &OutputPath_Qurt\Heap_Analysis_GuestOS.txt
        printer.filetype ascii
        printer.size 0xfa,0xfa
        do &CurrentDirectory\memheap2_heapWalker.cmm \\M8x26AAAAAAAAQ1234\memory_wrappers\default_heap_state &loc\Def_Heap
        wp.area ST
        WINclear TOP
        printer.file &OutputPath_Qurt\Heap_Analysis_Sensors.txt
        printer.filetype ascii
        printer.size 0xfa,0xfa
        do &CurrentDirectory\memheap2_heapWalker.cmm \\M8x26AAAAAAAAQ1234_SENSOR\memory_wrappers\default_heap_state &loc\Def_Heap_forSensors_img
        wp.area ST
        WINclear TOP
    )
    else if ("&Target_Name"=="8974")
    (
        printer.file &OutputPath_Qurt\Heap_Analysis_GuestOS.txt
        printer.filetype ascii
        printer.size 0xfa,0xfa
        do &CurrentDirectory\memheap2_heapWalker.cmm \\M8974AAAAAAAAQ1234\memory_wrappers\default_heap_state &loc\Def_Heap
        wp.area ST
        WINclear TOP
        printer.file &OutputPath_Qurt\Heap_Analysis_Sensors.txt
        printer.filetype ascii
        printer.size 0xfa,0xfa
        do &CurrentDirectory\memheap2_heapWalker.cmm \\M8974AAAAAAAAQ1234_SENSOR\memory_wrappers\default_heap_state &loc\Def_Heap_forSensors_img
        wp.area ST
        WINclear TOP
    )
    else if ("&Target_Name"=="8994")
    (
        printer.file &OutputPath_Qurt\Heap_Analysis_GuestOS.txt
        printer.filetype ascii
        printer.size 0xfa,0xfa
        do &CurrentDirectory\memheap2_heapWalker_Latest.cmm \\M8994AAAAAAAAQ1234\Global\amss_mem_heap &loc\Def_Heap
        wp.area ST
        WINclear TOP
        printer.file &OutputPath_Qurt\Heap_Analysis_Sensors.txt
        printer.filetype ascii
        printer.size 0xfa,0xfa
        do &CurrentDirectory\memheap2_heapWalker_Latest.cmm \\M8994AAAAAAAAQ1234_SENSOR\Global\amss_mem_heap &loc\Def_Heap_forSensors_img
        wp.area ST
        WINclear TOP
        if Y.EXIST(\\M8994AAAAAAAAQ1234_SENSOR\Global\sns_heap_state)
        (
            if OS.DIR(&loc\SNS_Heap_State_forSensors_img)
            (
                print " SNS_Heap_State_forSensors_img diretory already exists"
            )
            else 
            (
                mkdir &loc\SNS_Heap_State_forSensors_img
            )
            printer.file &loc\SNS_Heap_State_forSensors_img\Heap_Analysis_sns_heap_state.txt
            printer.filetype ascii
            printer.size 0xfa,0xfa
            do &CurrentDirectory\memheap2_heapWalker_Latest.cmm \\M8994AAAAAAAAQ1234_SENSOR\Global\sns_heap_state &loc\SNS_Heap_State_forSensors_img
            wp.area ST
            WINclear TOP
        )
        printer.file &OutputPath_Qurt\Heap_Analysis_QURT.txt
        printer.filetype ascii
        printer.size 0xfa,0xfa
        do &CurrentDirectory\heapwalker.cmm qurtos_heap_struct &OutputPath_Qurt &CurrentDirectory
        wp.area ST
        WINclear TOP
        printer.file &OutputPath_Qurt\Heap_Analysis_QURTISLAND.txt
        printer.filetype ascii
        printer.size 0xfa,0xfa
        do &CurrentDirectory\heapwalker_island.cmm qurtos_island_heap_ptr &OutputPath_Qurt &CurrentDirectory 
        wp.area ST
        WINclear TOP
    )
    else if ("&Target_Name"=="8992")
    (
        printer.file &OutputPath_Qurt\Heap_Analysis_GuestOS.txt
        printer.filetype ascii
        printer.size 0xfa,0xfa
        do &CurrentDirectory\memheap2_heapWalker_Latest.cmm \\M8992AAAAAAAAQ1234\Global\amss_mem_heap &loc\Def_Heap
        wp.area ST
        WINclear TOP
        printer.file &OutputPath_Qurt\Heap_Analysis_Sensors.txt
        printer.filetype ascii
        printer.size 0xfa,0xfa
        do &CurrentDirectory\memheap2_heapWalker_Latest.cmm \\M8992AAAAAAAAQ1234_SENSOR\Global\amss_mem_heap &loc\Def_Heap_forSensors_img
        wp.area ST
        WINclear TOP
        if Y.EXIST(\\M8992AAAAAAAAQ1234_SENSOR\Global\sns_heap_state)
        (
            if OS.DIR(&loc\SNS_Heap_State_forSensors_img)
            (
                print " SNS_Heap_State_forSensors_img diretory already exists"
            )
            else 
            (
                mkdir &loc\SNS_Heap_State_forSensors_img
            )
            printer.file &loc\SNS_Heap_State_forSensors_img\Heap_Analysis_sns_heap_state.txt
            printer.filetype ascii
            printer.size 0xfa,0xfa
            do &CurrentDirectory\memheap2_heapWalker_Latest.cmm \\M8992AAAAAAAAQ1234_SENSOR\Global\sns_heap_state &loc\SNS_Heap_State_forSensors_img
            wp.area ST
            WINclear TOP
        )
        printer.file &OutputPath_Qurt\Heap_Analysis_QURT.txt
        printer.filetype ascii
        printer.size 0xfa,0xfa
        do &CurrentDirectory\heapwalker.cmm qurtos_heap_struct &OutputPath_Qurt &CurrentDirectory
        wp.area ST
        WINclear TOP
        printer.file &OutputPath_Qurt\Heap_Analysis_QURTISLAND.txt
        printer.filetype ascii
        printer.size 0xfa,0xfa
        do &CurrentDirectory\heapwalker_island.cmm qurtos_island_heap_ptr &OutputPath_Qurt &CurrentDirectory 
        wp.area ST
        WINclear TOP
    )
    else if ("&Target_Name"=="8952")
    (
        printer.file &OutputPath_Qurt\Heap_Analysis_GuestOS.txt
        printer.filetype ascii
        printer.size 0xfa,0xfa
        do &CurrentDirectory\memheap2_heapWalker_Latest.cmm \\M8952AAAAAAAAQ1234\Global\amss_mem_heap &loc\Def_Heap
        wp.area ST
        WINclear TOP
        printer.file &OutputPath_Qurt\Heap_Analysis_Sensors.txt
        printer.filetype ascii
        printer.size 0xfa,0xfa
        do &CurrentDirectory\memheap2_heapWalker_Latest.cmm \\M8952AAAAAAAAQ1234_SENSOR\Global\amss_mem_heap &loc\Def_Heap_forSensors_img
        wp.area ST
        WINclear TOP
        if Y.EXIST(\\M8952AAAAAAAAQ1234_SENSOR\Global\sns_heap_state)
        (
            if OS.DIR(&loc\SNS_Heap_State_forSensors_img)
            (
                print " SNS_Heap_State_forSensors_img diretory already exists"
            )
            else 
            (
                mkdir &loc\SNS_Heap_State_forSensors_img
            )
            printer.file &loc\SNS_Heap_State_forSensors_img\Heap_Analysis_sns_heap_state.txt
            printer.filetype ascii
            printer.size 0xfa,0xfa
            do &CurrentDirectory\memheap2_heapWalker_Latest.cmm \\M8952AAAAAAAAQ1234_SENSOR\Global\sns_heap_state &loc\SNS_Heap_State_forSensors_img
            wp.area ST
            WINclear TOP
        )
        printer.file &OutputPath_Qurt\Heap_Analysis_QURT.txt
        printer.filetype ascii
        printer.size 0xfa,0xfa
        do &CurrentDirectory\heapwalker.cmm qurtos_heap_struct &OutputPath_Qurt &CurrentDirectory
        wp.area ST
        WINclear TOP
        printer.file &OutputPath_Qurt\Heap_Analysis_QURTISLAND.txt
        printer.filetype ascii
        printer.size 0xfa,0xfa
        do &CurrentDirectory\heapwalker_island_8952.cmm qurtos_island_heap_ptr &OutputPath_Qurt 
        wp.area ST
        WINclear TOP
    )
    else if ("&Target_Name"=="8953")
    (
        printer.file &OutputPath_Qurt\Heap_Analysis_GuestOS.txt
        printer.filetype ascii
        printer.size 0xfa,0xfa
        do &CurrentDirectory\memheap2_heapWalker_Latest.cmm \\M8953AAAAAAAAQ1234\Global\amss_mem_heap &loc\Def_Heap
        wp.area ST
        WINclear TOP
        printer.file &OutputPath_Qurt\Heap_Analysis_Sensors.txt
        printer.filetype ascii
        printer.size 0xfa,0xfa
        do &CurrentDirectory\memheap2_heapWalker_Latest.cmm \\M8953AAAAAAAAQ1234_SENSOR\Global\amss_mem_heap &loc\Def_Heap_forSensors_img
        wp.area ST
        WINclear TOP
        if Y.EXIST(\\M8953AAAAAAAAQ1234_SENSOR\Global\sns_heap_state)
        (
            if OS.DIR(&loc\SNS_Heap_State_forSensors_img)
            (
                print " SNS_Heap_State_forSensors_img diretory already exists"
            )
            else 
            (
                mkdir &loc\SNS_Heap_State_forSensors_img
            )
            printer.file &loc\SNS_Heap_State_forSensors_img\Heap_Analysis_sns_heap_state.txt
            printer.filetype ascii
            printer.size 0xfa,0xfa
            do &CurrentDirectory\memheap2_heapWalker_Latest.cmm \\M8953AAAAAAAAQ1234_SENSOR\Global\sns_heap_state &loc\SNS_Heap_State_forSensors_img
            wp.area ST
            WINclear TOP
        )
        printer.file &OutputPath_Qurt\Heap_Analysis_QURT.txt
        printer.filetype ascii
        printer.size 0xfa,0xfa
        do &CurrentDirectory\heapwalker.cmm qurtos_heap_struct &OutputPath_Qurt &CurrentDirectory
        wp.area ST
        WINclear TOP
        printer.file &OutputPath_Qurt\Heap_Analysis_QURTISLAND.txt
        printer.filetype ascii
        printer.size 0xfa,0xfa
        do &CurrentDirectory\heapwalker_island_8952.cmm qurtos_island_heap_ptr &OutputPath_Qurt 
        wp.area ST
        WINclear TOP
    )
    else if ("&Target_Name"=="8937")
    (
        printer.file &OutputPath_Qurt\Heap_Analysis_GuestOS.txt
        printer.filetype ascii
        printer.size 0xfa,0xfa
        do &CurrentDirectory\memheap2_heapWalker_Latest.cmm \\M8937AAAAAAAAQ1234\Global\amss_mem_heap &loc\Def_Heap
        wp.area ST
        WINclear TOP
        printer.file &OutputPath_Qurt\Heap_Analysis_Sensors.txt
        printer.filetype ascii
        printer.size 0xfa,0xfa
        do &CurrentDirectory\memheap2_heapWalker_Latest.cmm \\M8937AAAAAAAAQ1234_SENSOR\Global\amss_mem_heap &loc\Def_Heap_forSensors_img
        wp.area ST
        WINclear TOP
        if Y.EXIST(\\M8937AAAAAAAAQ1234_SENSOR\Global\sns_heap_state)
        (
            if OS.DIR(&loc\SNS_Heap_State_forSensors_img)
            (
                print " SNS_Heap_State_forSensors_img diretory already exists"
            )
            else 
            (
                mkdir &loc\SNS_Heap_State_forSensors_img
            )
            printer.file &loc\SNS_Heap_State_forSensors_img\Heap_Analysis_sns_heap_state.txt
            printer.filetype ascii
            printer.size 0xfa,0xfa
            do &CurrentDirectory\memheap2_heapWalker_Latest.cmm \\M8937AAAAAAAAQ1234_SENSOR\Global\sns_heap_state &loc\SNS_Heap_State_forSensors_img
            wp.area ST
            WINclear TOP
        )
        printer.file &OutputPath_Qurt\Heap_Analysis_QURT.txt
        printer.filetype ascii
        printer.size 0xfa,0xfa
        do &CurrentDirectory\heapwalker.cmm qurtos_heap_struct &OutputPath_Qurt &CurrentDirectory
        wp.area ST
        WINclear TOP
        printer.file &OutputPath_Qurt\Heap_Analysis_QURTISLAND.txt
        printer.filetype ascii
        printer.size 0xfa,0xfa
        do &CurrentDirectory\heapwalker_island_8952.cmm qurtos_island_heap_ptr &OutputPath_Qurt 
        wp.area ST
        WINclear TOP
    )
    else if ("&Target_Name"=="8976")
    (
        area.select Crashman
        print "Running Heap_Analysis_GuestOS scripts.."
        printer.file &OutputPath_Qurt\Heap_Analysis_GuestOS.txt
        printer.filetype ascii
        printer.size 0xfa,0xfa
        do &CurrentDirectory\memheap2_heapWalker_Latest.cmm \\M8976AAAAAAAAQ1234\Global\amss_mem_heap &loc\Def_Heap
        wp.area ST
        WINclear TOP
        area.select Crashman
        print "Running Heap_Analysis_GuestOS scripts..Done"
        printer.file &OutputPath_Qurt\Heap_Analysis_Sensors.txt
        printer.filetype ascii
        printer.size 0xfa,0xfa
        do &CurrentDirectory\memheap2_heapWalker_Latest.cmm \\M8976AAAAAAAAQ1234_SENSOR\Global\amss_mem_heap &loc\Def_Heap_forSensors_img
        wp.area ST
        WINclear TOP
        if Y.EXIST(\\M8976AAAAAAAAQ1234_SENSOR\Global\sns_heap_state)
        (
            if OS.DIR(&loc\SNS_Heap_State_forSensors_img)
            (
                print " SNS_Heap_State_forSensors_img diretory already exists"
            )
            else 
            (
                mkdir &loc\SNS_Heap_State_forSensors_img
            )
            printer.file &loc\SNS_Heap_State_forSensors_img\Heap_Analysis_sns_heap_state.txt
            printer.filetype ascii
            printer.size 0xfa,0xfa
            do &CurrentDirectory\memheap2_heapWalker_Latest.cmm \\M8976AAAAAAAAQ1234_SENSOR\Global\sns_heap_state &loc\SNS_Heap_State_forSensors_img
            wp.area ST
            WINclear TOP
        )
        printer.file &OutputPath_Qurt\Heap_Analysis_QURT.txt
        printer.filetype ascii
        printer.size 0xfa,0xfa
        do &CurrentDirectory\heapwalker.cmm qurtos_heap_struct &OutputPath_Qurt &CurrentDirectory
        wp.area ST
        WINclear TOP
        printer.file &OutputPath_Qurt\Heap_Analysis_QURTISLAND.txt
        printer.filetype ascii
        printer.size 0xfa,0xfa
        do &CurrentDirectory\heapwalker_island_8952.cmm qurtos_island_heap_ptr &OutputPath_Qurt 
        wp.area ST
        WINclear TOP
    )
    else if ("&Target_Name"=="9x25")
    (
        printer.file &OutputPath_Qurt\Heap_Analysis_GuestOS.txt
        printer.filetype ascii
        printer.size 0xfa,0xfa
        do &CurrentDirectory\memheap2_heapWalker.cmm \\M9x25AAAAAAAAAQ1234\memory_wrappers\default_heap_state &OutputPath\Def_Heap
        wp.area ST
        WINclear TOP
    )
    else if ("&Target_Name"=="9625")
    (
        printer.file &OutputPath_Qurt\Heap_Analysis_GuestOS.txt
        printer.filetype ascii
        printer.size 0xfa,0xfa
        do &CurrentDirectory\memheap2_heapWalker.cmm \\M9x25AAAAAAAAAQ1234\memory_wrappers\default_heap_state &OutputPath\Def_Heap
        wp.area ST
        WINclear TOP
    )
    else if ("&Target_Name"=="9x35")
    (
        printer.file &OutputPath_Qurt\Heap_Analysis_GuestOS.txt
        printer.filetype ascii
        printer.size 0xfa,0xfa
        do &CurrentDirectory\memheap2_heapWalker.cmm \\M9x35AAAAAAAAQ1234\memory_wrappers\default_heap_state &OutputPath\Def_Heap
        wp.area ST
        WINclear TOP
    )
    else if ("&Target_Name"=="9635")
    (
        printer.file &OutputPath_Qurt\Heap_Analysis_GuestOS.txt
        printer.filetype ascii
        printer.size 0xfa,0xfa
        do &CurrentDirectory\memheap2_heapWalker.cmm \\M9x35AAAAAAAAQ1234\memory_wrappers\default_heap_state &OutputPath\Def_Heap
        wp.area ST
        WINclear TOP
    )
    else if ("&Target_Name"=="8996")
    (
        if OS.DIR(&OutputPath\Def_Heap_for_AUDIO_img)
        (
            print "Def_Heap_for_AUDIO_img diretory already exists"
        )
        else 
        (
            mkdir &OutputPath\Def_Heap_for_AUDIO_img
            rmdir &OutputPath\Def_Heap_forSensors_img
        )
        printer.file &OutputPath_Qurt\Heap_Analysis_GuestOS.txt
        printer.filetype ascii
        printer.size 0xfa,0xfa
        ;cd qdsp6\scripts\msm8974
        do &CurrentDirectory\memheap2_heapWalker_Latest.cmm \\M8996AAAAAAAAQ1234\Global\amss_mem_heap &loc\Def_Heap
        wp.area ST
        WINclear TOP
        printer.file &OutputPath_Qurt\Heap_Analysis_Audio.txt
        printer.filetype ascii
        printer.size 0xfa,0xfa
        ;cd qdsp6\scripts\msm8974
        do &CurrentDirectory\memheap2_heapWalker_Latest.cmm \\M8996AAAAAAAAQ1234_AUDIO\Global\amss_mem_heap &loc\Def_Heap_for_AUDIO_img
        wp.area ST
        WINclear TOP	
        if Y.EXIST(\\M8996AAAAAAAAQ1234_SENSOR\Global\sns_heap_state)
        (
            if OS.DIR(&loc\SNS_Heap_State_forSensors_img)
            (
                print " SNS_Heap_State_forSensors_img diretory already exists"
            )
            else 
            (
                mkdir &loc\SNS_Heap_State_forSensors_img
            )
            printer.file &loc\SNS_Heap_State_forSensors_img\Heap_Analysis_sns_heap_state.txt
            printer.filetype ascii
            printer.size 0xfa,0xfa
            do &CurrentDirectory\memheap2_heapWalker_Latest.cmm \\M8996AAAAAAAAQ1234_SENSOR\Global\sns_heap_state &loc\SNS_Heap_State_forSensors_img
            wp.area ST
            WINclear TOP
        )
        printer.file &OutputPath_Qurt\Heap_Analysis_QURT.txt
        printer.filetype ascii
        printer.size 0xfa,0xfa
        do &CurrentDirectory\heapwalker.cmm qurtos_heap_struct &OutputPath_Qurt &CurrentDirectory
        wp.area ST
        WINclear TOP
        printer.file &OutputPath_Qurt\Heap_Analysis_QURTISLAND.txt
        printer.filetype ascii
        printer.size 0xfa,0xfa
        do &CurrentDirectory\heapwalker_island.cmm qurtos_island_heap_ptr &OutputPath_Qurt &CurrentDirectory 
        wp.area ST
        WINclear TOP
    )
    else if ("&Target_Name"=="660")
    (
        if OS.DIR(&OutputPath\Def_Heap_for_AUDIO_img)
        (
            print "Def_Heap_for_AUDIO_img diretory already exists"
        )
        else 
        (
            mkdir &OutputPath\Def_Heap_for_AUDIO_img
        )
        if OS.DIR(&OutputPath\Def_Heap_forSensors_img)
        (
            print "Def_Heap_forSensors_img diretory already exists"
        )
        else 
        (
            mkdir &OutputPath\Def_Heap_forSensors_img
        )
        printer.file &OutputPath_Qurt\Heap_Analysis_GuestOS.txt
        printer.filetype ascii
        printer.size 0xfa,0xfa
        ;cd qdsp6\scripts\msm8974
        do &CurrentDirectory\memheap2_heapWalker_Latest.cmm \\ROOT_660\Global\amss_mem_heap &loc\Def_Heap
        wp.area ST
        WINclear TOP
        printer.file &OutputPath_Qurt\Heap_Analysis_Audio.txt
        printer.filetype ascii
        printer.size 0xfa,0xfa
        ;cd qdsp6\scripts\msm8974
        do &CurrentDirectory\memheap2_heapWalker_Latest.cmm \\AUDIO_660\Global\amss_mem_heap &loc\Def_Heap_for_AUDIO_img
        wp.area ST
        WINclear TOP	
        printer.file &OutputPath_Qurt\Heap_Analysis_Sensors.txt
        printer.filetype ascii
        printer.size 0xfa,0xfa
        ;cd qdsp6\scripts\msm8974
        do &CurrentDirectory\memheap2_heapWalker_Latest.cmm \\SENSOR_660\Global\amss_mem_heap &loc\Def_Heap_forSensors_img
        wp.area ST
        WINclear TOP	
        if Y.EXIST(\\SENSOR_660\Global\sns_heap_state)
        (
            if OS.DIR(&loc\SNS_Heap_State_forSensors_img)
            (
                print " SNS_Heap_State_forSensors_img diretory already exists"
            )
            else 
            (
                mkdir &loc\SNS_Heap_State_forSensors_img
            )
            printer.file &loc\SNS_Heap_State_forSensors_img\Heap_Analysis_sns_heap_state.txt
            printer.filetype ascii
            printer.size 0xfa,0xfa
            do &CurrentDirectory\memheap2_heapWalker_Latest.cmm \\SENSOR_660\Global\sns_heap_state &loc\SNS_Heap_State_forSensors_img
            wp.area ST
            WINclear TOP
        )
        printer.file &OutputPath_Qurt\Heap_Analysis_QURT.txt
        printer.filetype ascii
        printer.size 0xfa,0xfa
        do &CurrentDirectory\heapwalker.cmm qurtos_heap_struct &OutputPath_Qurt &CurrentDirectory
        wp.area ST
        WINclear TOP
        printer.file &OutputPath_Qurt\Heap_Analysis_QURTISLAND.txt
        printer.filetype ascii
        printer.size 0xfa,0xfa
        do &CurrentDirectory\heapwalker_island.cmm qurtos_island_heap_ptr &OutputPath_Qurt &CurrentDirectory 
        wp.area ST
        WINclear TOP
    )
    else if ("&Target_Name"=="670")
    (
        if OS.DIR(&OutputPath\Def_Heap_for_AUDIO_img)
        (
            print "Def_Heap_for_AUDIO_img diretory already exists"
        )
        else 
        (
            mkdir &OutputPath\Def_Heap_for_AUDIO_img
        )
        if OS.DIR(&OutputPath\Def_Heap_forSensors_img)
        (
            print "Def_Heap_forSensors_img diretory already exists"
        )
        else 
        (
            mkdir &OutputPath\Def_Heap_forSensors_img
        )
        printer.file &OutputPath_Qurt\Heap_Analysis_GuestOS.txt
        printer.filetype ascii
        printer.size 0xfa,0xfa
        ;cd qdsp6\scripts\msm8974
        do &CurrentDirectory\memheap2_heapWalker_Latest.cmm \\ROOT_670\Global\amss_mem_heap &loc\Def_Heap
        wp.area ST
        WINclear TOP
        printer.file &OutputPath_Qurt\Heap_Analysis_Audio.txt
        printer.filetype ascii
        printer.size 0xfa,0xfa
        ;cd qdsp6\scripts\msm8974
        do &CurrentDirectory\memheap2_heapWalker_Latest.cmm \\AUDIO_670\Global\amss_mem_heap &loc\Def_Heap_for_AUDIO_img
        wp.area ST
        WINclear TOP	
        printer.file &OutputPath_Qurt\Heap_Analysis_Sensors.txt
        printer.filetype ascii
        printer.size 0xfa,0xfa
        ;cd qdsp6\scripts\msm8974
        do &CurrentDirectory\memheap2_heapWalker_Latest.cmm \\SENSOR_670\Global\amss_mem_heap &loc\Def_Heap_forSensors_img
        wp.area ST
        WINclear TOP	
        if Y.EXIST(\\SENSOR_670\Global\sns_heap_state)
        (
            if OS.DIR(&loc\SNS_Heap_State_forSensors_img)
            (
                print " SNS_Heap_State_forSensors_img diretory already exists"
            )
            else 
            (
                mkdir &loc\SNS_Heap_State_forSensors_img
            )
            printer.file &loc\SNS_Heap_State_forSensors_img\Heap_Analysis_sns_heap_state.txt
            printer.filetype ascii
            printer.size 0xfa,0xfa
            do &CurrentDirectory\memheap2_heapWalker_Latest.cmm \\SENSOR_670\Global\sns_heap_state &loc\SNS_Heap_State_forSensors_img
            wp.area ST
            WINclear TOP
        )
        printer.file &OutputPath_Qurt\Heap_Analysis_QURT.txt
        printer.filetype ascii
        printer.size 0xfa,0xfa
        do &CurrentDirectory\heapwalker.cmm qurtos_heap_struct &OutputPath_Qurt &CurrentDirectory
        wp.area ST
        WINclear TOP
        printer.file &OutputPath_Qurt\Heap_Analysis_QURTISLAND.txt
        printer.filetype ascii
        printer.size 0xfa,0xfa
        do &CurrentDirectory\heapwalker_island.cmm qurtos_island_heap_ptr &OutputPath_Qurt &CurrentDirectory 
        wp.area ST
        WINclear TOP
    )
    else if ("&Target_Name"=="845")
    (
        if OS.DIR(&OutputPath\Def_Heap_for_AUDIO_img)
        (
            print "Def_Heap_for_AUDIO_img diretory already exists"
        )
        else 
        (
            mkdir &OutputPath\Def_Heap_for_AUDIO_img
        )
        if OS.DIR(&OutputPath\Def_Heap_forSensors_img)
        (
            print "Def_Heap_forSensors_img diretory already exists"
        )
        else 
        (
            mkdir &OutputPath\Def_Heap_forSensors_img
        )
        printer.file &OutputPath_Qurt\Heap_Analysis_GuestOS.txt
        printer.filetype ascii
        printer.size 0xfa,0xfa
        ;cd qdsp6\scripts\msm8974
        do &CurrentDirectory\memheap2_heapWalker_Latest.cmm \\ROOT_845\Global\amss_mem_heap &loc\Def_Heap
        wp.area ST
        WINclear TOP
        printer.file &OutputPath_Qurt\Heap_Analysis_Audio.txt
        printer.filetype ascii
        printer.size 0xfa,0xfa
        ;cd qdsp6\scripts\msm8974
        do &CurrentDirectory\memheap2_heapWalker_Latest.cmm \\AUDIO_845\Global\amss_mem_heap &loc\Def_Heap_for_AUDIO_img
        wp.area ST
        WINclear TOP	
        printer.file &OutputPath_Qurt\Heap_Analysis_Sensors.txt
        printer.filetype ascii
        printer.size 0xfa,0xfa
        ;cd qdsp6\scripts\msm8974
        do &CurrentDirectory\memheap2_heapWalker_Latest.cmm \\SENSOR_845\Global\amss_mem_heap &loc\Def_Heap_forSensors_img
        wp.area ST
        WINclear TOP	
        if Y.EXIST(\\SENSOR_845\Global\sns_heap_state)
        (
            if OS.DIR(&loc\SNS_Heap_State_forSensors_img)
            (
                print " SNS_Heap_State_forSensors_img diretory already exists"
            )
            else 
            (
                mkdir &loc\SNS_Heap_State_forSensors_img
            )
            printer.file &loc\SNS_Heap_State_forSensors_img\Heap_Analysis_sns_heap_state.txt
            printer.filetype ascii
            printer.size 0xfa,0xfa
            do &CurrentDirectory\memheap2_heapWalker_Latest.cmm \\SENSOR_845\Global\sns_heap_state &loc\SNS_Heap_State_forSensors_img
            wp.area ST
            WINclear TOP
        )
        printer.file &OutputPath_Qurt\Heap_Analysis_QURT.txt
        printer.filetype ascii
        printer.size 0xfa,0xfa
        do &CurrentDirectory\heapwalker.cmm qurtos_heap_struct &OutputPath_Qurt &CurrentDirectory
        wp.area ST
        WINclear TOP
        printer.file &OutputPath_Qurt\Heap_Analysis_QURTISLAND.txt
        printer.filetype ascii
        printer.size 0xfa,0xfa
        do &CurrentDirectory\heapwalker_island.cmm qurtos_island_heap_ptr &OutputPath_Qurt &CurrentDirectory 
        wp.area ST
        WINclear TOP
    )
    else if ("&Target_Name"=="8998")
    (
        if OS.DIR(&OutputPath\Def_Heap_for_AUDIO_img)
        (
            print "Def_Heap_for_AUDIO_img diretory already exists"
        )
        else 
        (
            mkdir &OutputPath\Def_Heap_for_AUDIO_img
            rmdir &OutputPath\Def_Heap_forSensors_img
        )
        printer.file &OutputPath_Qurt\Heap_Analysis_GuestOS.txt
        printer.filetype ascii
        printer.size 0xfa,0xfa
        ;cd qdsp6\scripts\msm8974
        do &CurrentDirectory\memheap2_heapWalker_Latest.cmm \\M8998AAAAAAAAQ1234\Global\amss_mem_heap &loc\Def_Heap
        wp.area ST
        WINclear TOP
        printer.file &OutputPath_Qurt\Heap_Analysis_Audio.txt
        printer.filetype ascii
        printer.size 0xfa,0xfa
        ;cd qdsp6\scripts\msm8974
        do &CurrentDirectory\memheap2_heapWalker_Latest.cmm \\M8998AAAAAAAAQ1234_AUDIO\Global\amss_mem_heap &loc\Def_Heap_for_AUDIO_img
        wp.area ST
        WINclear TOP	
        if Y.EXIST(\\M8998AAAAAAAAQ1234_SENSOR\Global\sns_heap_state)
        (
            if OS.DIR(&loc\SNS_Heap_State_forSensors_img)
            (
                print " SNS_Heap_State_forSensors_img diretory already exists"
            )
            else 
            (
                mkdir &loc\SNS_Heap_State_forSensors_img
            )
            printer.file &loc\SNS_Heap_State_forSensors_img\Heap_Analysis_sns_heap_state.txt
            printer.filetype ascii
            printer.size 0xfa,0xfa
            do &CurrentDirectory\memheap2_heapWalker_Latest.cmm \\M8998AAAAAAAAQ1234_SENSOR\Global\sns_heap_state &loc\SNS_Heap_State_forSensors_img
            wp.area ST
            WINclear TOP
        )
        printer.file &OutputPath_Qurt\Heap_Analysis_QURT.txt
        printer.filetype ascii
        printer.size 0xfa,0xfa
        do &CurrentDirectory\heapwalker.cmm qurtos_heap_struct &OutputPath_Qurt &CurrentDirectory
        wp.area ST
        WINclear TOP
        printer.file &OutputPath_Qurt\Heap_Analysis_QURTISLAND.txt
        printer.filetype ascii
        printer.size 0xfa,0xfa
        do &CurrentDirectory\heapwalker_island.cmm qurtos_island_heap_ptr &OutputPath_Qurt &CurrentDirectory 
        wp.area ST
        WINclear TOP
    )
)
enddo

memory_end:
do &CurrentDirectory\cmm_error.cmm "memheap_analysis.cmm"
enddo
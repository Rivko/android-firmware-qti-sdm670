entry &filename
OPEN #2 "&OutputPath_temp\Error_CMM_Files.txt" /APPEND
WRITE #2 " Error in CMM File : &filename"
CLOSE #2




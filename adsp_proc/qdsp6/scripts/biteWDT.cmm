; this is only intended for testing
; this will make watch dog timer expire and send bite interrupt to apps

PER.S AD:0x28882014 %LONG 0x3fff


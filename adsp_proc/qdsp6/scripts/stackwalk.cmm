TOOLBAR ON
STATUSBAR ON
WINPAGE.RESET
WINCLEAR
WINPOS 0.0 0.0 80. 25. 13. 1. W003
WINTABS 16. 10. 25. 62.
d.l
WINPOS 85.0 0.0 80. 25. 5. 0. W000
var.frame
WINPOS 0.42857 31.5 80. 23. 0. 0. W002
area.view
WINPOS 85.714 31.25 73. 21. 0. 0. W001
register
WINPAGE.SELECT P000  
area.select
area.view
print "                   "
print "                   "
&FR1=register(FP)
&nn=0
if (&FR1==0)
(
	goto usage
)
if (&FR1<0xc0000000) 
(
	goto usage
)
if (&FR1>0xc1800000) 
( 
	goto usage
)


&LR1=d.l(D:(&FR1+4))

print "Num FR  LR"
print "&nn &FR1 &LR1"

r.s LR &LR1
r.s FP &FR1
r.s SP &FR1
r.s PC register(ELR)

stop

&FR=&FR1
&PC=&LR1

start:

&FR=d.l(D:&FR)
if (&FR==0) 
(
	goto done
)
if (&FR<0xc0000000) 
(
	goto done
)
if (&FR>0xc1800000)
(
 	goto done
)

&LR=d.l(D:(&FR+4))
&nn=&nn+1

print "&nn &FR &LR"
r.s LR &LR
r.s FP &FR
r.s SP &FR
r.s PC &PC

stop

&PC=&LR

goto start





done:
print "Last value=&FR"
print "Done"
end



usage:
print "stackwalk <FR value)"
end










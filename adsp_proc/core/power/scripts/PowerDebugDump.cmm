; PowerDebugDump.cmm
; ------------------------------------------------------------------
;
; Copyright (c) 2013-2016 Qualcomm Technologies Incorporated.
; All Rights Reserved.
; QUALCOMM Proprietary/GTDR
;
; When to use this script 
; -----------------------
; This script calls all the available debug dump scripts and dumps the results
; to the provided logpath.
;
; 
; How to use this script
; ----------------------
; After breaking, retrieve all logs by running
;
; do PowerDebugDump.cmm <logPath>
;
;
ENTRY &logPath
LOCAL &basedir &ulogdump &ulogdebugstatusdump &npadump &sleepdump


; Locate the core directory (by doing \..\ two times in the current working directory)
&coredir=os.ppd()
&coredir=os.file.path(&coredir)
&coredir=os.file.path(&coredir)

&ulogdump            = "&(coredir)\services\diag\diagbuffer\scripts\ULogDump.cmm"
&ulogdebugstatusdump = "&(coredir)\services\diag\diagbuffer\scripts\ULogDebugStatus.cmm"
&npadump             = "&(coredir)\power\npa\scripts\NPADump.cmm"
&sleepdump           = "&(coredir)\power\sleep2.0\scripts\SleepDump.cmm"


PRINT "Power Debug Dump: Starting ULog Dump"
DO &ulogdump &logPath 

PRINT "Power Debug Dump: Starting ULog Debug Status Dump"
DO &ulogdebugstatusdump &logPath 


PRINT "Power Debug Dump: Starting NPA Dump"
DO &npadump &logPath state


PRINT "Power Debug Dump: Starting Sleep Dump"
DO &sleepdump &logPath nolog


PRINT "Power Debug Dump: Done."


;============================================================================
;  Name:
;    DOG_DISABLE.CMM
;
;  Description:
;
; Copyright (c) 2017 by Qualcomm Technologies, Inc.  All Rights Reserved.
; Qualcomm Confidential and Proprietary
;----------------------------------------------------------------------------
;============================================================================
;
;                        EDIT HISTORY FOR MODULE
;
; when        who       what, where, why
; ----------  --------  -----------------------------------------------------
; 03/16/2017  dlohia    Created.
;============================================================================;

;============================================================================

;============================================================================
; Get the arguments passed in.
;============================================================================
ENTRY 

WE.AREA.RESet
WE.WINPOS 0. 0. 35% 100%
WE.AREA.Create DISABLE_DOG
AREA DISABLE_DOG
;RADIX.DECIMAL
;setup.var.%SYMBOL
;setup.var.%HEX
  
  ; Setup vars to use hex, strings, symbols & index 
  SETUP.VAR %H %S %Y %I

  ; setup the scrip variables to use hex symbols
  radix HEX


GOSUB PRINT_HELPER " "
GOSUB PRINT_HELPER "######################################################################"
GOSUB PRINT_HELPER " "
GOSUB PRINT_HELPER "                         DISABLE_DOG_SCRIPT                           "
GOSUB PRINT_HELPER " "
GOSUB PRINT_HELPER "######################################################################"
GOSUB PRINT_HELPER " "



GOSUB PRINT_HELPER "--------------------------------------------------------------------"
GOSUB PRINT_HELPER "Disabling the hardware dog and 40sec startup grace timer in root-pd"

IF sYmbol.EXIST(dog_hal_disable_for_bringup)
(
  V dog_hal_disable_for_bringup = 1
  GOSUB PRINT_HELPER "Done !!! "
)
ELSE
(
  GOSUB PRINT_HELPER "Failed.. Symbol not found "
)

GOSUB PRINT_HELPER "--------------------------------------------------------------------"
GOSUB PRINT_HELPER "Disabling monitoring the state of each PD in the system"

IF sYmbol.EXIST(dog_virtual_disable)
(
  V dog_virtual_disable = 1
  GOSUB PRINT_HELPER "Done !!! "
)
ELSE
(
  GOSUB PRINT_HELPER "Failed.. Symbol not found "
)

GOSUB PRINT_HELPER "--------------------------------------------------------------------"
GOSUB PRINT_HELPER "Disabling 40sec pd grace timer"

IF sYmbol.EXIST(dog_disable_pd_grace_timer)
(
  V dog_disable_pd_grace_timer = 1
  GOSUB PRINT_HELPER "Done !!! "
)
ELSE
(
  GOSUB PRINT_HELPER "Failed.. Symbol not found "
)

GOSUB PRINT_HELPER "--------------------------------------------------------------------"
GOSUB PRINT_HELPER "Disabling 40sec startup grace timer in user-pd"

IF sYmbol.EXIST(dog_disable_user_startup_timer)
(
  V dog_disable_user_startup_timer = 1
  GOSUB PRINT_HELPER "Done !!! "
)
ELSE
(
  GOSUB PRINT_HELPER "Failed.. Symbol not found "
)

GOSUB PRINT_HELPER "--------------------------------------------------------------------"
GOSUB PRINT_HELPER "Disabling the heartbeat monitoring"

sYmbol.ForEach " 'V' *dog_hb_disable =1"
GOSUB PRINT_HELPER "Done !!! "

ENDDO

;============================================================================
; PRINT SUBROUTINE
;============================================================================
PRINT_HELPER:
  ENTRY &str
  PRINT &str
RETURN

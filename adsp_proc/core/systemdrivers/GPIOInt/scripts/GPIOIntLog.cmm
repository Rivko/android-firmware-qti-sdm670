; InterruptState.cmm
;******************************************************************************
;
;          G P I O   I N T E R R U P T   L O G   S C R I P T
;
;******************************************************************************
;               Copyright (c) 2011 QUALCOMM Technologies Incorporated.
;                         All Rights Reserved.
;                      QUALCOMM Proprietary/GTDR
;******************************************************************************
;
;                      EDIT HISTORY FOR FILE
;
;This section contains comments describing changes made to this file.
;Notice that changes are listed in reverse chronological order.
;
;when         who     what, where, why
;----------   ------  ----------------------------------------------------------
;10/26/2012   aratin  First draft created. 
;******************************************************************************
;
; This script should be used to dump the interrupt controller components from T32. 
; The script first checks if a file path is provided. If yes, it will by default
; dump all the user queries onto this file.
; 
; How to use this script
; ----------------------
; After after breaking, retrieve  state by running
;
; do GPIOIntLog.cmm
;
; GPIO Interrupt log and registration state will be dispalyed on the std output window.

;******************************************************************************
; If there is a file path given then the data is just dumped onto the file.
; This process is slow hence just displaying it on T32 window by not writing
; to a file will give both the Interrupt Table and the Interrupt Log very quickly.
;******************************************************************************

  v.v GPIOIntData
  v.v GPIOIntData.state
  v.v GPIOIntData.log
  GOTO ProgramEnd
  


ProgramEnd:
ENDDO























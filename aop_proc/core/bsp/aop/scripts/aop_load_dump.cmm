; aop_load_dump.cmm
; ------------------------------------------------------------------
;
; When to use this script 
; -----------------------
; This script should be used take a series of dump files (presumably from
; rpm_dump.cmm, but maybe from a usb dump, etc.) and load them into the
; appropriate place in the simulator.
;
; What this script does
; -----------------------
; This script simply reverses the d.save command from the dump script.
;
; How to use this script
; ----------------------
; Open a T32 simulator and run...
;
; do aop_load_dump <dumpPath>
;
ENTRY &dumpPath

; Trim trailing "\" if necessary
IF string.char("&(dumpPath)", string.len("&(dumpPath)")-1)=='\'
(
  &dumpPath=string.cut("&(dumpPath)", -1)
)

; Get a fresh M3
sys.d
sys.cpu CortexM3
sys.u

do "&(dumpPath)\aop_register_dump.cmm"

d.load.binary "&(dumpPath)\aop_code_ram.bin" 0x0
d.load.binary "&(dumpPath)\aop_data_ram.bin" 0xE0000

d.load.binary "&(dumpPath)\aop_scs.bin"      0xE000E000

d.load.binary "&(dumpPath)\msg_ram_0.bin" 0x1300000
d.load.binary "&(dumpPath)\msg_ram_1.bin" 0x1310000
d.load.binary "&(dumpPath)\msg_ram_2.bin" 0x1320000
d.load.binary "&(dumpPath)\msg_ram_3.bin" 0x1330000
d.load.binary "&(dumpPath)\msg_ram_4.bin" 0x1340000
d.load.binary "&(dumpPath)\msg_ram_5.bin" 0x1350000
d.load.binary "&(dumpPath)\msg_ram_6.bin" 0x1360000
d.load.binary "&(dumpPath)\msg_ram_7.bin" 0x1370000
d.load.binary "&(dumpPath)\msg_ram_8.bin" 0x1380000
d.load.binary "&(dumpPath)\msg_ram_9.bin" 0x1390000
d.load.binary "&(dumpPath)\msg_ram_A.bin" 0x13A0000
d.load.binary "&(dumpPath)\msg_ram_B.bin" 0x13B0000
d.load.binary "&(dumpPath)\msg_ram_C.bin" 0x13C0000
d.load.binary "&(dumpPath)\msg_ram_D.bin" 0x13D0000
d.load.binary "&(dumpPath)\msg_ram_E.bin" 0x13E0000
d.load.binary "&(dumpPath)\msg_ram_F.bin" 0x13F0000

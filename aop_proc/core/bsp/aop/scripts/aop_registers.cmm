; aop_registers.cmm
; ------------------------------------------------------------------
;
; When to use this script 
; -----------------------
; This script should be used to dump AOP register values from T32 when the 
; on-target application is not practical.
;
; 
; How to use this script
; ----------------------
; After breaking, retrieve all logs by running
;
; do aop_registers.cmm [register_name]
;
;
ENTRY &choice


if "&choice"==""
(
  per.view ~~~~/aop_register_tree.per
)
else
(
  per.view ~~~~/aop_register_tree.per "AOP,&(choice)"
)
enddo





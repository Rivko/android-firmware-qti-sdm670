; aop_restore_from_core.cmm
; ------------------------------------------------------------------
;
; When to use this script 
; -----------------------
; This script should be used to configure a T32 simulator session loaded with a
; crashed AOP memory image to the register state at the time of the crash.
;
; Note: You must have the symbols loaded for the build for this script to work.
;
; What this script does
; -----------------------
; This script looks for a crash dump in the global variable aop_core_dump.  If
; it finds one it will restore the register state of that crash.
;
; How to use this script
; ----------------------
; After loading all memory dumps and symbols...
;
; do aop_restore_from_core
;
ENTRY

; Check to see if a valid core dump exists.
&cookie=V.VALUE(aop_core_dump.cookie)
&dumped=V.VALUE(aop_core_dump.dumped_at)

if (&cookie!=0xbaff1ed)||(&dumped==0)
(
    PRINT "*** No valid core dump detected! ***"
    ENDDO
)

; Basic ARM registers
register.set r0  v.value(aop_core_dump.registers.gp_regs[0])
register.set r1  v.value(aop_core_dump.registers.gp_regs[1])
register.set r2  v.value(aop_core_dump.registers.gp_regs[2])
register.set r3  v.value(aop_core_dump.registers.gp_regs[3])
register.set r4  v.value(aop_core_dump.registers.gp_regs[4])
register.set r5  v.value(aop_core_dump.registers.gp_regs[5])
register.set r6  v.value(aop_core_dump.registers.gp_regs[6])
register.set r7  v.value(aop_core_dump.registers.gp_regs[7])
register.set r8  v.value(aop_core_dump.registers.gp_regs[8])
register.set r9  v.value(aop_core_dump.registers.gp_regs[9])
register.set r10 v.value(aop_core_dump.registers.gp_regs[10])
register.set r11 v.value(aop_core_dump.registers.gp_regs[11])
register.set r12 v.value(aop_core_dump.registers.gp_regs[12])
register.set MSP v.value(aop_core_dump.registers.SP_main)
register.set PSP v.value(aop_core_dump.registers.SP_process)
register.set r14 v.value(aop_core_dump.registers.LR)
register.set PP  v.value(aop_core_dump.registers.PC)

; Cortex M3 registers
register.set XPSR      v.value(aop_core_dump.registers.xPSR)
register.set PRIMASK   v.value(aop_core_dump.registers.PRIMASK)
register.set FAULTMASK v.value(aop_core_dump.registers.FAULTMASK)
register.set BASEPRI   v.value(aop_core_dump.registers.BASEPRI)
register.set CONTROL   v.value(aop_core_dump.registers.CONTROL)


entry &master_id &show_all_rsrc

;&title="ESTIMATE"
;AREA.CREATE "&title" 500. 500.
AREA.VIEW A000
AREA.SELECT A000

print "Master ID: &master_id"

&op_points=v.sizeof(rpm_estimator.clockFreqkHz_)/4.
&op_point=0
while &op_point<&op_points
(
    &transition=0
    while &transition<2
    (
        &cpu_freq=v.value(rpm_estimator.clockFreqkHz_[&op_point])

        print %attr 0x2 v.string((enum rpm_transition_type)&transition)+" Transition Estimate @ "+format.decimal(0,&cpu_freq)+" KHz:"

        &approxWorkRemaining=0;
        ;actionHash_ = 0xb7ee364b;
        &i=0
        &num_supported_resources=v.value(rpm->supported_resources)
        &approxSettlingRemaining=0

        print "    "+" RSRC        "+"ESTIMATES"+"                "+"SETTLING_ESTIMATES"
        print "    "+"--------------------------------------------------------------------------------"
        while &i<&num_supported_resources
        (
            &rsrc=v.value((ResourceData*)&rpm->resources[&i])

            if (&rsrc==0x0);||(v.value(((ResourceData*)&rsrc)->current_state)==0x0)
            (
                goto continue
            )

            &cls_idx=v.value(((ResourceData*)&rsrc)->class_idx)
            &rsrc_id=format.decimal(2,v.value(((ResourceData*)&rsrc)->id))

            gosub resource_ee_has_transition_work &rsrc &master_id &transition
            entry &ret

            if &ret==0x0
            (
                if "&show_all_rsrc"!=""
                (
                    print "    "+format.string(v.string((char[4])rpm->classes[&cls_idx].type),4,' ')+","+format.decimal(3,&rsrc_id)+": no work"
                )
                goto continue
            )


            gosub resource_estimate &rsrc &op_point
            entry &rsrc_estimate

            &usec_float=convert.floattoint(&rsrc_estimate/19.2)
            &usec=format.decimal(6,convert.floattoint(&rsrc_estimate/19.2))

            &settling_estimate=v.value(rpm->classes[&cls_idx].settling_estimate)

            print "    "+format.string(v.string((char[4])rpm->classes[&cls_idx].type),4,' ')+","+format.decimal(3,&rsrc_id)+": "+format.string("&rsrc_estimate",-8,' ')+" (&usec usec) "+format.string("&settling_estimate",-8,' ')+" ("+format.decimal(8,convert.floattoint(&settling_estimate/19.2))+" usec)"


            &approxWorkRemaining=&approxWorkRemaining+&rsrc_estimate

            if &approxSettlingRemaining<&settling_estimate
            (
                &approxSettlingRemaining=&settling_estimate
            )

continue:
            &i=&i+1
        )

        print "    "+"--------------------------------------------------------------------------------"
        print "    "+"Total Estimates       = "+format.string("&approxWorkRemaining",-8,' ')+" ("+format.decimal(8,convert.floattoint(&approxWorkRemaining/19.2))+" usec)"
        print "    "+"Max Settling Estimate = "+format.string("&approxSettlingRemaining",-8,' ')+" ("+format.decimal(8,convert.floattoint(&approxSettlingRemaining/19.2))+" usec)"
        &approxWorkRemaining=&approxWorkRemaining+&approxSettlingRemaining
        if &approxWorkRemaining==0
        (
            if y.exist(noWorkEstimates)
                if v.value(noWorkEstimates[&op_point])==0
                    &approxWorkRemaining=0x780
                else
                    &approxWorkRemaining=v.value(noWorkEstimates[&op_point])
            else
                &approxWorkRemaining=0x2605
        )
        print %attr 0x46 "    "+"Estimated Work        = "+format.string("&approxWorkRemaining",-8,' ')+" ("+format.decimal(8,convert.floattoint(&approxWorkRemaining/19.2))+" usec)"

        print
        &transition=&transition+1
    )

    &op_point=&op_point+1
)

enddo



;;;;;;;;;;;;;;;;;;;;;;;;;;;;;;;;;;;;;;;;;;;;;;;;;;;;;;;;;;;;;;;;;;;;;;;;;;;;;;;;
resource_estimate:
    entry &r &op_point
    &estimate=v.value(((ResourceData*)&r)->estimates[&op_point])
    if &estimate==0
        return 0x4B00   ;No estimate yet, approximate ~1 ms.
    else
        return &estimate

;;;;;;;;;;;;;;;;;;;;;;;;;;;;;;;;;;;;;;;;;;;;;;;;;;;;;;;;;;;;;;;;;;;;;;;;;;;;;;;;

resource_ee_has_transition_work:
    entry &r &ee_id &trans

    gosub resource_lookup_ee_client &r &ee_id
    entry &client

    if &client==0x0
        return 0

    &dst_set=v.value(((SetChanger*)rpm->ees[&ee_id].changer)->destinationSet_)
    &cur_set=v.value(((SetChanger*)rpm->ees[&ee_id].changer)->currentSet_)

    &idx=0
    if &cur_set!=&dst_set
    (
        if v.string((enum rpm_transition_type)&trans)=="ACTIVE_TO_SLEEP"&&&cur_set==0
            &idx=v.value(((EEClient*)&client)->selected)^1
        else if v.string((enum rpm_transition_type)&trans)=="SLEEP_TO_ACTIVE"&&&cur_set==1
            &idx=v.value(((EEClient*)&client)->selected)^1
        else
            &idx=v.value(((EEClient*)&client)->selected)
    )
    else
    (
        &req_type0=v.string(((EEClient*)&client)->req_type[0.])
        &req_type1=v.string(((EEClient*)&client)->req_type[1.])

        if v.string((enum rpm_transition_type)&trans)=="ACTIVE_TO_SLEEP"
        (
            if "&req_type0"=="SLEEP_REQUEST"
                &idx=0
            else if "&req_type1"=="SLEEP_REQUEST"
                &idx=1
            else
                return 0
        )
        else
        (
            if "&req_type0"=="ACTIVE_REQUEST"
                &idx=0
            else if "&req_type1"=="ACTIVE_REQUEST"
                &idx=1
            else
                return 0
        )
    )

    if v.string((enum rpm_transition_type)&trans)=="ACTIVE_TO_SLEEP"
    (
        if v.string(((EEClient*)&client)->req_type[&idx])=="SLEEP_REQUEST"
            return 1
        else
            return 0
    )
    else
    (
        if (v.string(((EEClient*)&client)->req_type[&idx])!="NO_REQUEST")&&(v.string(((EEClient*)&client)->req_type[&idx])!="SLEEP_REQUEST")
            return 1
        else
            return 0
    )
    return 0


;;;;;;;;;;;;;;;;;;;;;;;;;;;;;;;;;;;;;;;;;;;;;;;;;;;;;;;;;;;;;;;;;;;;;;;;;;;;;;;;

resource_lookup_ee_client:
    entry &r &ee_id

    &client=v.value(((ResourceData*)&r)->ees)
    while (&client!=0x0)&&(v.value(((EEClient*)&client)->ee_id)!=&ee_id)
    (
        &client=v.value(((EEClient*)&client)->next)
    )

    return &client

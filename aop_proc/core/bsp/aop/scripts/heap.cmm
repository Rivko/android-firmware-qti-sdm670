// MSM8974_RPM Wed Jan 16 17:17:36 2013

 B::
 
 BREAK.RESET
 B.S   __dso_handle /P /O /CMD "printer.open c:\temp\trace00.dat" /RESUME
 B.S   __Heap_Alloc+0x2 /P /O /CMD "wp.v.f" /CMD "wp.register" /RESUME
 
 ENDDO
